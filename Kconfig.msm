## drivers/mihw/Kconfig
```kconfig
config MI_SCHED
    tristate "schedule policy defined by xiaomi"
	depends on MIHW && MI_SCHED_WALT
    default n
    help
        This option can show package runtime info in sup/big/little core.

config METIS
	tristate "frame tracing sched"
	depends on MI_SCHED && METIS_WALT
	help
	  MI vip task run frist.

config MI_LOAD_TRACE
	tristate "load trace defined by xiaomi"
	depends on MI_GROUP_ASSIST
	help
	  MI FRAME LOAD TRACE

config MI_SCHED_4_CLUSTER
	tristate "mi sched for 4 clusters"
	depends on MIHW
	default n
	help
	  The case is used to for Compatibility

config MI_SCHED_3_CLUSTER
	tristate "mi sched for 3 clusters"
	depends on MIHW
	default n
	help
	  The case is used to for Compatibility

config MI_SCHED_2_CLUSTER
	tristate "mi sched for 2 clusters"
	depends on MIHW
	default n
	help
	  The case is used to for Compatibility

config MI_SOC
	tristate "mi soc frame load monitor"
	depends on MIHW
	help
	  The case is used to monitor soc frame load

config MQOS_PERF_ACTUATOR
        tristate "perf actuator interface"
	default n
        help
	  perf actuator

config MQOS_WALT
	bool "xiaomi qos"
	default n
	help
	  xiaomi QOS

source "$(KCONFIG_EXT_PREFIX)drivers/mihw/dcvs_arbi/Kconfig"
```

## drivers/mimon/Kconfig
```kconfig
config XM_MIMON
    tristate "CPU monitoring"
    default n
    help
      Enable CPU monitoring functionality including
      cpu netlink communication and cpu load notification.
```

## drivers/misc/Kconfig
```kconfig
# SPDX-License-Identifier: GPL-2.0-only
#
# Misc strange devices
#

menu "Misc devices"

config QCOM_COINCELL
	tristate "Qualcomm coincell charger support"
	depends on MFD_SPMI_PMIC || COMPILE_TEST
	help
	  This driver supports the coincell block found inside of
	  Qualcomm PMICs.  The coincell charger provides a means to
	  charge a coincell battery or backup capacitor which is used
	  to maintain PMIC register and RTC state in the absence of
	  external power.

config QSEECOM_PROXY
	tristate "To enable qseecom proxy driver for kernel client"
	help
	 qseecom proxy driver serves the kernel clients by providing
	 required ops via call back functions with a minimal framework.
	 These callback functions can be used to start, shutdown and
	 send commands to the trusted apps.

config MI_NTSYNC
	tristate "NT synchronization primitive emulation"
	help
	  This module provides kernel support for emulation of Windows NT
	  synchronization primitives. It is not a hardware driver.

	  To compile this driver as a module, choose M here: the
	  module will be called ntsync.

	  If unsure, say N.

config LKDTM
	tristate "Linux Kernel Dump Test Tool Module"
	depends on DEBUG_FS
	help
	This module enables testing of the different dumping mechanisms by
	inducing system failures at predefined crash points.
	If you don't need it: say N
	Choose M here to compile this code as a module. The module will be
	called lkdtm.

	Documentation on how to use the module can be found in
	Documentation/fault-injection/provoke-crashes.rst

config ISL97900_LED
	tristate "ISL97900_I2C_Driver"
	select REGMAP_I2C
	depends on I2C
	help
	  Support for ISL97900 LED driver IC, using this driver,
	  user can set different values to control the LED current
	  using I2C.

	  Say Y if you want to enable ISL97900 driver.
endmenu
```

## drivers/ntag/Kconfig
```kconfig
# SPDX-License-Identifier: GPL-2.0-only
#
# NFC Tag devices
#

source "$(KCONFIG_EXT_PREFIX)drivers/ntag/fm19511/Kconfig"
```

## drivers/power/supply/Kconfig
```kconfig
# SPDX-License-Identifier: GPL-2.0-only
if POWER_SUPPLY

config QTI_BATTERY_CHARGER
	tristate "QTI Glink battery charger"
	depends on QTI_PMIC_GLINK && EXTCON && TYPEC
	help
	  Say Y here to enable Qualcomm Technologies, Inc. battery charger
	  driver which interfaces with the charger firmware running on the
	  remote subsystem (e.g. DSP) by communicating over PMIC Glink channel
	  and provides information about the battery, USB and wireless charging
	  by exposing them as power supply devices.

	  To compile the driver as a module, choose M here: the module will be
	  called qti_battery_charger.

config CHARGER_QCOM_SMBB
	tristate "Qualcomm Switch-Mode Battery Charger and Boost"
	depends on MFD_SPMI_PMIC || COMPILE_TEST
	depends on OF
	depends on EXTCON
	depends on REGULATOR
	help
	  Say Y to include support for the Switch-Mode Battery Charger and
	  Boost (SMBB) hardware found in Qualcomm PM8941 PMICs.  The charger
	  is an integrated, single-cell lithium-ion battery charger.  DT
	  configuration is required for loading, see the devicetree
	  documentation for more detail.  The base name for this driver is
	  'pm8941_charger'.

config  XM_POWER_SUPPLY
	tristate "Xiaomi power supply config"
	help
	  Say Y or M here to enable xiaomi power supply

#source "$(KCONFIG_EXT_PREFIX)drivers/power/supply/mca/Kconfig"

config QTI_CHARGER_NFC_VREG
	bool "Allow client to vote on Charger reverse boost regulator"
	depends on QTI_BATTERY_CHARGER
	help
	  Say 'y' here to allow client drivers to enable and perform voltage
	  get/set operations via the regulator framework on the charger reverse
	  boost regulator. This may be used by client drivers such as NFC
	  to manage their power supply requirements through the charger’s
	  reverse boost regulator.

source "$(KCONFIG_EXT_PREFIX)drivers/power/supply/qcom/Kconfig"

endif # POWER_SUPPLY
```

## drivers/powerinsight/Kconfig
```kconfig
source "$(KCONFIG_EXT_PREFIX)drivers/powerinsight/gpu_stats/Kconfig"
source "$(KCONFIG_EXT_PREFIX)drivers/powerinsight/gpu_freq_stats/Kconfig"
source "$(KCONFIG_EXT_PREFIX)drivers/powerinsight/common/Kconfig"
source "$(KCONFIG_EXT_PREFIX)drivers/powerinsight/powerinsight_interface/Kconfig"
```

## drivers/powerinsight/common/Kconfig
```kconfig
config POWERINSIGHT
	tristate "Power Insight"
	default n
	help
	  This driver provides PowerInsight feature
```

## drivers/xiaomi/fault_report/Kconfig
```kconfig
config FAULT_REPORT
       tristate "F2FS fault reporting"
       default n
       help
       Support F2FS fault reporting.
```

## drivers/xiaomi/mi_qmi_trace/Kconfig
```kconfig
config MI_QMI_TRACE
tristate "Xiaomi QMI Tracing"
default n
help
This option enables tracing of QMI messages in Xiaomi devices.
```

## init/Kconfig
```kconfig
# SPDX-License-Identifier: GPL-2.0-only
menu "General setup"

config MSM_SYSSTATS
        tristate "Export system/task statistics through netlink"
        depends on NET
        depends on MULTIUSER
        help
          Export system and task statistics through generic netlink
          interface. Userspace can retrieve these statistics via netlink
          socket.
          If unsure, say N

config MSM_SYSSTATS_STUB_NONEXPORTED_SYMBOLS
        bool "Stub out non-exported core-kernel symbols"
        depends on MSM_SYSSTATS
        help
          Stub out is_system_dmabufheap(), vmalloc_nr_pages() and si_swapinfo().
          Enabling this option will make the swap_used, swap_total and
          vmalloc_total fields of struct sysstats_mem 0, and will make the
          unreclaimable field either 0, or make it only include the KGSL memory.
          If unsure, say N.

config MIHW
        bool "MI driver"
        default n
        help
          Mi driver code

config MI_SCHED_WALT
        bool "mi sched walt"
        default n
        help
          MI SCHED WALT

config METIS_WALT
        bool "metis walt"
        default n
        help
          METIS WALT

config MI_SOC_DFLT
		bool "ddr devf"
		default n
		help
		ddr DEVF

config MI_SOC_GFLT
		bool "gpu devf"
		default n
		help
			gpu DEVF

config MI_GROUP_ASSIST
        bool "mi group assist"
        default n
        help
          MI_GROUP_ASSIST

config MI_LOAD_TRACE_ASSIST
        bool "mi load trace assist"
        default n
        help
          MI_LOAD_TRACE_ASSIST

endmenu		# General setup
```

## kernel/sched/walt/Kconfig
```kconfig
# SPDX-License-Identifier: GPL-2.0-only
#
# QTI WALT based scheduler
#
menu "QTI WALT based scheduler features"

config SCHED_WALT
	tristate "Support window based load tracking"
	depends on SMP
	help
	This feature will allow the scheduler to maintain a tunable window
	based set of metrics for tasks and runqueues. These metrics can be
	used to guide task placement as well as task frequency requirements
	for cpufreq governors.

config SCHED_WALT_DEBUG
	tristate "WALT debug module"
	depends on SCHED_WALT
	select TRACE_PREEMPT_TOGGLE
	select TRACE_IRQFLAGS
	help
	  This module provides the means of debugging long preempt and
	  irq disable code. This helps in identifying the scheduling
	  latencies. The module rely on preemptirq trace hooks and
	  print the stacktrace to the ftrace upon long preempt and irq
	  events. Sysctl knobs are available for the user to configure
	  the thresholds.

	  This module also used to crash the system to catch issues
	  in scenarios like RT throttling and sleeping while in atomic
	  context etc.

config SCHED_WALT_STATS
	tristate "WALT stats"
	depends on SCHED_WALT
	help
	  This feature will statistic the number of idle/active load
	  balances, the reasons for CPU frequency selection, the time
	  the CPU spends at minimum/maximum frequency (excluding idle
	  time), and the time the CPU spends at each frequency point.

config SCHED_CONSERVATIVE_BOOST_LPM_BIAS
	bool "Enable LPM bias if conservative boost is enabled"
	default n
	help
	  This feature will allow the scheduler to disable low power
	  modes on a cpu if conservative boost is active. The cpu
	  will not enter low power mode for a hysteresis time period,
	  which can be configured from userspace.

config SCHED_WALT_MIDPOINT
	tristate "sched walt midpoint"
	depends on SCHED_WALT
	help
	  This feature will have a midpoint frequency voted qos request
	  in fmin and fmax.

config MI_CAM_WALT
	bool "cam sched"
	default n
	help
	  Camera WALT cpu stall2.0 feature

config SCHED_WALT_NR_CPUS
	int "Maximum number of CPUs managed by WALT"
	range 2 32
	default 8
	help
	  This feature allows the configuration of the number of CPUs
	  in the system that need to be managed by WALT.

endmenu
```

## kernel/sched/xiaomi_sched/Kconfig
```kconfig
# SPDX-License-Identifier: GPL-2.0
# Copyright (C) 2026, xiaomi technologies Inc., All rights reserved.

menu "XiaoMi scheduler features"

config OS_CPU_DEPEND_GKI
	bool "Support for OS-CPU Module"
	default n
	help
	  dependence on GKI existence state

config OS_CPU_PERF_ACTUATOR
        tristate "perf actuator interface"
	default n
        help
	  perf actuator

config OS_CPU_FBT
	tristate "os-cpu fbt interface"
	depends on OS_CPU_PERF_ACTUATOR
	default n
	help
	  os-cpu fbt interface

config OS_CPU_DYNAMIC_TASK_SIZE
	bool "Support for Dynamic Task Size"
	default n
	help
	  This enables Dynamic Task Size

config OS_CPU_QIS_V2
	bool "Support for os-cpu qis V2"
	default n
	help
	  This enables qis2.0

config OS_CPU_PLAT_COMMON
	tristate "Support for OS-CPU Platform Common"
	default n
	help
	  Enable OS-CPU Platform Common

config PLAT_SCHED_SYNC
	bool "Support for sched sync wake"
	depends on OS_CPU_PLAT_COMMON
	default n
	help
	  Enable sync wake for critical task waking.

config OS_CPU_RTG_WALT
	tristate "Support for os-cpu RTG Driver"
	depends on OS_CPU_PERF_ACTUATOR
	default n
	help
	  Enable os-cpu RTG driver

config OS_CPU_RTG_DESIGN_QCOM
	bool "Support for OS-CPU RTG Design QCOM"
	depends on OS_CPU_RTG_WALT
	default n
	help
	  Enable RTG design features for QCOM platform.
	  This controls special mark handling and RTG group
	  assignment in QIS module.

config OS_CPU_SCHED_VIP
	tristate "Support for OS-CPU Sched Driver"
	depends on OS_CPU_PERF_ACTUATOR
	default n
	help
	  This feature will add a vip task list in cfs sched class. The
	  high priority vip tasks would preempt the normal tasks and low
	  priority vip tasks. Meanwhile, vip balance is triggered in
	  scheduler tick and other situations to keep high priority vip
	  tasks get a smaller schedule latency.

config OS_CPU_QOS_INHERIT
	tristate "Support for os-cpu QoS Inherit Driver"
	depends on OS_CPU_PERF_ACTUATOR && OS_CPU_QIS_V2
	default n
	help
	  Enable qos inheritance(QI).
	  With this feature enabled, if the task is
	  blocked by binder request, mutex, rwsem,
	  or futex, and its QOS is critical level, then
	  its QOS will be inherited by binder server or
	  lock owner task.

config OS_CPU_QOS_SCHED
	tristate "Support for os-cpu QoS Sched Driver"
	depends on OS_CPU_QOS_INHERIT
	default n
	help
	  Enable scheduler based QoS inheritance.
	  With the feature enabled, FIFO schedule policy
	  or VIP schedule will be set to task when the
	  task inherits the critical level QoS from the
	  critical task. With qos speedlock feature enabled,
	  when the task from the critical process try to
	  hold reader rwsem and get blocked, VIP sched
	  schedule will be set to the task until the task
	  releases the rwsem lock.

config MIPLAT_4CLU_TYPE_A
	bool "4 cluster type A (2+3+2+1, mask 0x9c)"
	depends on OS_CPU_PLAT_COMMON
	default n
	help
	  4-cluster platform with 2+3+2+1 architecture (CPU 2,3,4,7).

config MIPLAT_4CLU_TYPE_B
	bool "4 cluster type B (2+4+2+2, mask 0x300)"
	depends on OS_CPU_PLAT_COMMON
	default n
	help
	  4-cluster platform with 2+4+2+2 architecture (CPU 8,9).

config MIPLAT_3CLU_TYPE_A
	bool "3 cluster type A (4+3+1, mask 0xf0)"
	depends on OS_CPU_PLAT_COMMON
	default n
	help
	  3-cluster platform with 4+3+1 architecture (CPU 4,5,6,7).

config MIPLAT_3CLU_TYPE_B
	bool "3 cluster type B (3+4+1, mask 0xf8)"
	depends on OS_CPU_PLAT_COMMON
	default n
	help
	  3-cluster platform with 3+4+1 architecture (CPU 3,4,5,6,7).

config MIPLAT_3CLU_TYPE_C
	bool "3 cluster type C (2+5+1, mask 0xfc)"
	depends on OS_CPU_PLAT_COMMON
	default n
	help
	  3-cluster platform with 2+5+1 architecture (CPU 2,3,4,5,6,7).

config MIPLAT_2CLU_TYPE_A
	bool "2 cluster type A (6+2, mask 0xc0)"
	depends on OS_CPU_PLAT_COMMON
	default n
	help
	  2-cluster platform with 6+2 architecture (CPU 6,7).

config MIPLAT_2CLU_TYPE_B
	bool "2 cluster type B (4+4, mask 0xf0)"
	depends on OS_CPU_PLAT_COMMON
	default n
	help
	  2-cluster platform with 4+4 architecture (CPU 4,5,6,7).

endmenu
```
