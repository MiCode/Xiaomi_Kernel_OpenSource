## Kconfig.msm
```kconfig
# SPDX-License-Identifier: GPL-2.0

menu "Qualcomm SoC Repostiory Configuration"

source "$(KCONFIG_EXT_PREFIX)arch/arm64/gunyah/Kconfig"

source "$(KCONFIG_EXT_PREFIX)arch/arm64/Kconfig.platforms"

source "$(KCONFIG_EXT_PREFIX)drivers/base/regmap/Kconfig"

source "$(KCONFIG_EXT_PREFIX)drivers/bus/mhi/Kconfig"

source "$(KCONFIG_EXT_PREFIX)drivers/char/Kconfig"

source "$(KCONFIG_EXT_PREFIX)drivers/clk/qcom/Kconfig"

source "$(KCONFIG_EXT_PREFIX)drivers/cpufreq/Kconfig.arm"

source "$(KCONFIG_EXT_PREFIX)drivers/cpuidle/Kconfig"

source "$(KCONFIG_EXT_PREFIX)drivers/mimon/Kconfig"

source "$(KCONFIG_EXT_PREFIX)drivers/devfreq/Kconfig"

source "$(KCONFIG_EXT_PREFIX)drivers/dma-buf/heaps/Kconfig"

source "$(KCONFIG_EXT_PREFIX)drivers/dma/qcom/Kconfig"

source "$(KCONFIG_EXT_PREFIX)drivers/edac/Kconfig"

source "$(KCONFIG_EXT_PREFIX)drivers/extcon/Kconfig"

source "$(KCONFIG_EXT_PREFIX)drivers/firmware/Kconfig"

source "$(KCONFIG_EXT_PREFIX)drivers/gpu/drm/bridge/Kconfig"

source "$(KCONFIG_EXT_PREFIX)drivers/gpu/drm/msm/Kconfig"

source "$(KCONFIG_EXT_PREFIX)drivers/hwmon/Kconfig"

source "$(KCONFIG_EXT_PREFIX)drivers/hwtracing/coresight/Kconfig"

source "$(KCONFIG_EXT_PREFIX)drivers/hwtracing/stm/Kconfig"

source "$(KCONFIG_EXT_PREFIX)drivers/i2c/busses/Kconfig"

source "$(KCONFIG_EXT_PREFIX)drivers/i3c/master/Kconfig"

source "$(KCONFIG_EXT_PREFIX)drivers/iio/adc/Kconfig"

source "$(KCONFIG_EXT_PREFIX)drivers/iio/dac/Kconfig"

source "$(KCONFIG_EXT_PREFIX)drivers/input/misc/Kconfig"

source "$(KCONFIG_EXT_PREFIX)drivers/interconnect/Kconfig"

source "$(KCONFIG_EXT_PREFIX)drivers/iommu/Kconfig"

source "$(KCONFIG_EXT_PREFIX)drivers/irqchip/Kconfig"

source "$(KCONFIG_EXT_PREFIX)drivers/leds/Kconfig"

source "$(KCONFIG_EXT_PREFIX)drivers/mailbox/Kconfig"

source "$(KCONFIG_EXT_PREFIX)drivers/mfd/Kconfig"

source "$(KCONFIG_EXT_PREFIX)drivers/eom/Kconfig"

source "$(KCONFIG_EXT_PREFIX)drivers/eom/pcie/Kconfig"

source "$(KCONFIG_EXT_PREFIX)drivers/misc/Kconfig"

source "$(KCONFIG_EXT_PREFIX)drivers/mmc/host/Kconfig"

source "$(KCONFIG_EXT_PREFIX)drivers/net/Kconfig"

source "$(KCONFIG_EXT_PREFIX)drivers/pci/controller/Kconfig"

source "$(KCONFIG_EXT_PREFIX)drivers/perf/Kconfig"

source "$(KCONFIG_EXT_PREFIX)drivers/phy/Kconfig"

source "$(KCONFIG_EXT_PREFIX)drivers/phy/qualcomm/Kconfig"

source "$(KCONFIG_EXT_PREFIX)drivers/pinctrl/qcom/Kconfig"

source "$(KCONFIG_EXT_PREFIX)drivers/power/reset/Kconfig"

source "$(KCONFIG_EXT_PREFIX)drivers/power/supply/Kconfig"

source "$(KCONFIG_EXT_PREFIX)drivers/power/supply/mca/Kconfig"

source "$(KCONFIG_EXT_PREFIX)drivers/powercap/qcom/Kconfig"

source "$(KCONFIG_EXT_PREFIX)drivers/powerinsight/Kconfig"
source "$(KCONFIG_EXT_PREFIX)drivers/ptp/Kconfig"

source "$(KCONFIG_EXT_PREFIX)drivers/regulator/Kconfig"

source "$(KCONFIG_EXT_PREFIX)drivers/remoteproc/Kconfig"

source "$(KCONFIG_EXT_PREFIX)drivers/rpmsg/Kconfig"

source "$(KCONFIG_EXT_PREFIX)drivers/soc/qcom/dcvs/Kconfig"

source "$(KCONFIG_EXT_PREFIX)drivers/soc/qcom/Kconfig"

source "$(KCONFIG_EXT_PREFIX)drivers/soc/qcom/mem_buf/Kconfig"

source "$(KCONFIG_EXT_PREFIX)drivers/soc/qcom/memshare/Kconfig"

source "$(KCONFIG_EXT_PREFIX)drivers/spi/Kconfig"

source "$(KCONFIG_EXT_PREFIX)drivers/spmi/Kconfig"

source "$(KCONFIG_EXT_PREFIX)drivers/thermal/qcom/Kconfig"

source "$(KCONFIG_EXT_PREFIX)drivers/tty/hvc/Kconfig"

source "$(KCONFIG_EXT_PREFIX)drivers/tty/serial/Kconfig"

source "$(KCONFIG_EXT_PREFIX)drivers/ufs/host/Kconfig"

source "$(KCONFIG_EXT_PREFIX)drivers/uio/Kconfig"

source "$(KCONFIG_EXT_PREFIX)drivers/usb/dwc3/Kconfig"

source "$(KCONFIG_EXT_PREFIX)drivers/usb/gadget/Kconfig"

source "$(KCONFIG_EXT_PREFIX)drivers/usb/Kconfig"

source "$(KCONFIG_EXT_PREFIX)drivers/video/Kconfig"

source "$(KCONFIG_EXT_PREFIX)drivers/virt/Kconfig"

source "$(KCONFIG_EXT_PREFIX)drivers/virtio/Kconfig"

source "$(KCONFIG_EXT_PREFIX)init/Kconfig"

source "$(KCONFIG_EXT_PREFIX)kernel/sched/walt/Kconfig"

source "$(KCONFIG_EXT_PREFIX)kernel/sched/xiaomi_sched/Kconfig"

source "$(KCONFIG_EXT_PREFIX)kernel/trace/Kconfig"

source "$(KCONFIG_EXT_PREFIX)net/Kconfig"

source "$(KCONFIG_EXT_PREFIX)sound/usb/Kconfig"

source "$(KCONFIG_EXT_PREFIX)drivers/misc/hwid/Kconfig"

source "$(KCONFIG_EXT_PREFIX)drivers/block/Kconfig"

source "$(KCONFIG_EXT_PREFIX)Kconfig.qtvm"

source "$(KCONFIG_EXT_PREFIX)drivers/misc/dio_dma_mapper/Kconfig"

source "$(KCONFIG_EXT_PREFIX)drivers/input/fingerprint/mi_fp/Kconfig"

source "$(KCONFIG_EXT_PREFIX)drivers/xiaomi/Kconfig"

source "$(KCONFIG_EXT_PREFIX)drivers/ir-spi/Kconfig"

source "$(KCONFIG_EXT_PREFIX)drivers/input/misc/cs40l26_haptic/Kconfig"

source "$(KCONFIG_EXT_PREFIX)sound/soc/codecs/Kconfig"

source "$(KCONFIG_EXT_PREFIX)drivers/firmware/cirrus/Kconfig"

source "$(KCONFIG_EXT_PREFIX)drivers/rsmc/Kconfig"

source "$(KCONFIG_EXT_PREFIX)drivers/xiaomi/mi_kernel_monitor/Kconfig"

source "$(KCONFIG_EXT_PREFIX)drivers/xiaomi/fault_report/Kconfig"

source "$(KCONFIG_EXT_PREFIX)drivers/stmvl53l5/Kconfig"

source "$(KCONFIG_EXT_PREFIX)drivers/mihw/Kconfig"

source "$(KCONFIG_EXT_PREFIX)drivers/ntag/Kconfig"

source "$(KCONFIG_EXT_PREFIX)drivers/ntag/fm19511/Kconfig"

endmenu
```

## arch/arm64/Kconfig.platforms
```kconfig
# SPDX-License-Identifier: GPL-2.0-only
menu "Platform selection"

config ARCH_CANOE
	bool "Enable support for Qualcomm Technologies, Inc. Canoe"
	depends on ARCH_QCOM
	help
	  This enables support for Qualcomm Technologies, Inc. Canoe
	  chipset. If you do not wish to build a kernel that runs on this
	  chipset or if you are unsure, say 'N' here.

config ARCH_ALOR
	bool "Enable support for Qualcomm Technologies, Inc. Alor"
	depends on ARCH_QCOM
	help
	  This enables support for Qualcomm Technologies, Inc. Alor
	  chipset. If you do not wish to build a kernel that runs on this
	  chipset or if you are unsure, say 'N' here.

config ARCH_CHORA
	bool "Enable support for Qualcomm Technologies, Inc. Chora"
	depends on ARCH_QCOM
	help
	  This enables support for Qualcomm Technologies, Inc. Chora
	  chipset. It is based on Kryo cores.

	  If you do not wish to build a kernel that runs on this
	  chipset or if you are unsure, say 'N' here.

config ARCH_MALABAR
	bool "Enable support for Qualcomm Technologies, Inc. Malabar"
	depends on ARCH_QCOM
	help
	  This enables support for Qualcomm Technologies, Inc. Malabar
	  chipset.

	  If you do not wish to build a kernel that runs on this
	  chipset or if you are unsure, say 'N' here.

config ARCH_QTI_VM
       bool "Enable Virtual Machines Support for Qualcomm Technologies, Inc."
       depends on ARCH_QCOM
       help
         This enables support for the Qualcomm Technologies, Inc.'s
         Virtual Machines. If you wish to build a kernel that doesn't
         require VM support or if you are unsure,
         say 'N' here.

config ARCH_SUN
	bool "Enable support for Qualcomm Technologies, Inc. Sun"
	depends on ARCH_QCOM
	help
	  This enables support for Qualcomm Technologies, Inc. Sun
	  chipset. If you do not wish to build a kernel that runs on this
	  chipset or if you are unsure, say 'N' here.

config ARCH_PINEAPPLE
	bool "Enable support for Qualcomm Technologies, Inc. Pineapple"
	depends on ARCH_QCOM
	help
	  This enables support for Qualcomm Technologies, Inc. Pineapple
	  chipset. If you do not wish to build a kernel that runs on this
	  chipset or if you are unsure, say 'N' here.

config ARCH_VIENNA
	bool "Enable Support for Qualcomm Technologies, Inc. VIENNA"
	depends on ARCH_QCOM
	help
	  This enables support for the Qualcomm Technologies, Inc.
	  Vienna chipset.
	  If you do not wish to build a kernel that runs on this
	  chipset or if you are unsure, say 'N' here.

config ARCH_X1E80100
	bool "Enable support for Qualcomm Technologies, Inc. X1e80100"
	depends on ARCH_QCOM
	help
	  This enables support for Qualcomm Technologies, Inc. X1e80100
	  chipset.
          If you do not wish to build a kernel that runs on this
	  chipset or if you are unsure, say 'N' here.

config ARCH_X1P42100
	bool "Enable support for Qualcomm Technologies, Inc. X1p42100"
	depends on ARCH_QCOM
	help
	  This enables support for Qualcomm Technologies, Inc. X1p42100
	  chipset.
          If you do not wish to build a kernel that runs on this
	  chipset or if you are unsure, say 'N' here.

config ARCH_YUPIK
	bool "Enable Support for Qualcomm Technologies, Inc. YUPIK"
	depends on ARCH_QCOM
	help
	  This enables support for the Qualcomm Technologies,
	  Inc.'s YUPIK chipset. If you do not wish to build a
	  kernel that runs on this chipset or if you are unsure,
	  say 'N' here.

config ARCH_LAHAINA
	bool "Enable Support for Qualcomm Technologies, Inc. LAHAINA"
	depends on ARCH_QCOM
	help
	  This enables support for the Qualcomm Technologies,
	  Inc.'s LAHAINA chipset. If you do not wish to build a
	  kernel that runs on this chipset or if you are unsure,
	  say 'N' here.

config ARCH_BENGAL
	bool "Enable Support for Qualcomm Technologies, Inc. BENGAL"
	depends on ARCH_QCOM
	help
	  This enables support for the Qualcomm Technologies,
	  Inc.'s BENGAL chipset. If you do not wish to build a
	  kernel that runs on this chipset or if you are unsure,
	  say 'N' here.

config ARCH_KHAJE
	bool "Enable Support for Qualcomm Technologies, Inc. KHAJE"
	depends on ARCH_QCOM
	help
	  This enables support for the Qualcomm Technologies,
	  Inc.'s KHAJE chipset. If you do not wish to build a
	  kernel that runs on this chipset or if you are unsure,
	  say 'N' here.

config ARCH_MONACO
	bool "Enable Support for Qualcomm Technologies, Inc. MONACO"
	depends on ARCH_QCOM
	help
	  This enables support for the Qualcomm Technologies,
	  Inc.'s monaco chipset. If you do not wish to build a
	  kernel that runs on this chipset or if you are unsure,
	  say 'N' here.

config ARCH_DIREWOLF
	bool "Enable Support for Qualcomm Technologies, Inc. DIREWOLF"
	depends on ARCH_QCOM
	help
	  This enables support for the Qualcomm Technologies, Inc.'s
	  DIREWOLF chipset. If you do not wish to build a kernel that
	  runs on this chipset or if you are unsure, say 'N' here.

config ARCH_LEMANS
	bool "Enable Support for Qualcomm Technologies, Inc. LEMANS"
	depends on ARCH_QCOM
	help
	  This enables support for the Qualcomm Technologies, Inc.'s
	  LEMANS chipset. If you do not wish to build a kernel that
	  runs on this chipset or if you are unsure, say 'N' here.

config ARCH_MONACO_AUTO
	bool "Enable Support for Qualcomm Technologies, Inc. MONACO_AUTO"
	depends on ARCH_QCOM
	help
	  This enables support for the Qualcomm Technologies, Inc.'s
	  MONACO_AUTO chipset. If you do not wish to build a kernel that
	  runs on this chipset or if you are unsure, say 'N' here.

config ARCH_NORD
	bool "Enable Support for Qualcomm Technologies, Inc. NORD"
	depends on ARCH_QCOM
	help
	  This enables support for the Qualcomm Technologies, Inc.'s
	  NORD chipset. If you do not wish to build a kernel that
	  runs on this chipset or if you are unsure, say 'N' here.

config ARM64_PMEM
	bool "Enable support for persistent memory"
	select ARCH_HAS_PMEM_API
	select ARCH_HAS_UACCESS_FLUSHCACHE
	help
	  Say Y to enable support for the persistent memory API based on the
	  ARMv8.2 DCPoP feature.

	  The feature is detected at runtime, and the kernel will use DC CVAC
	  operations if DC CVAP is not supported (following the behaviour of
	  DC CVAP itself if the system does not define a point of persistence).

config ARCH_PIKACHU
        bool "Enable support for Qualcomm Technologies, Inc. Pikachu"
        depends on ARCH_QCOM
        help
          This enables support for Qualcomm Technologies, Inc. Pikachu
          chipset. If you do not wish to build a kernel that runs on this
          chipset or if you are unsure,
          say 'N' here.

config ARCH_RAVELIN
	bool "Enable Support for Qualcomm Technologies, Inc. RAVELIN"
	depends on ARCH_QCOM
	help
	  This enables support for Qualcomm Technologies, Inc.'s
	  RAVELIN chipset.
	  If you do not wish to build a kernel that runs on this
	  chipset or if you are unsure, say 'N' here.

config ARCH_SCUBA
	bool "Enable Support for Qualcomm Technologies, Inc. SCUBA"
	depends on ARCH_QCOM
	help
	  This enables support for Qualcomm Technologies, Inc.'s
	  SCUBA chipset.
	  If you do not wish to build a kernel that runs on this
	  chipset or if you are unsure, say 'N' here.

config ARCH_SHIKRA
        bool "Enable support for Qualcomm Technologies, Inc. SHIKRA"
        depends on ARCH_QCOM
        help
	  This enables support for Qualcomm Technologies, Inc.'s
	  SHIKRA chipset.
	  If you do not wish to build a kernel that runs on this
	  chipset or if you are unsure, say 'N' here.

config ARCH_SERAPH
	bool "Enable support for Qualcomm Technologies, Inc. Seraph"
	depends on ARCH_QCOM
	help
	  This enables support for Qualcomm Technologies, Inc. Seraph
	  chipset. If you do not wish to build a kernel that runs on this
	  chipset or if you are unsure,
	  say 'N' here.

endmenu # "Platform selection"

config FACTORY_BUILD
	bool "distiguish factory version from dev version"
	default n
	help
	  This macro will be defined when build factory version. It is used to
	  distinguish factory and dev codes in kernel.
```

## drivers/leds/Kconfig
```kconfig
# SPDX-License-Identifier: GPL-2.0-only
# This library does not depend on NEW_LEDS and must be independent so it can be
# selected from other subsystems (specifically backlight).
if NEW_LEDS

comment "LED drivers"

config LEDS_QTI_FLASH
	tristate "Support for QTI Flash LEDs"
	depends on LEDS_CLASS_FLASH
	depends on MFD_SPMI_PMIC
	select LEDS_TRIGGERS
	help
	  This driver supports flash LED peripheral that is present on
	  some Qualcomm Technologies, Inc. PMICs (e.g. PM8350C).  It can
	  configure the flash LED target current for several independent
	  channels. It also supports various over current and over
	  temperature mitigation features.

	  To compile this driver as a module, choose M here: the
	  module will be called leds-qti-flash.

config LEDS_QPNP_VIBRATOR_LDO
        tristate "Vibrator-LDO support for QPNP PMIC"
        depends on LEDS_CLASS && MFD_SPMI_PMIC
        help
          This option enables device driver support for the vibrator-ldo
          peripheral found on Qualcomm Technologies, Inc. QPNP PMICs.
          The vibrator-ldo peripheral is capable of driving ERM vibrators.

          To compile this driver as a module, choose M here: the module
          will be called leds-qpnp-vibrator-ldo.

config LEDS_AW2016
	tristate "LED Support for AW2016"
	depends on LEDS_CLASS && I2C
	help
	  this option enables support for the AW2016 RGB LED connected
	  through I2C. Say Y to enable support for the AW2016 LED.

	  To compile this driver as a module, choose M here: the module
	  will be called leds-aw2016.

config LEDS_AW21024
	tristate "LED Support for AW21024"
	depends on LEDS_CLASS && I2C
	help
	  this option enables support for the AW21024 RGB LED connected
	  through I2C. Say Y to enable support for the AW21024 LED
	  light automatically.

endif # NEW_LEDS
```
