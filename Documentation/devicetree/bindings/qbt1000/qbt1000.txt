## Documentation/devicetree/bindings/qbt1000/qbt1000.txt
```
Qualcomm Technologies, Inc. QBT1000 Specific Bindings

QBT is a fingerprint sensor ASIC capable of performing fingerprint image scans
and detecting finger presence on the sensor using programmable firmware.

=======================
Required Node Structure
=======================

- compatible
  Usage:      required
  Value type: <string>
  Definition: "qcom,qbt1000".

- clock-names
  Usage:      required
  Value type: <stringlist>
  Definition: List of clock names that need to be voted on/off.

- clocks
  Usage:      required
  Value type: <prop_encoded-array>
  Definition: Property pair that represents the clock controller and the clock
		id. This in combination with the clock-name is used to obtain
		the handle for the clock that needs to be voted on/off.

- clock-frequency
  Usage:      required
  Value type: <u32>
  Definition: Frequency of clock in Hz.

- qcom,ipc-gpio
  Usage:      required
  Value type: <phandle>
  Definition: phandle for GPIO to be used for IPC.

- qcom,finger-detect-gpio
  Usage:      required
  Value type: <phandle>
  Definition: phandle for GPIO to be used for finger detect.

=======
Example
=======

qcom,qbt1000 {
	compatible = "qcom,qbt1000";
	clock-names = "core", "iface";
	clocks = <&clock_gcc clk_gcc_blsp2_qup6_spi_apps_clk>,
		<&clock_gcc clk_gcc_blsp2_ahb_clk>;
	clock-frequency = <15000000>;
	qcom,ipc-gpio = <&tlmm 121 0>;
	qcom,finger-detect-gpio = <&pmcobalt_gpios 2 0>;
};
```

## Documentation/devicetree/bindings/qbt_handler/qbt_handler.txt
```
Qualcomm Technologies, Inc. QBT_HANDLER Specific Bindings

QBT is a fingerprint sensor ASIC capable of performing fingerprint image scans
and detecting finger presence on the sensor using programmable firmware.

=======================
Required Node Structure
=======================

- compatible
  Usage:      required
  Value type: <string>
  Definition: "qcom,qbt-handler".

- qcom,ipc-gpio
  Usage:      required
  Value type: <phandle>
  Definition: phandle for GPIO to be used for IPC.

- qcom,finger-detect-gpio
  Usage:      required
  Value type: <phandle>
  Definition: phandle for GPIO to be used for finger detect.

=======
Example
=======

qcom,qbt_handler {
                compatible = "qcom,qbt-handler";
                qcom,ipc-gpio = <&tlmm 23 0>;
                pinctrl-names = "default";
                pinctrl-0 = <&key_home_default>;
                qcom,finger-detect-gpio = <&pm8150_gpios 1 0>;
};
```

## Documentation/devicetree/bindings/qdsp/adsp-loader.txt
```
* MSM Application DSP loader binding

Required properties:
- compatible : "qcom,adsp-loader"

Example:

	qcom,msm-adsp-loader {
		compatible = "qcom,adsp-loader";
	};
```

## Documentation/devicetree/bindings/qdsp/msm-adsp-sensors.txt
```
* msm-adsp-sensors

Required properties:

 - compatible:	"qcom,msm-adsp-sensors"

Example:

	qcom,msm-adsp-sensors {
		compatible = "qcom,msm-adsp-sensors";
	};
```

## Documentation/devicetree/bindings/qdsp/msm-adsprpc-mem.txt
```
Qualcomm Technologies, Inc. Dynamic Heap Allocator

The MSM ADSPRPC memory device allocates memory, when remote processor(ADSP)
requests memory from application subsystem for use cases where it does not
have enough memory available locally and later release the memory when
use case ends.

Required properties:
-compatible: Must be "qcom,msm-adsprpc-mem-region"
-linux,contiguous-region: A phandle that points to a memory heap where the
dynamic heap memory is allocated

Example:
	qcom,adsprpc-mem {
		compatible = "qcom,msm-adsprpc-mem-region";
		linux,contiguous-region = <&adsp_mem>;
	};
```

## Documentation/devicetree/bindings/qdsp/msm-cdsp-loader.txt
```
Qualcomm Technologies, Inc. CDSP Loader Driver

msm-cdsp-loader driver implements the mechanism that allows to load CDSP firmware images.

Required properties:

 - compatible:  This must be "qcom,msm-cdsp-loader".
 - qcom,proc-img-to-load: CDSP firmware name, must be "cdsp".

Example:
 The following for sdm660.

	qcom,msm-cdsp-loader {
		compatible = "qcom,cdsp-loader";
		qcom,proc-img-to-load = "cdsp";
	};
```

## Documentation/devicetree/bindings/qdsp/msm-fastrpc.txt
```
Qualcomm Technologies, Inc. FastRPC Driver

The MSM FastRPC driver implements an IPC (Inter-Processor Communication)
mechanism that allows for clients to transparently make remote method
invocations across DSP and APPS boundaries. This enables developers
to offload tasks to the DSP and free up the application processor for
other tasks.

Required properties:
- compatible :	Must be one of "qcom,msm-fastrpc-adsp" or
		"qcom,msm-fastrpc-compute"

Optional properties:
- qcom,rpc-latency-us:	FastRPC QoS latency vote
- qcom,adsp-remoteheap-vmid:  FastRPC remote heap VMID list
- qcom,secure-context-bank		:	Bool indicating secure FastRPC context bank.
- qcom,fastrpc-legacy-remote-heap	:	Bool indicating hypervisor is not supported.
- qcom,fastrpc-adsp-audio-pdr:  Flag to enable ADSP Audio PDR
- qcom,secure-domains:  FastRPC secure domain configuration
- qcom,fastrpc-adsp-sensors-pdr: Flag to enable Sensors PDR

Optional subnodes:
- qcom,msm_fastrpc_compute_cb :	Child nodes representing the compute context
				banks
- qcom,msm-fastrpc-rpmsg      :	Child node for rpmsg instead of glink for IPC

Subnode Required properties:
- compatible   :  Must be "qcom,msm-fastrpc-compute-cb"
- label        :  Label describing the channel this context bank belongs to
- iommus       :  A list of phandle and IOMMU specifier pairs that describe the
			IOMMU master interfaces of the device
- dma-coherent :  A flag marking a context bank as I/O coherent
- shared-cb    :  A value indicating how many fastrpc sessions can share a
			context bank
- shared-sid   :  A value indicating the number of sids that are using the same
			context bank

Example:
	qcom,msm_fastrpc {
		compatible = "qcom,msm-fastrpc-compute";
		qcom,fastrpc-rpmsg;
		qcom,rpc-latency-us = <2343>;
		qcom,adsp-remoteheap-vmid = <22 37>;
		qcom,fastrpc-adsp-sensors-pdr;

		qcom,msm_fastrpc_rpmsg {
			compatible = "qcom,msm-fastrpc-rpmsg";
			qcom,glink-channels = "fastrpcglink-apps-dsp";
			intents = <0x64 64>;
		};

		qcom,msm_fastrpc_compute_cb_1 {
			compatible = "qcom,msm-fastrpc-compute-cb";
			label = "adsprpc-smd";
			iommus = <&apps_smmu 0x1401 0x0>;
			dma-coherent;
		};
		qcom,msm_fastrpc_compute_cb_2 {
			compatible = "qcom,msm-fastrpc-compute-cb";
			label = "sdsprpc-smd";
			iommus = <&apps_smmu 0x1402 0x0>;
			shared-cb = <5>;
		};
		qcom,msm_fastrpc_compute_cb_3 {
			compatible = "qcom,msm-fastrpc-compute-cb";
			label = "adsprpc-smd";
			iommus = <&apps_smmu 0x0043 0x0>,
				 <&apps_smmu 0x0044 0x0>;
			shared-sid = <2>;
		};
	};

Legacy SMMU v1/v2:

Required properties:
- compatible : Must be "qcom,msm-fastprc-legacy-compute-cb"

Required subnode:
- qcom,msm_fastrpc_compute_cb : Child nodes representing the compute context
                                banks

Required subnode properties:
- qcom,adsp-shared-phandle: phandle that describe the context bank handle
- qcom,adsp-shared-sids : A list of SID associated with the context bank
- qcom,virtual-addr-pool : Virtual address range that the context bank
                           will be using

Example:
        qcom,adsprpc_domains {
                compatible = "qcom,msm-fastrpc-legacy-compute-cb";
                qcom,msm_fastrpc_compute_cb {
                       qcom,adsp-shared-phandle = <&adsp_shared>;
                       qcom,adsp-shared-sids = <0x8 0x9>;
                       qcom,virtual-addr-pool = <0x80000000 0x7FFFFFFF>;
                };
        };

Remote Heap:

Required properties:
- compatible : Must be "qcom,msm-adsprpc-mem-region"
- memory-region : CMA region which is owned by this device
- restrict-access : Blocking vote for hyp_assign_phys function call

Example:
       qcom,adsprpc-mem {
               compatible = "qcom,msm-adsprpc-mem-region";
               memory-region = <&adsp_mem>;
               restrict-access;
       };
```

## Documentation/devicetree/bindings/qdsp/msm-mdsprpc-mem.txt
```
Qualcomm Technologies, Inc. FastRPC MDSP CMA Heap

The MSM MDSPRPC memory device allocates CMA memory, for sharing memory
of FastRPC buffers to remote processor(MDSP).

Required properties:
-compatible: Must be "qcom,msm-mdsprpc-mem-region"
-memory-region: A phandle that points to a memory heap where the
heap memory is allocated

Example:
	qcom,mdsprpc-mem {
		compatible = "qcom,msm-mdsprpc-mem-region";
		memory-region = <&mdsp_mem>;
	};

Ion Heap:

Ion heap allows for sharing of buffers between different processors
and between user space and kernel space.
(see Documentation/devicetree/bindings/arm/msm/msm_ion.txt).

Required properties for Ion heap:
- compatible : "qcom,msm-ion"
```

## Documentation/devicetree/bindings/qdsp/msm-ssc-sensors.txt
```
Qualcomm Technologies, Inc. SSC Driver

msm-ssc-sensors driver implements the mechanism that allows to load SLPI firmware images.

Required properties:

 - compatible:  This must be "qcom,msm-ssc-sensors"

Optional properties:

 - qcom,firmware-name: SLPI firmware name, must be "slpi" or "slpi_v1" or "slpi_v2"
	Firmware name is not required, if sensors driver is sharing processor for execution.


Example:
 The following for sdm845.

	qcom,msm-ssc-sensors {
		compatible = "qcom,msm-ssc-sensors";
		qcom,firmware-name = "slpi";
	};
```

## Documentation/devicetree/bindings/qseecom/qseecom.txt
```
* QSEECOM (Qualcomm Secure Execution Environment Communicator)

Required properties:
- compatible : Should be "qcom,qseecom"
- reg : should contain memory region address reserved for loading secure apps.
- qcom,disk-encrypt-pipe-pair : indicates what CE HW pipe pair is used for disk encryption
- qcom,file-encrypt-pipe-pair : indicates what CE HW pipe pair is used for file encryption
- qcom,support-multiple-ce-hw-instance : indicates if multicore CE support is supported.
- qcom,hlos-num-ce-hw-instances : indicates number of CE HW instances hlos can use.
- qcom,hlos-ce-hw-instance : indicates what CE HW is used by HLOS crypto driver
- qcom,qsee-ce-hw-instance : indicates what CE HW is used by secure domain (TZ) crypto driver
- qcom, msm_bus,name: Should be "qseecom-noc"
- qcom, msm_bus,num_cases: Depends on the use cases for bus scaling
- qcom, msm_bus,num_paths: The paths for source and destination ports
- qcom, msm_bus,vectors: Vectors for bus topology.
- qcom,ce-opp-freq: indicates the CE operating frequency in Hz, changes from target to target.
- qcom,full-disk-encrypt-info : Vectors defining full disk encryption unit, crypto engine, pipe pair configuration in <unit#, ce#, pipe-pair#>
- qcom,per-file-encrypt-info : Vectors defining per file encryption unit, crypto engine, pipe pair configuration in <unit#, ce#, pipe-pair#>

Optional properties:
  - qcom,support-bus-scaling : indicates if driver support scaling the bus for crypto operation.
  - qcom,support-fde : indicates if driver support key managing for full disk encryption feature.
  - qcom,support-pfe : indicates if driver support key managing for per file encryption feature.
  - qcom,no-clock-support : indicates clocks are not handled by qseecom (could be handled by RPM)
  - qcom,appsbl-qseecom-support : indicates if there is qseecom support in appsbootloader
  - vdd-hba-supply   : handle for fixed power regulator
  - qcom,qsee-reentrancy-support: indicates the qsee reentrancy phase supported by the target

Example:
	qcom,qseecom@fe806000 {
		compatible = "qcom,qseecom";
		reg = <0x7f00000 0x500000>;
		reg-names = "secapp-region";
                qcom,disk-encrypt-pipe-pair = <2>;
                qcom,file-encrypt-pipe-pair = <0>;
		qcom,support-multiple-ce-hw-instance;
		qcom,hlos-num-ce-hw-instances = <2>;
		qcom,hlos-ce-hw-instance = <1 2>;
		qcom,qsee-ce-hw-instance = <0>;
		qcom,support-fde;
		qcom,support-pfe;
		qcom,msm_bus,name = "qseecom-noc";
		qcom,msm_bus,num_cases = <4>;
		qcom,msm_bus,active_only = <0>;
		qcom,msm_bus,num_paths = <1>;
		qcom,no-clock-support;
		qcom,appsbl-qseecom-support;
		qcom,msm_bus,vectors =
			<55 512 0 0>,
			<55 512 3936000000 393600000>,
			<55 512 3936000000 393600000>,
			<55 512 3936000000 393600000>;
		qcom,ce-opp-freq = <100000000>;
		vdd-hba-supply = <&gdsc_ufs>;
	};

Example: The following dts setup is the same as the example above.

	qcom,qseecom@fe806000 {
		compatible = "qcom,qseecom";
		reg = <0x7f00000 0x500000>;
		reg-names = "secapp-region";
		qcom,support-fde;
		qcom,full-disk-encrypt-info = <0 1 2>, <0 2 2>;
		qcom,support-pfe;
		qcom,per-file-encrypt-info = <0 1 0>, <0 2 0>;
		qcom,qsee-ce-hw-instance = <0>;
		qcom,msm_bus,name = "qseecom-noc";
		qcom,msm_bus,num_cases = <4>;
		qcom,msm_bus,active_only = <0>;
		qcom,msm_bus,num_paths = <1>;
		qcom,no-clock-support;
		qcom,appsbl-qseecom-support;
		qcom,msm_bus,vectors =
			<55 512 0 0>,
			<55 512 3936000000 393600000>,
			<55 512 3936000000 393600000>,
			<55 512 3936000000 393600000>;
		qcom,ce-opp-freq = <100000000>;
		vdd-hba-supply = <&gdsc_ufs>;
	};
```
