## Documentation/devicetree/bindings/regulator/fan53555.txt
```
Binding for Fairchild FAN53555 regulators

Required properties:
  - compatible: one of "fcs,fan53555", "silergy,syr827", "silergy,syr828",
    "halo,hl7509" or "halo,hl7503"
  - reg: I2C address

Optional properties:
  - fcs,suspend-voltage-selector: declare which of the two available
		voltage selector registers should be used for the suspend
		voltage. The other one is used for the runtime voltage setting
		Possible values are either <0> or <1>
  - vin-supply: regulator supplying the vin pin
  - fcs,disable-suspend: Boolean flag which specifies if suspend voltage
		configuration should be avoided. If this property is present,
		then the voltage selector register defined by
		fcs,suspend-voltage-selector should not be modified at runtime.

Example:

	regulator@40 {
		compatible = "fcs,fan53555";
		regulator-name = "fan53555";
		regulator-min-microvolt = <1000000>;
		regulator-max-microvolt = <1800000>;
		vin-supply = <&parent_reg>;
		fcs,suspend-voltage-selector = <1>;
	};

	regulator@60 {
		compatible = "halo,hl7509";
		regulator-name = "hl7509";
		regulator-min-microvolt = <600000>;
		regulator-max-microvolt = <1230000>;
		fcs,suspend-voltage-selector = <1>;
		fcs,disable-suspend;
	};
```

## Documentation/devicetree/bindings/regulator/gdsc-regulator.txt
```
QTI Global Distributed Switch Controller (GDSC) Regulator Driver

The GDSC driver, implemented under the regulator framework, is responsible for
safely collapsing and restoring power to peripheral and multimedia cores on
chipsets like SDM845 for power savings.

Required properties:
 - compatible:      Must be "qcom,gdsc"
 - regulator-name:  A string used as a descriptive name for regulator outputs
 - reg:             The address of the GDSCR register

Optional properties:
 - parent-supply:   phandle to the parent supply/regulator node
 - clock-names:     List of string names for core clocks
 - qcom,retain-mem:  Presence denotes a hardware requirement to leave the
		     forced core memory retention signals in the core's clock
		     branch control registers asserted.
 - qcom,retain-periph: Presence denotes a hardware requirement to leave the
		     forced periph memory retention signal in the core's clock
		     branch control registers asserted.
 - qcom,skip-logic-collapse: Presence denotes a requirement to leave power to
                             the core's logic enabled.
 - qcom,support-hw-trigger: Presence denotes a hardware feature to switch
			    on/off this regulator based on internal HW signals
			    to save more power.
 - qcom,enable-root-clk: Presence denotes that the clocks in the "clocks"
			property are required to be enabled before gdsc is
			turned on and disabled before turning off gdsc. This
			will be used in subsystems where reset is synchronous
			and root clk is active without sw being aware of its
			state. The clock-name which denotes the root clock
			should be named as "core_root_clk".
 - qcom,force-enable-root-clk: If set, denotes that the root clock should be
			force enabled before turning on the GDSC and then be
			immediately force disabled. Likewise for GDSC disable.
			This is used in cases where the core root clock needs
			to be force-enabled prior to turning on the core. The
			clock-name which denotes the root clock should be
			"core_root_clk".
 - qcom,clk-dis-wait-val: Input value for CLK_DIS_WAIT controls state transition
			 delay after halting clock in the collapsible core.
 - reg-names:		Names of the bases for the above "reg" registers.
			Ex. "base", "domain-addr", "sw-reset", "hw-ctrl-addr".
 - qcom,no-status-check-on-disable: Do not poll the status bit when GDSC
			is disabled.
 - qcom,skip-disable:	Boolean flag indicating that the GDSC must not be
			physically disabled upon a software disable request.
			Instead, the GDSC will be disabled by the always-on
			processor (AOP) upon entering system sleep.  The AOP
			will also perform a special reset sequence for the GDSC
			upon resuming from system sleep.
 - qcom,disallow-clear: Presence denotes the periph & core memory will not be
			cleared, unless the required subsystem does not invoke
			the api which will allow clearing the bits.
 - qcom,gds-timeout:	Maximum time (in usecs) that might be taken by a GDSC
			to enable.
 - qcom,reset-aon-logic: If present, the GPU DEMET cells need to be reset while
			 enabling the GX GDSC.
 - vdd_parent-supply:	phandle to the regulator that this GDSC gates. If
			present, need to vote for a minimum operational voltage
			(LOW_SVS) on the GDSC parent regulator prior to
			configuring it. The vote is removed once the GDSC FSM
			has latched on to the new state.
 - resets: reset specifier pair consisting of phandle for the reset controller
			and reset lines used by this controller. These can be
			supplied only if we support qcom,skip-logic-collapse.
 - reset-names: reset signal name strings sorted in the same order as the resets
			property. These can be supplied only if we support
			qcom,skip-logic-collapse.
 - qcom,msm-bus,name:	Name to use for the bus client.  See [1] for details.
 - qcom,msm-bus,num-cases: Must be 2 if qcom,msm-bus,name is specified.  The
			first case corresponds to no bus request and the second
			case corresponds to a minimum bus request.  See [1] for
			details.
 - qcom,msm-bus,num-paths: Should be 1 if qcom,msm-bus,name is specified.  See
			[1] for details.
 - qcom,msm-bus,vectors-KBps: Required if qcom,msm-bus,name is specified.  See
			[1] for an explanation of the data format.
 - mboxes:		Mailbox tuple containing QMP mailbox phandle and channel
			identifier.  If this is specified, then a QMP message
			should be sent to enable the GDSC instead of setting
			SW_COLLAPSE=0.
 - qcom,skip-disable-before-sw-enable: Presence denotes a hardware requirement
					to leave the GDSC on that has been
					enabled by an entity external to HLOS.

[1]: Documentation/devicetree/bindings/arm/msm/msm_bus.txt

Example:
	gdsc_oxili_gx: qcom,gdsc@fd8c4024 {
		compatible = "qcom,gdsc";
		regulator-name = "gdsc_oxili_gx";
		parent-supply = <&pm8841_s4>;
		reg = <0xfd8c4024 0x4>;
		clock-names = "core_clk";
	};
```

## Documentation/devicetree/bindings/regulator/krait-regulator-pmic.txt
```
Krait Voltage regulators in the PMIC

In certain MSMs the CPUs are powered using a single supply powered by PMIC ganged regulators
operating in different phases. The krait-regulator-pmic node represents the gang leader and its
associated control, power stage and frequency peripherals.

[First Level Nodes]
Required properties:
- compatible:			Must be "qcom,krait-regulator-pmic".
- spmi-dev-container:	        Specifies that all the device nodes specified
				within this node should have their resources coalesced into a
				single spmi_device.  This is used to specify all SPMI peripherals
				that logically make up the gang leader.
 - #address-cells:		The number of cells dedicated to represent an address
				This must be set to '1'.
 - #size-cells:			The number of cells dedicated to represent address
				space range of a peripheral. This must be set to '1'.

[Second Level Nodes]
Required properties:
- reg:             Specifies the SPMI address and size for this peripheral.
There must be exactly three subnodes qcom,ctl qcom,ps and qcom,freq representing control,
power stage and frequency SPMI peripherals respectively of the gang leader.

Example:
		krait_regulator_pmic: qcom,krait-regulator-pmic {
			spmi-dev-container;
			compatible = "qcom,krait-regulator-pmic";
			#address-cells = <1>;
			#size-cells = <1>;
			status = "disabled";

			qcom,ctl@2000 {
				status = "disabled";
				reg = <0x2000 0x100>;
			};

			qcom,ps@2100 {
				status = "disabled";
				reg = <0x2100 0x100>;
			};

			qcom,freq@2200 {
				status = "disabled";
				reg = <0x2200 0x100>;
			};
		};
```

## Documentation/devicetree/bindings/regulator/krait-regulator.txt
```
Krait Voltage regulators

The cpus are powered using a single supply powered by PMIC ganged regulators operating in
different phases. Individual kraits further can draw power from the single supply via
a LDO or a head switch (BHS).  The first level node represents the PMIC ganged regulator
and its properties and encompasses second level nodes that represent the individual
krait LDO/BHS control regulator.

[First Level Nodes]
Required properties:
- compatible:			Must be "qcom,krait-pdn"
- reg:				This property contains a list of physical
				addresses for Krait PDN features.  The list
				should contain the address of the APCS GCC
				register base and the address of the phase
				scaling factor eFuse.
- reg-names:			This property contains a list of strings naming
				the registers listed in the reg property.
				"apcs_gcc" is a string to identify the area
				where the APCS GCC registers reside.
				"phase-scaling-efuse" should be used to identify
				the phase scaling factor eFuse address.
- qcom,pfm-threshold		The power coeff threshold in abstract power units below which
				pmic will be made to operate in PFM mode.

Optional properties:
- qcom,use-phase-switching	indicates whether the driver should add/shed phases on the PMIC
				ganged regulator as cpus are hotplugged.
- qcom,use-phase-scaling-factor	Boolean which indicates if the value stored in
				the phase scaling eFuse should be used or not.
				If this property is not specified, then worst
				case scaling will be assumed.

[Second Level Nodes]
Required properties:
- compatible:			Must be "qcom,krait-regulator"
- reg:				Specifies the address and size for this regulator device,
				also specifies the address and the size for the MDD area
				to be used along with the regulator
- reg-names:			"acs" -string to identify the area where main power control
					registers reside.
				"mdd" - string to identify the area where mdd registers reside.
- qcom,headroom-voltage:	The minimum required voltage drop between the input
			 	voltage and the output voltage for the LDO to be
			 	operational, in microvolts. Acceptable values are from
				50000uV to 250000uV
- qcom,retention-voltage:	The value for retention voltage in microvolts. Acceptable
				values are from 465000uV to 750000uV
- qcom,ldo-default-voltage:	The default value for LDO voltage in microvolts. Acceptable
				values are from 465000uV to 750000uV
- qcom,ldo-threshold-voltage:	The voltage value above which LDO is nonfunctional.
				Acceptable values are from 600000uV to 900000uV
- qcom,ldo-delta-voltage:	The delta used to reduce the requested voltage in order
				to derive the LDO output voltage while switching
				to LDO mode. Acceptable values are from 1000uV to 100000uV
- qcom,cpu-num:			Indicates what cpu this regulator controls

Optional properties:
- qcom,ldo-disable:		Indicates whether to disable using LDO mode

Any property defined as part of the core regulator
binding, defined in regulator.txt, can also be used.

Example:
	krait_pdn: krait-pdn@f9011000 {
		reg = <0xf9011000 0x1000>,
		      <0xfc4b80b0 8>;
		reg-names = "apcs_gcc", "phase-scaling-efuse";
		compatible = "qcom,krait-pdn";
		qcom,use-phase-switching;
		qcom,use-phase-scaling-factor;
		qcom,pfm-threshold = <376975>;
		#address-cells = <1>;
		#size-cells = <1>;
		ranges;

		krait0_vreg: regulator@f9088000 {
			compatible = "qcom,krait-regulator";
			regulator-name = "krait0";
			reg = <0xf9088000 0x1000>, /* APCS_ALIAS0_KPSS_ACS */
				<0xf908a800 0x1000>; /* APCS_ALIAS0_KPSS_MDD */
			reg-names = "acs", "mdd";
			regulator-min-microvolt = <500000>;
			regulator-max-microvolt = <1100000>;
			qcom,headroom-voltage = <150000>;
			qcom,retention-voltage = <675000>;
			qcom,ldo-default-voltage = <750000>;
			qcom,ldo-threshold-voltage = <850000>;
			qcom,ldo-delta-voltage = <50000>;
			qcom,cpu-num = <0>;
		};
	};
```
