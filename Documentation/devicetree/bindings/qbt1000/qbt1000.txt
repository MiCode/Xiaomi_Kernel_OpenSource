## Documentation/devicetree/bindings/regulator/kryo-regulator.txt
```
Qualcomm Technologies, Inc. Kryo Regulator

The Kryo regulator device is designed for QTI's application processor cores
that can draw power from a common power rail via a block head switch (BHS)
or from a configurable LDO when certain power constraints are met. By using
Kryo regulators, the CPU subsystem is capable of selecting LDO or BHS modes
for each cluster.

=================
First Level Nodes
=================

- compatible
	Usage:      required
	Value type: <string>
	Definition: must be "qcom,kryo-regulator"

- reg
	Usage:      required
	Value type: <prop-encoded-array>
	Definition: Specifies addresses and sizes for the memory mapped regions of the
		    power gate and LDO registers per cluster and per shared power rail
		    domain. The third address must correspond to the register space
		    containing the CPU subsystem HW revision register.

- reg-names
	Usage:      required
	Value type: <stringlist>
	Definition: Identifies the reg property entries. Must contain the following
		    strings: "pm-apc", "pm-apcc", and "apcs-csr".

- qcom,ldo-default-voltage
	Usage:      required
	Value type: <u32>
	Definition: The default value for LDO voltage in microvolts. Must be
		    between 520000 uV and 865000 uV.

- qcom,retention-voltage
	Usage:      required
	Value type: <u32>
	Definition: The value for retention voltage in microvolts. Must be
		    between 520000 and 865000 uV.

- qcom,ldo-headroom-voltage
	Usage:      required
	Value type: <u32>
	Definition: Voltage in microvolts required between the VDD_APCC voltage supply
		    and the LDO output in order for the LDO to be operational.

- qcom,vref-functional-step-voltage
	Usage:      required
	Value type: <u32>
	Definition: The voltage change in microvolts for each step in the
		    functional LDO set point.

- qcom,vref-functional-min-voltage
	Usage:      required
	Value type: <u32>
	Definition: The minimum configurable functional LDO voltage in microvolts.

- qcom,vref-retention-step-voltage
	Usage:      required
	Value type: <u32>
	Definition: The voltage change in microvolts for each step in the
		    retention LDO set point.

- qcom,vref-retention-min-voltage
	Usage:      required
	Value type: <u32>
	Definition: The minimum configurable retention LDO voltage in microvolts.

- qcom,ldo-config-init
	Usage:      required
	Value type: <u32>
	Definition: Initialization value used to configure the Kryo LDO hardware.

- qcom,apm-config-init
	Usage:      required
	Value type: <u32>
	Definition: Initialization value used to configure the Kryo APM hardware.

- qcom,cluster-num
	Usage:      required
	Value type: <u32>
	Definition: Specifies the number of the cluster this regulator controls.

==================
Second Level Nodes
==================
The second level node represents a regulator which enables control of LDO retention
mode per Kryo regulator device. This second level node is required.

The following regulator framework properties must be specified for both first and
second level nodes: regulator-name, regulator-min-microvolt, and regulator-max-microvolt.

Additional core regulator framework properties may also be used. For a full list of
supported bindings refer to Documentation/devicetree/bindings/regulator/regulator.txt.

=======
Example
=======

	kryo0_vreg: regulator@99a2000 {
		compatible = "qcom,kryo-regulator";
		regulator-name = "kryo0";
		reg = <0x99a2000 0x1000>, <0x99e0000 0x1000>,
		      <0x9820000 0x1000>;
		reg-names = "pm-apc", "pm-apcc", "apcs-csr";
		regulator-min-microvolt = <520000>;
		regulator-max-microvolt = <865000>;
		qcom,ldo-default-voltage = <750000>;
		qcom,retention-voltage = <520000>;
		qcom,ldo-headroom-voltage = <150000>;
		qcom,vref-functional-step-voltage = <4100>;
		qcom,vref-functional-min-voltage = <299000>;
		qcom,vref-retention-step-voltage = <4554>;
		qcom,vref-retention-min-voltage = <332000>;
		qcom,ldo-config-init = <0xf1f0e471>;
		qcom,apm-config-init = <0x0>;
		qcom,cluster-num = <0>;
		kryo0_retention_vreg: regulator {
			regulator-name = "kryo0-retention";
			regulator-min-microvolt = <332000>;
			regulator-max-microvolt = <865000>;
		};
	};

	kryo1_vreg: regulator@99d2000 {
		compatible = "qcom,kryo-regulator";
		regulator-name = "kryo1";
		reg = <0x99d2000 0x1000>, <0x99e0000 0x1000>,
		      <0x9820000 0x1000>;
		reg-names = "pm-apc", "pm-apcc", "apcs-csr";
		regulator-min-microvolt = <520000>;
		regulator-max-microvolt = <865000>;
		qcom,ldo-default-voltage = <750000>;
		qcom,retention-voltage = <520000>;
		qcom,ldo-headroom-voltage = <150000>;
		qcom,vref-functional-step-voltage = <4063>;
		qcom,vref-functional-min-voltage = <296000>;
		qcom,vref-retention-step-voltage = <4554>;
		qcom,vref-retention-min-voltage = <332000>;
		qcom,ldo-config-init = <0xf1f0e471>;
		qcom,apm-config-init = <0x0>;
		qcom,cluster-num = <1>;
		kryo1_retention_vreg: regulator {
			regulator-name = "kryo1-retention";
			regulator-min-microvolt = <332000>;
			regulator-max-microvolt = <865000>;
		};
	};
```

## Documentation/devicetree/bindings/regulator/max20010.txt
```
Binding for Maxim MAX20010 regulator

MAX20010 is a synchronous step-down converter. It is able to deliver upto 6A
with 2 different programmable output voltages from 0.5V to 1.27V in 10mV steps
and from 0.625V to 1.5875V in 12.5mV steps. It supports synchronous
rectification and automatic PWM/PFM transitions.

The MAX20010 interface is via I2C bus.

=======================
Supported Properties
=======================

- compatible
	Usage:      required
	Value type: <string>
	Definition: should be "maxim,max20010".

- reg
	Usage:      required
	Value type: <u32>
	Definition: The device 8-bit I2C address.

- vin-supply
	Usage:      optional
	Value type: <phandle>
	Definition: This is the phandle for the parent regulator. Typically used
		    for EN pin control of the buck.

- regulator-initial-mode
	Usage:      optional
	Value type: <u32>
	Definition: The regulator operating mode. Should be either
		    "MAX20010_OPMODE_SYNC" or "MAX20010_OPMODE_FPWM".
		    These constants are defined in file
		    include/dt-bindings/regulator/max20010.h

- maxim,vrange-sel
	Usage:      optional
	Value type: <u32>
	Definition: Integer value specifies the voltage range to be used.
		    Supported values are 0 or 1.
		    Value 0 supports voltage range from 0.5V to 1.27V in 10mV
		    steps. Value 1 supports voltage range from 0.625V to 1.5875V
		    in 12.5mV steps.

- maxim,soft-start-slew-rate
	Usage:      optional
	Value type: <u32>
	Definition: An integer value specifies the slew rate in uV/uS to be used
		    for soft-start operation of the buck. Supported values are
		    5500, 11000, 22000 and 44000.

- maxim,dvs-slew-rate
	Usage:      optional
	Value type: <u32>
	Definition: An integer value specifies the slew rate in uV/uS to be used
		    for buck dynamic voltage scaling operations. Supported
		    values are 5500, 11000, 22000 and 44000.

=======
Example
=======

	i2c_0 {
		max20010-regulator@74 {
			compatible = "maxim,max20010";
			reg = <0x74>;
			vin-supply = <&parent_reg>;
			regulator-min-microvolt = <600000>;
			regulator-max-microvolt = <1270000>;
			regulator-initial-mode = <MAX20010_OPMODE_SYNC>;
			maxim,vrange-sel = <0>;
			maxim,soft-start-slew-rate = <5500>;
			maxim,dvs-slew-rate = <5500>;
		}
	}
```

## Documentation/devicetree/bindings/regulator/mediatek,mt6317.yaml
```yaml
# SPDX-License-Identifier: GPL-2.0
%YAML 1.2
---
$id: http://devicetree.org/schemas/regulator/mediatek,mt6317.yaml#
$schema: http://devicetree.org/meta-schemas/core.yaml#

title: Mediatek MT6317 voltage regulator

maintainers:
  - Jeff Chang <jeff_chang@richtek.com>

description: |
  Mediatek MT6317 is a integrated IC that includes 8 LDOs and 3 output only
  GPIO. There's a limit for GPIO output. It tied to LDO1 output. For example,
  if LDO1 is 1.8V, the GPIO output high level will be 1.8V.

properties:
  compatible:
    const: mediatek,mt6317

  reg:
    maxItems: 1

  wakeup-source: true

  interrupts:
    maxItems: 1

  enable-gpio:
    maxItems: 1
    description: A connection of the 'enable' gpio line.

  gpio-controller: true

  gpio-supply: true

  "#gpio-cells":
    const: 2

  regulators:
    type: object

    patternProperties:
      "BASE":
        type: object
        $ref: "regulator.yaml#"

        properties:
          oc_shutdown_all:
            description: |
              If any LDO OC event occurred, to disable all LDOs or not.
            $ref: "/schemas/types.yaml#/definitions/uint32"
            minimum: 0
            maximum: 1
            default: 0

          pgb_shutdown_all:
            description: |
              If any LDO PGB event occurred, to disable all LDOs or not.
            $ref: "/schemas/types.yaml#/definitions/uint32"
            minimum: 0
            maximum: 1
            default: 0

        unevaluatedProperties: false

      "^LDO[1-8]$":
        type: object
        $ref: "regulator.yaml#"

        properties:
          oc_ptsel:
            description: Specify OC protect behavior.
            $ref: "/schemas/types.yaml#/definitions/uint32"
            minimum: 0
            maximum: 1
            default: 1

          pgb_ptsel:
            description: Specify PGB protect behavior.
            $ref: "/schemas/types.yaml#/definitions/uint32"
            minimum: 0
            maximum: 1
            default: 1

          soft_start_time_sel:
            description: Specify soft start time selection.
            $ref: "/schemas/types.yaml#/definitions/uint32"
            minimum: 0
            maximum: 3
            default: 1

        unevaluatedProperties: false

    additionalProperties: false

additionalProperties: false

examples:
  - |
    #include <dt-bindings/interrupt-controller/irq.h>
    i2c {
      #address-cells = <1>;
      #size-cells = <0>;

      mt6317@18 {
        compatible = "mediatek,mt6317-regulator";
        reg = <0x18>;
        wakeup-source;
        interrupts-extend = <&gpio26 2 IRQ_TYPE_LEVEL_LOW>;
        enable-gpio = <&gpio26 3 0>;
        gpio-supply = <&ldo1>;
        gpio-controller;
        #gpio-cells = <2>;

        regulators {
          BASE {
            regulator-name = "mt6317,base";
            oc_shutdown_all = <0>;
            pgb_shutdown_all = <0>;
          };
          ldo1: LDO1 {
            regulator-name = "mt6317,ldo1";
            regulator-min-microvolt = <1800000>;
            regulator-max-microvolt = <3200000>;
            oc_ptsel = <1>;
            pgb_ptsel = <1>;
            soft_start_time_sel = <1>;
          };
          LDO2 {
            regulator-name = "mt6317,ldo2";
            regulator-min-microvolt = <1800000>;
            regulator-max-microvolt = <3200000>;
            oc_ptsel = <1>;
            pgb_ptsel = <1>;
            soft_start_time_sel = <1>;
          };
          LDO3 {
            regulator-name = "mt6317,ldo3";
            regulator-min-microvolt = <1700000>;
            regulator-max-microvolt = <3000000>;
            oc_ptsel = <1>;
            pgb_ptsel = <1>;
            soft_start_time_sel = <1>;
          };
          LDO4 {
            regulator-name = "mt6317,ldo4";
            regulator-min-microvolt = <1700000>;
            regulator-max-microvolt = <3000000>;
            oc_ptsel = <1>;
            pgb_ptsel = <1>;
            soft_start_time_sel = <1>;
          };
          LDO5 {
            regulator-name = "mt6317,ldo5";
            regulator-min-microvolt = <1700000>;
            regulator-max-microvolt = <3000000>;
            oc_ptsel = <1>;
            pgb_ptsel = <1>;
            soft_start_time_sel = <1>;
          };
          LDO6 {
            regulator-name = "mt6317,ldo6";
            regulator-min-microvolt = <1700000>;
            regulator-max-microvolt = <3000000>;
            oc_ptsel = <1>;
            pgb_ptsel = <1>;
            soft_start_time_sel = <1>;
          };
          LDO7 {
            regulator-name = "mt6317,ldo7";
            regulator-min-microvolt = <900000>;
            regulator-max-microvolt = <1800000>;
            oc_ptsel = <1>;
            pgb_ptsel = <1>;
            soft_start_time_sel = <1>;
          };
          LDO8 {
            regulator-name = "mt6317,ldo8";
            regulator-min-microvolt = <900000>;
            regulator-max-microvolt = <1800000>;
            oc_ptsel = <1>;
            pgb_ptsel = <1>;
            soft_start_time_sel = <1>;
          };
        };
      };
    };
...
```
