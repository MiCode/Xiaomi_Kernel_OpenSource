## Documentation/devicetree/bindings/input/hbtp-input.txt
```
Platform device for Host Based Touch Processing (HBTP)

hbtp_input is a kernel driver that provides functionality needed by
Host Based Touch Processing (HBTP) from the kernel. One of the
functionality is to manage the power source for touch Analog Front
End (AFE).

Required properties:

 - compatible		: should be "qcom,hbtp-input"

Optional properties:

 - vcc_ana-supply	: Analog power supply needed to power device
 - qcom,afe-load	: AFE/Analog supply load in uA
 - qcom,afe-vtg-min	: AFE/Analog minimum voltage in uV
 - qcom,afe-vtg-max	: AFE/Analog maximum voltage in uV
 - qcom,dig-load	: Digital supply load in uA
 - qcom,dig-vtg-min	: Digital supply minimum voltage in uV
 - qcom,dig-vtg-max	: Digital supply maximum voltage in uV
 - qcom,display-resolution	: Display resolution - maxX, maxY
 - qcom,use-scale	: boolean, enables the scaling for touch coordinates
 - pinctrl-names	: defines pinctrl names
			"pmx_ts_active" : Required pinctrl name.
				This should specify active config of TS RST gpio
			"pmx_ts_suspend" : Required pinctrl name
				This should specify suspend config of TS RST gpio
			"ddic_rst_active" : Required pinctrl name
				This should specify active config of DDIC RST gpio
			"ddic_rst_suspend" : Required pinctrl name
				This should specify suspend config of DDIC RST gpio
 - pinctrl-0		: pin control to be used for TS active config
 - pinctrl-1		: pin control to be used for TS suspend config
 - pinctrl-2		: pin control to be used for DDIC active config
 - pinctrl-3		: pin control to be used for DDIC suspend config

Optional properties if qcom,use-scale DT property is defined:
 - qcom,def-maxx	: default X-resolution of the touch panel.
 - qcom,def-maxy	: default Y-resolution of the touch panel.
			(Above two properties should be defined in pairs only)
 - qcom,des-maxx	: desired X-resolution of the touch panel.
 - qcom,des-maxy	: desired Y-resolution of the touch panel.
			(Above two properties should be defined in pairs only)

Optional Properties if pinctrl names are defined:
 - qcom,pmx-ts-on-seq-delay-us : unsigned integer type for
		delay after active TS RST gpio is changed
 - qcom,fb-resume-delay-us : unsigned integer type for
		delay in early resume framebuffer callback
 - qcom,ddic-rst-on-seq-delay-us : array of unsigned integer type for
		delay of each step in series of DDIC RST gpio control

Optional Properties if qcom,afe-vtg and qcom,dig-vtg are defined
 - qcom,afe-power-on-delay-us : unsigned integer type for
		delay between turning on analog and digital power supply
 - qcom,afe-power-off-delay-us : unsigned integer type for
		delay between turning off digital and analog power supply

Example:
	&soc {
		hbtp {
			compatible = "qcom,hbtp-input";
			vcc_ana-supply = <&pm8941_l17>;
			vcc_dig-supply = <&pm8950_l16>;
			qcom,afe-load = <50000>;
			qcom,afe-vtg-min = <2850000>;
			qcom,afe-vtg-max = <2850000>;
			qcom,dig-load = <15000>;
			qcom,dig-vtg-min = <1800000>;
			qcom,dig-vtg-max = <1800000>;
			qcom,display-resolution = <719 1279>;
			qcom,use-scale;
			qcom,default-max-x = <1080>;
			qcom,default-max-y = <1920>;
			qcom,desired-max-x = <720>;
			qcom,desired-max-y = <1280>;
			pinctrl-names = "pmx_ts_active","pmx_ts_suspend",
					"ddic_rst_active", "ddic_rst_suspend";
			pinctrl-0 = <&ts_rst_active>;
			pinctrl-1 = <&ts_rst_suspend>;
			pinctrl-2 = <&ddic_rst_active>;
			pinctrl-3 = <&ddic_rst_suspend>;
			qcom,pmx-ts-on-seq-delay-us = <1000>;
			qcom,ddic-rst-on-seq-delay-us = <10000 10000 10000 10000>;
			qcom,fb-resume-delay-us = <90000>;
			qcom,afe-power-on-delay-us = <1000>;
			qcom,afe-power-off-delay-us = <6>;
		};
	};
```

## Documentation/devicetree/bindings/input/inv-mpu-sensors.txt
```
* Invensense MPU6xxx Gyro + Accelerometer
* Invensense MPU9xxx Gyro + Accelerometer + Compass

Required properties:
- compatible: The driver is compatible with
  "invensense,itg3500"
  "invensense,mpu3050"
  "invensense,mpu6050"
  "invensense,mpu9150"
  "invensense,mpu6500"
  "invensense,mpu9250"
  "invensense,mpu6xxx"
- reg: the I2C address
- interrupt-parent: the interrupt controller that it is attached to.
- interrupts: The intterrupt property of device node.
- invensense,int_config: Bits [7:3] of the int config register.
- invensense,level_shifter: 0: VLogic, 1: VDD
- invensense,orientation: the orientation matricies are 3x3 rotation matricies
  that are applied to the data to rotate from the mounting orientation to the
  platform orientation. The values must be one of 0, 1, or -1(0xff in byte
  array) and each row and column should have exactly 1 non-zero value.
- invensense,sec_slave_type: secondary slave device type
  0: SECONDARY_SLAVE_TYPE_NONE
  1: SECONDARY_SLAVE_TYPE_ACCEL
  2: SECONDARY_SLAVE_TYPE_COMPASS
  3: SECONDARY_SLAVE_TYPE_PRESSURE
- invensense,key: key for MPL library.

Example:

mpu9250@69 {
	compatible = "invensense,mpu9250";
	reg = <0x69>;
	interrupt-parent = <&gpio>;
	interrupts = <144 0x01>;
	invensense,int_config = <0x10>;
	invensense,level_shifter = <0>;
	invensense,orientation = [01 00 00 00 01 00 00 00 01];
	invensense,sec_slave_type = <0>;
	invensense,key = [4e cc 7e eb f6 1e 35 22 00 34 0d 65 32 e9 94 89];
};
```

## Documentation/devicetree/bindings/input/misc/akm09911.txt
```
AKM AK09911 3-axis electronic compass driver

Required properties:

 - compatible		: Should be "ak,ak09911" or "akm,akm09911".
 - reg				: i2c address of the device.
 - pinctrl-names	: The pinctrl configration names of this sensor driver. Should be "default","reset".
 - pinctrl-0		: The pinctrl node corresponding to "default", should be <&akm_default>.
 - pinctrl-1		: The pinctrl node corresponding to "reset", should be <&akm_reset>.
 - vdd-supply		: Analog power supply needed to power up the device.
 - vio-supply		: Digital IO power supply needed for IO and I2C.
 - akm,layout		: The layout of the ecompass sensor chip. There are 8
	patterns of layout described as below:
	0: Indicate the invalid pattern, The userspace will decide the pattern.
	1: 1st pin is right down
	2: 1st pin is left down
	3: 1st pin is left top
	4: 1st pin is right top
	5: 1st pin is left down (from top view)
	6: 1st pin is left top (from top view)
	7: 1st pin is right top (from top view)
	8: 1st pin is right down (from top view)
 - akm,gpio_rstn	: The gpio pin to reset the sensor chip.

Optional properites:

 - akm,auto-report	: Enable auto-report mode.
 - akm,use-hrtimer	: Enable the hrtimer mode. The hrtimer will be used as the poling
	 delay timer, and high priority workqueue will be used in order to get a more stable polling interval.

 Example:
	akm@c {
			compatible = "ak,ak09911";
			reg = <0x0c>;
			pinctrl-names = "default","reset";
			pinctrl-0 = <&akm_default>;
			pinctrl-1 = <&akm_reset>;
			vdd-supply = <&pm8110_l19>;
			vio-supply = <&pm8110_l14>;
			akm,layout = <0x0>;
			akm,gpio_rstn = <&msmgpio 82 0x0>;
			akm,auto-report;
	};
```

## Documentation/devicetree/bindings/input/misc/akm8963.txt
```
AKM AK8963 3-axis electronic compass driver

Required properties:

 - compatible		: Should be "ak,ak8963" or "akm,akm8963".
 - reg			: i2c address of the device.
 - pinctrl-names	: The pinctrl configration names of this sensor driver. Should be "ak8963_default".
 - pinctrl-0		: The pinctrl node corresponding to "ak8963_default", should be <&ak8963_default>.
 - interrupt-parent	: Parent of interrupt.
 - interrupts		: Ecompass interrupt to indicate new data ready.
 - vdd-supply		: Analog power supply needed to power up the device.
 - vio-supply		: Digital IO power supply needed for IO and I2C.
 - ak,layout		: The layout of the ecompass sensor chip. There are 8
	patterns of layout described as below:
	0: Indicate the invalid pattern, The userspace will decide the pattern.
	1: 1st pin is right down
	2: 1st pin is left down
	3: 1st pin is left top
	4: 1st pin is right top
	5: 1st pin is left down (from top view)
	6: 1st pin is left top (from top view)
	7: 1st pin is right top (from top view)
	8: 1st pin is right down (from top view)

Optional properites:
 - ak,gpio_rstn		: The gpio pin to reset the sensor chip.
 - ak,auto-report	: Enable auto-report mode.
 Example:
	akm@c {
			compatible = "ak,ak8963";
			reg = <0x0c>;
			pinctrl-names = "ak8963_default";
			pinctrl-0 = <&ak8963_default>;
			interrupt-parent = <&msm_gpio>;
			interrupts = <69 0x2>;
			vdd-supply = <&pm8916_l17>;
			vio-supply = <&pm8916_l6>;
			ak,layout = <0x0>;
			ak,gpio_rstn = <&msm_gpio 82 0x0>;
			ak,auto-report;
	};
```

## Documentation/devicetree/bindings/input/misc/ap3426.txt
```
AP3426 3-in-1 digital ALS+PS+IRLED module

AP3426 is a module integrated with a digital ambient light sensor, a proximity
sensor, and an IR LED in a single package. It provides multiple gain ambient
light detection as well as external object distance detection. It can be
connected to host processor via i2c.

Required properties:
 - compatible		: Should be "di,ap3426".
 - reg			: i2c slave address of this device.
 - vdd-supply		: Analog power supply needed to power up this device.
 - vio-supply		: Digital IO power supply needed for IO and i2c.
 - interrupt-parent	: The interrupt controler this device connected to.
 - interrupts		: L/P sample interrupt to indicate new data ready.
 - pinctrl-names	: pinctrl configuration names of this device. Should be "default" and "sleep".
 - pinctrl-0		: Should specify pin control groups used for this sensor.
 - pinctrl-1		: Should specify pin control groups used for this sensor.
 - di,irq-gpio		: GPIO pin for interrupt of this device.
 - di,als-cal		: Coefficient to calibrate this device for specific board.
 - di,als-gain		: Default als gain configuration for the device. 0 for 32768,
		1 for 8192, 2 for 2048 and 3 for 512.
 - di,als-persist	: Interrupt persist configuration for the device. It indicates
		how much conversion cycles will trigger ALS interrupt. The maximum value
		is 63.
 - di,ps-led-driver	: Specifies proximity LED driver ratio based on 140mA of this device.
		0 for 16.7%, 1 for 33.3%, 2 for 66.7% and 3 for 100%.
 - di,ps-mean-time	: Configures response time of proximity detection cycle. 0 for conversion
		time 5ms, 1 for conversion time 9.6ms, 2 for conversion time 14.1ms and 3 for
		conversion time 18.7ms.
 - di,ps-integrated-time: Selects the duration at which the device's ADC will sample the
		photodiode current signal. The maximum value is 63.


Optional properties:
 - di,ps-distance-table	: Calibrated ADC value of proximity sensor to indicate the distance of
		the object in centimeter. The value in this table should in descend order and the
		maximum value is 1023. Use default value if not exist.
 - di,als-sensitivity	: Ambient light sensitivity in lux. This array configures how much light
		intensity change will trigger a light sensor event. The array size should be 4.
 - di,wakeup-threshold	: This value configures the threshold in centimeter that can wake up
		SoC when system is suspended. This value should between 0 and
		ARRAY_SIZE(di,ps-distance-table).

Example:

i2c@78b5000 { /* BLSP1 QUP1 */
	di@1e {
		compatible = "di,ap3426";
		reg = <0x1e>;
		vdd-supply = <&pm8909_l17>;
		vio-supply = <&pm8909_l6>;
		interrupt-parent = <&msm_gpio>;
		interrupts = <94 0x2002>;
		pinctrl-names = "default","sleep";
		pinctrl-0 = <&ap3426_default>;
		pinctrl-1 = <&ap3426_sleep>;
		di,irq-gpio = <&msm_gpio 94 0x2002>;
		di,als-cal = <6>;
		di,als-gain = <0>;
		di,als-persist = <1>;
		di,ps-gain = <1>;
		di,ps-persist = <2>;
		di,ps-led-driver = <3>;
		di,ps-mean-time = <0>;
		di,ps-integrated-time = <0>;
		di,ps-distance-table = <887 282 111 78 53 46>;
		di,als-sensitivity = <200 40 10 1>;
		di,wakeup-threshold = <4>;
	};
};
```

## Documentation/devicetree/bindings/input/misc/apds993x.txt
```
Avago apds993x and apds990x ambient light + proximity combo driver.

Required properties:

 - compatible					: Should be "avago,apds9930" or "avago,apds9900".
 - reg							: i2c slave address of the device.
 - pinctrl-names				: The pinctrl configration names of this sensor driver. Should be
					"default" and "sleep".
 - pinctrl-0					: Should specify pin control groups used for this controller.
 - pinctrl-1					: Should specify pin control groups used for this controller.
 - interrupt-parent				: Parent of interrupt.
 - interupts					: L/P sample interrupt to indicate new data ready.
 - vdd-supply					: Power supply needed to power up the device.
 - vio-supply					: IO power supply needed for IO and I2C.
 - avago,irq-gpio				: The gpio pin for the interrupt.
 - avago,ps-threshold			: The threshold adc value for proximity sensor
				to trigger away interrupt.
 - avago,ps-hysteresis-threshold: The hysteresis threshold adc value for
				proximity sensor to trigger  close interrupt.
 - avago,ps-pulse				: The proximity pulse that the LDR will generate.
 - avago,ps-gain				: The proximity gain of the sensor.
 - avago,als-B					: Tuning value of COE_B parameter.
 - avago,als-C					: Tuning value of COE_C parameter.
 - avago,als-D					: Tuning value of COE_D parameter.
 - avago,ga-value				: Tuning value of the gain for light sensor.

 Optional properties:

 - avago,cross-talk                             : Calibrate the threshold of proximity sensor.
					the cross-talk value is raw data of proximity.

 - avago,default-cal				: Boolean to select calibration,if this property is defined
						sensor will be use default calibration, otherwise the sensor
						will be use factroy calibration.

 Example:

&i2c_0 { /* BLSP1 QUP2 */
	 avago@39 {
		 compatible = "avago,apds9930";
		 reg = <0x39>;
		 pinctrl-names = "default","sleep";
		 pinctrl-0 = <&apds99xx_default>;
		 pinctrl-1 = <&apds99xx_sleep>;
		 interrupt-parent = <&msmgpio>;
		 interrupts = <80 0x2>;
		 vdd-supply = <&pm8110_l19>;
		 vio-supply = <&pm8110_l14>;
		 avago,irq-gpio = <&msmgpio 80 0x2>;
		 avago,ps_threshold = <600>;
		 avago,ps_hysteresis_threshold = <500>;
		 avago,cross-talk = <0>;
		 avago,ps_pulse = <8>;
		 avago,ps_pgain = <0>;
		 avago,als_B = <223>;
		 avago,als_C = <70>;
		 avago,als_D = <142>;
		 avago,ga_value = <48>;
		 avago,default-cal;
	 };
};
```
