## Documentation/devicetree/bindings/input/misc/bma2x2.txt
```
BOSCH bma2x2 3-axis accelerometer sensor driver.

Required properties:

 - compatible		: Should be "bosch,bma2x2".
 - reg			: i2c slave address of the device.
 - pinctrl-names	: Pinctrl configuration names of this sensor driver.
				Should be "default".
 - pinctrl-0		: The pinctrl node corresponding to "default",
				should be <&bma2x2_int1_default &bma2x2_int2_default>.
 - interrupt-parent	: Parent of interrupt.
 - interrupts		: Accelerometer interrupts to indicate new data ready or events.
 - vdd-supply		: Analog power supply needed to power device.
 - vio-supply		: Digital IO power supply needed for IO and I2C.
 - bosch,init-interval	: Initial data polling interval in millisecond.
 - bosch,place		: The placing of the accelerometer on board. There are 8
				patterns of placing described as below:
				0: 1st pin is right down
				1: 1st pin is left down
				2: 1st pin is left top
				3: 1st pin is right top
				4: 1st pin is left down (from top view)
				5: 1st pin is left top (from top view)
				6: 1st pin is right top (from top view)
				7: 1st pin is right down (from top view)

Optional properties:

 - bosch,gpio-int1	: 1st irq gpio which is to provide interrupts
				to host, interrupt events can be route to any of
				these two irq pins according device configuration.
 - bosch,gpio-int2	: 2nd irq gpio which is to provide interrupts
				to host.

Example:
&i2c_0 { /* BLSP1 QUP2 */
	 bosch@18 { /* Accelerometer sensor */
		compatible = "bosch,bma2x2";
		reg = <0x18>;
		pinctrl-names = "default";
		pinctrl-0 = <&bma2x2_int1_default &bma2x2_int2_default>;
		interrupt-parent = <&msm_gpio>;
		interrupts = <112 0x2002>;
		vdd-supply = <&pm8916_l17>;
		vio-supply = <&pm8916_l6>;
		bosch,init-interval = <200>;
		bosch,place = <1>;
		bosch,gpio-int1 = <&msm_gpio 112 0x2002>;
		bosch,gpio-int2 = <&msm_gpio 114 0x2002>;
	};
};
```

## Documentation/devicetree/bindings/input/misc/bmg160.txt
```
Bosch bmg160 3 Axis gyroscope sensor driver

Required properties:

 - compatible		: Should be "bosch,bmg160".
 - reg			: i2c slave address of the device.
 - vdd-supply		: Analog power supply needed to power device.
 - vi2c-supply		: Digital IO Power supply needed for I2C.

Example:
	bmg160@69 { /* Gyroscope sensor */
			compatible = "bosch,bmg160";
			reg = <0x69>;
			vdd-supply = <&pm8916_l17>;
			vi2c-supply = <&pm8916_l16>;
	};
```

## Documentation/devicetree/bindings/input/misc/bmm150.txt
```
BOSCH BMM150 3-axis magnetic sensor

The BOSCH 3-axis magnetic sensor is a complete 3-axis magnetic sensor with
on-chip signal processing and intergrated i2c bus. It can be connected to host
processor via i2c. It can measure magnetic fields within the full scale range
from -16 Gauss to +16 Gauss.

Required properties:

 - compatible		: Should be "bosch,bmm150".
 - reg			: i2c address of the device.
 - vdd-supply		: Analog power supply needed to power up the device.
 - vio-supply		: Digital IO power supply needed for IO and I2C.
 - bmm,dir		: String value of the direction of the ecompass sensor
	chip. There are 8 patterns of direction:


       x > 0 /___________o
               /        /|
              /        / |* 1st pin is here
             /________/ /|
             |_______/|/ |/ z > 0
                    /
                  |/ y > 0


		The above graph shows the coordination of the sensor chip. Specify the
		following string to bosch,dir to convert it into Android coordination.
		Note the definition of sensor placement on target board is relative to
		Android portrait mode.

						left	right	up	down
		obverse-x-axis-forward		Y+	Y-	X+	X-
		obverse-x-axis-rightward	X-	X+	Y+	Y-
		obverse-x-axis-backward		Y-	Y+	X-	X+
		obverse-x-axis-leftward		X+	X-	Y-	Y+
		reverse-x-axis-forward		Y-	Y+	X+	X-
		reverse-x-axis-rightward	X-	X+	Y-	Y+
		reverse-x-axis-backward		Y+	Y-	X-	X+
		reverse-x-axis-leftward		X+	X-	Y+	Y-

Optional properites:

 - bmm,auto-report	: Boolean value to enable auto-report mode.

 Example:
	A chip on 8916 platform with the pattern as the above graph:
	&i2c_0 { /* BLSP1 QUP2 */
		bosch@12 {
				compatible = "bosch,bmm150";
				reg = <0x12>;
				vdd-supply = <&pm8916_l17>;
				vio-supply = <&pm8916_l6>;
				bmm,dir = "obverse-x-axis-forward";
				bmm,auto-report;
		};
	};
```

## Documentation/devicetree/bindings/input/misc/bmp180.txt
```
Bosch BMP18x-series altimeter driver

Required properties:

 - compatible			: Should be "bosch,bmp180".
 - reg					: i2c slave address of the device.
 - vdd-supply		: Analog power supply needed to power device.
 - vddio-supply		: Digital IO power supply needed for IO and I2C.
 - bosch,chip-id		: Chip id for the bmp18x altimeter sensor.
 - bosch,oversample	: Sensor default oversampling value.
				Default oversampling value to be used at startup.
				Value range is 0-3 with rising sensitivity.
 - bosch,period	: Temperature measurement period (milliseconds).
				Set to zero if unsure.

Optional properties:

 - bosch,sw-oversample	: Boolean to enable software oversampling if
				this property is defined. Only take effect when
				default_oversampling is 3.

Example:
	i2c@f9925000 {
		bmp180@77 {
			status = "okay";
			reg = <0x77>;
			compatible = "bosch,bmp180";
			vdd-supply = <&pm8110_l19>;
			vddio-supply = <&pm8110_l14>;
			bosch,chip-id = <0x55>;
			bosch,oversample = <3>;
			bosch,period = <1000>;
			bosch,sw-oversample;
		};
	};
```

## Documentation/devicetree/bindings/input/misc/cm36283.txt
```
Capella cm36283 L/P sensor

Required properties:

 - compatible		: Should be "capella,cm36283".
 - reg				: i2c slave address of the device.
 - interrupt-parent	: Parent of interrupt.
 - interrupts		: L/P sample interrupt to indicate new data ready.
 - vdd-supply		: Power supply needed to power up the device.
 - vio-supply		: IO power supply needed for IO and I2C.
 - capella,interrupt-gpio	: The gpio pin for the interrupt.
 - capella,levels	: The adc value for light sensor to trigger different light level.
 - capella,ps_close_thd_set	: The threshold adc value for proximity sensor to trigger close  interrupt.
 - capella,ps_away_thd_set: The threshold adc value for proximity sensor to trigger away interrupt.
 - capella,ls_cmd	: The initial value to configure cm36283 ALS_CONF register.
 - capella,ps_conf1_val	: The initial value to configure cm36283 PS_CONF1 register.
 - capella,ps_conf3_val	: The initial value to configure cm36283 PS_CONF3 register.

Optional properties:

 - capella,use-polling	: Property to specify if using polling instead of interrupt for adc value report.

Example:

		capella@60 {
				compatible = "capella,cm36283";
				reg = <0x60>;
				interrupt-parent = <&msmgpio>;
				interrupts = <80 0x2>;
				vdd-supply = <&pm8110_l19>;
				vio-supply = <&pm8110_l14>;
				capella,use-polling;
				capella,interrupt-gpio = <80>;
				capella,levels = <0x0A 0xA0 0xE1 0x140 0x280 0x500 0xA28 0x16A8 0x1F40 0x2800>;
				capella,ps_close_thd_set = <0xa>;
				capella,ps_away_thd_set = <0x5>;
				capella,ls_cmd = <0x44>;  /* PS_IT=160ms, INT_PERS=2*/
				capella,ps_conf1_val = <0x0006>;  /*CM36283_PS_ITB_1_2 | CM36283_PS_DR_1_40| CM36283_PS_IT_1T | CM36283_PS_PERS_2 | CM36283_PS_RES_1*/
				capella,ps_conf3_val = <0x3010>;  /* CM36283_PS_MS_NORMAL | CM36283_PS_PROL_255 | CM36283_PS_SMART_PERS_ENABLE, */
		};
```

## Documentation/devicetree/bindings/input/misc/hbtp-input.txt
```
Platform device for Host Based Touch Processing (HBTP)

hbtp_input is a kernel driver that provides functionality needed by
Host Based Touch Processing (HBTP) from the kernel. One of the
functionality is to manage the power source for touch Analog Front
End (AFE).

Required properties:

 - compatible		: should be "qcom,hbtp-input"

Optional properties:

 - vcc_ana-supply	: Analog power supply needed to power device
 - qcom,afe-load	: AFE load in uA
 - qcom,afe-vtg-min	: AFE minimum voltage in uV
 - qcom,afe-vtg-max	: AFE maximum voltage in uV

Example:
	&soc {
		hbtp {
			compatible = "qcom,hbtp-input";
			vcc_ana-supply = <&pm8941_l18>;
			qcom,afe-load = <150000>;
			qcom,afe-vtg-min = <2700000>;
			qcom,afe-vtg-max = <3300000>;
		};
	};
```

## Documentation/devicetree/bindings/input/misc/hbtp_input.txt
```
Platform device for Host Based Touch Processing (hbtp)

Required properties:

 - compatible		: should be "qcom,hbtp"
 - vcc_ana-supply	: Analog power supply needed to power device

Example:
	&soc {
		hbtp {
			compatible = "qcom,hbtp";
			vcc_ana-supply = <&pm8941_l18>;
		};
	};
```

## Documentation/devicetree/bindings/input/misc/isl29044a.txt
```
Intersil isl29044a L/P sensor

Required properties:

 - compatible			: Should be "intersil,isl29044a".
 - reg				: i2c slave address of the device.
 - vdd-supply			: Power supply needed to power up the device.
 - vio-supply			: IO power supply needed for IO and I2C.
 - intersil,als-range		: Light Sensor als range, 0: 0-125 Lux, 1: 0-2000Lux
 - intersil,ps-lt		: proximity low threshold. The proximity interrupt
				event is governed by the high and low thresholds.
 - intersil,ps-ht		: proximity high threshold.

Example:
i2c@f9925000 { /* BLSP-1 QUP-3 */
	intersil@44 {
		compatible = "intersil,isl29044a";
		reg = <0x44>;
		vdd-supply = <&pm8110_l19>;
		vio-supply = <&pm8110_l14>;
		intersil,als-range = <1>;
		intersil,ps-lt = <30>;
		intersil,ps-ht = <50>;
	};
};
```
