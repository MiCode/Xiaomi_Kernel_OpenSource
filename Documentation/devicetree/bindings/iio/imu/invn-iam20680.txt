## Documentation/devicetree/bindings/iio/imu/invn-iam20680.txt
```
The IAM20680 sensor is 6-axis gyroscope+accelerometer combo
device which is made by InvenSense Inc.

Required properties:

 - compatible   : Should be "invn,iam20680".
 - reg          : the I2C address which depends on the AD0 pin.
 - gpios        : INVENSENSE GPIO in the format described by ../gpio/gpio.txt

Optional properties:
 - inven,vdd_ana-supply :
 - inven,vcc_i2c-supply :
 - inven,gpio_int1 :
 - axis_map_x :
 - axis_map_y :
 - axis_map_z :
 - negate_x   :
 - negate_y   :
 - negate_z   :
 - fs_range :
 - poll_interval :
 - min_interval :
 - inven,secondary_reg :
 - inven,secondary_type :
 - inven,secondary_name :
 - inven,secondary_axis_map_x :
 - inven,secondary_axis_map_y :
 - inven,secondary_axis_map_z :
 - inven,secondary_negate_x :
 - inven,secondary_negate_y :
 - inven,secondary_negate_z :
 - inven,aux_type :
 - inven,aux_name :
 - inven,aux_reg :
 - inven,read_only_slave_type :
 - inven,read_only_slave_name :
 - inven,read_only_slave_reg :

Example:
	iam20680@69 {
		compatible = "inven,iam20680";
		reg = <0x69>;
		pinctrl-names = "default";
		pinctrl-0 = <&int1_default>;
		interrupt-parent = <&tlmm_pinmux>;
		interrupts = <78 IRQ_TYPE_EDGE_RISING>;
		inven,vdd_ana-supply = <&pm8941_l17>;
		inven,vcc_i2c-supply = <&pm8941_lvs1>;
		inven,gpio_int1 = <&msmgpio 73 0x00>;
		axis_map_x = <1>;
		axis_map_y = <0>;
		axis_map_z = <2>;
		negate_x = <1>;
		negate_y = <0>;
		negate_z = <0>;
		fs_range = <0x00>;
		poll_interval = <200>;
		min_interval = <5>;
		inven,secondary_reg = <0x0c>;
		/* If no compass sensor,
		 * replace "compass" with "none"
		 */
		inven,secondary_type = "compass";
		inven,secondary_name = "ak09911";
		inven,secondary_axis_map_x = <1>;
		inven,secondary_axis_map_y = <0>;
		inven,secondary_axis_map_z = <2>;
		inven,secondary_negate_x = <1>;
		inven,secondary_negate_y = <1>;
		inven,secondary_negate_z = <1>;
		/* If no pressure sensor,
		 * replace "pressure" with "none"
		 */
		inven,aux_type = "pressure";
		inven,aux_name = "bmp280";
		inven,aux_reg = <0x76>;
		/* If no ALS sensor
		 * replace "als" with "none"
		 */
		inven,read_only_slave_type = "als";
		inven,read_only_slave_name = "apds9930";
		inven,read_only_slave_reg = <0x39>;
	};
```

## Documentation/devicetree/bindings/iio/imu/invn-icm20602.txt
```
The ICM20602 sensor is 6-axis gyroscope+accelerometer combo
device which is made by InvenSense Inc.

Required properties:

 - compatible	: Should be "invensense,icm20602".
 - reg	: the I2C address which depends on the AD0 pin.
 - interrupt-parent	: should be the phandle for the interrupt controller
 - interrupts	: interrupt mapping for GPIO IRQ

Optional properties:
 - invensense,icm20602-gpio:  the irq gpio. This is not used if
 using SMD to trigger. this is needed only if using the
 device IRQ to trigger. Only using SMD to trigger can
 support 8K sample rate.

Example:
	icm20602-i2c@068 {
		compatible = "invensense,icm20602";
		reg = <0x68>;
		interrupt-parent = <&msm_gpio>;
		interrupts = <13 0>;
		invensense,icm20602-gpio = <&msm_gpio 13 0x0>;
		pinctrl-names = "imu_active","imu_suspend";
		pinctrl-0 = <&imu_int_active>;
		pinctrl-1 = <&imu_int_suspend>;
		status = "okay";
	};
```

## Documentation/devicetree/bindings/iio/imu/invn-icm20689.txt
```
The ICM20689 sensor is 6-axis gyroscope+accelerometer combo
device which is made by InvenSense Inc. It can be accessed
via SPI bus with max frequency up to 8MHz. The recommended
SPI mode is the mode 3(CPOL=1, CPHA=1).

The datasheet can be found as the following link:
https://www.invensense.com/products/motion-tracking/6-axis/icm-20689/


Required properties:

 - compatible		: Should be "invn,icm20689".
 - reg		: the Chip select ID.
 - spi-max-frequency: the SPI bus max frequency

Optional properties:
 - invn,icm20689-irq:  the irq gpio. This is not used if
 using SMD to trigger. this is needed only if using the
 device IRQ to trigger. Only using SMD to trigger can
 support 8K sample rate.

 - spi-cpol		: SPI MODE(CPOL)
 - spi-cpha		: SPI MODE(CPHA)

Example:
	spi@78b6000 {
		icm20689-spi@0 {
			compatible = "invn,icm20689";
			reg = <0>;
			spi-max-frequency = <8000000>;
			invn,icm20689-irq = <&msm_gpio 96 0>;
			spi-cpol;
			spi-cpha;
		};
	};
```

## Documentation/devicetree/bindings/iio/imu/st-asm330.txt
```
The ASM330 is a highly integrated, low power inertial measurement unit (IMU)
that provides precise acceleration and angular rate (gyroscopic) measurement.

To enable driver probing, add the asm330lhh node to the platform device tree as described below.

Required properties:

- compatible: "st,asm330lhh"
- reg: the I2C address or SPI chip select the device will respond to
- interrupt-parent: phandle to the parent interrupt controller as documented in [interrupts][4]
- interrupts: interrupt mapping for IRQ as documented in [interrupts][4]

Recommended properties for SPI bus usage:
- spi-max-frequency: maximum SPI bus frequency as documented in [SPI][3]

Optional properties:
- st,drdy-int-pin: MEMS sensor interrupt line to use (default 1)

I2C example (based on Raspberry PI 3):

	&i2c0 {
		status = "ok";
		#address-cells = <0x1>;
		#size-cells = <0x0>;
		asm330lhh@6b {
			compatible = "st,asm330lhh";
			reg = <0x6b>;
			interrupt-parent = <&gpio>;
			interrupts = <26 IRQ_TYPE_EDGE_RISING>;
		};

SPI example (based on Raspberry PI 3):

	&spi0 {
		status = "ok";
		#address-cells = <0x1>;
		#size-cells = <0x0>;
		asm330lhh@0 {
			spi-max-frequency = <500000>;
			compatible = "st,asm330lhh";
			reg = <0>;
			interrupt-parent = <&gpio>;
			interrupts = <26 IRQ_TYPE_EDGE_RISING>;
		};
```

## Documentation/devicetree/bindings/iio/imu/st_sensor_hub.txt
```
* STMicroelectronics sensor-hub sensor

Required properties:

  - compatible : should be "st,lis331eb" or "st,lsm6db0"
  - reg : the I2C address of the sensor-hub
  - interrupt-parent : should be the phandle for the interrupt controller
  - interrupts : interrupt mapping for GPIO IRQ, it should by configured with
		flags IRQ_TYPE_EDGE_RISING
  - st,wakeup-gpio : needed to wake-up sensor hub when in sleep mode

Optional properties:

  - st,reset-gpio : needed to reset sensor hub @ boot time

Example:

lsm6db0@03 {
	compatible = "st,lsm6db0";
	reg = <0x03>;
	interrupt-parent = <&gpio>;
	interrupts = <1 IRQ_TYPE_EDGE_RISING>;

	st,wakeup-gpio = <&gpio 2 0x00>;
	st,reset-gpio = <&gpio 3 0x00>;
};
```

## Documentation/devicetree/bindings/iio/sprd_hub/sprd,sensorhub.yaml
```yaml
# SPDX-License-Identifier: (GPL-2.0 OR BSD-2-Clause)

$id: "http://devicetree.org/schemas/unisoc_platform/sprd,powerstat.yaml#"
$schema: "http://devicetree.org/meta-schemas/core.yaml#"

title: Unisoc sensor hub bindings

description: Unisoc's some SoCs integrates sensor hub. This sensor hub driver collect and
analyze data uploaded from sensors.

Required properties:
- compatible: consisted of platform name and common name.
 - "sprd,sharkl3-sensorhub", "sprd,sensor-hub": for Sharkl3-compatible sensor hub
 - "sprd,sharkl5-sensorhub", "sprd,sensor-hub": for Sharkl5-compatible sensor hub
 - "sprd,sharkl5Pro-sensorhub", "sprd,sensor-hub": for Sharkl5pro-compatible sensor hub
 - "sprd,roc1-sensorhub", "sprd,sensor-hub": for Roc1-compatible sensor hub
 - "sprd,qogirl6-sensorhub", "sprd,sensor-hub": for qogirl6-compatible sensor hub
 - "sprd,qogirn6pro-sensorhub", "sprd,sensor-hub": for qogirn6pro-compatible sensor hub

- sipc-sensorhub-id: define sensorhub id value in sipc communication
 - <6>: SIPC_ID_PM_SYS, sensorhub running on sp sys,
 - <9>: SIPC_ID_CH, sensorhub running on ch sys,
 if sipc-sensorhub-id not defined, sensorhub driver code will use 6 as default

examples:
sensorhub {
 		compatible = "sprd,sharkl5-sensorhub", "sprd,sensor-hub";
 		sipc-sensorhub-id = <6>;
 	};
```

## Documentation/devicetree/bindings/input/ak-akm89xx.txt
```
* Asahi Kasei AKM89XX compass sensor

Required properties:
- compatible: should be one of the following.
  - "ak,ak8963"
  - "ak,ak8972"
  - "ak,ak8975"
- reg: the I2C address of AKM89XX
- config: the selection determines the device behavior.
  - "auto": auto detect connection to MPU
  - "mpu": connected to MPU
  - "host": connected to host
- orientation: the orientation matricies are 3x3 rotation matricies that are
  applied to the data to rotate from the mounting orientation to the platform
  orientation. The values must be one of 0, 1, or -1(0xff in byte array) and
  each row and column should have exactly 1 non-zero value.

Example:

akm8963@0d {
	compatible = "ak,ak8963";
	reg = <0x0d>;
	orientation = [00 01 00 ff 00 00 00 00 01];
	config = "mpu";
};
```

## Documentation/devicetree/bindings/input/capella-cm3217.txt
```
* Capella CM3217 Ambient light sensor

Required properties:
- compatible: "capella,cm3217"
- reg : the I2C address of CM3217

Example:

cm3217@10 {
	compatible = "capella,cm3217";
	reg = <0x10>;
};
```

## Documentation/devicetree/bindings/input/fpc1020.txt
```
Fingerprint Cards FPC1020 Swipe Sensor (SPI)

Required properties:
- compatible        : Should be "fpc,fpc1020".
- reg               : Offset and length of the register regions for the device
- spi-max-frequency : Specifies maximum SPI clock frequency, Units - Hz.
- fpc,gpio_irq      : GPIO input for sensor IRQ
- fpc,gpio_reset    : GPIO output for sensor reset signal
- fpc,gpio_cs       : GPIO output for sensor chip select signal
- vcc_spi-supply    : Power supply regulator for SPI core
- vdd_ana-supply    : Power supply regulator for sensor core and analog supply ("VDDA")
- vdd_io-supply     : Power supply regulator sensor I/O ("VDDIO")

Optional properties:
- fpc,vddtx_mv : TxOut, external power supply voltage in millivolt.
                 "0", or missing entry, selects internal supply (sourced from VDDA)

- fpc,txout_boost_enable : If defined, enable voltage boost for internal TxOut power
                           supply. External TxOut power overrides this setting.

- fpc,force_hwid : If defined, override chip hardware identifier.

- fpc,use_fpc2050 : If defined hwid/sensorid will translate to one with bezel independent imaging

Example:
	spi@f9925000 {
		status = "ok";
		fpc_fpc1020 {
			compatible = "fpc,fpc1020";
			reg = <2>;
			spi-max-frequency = <16000000>;
			fpc,gpio_irq	= <86>;
			fpc,gpio_reset	= <64>;
			fpc,gpio_cs	= <85>;
			/* fpc,vddtx_mv	= <3300>;  */
			/* fpc,txout_boost_enable; */
			/* fpc,force_hwid = <0x1234> */
			vcc_spi-supply	= <&pm8941_s3>;
			vdd_ana-supply	= <&pm8941_lvs1>;
			vdd_io-supply	= <&pm8941_lvs1>;
		};
	};
```

## Documentation/devicetree/bindings/input/gen_vkeys.txt
```
Touchscreen Virtual Keys Device

Generate virtual keys sysfs entry for Android

Required properties:

 - compatible	: should be "qcom,gen-vkeys"
 - label		: name of the touch controller
 - qcom,disp-maxx	: Maximum x-coordinate of display
 - qcom,disp-maxy	: Maximum y-coordinate of display
 - qcom,panel-maxx	: Maximum x-coordinate of touch panel
 - qcom,panel-maxy	: Maximum y-coordinate of touch panel
 - qcom,key-codes	: Array of key codes for virtual keys

Optional properties:
 - qcom,y-offset	: Offset of y-location for virtual keys, default 0

Example:
	gen-vkeys {
		compatible = "qcom,gen-vkeys";
		label = "atmel_mxt_ts";
		qcom,disp-maxx = <720>;
		qcom,disp-maxy = <1280>;
		qcom,panel-maxx = <760>;
		qcom,panel-maxy = <1424>;
		qcom,key-codes = <158 139 102 217>;
		qcom,y-offset = <35>;
	};
```

## Documentation/devicetree/bindings/input/hall_sensor.txt
```
Hall sensor driver

Hall sensor is a switch. It senses magnetic field change and trigger interrupts to cpu.

Required properties:

 - compatible		: Should be "hall-switch".
 - pinctrl-names	: Pinctrl configuration names of this sensor driver.
				Should be "default".
 - interrupt-parent	: Parent of interrupt.
 - interrupts		: Hall Sensor interrupts to indicate new data ready or events.
 - vddio-supply		: Analog power supply needed to power device.
 - linux,gpio-int	: Irq gpio which is to provide interrupts to host.
 - linux,min-uv		: Device required minimum voltage.
 - linux,max-uv		: Device required max voltage.

Optional properties:

 - linux,wakeup		: Boolean to select interrupt wakeup or not, if this property is defined
				device will wakeup system.

Example:
 &soc {
	hall {
		compatible = "hall-switch";
		pinctrl-names = "default";
		pinctrl-0 = <&hall_sensor_int_default>;
		interrupt-parent = <&msm_gpio>;
		interrupts = <36 0x2003>;
		vddio-supply = <&pm8909_l6>;
		linux,gpio-int = <&msm_gpio 36 0x1>;
		linux,wakeup;
		linux,min-uv = <1650000>;
		linux,max-uv = <3300000>;
	};
 };
```
