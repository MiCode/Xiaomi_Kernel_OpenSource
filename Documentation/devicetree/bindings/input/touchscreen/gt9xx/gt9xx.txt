## Documentation/devicetree/bindings/input/touchscreen/maxim-sti.txt
```
Maxim STI touch controller:

Required properties:
- spi-max-frequency: Maximum SPI frequency supported by the controller.
- avdd-supply: analog power supply.
- dvdd-supply: digial power supply.
- maxim_sti,irq-gpio: irq gpio.
- maxim_sti,reset-gpio: reset gpio.
- maxim_sti,touch_fusion: path to touch_fusion daemon.
- maxim_sti,config_file: path to config file.
- maxim_sti,fw_name: name of firmware file.

Optional properties:
 - pinctrl-names	: this should be defined if a target uses pinctrl framework.
			See "pinctrl" in documentation/devicetree/bindings/pinctrl/msm-pinctrl.txt.
			It should specify the names of the configs that pinctrl can install in driver.
			Following are the pinctrl configs that can be installed:
			"pmx_ts_active" : active configuration of pins. This should specify active
			config defined in pin groups of interrupt and reset gpios.
			"pmx_ts_suspend" : disabled configuration of pins. This should specify sleep
			config defined in pin groups of interrupt and reset gpios.
 - maxim_sti,mt_type_b_enabled	: Boolean type. This should be used to enable type B multitouch protocol.
Example:

&spi_13 { /* BLSP1 QUP3 */
	status = "ok";
	maxim_sti@0 {
		compatible = "maxim,maxim_sti";
		reg = <0>;
		interrupt-parent = <&msm_gpio>;
		interrupts = <65 0>;
		spi-max-frequency = <16000000>;
		avdd-supply = <&pm8950_l17>;
		dvdd-supply = <&pm8950_l6>;
		spi-supply = <&pm8950_l5>;
		maxim_sti,irq-gpio = <&msm_gpio 65 0x00>;
		maxim_sti,reset-gpio = <&msm_gpio 64 0x00>;
		maxim_sti,touch_fusion = "/vendor/bin/touch_fusion";
		maxim_sti,config_file = "/vendor/firmware/touch_fusion_panel_id_0x%04x.cfg";
		maxim_sti,fw_name = "maxim_fp35.bin";
		maxim_sti,mt_type_b_enabled;
		pinctrl-names = "pmx_ts_active","pmx_ts_suspend","pmx_ts_release";
		pinctrl-0 = <&ts_int_active &ts_reset_active>;
		pinctrl-1 = <&ts_int_suspend &ts_reset_suspend>;
		pinctrl-2 = <&ts_release>;
       };
};
```

## Documentation/devicetree/bindings/input/touchscreen/msg21xx-ts.txt
```
Mstar touch controller

The mstar controller is connected to host processor
via i2c. The controller generates interrupts when the
user touches the panel. The host controller is expected
to read the touch coordinates over i2c and pass the coordinates
to the rest of the system.

Required properties:

 - compatible		: should be "mstar,msg21xx"
 - reg			: i2c slave address of the device
 - interrupt-parent	: parent of interrupt
 - interrupts		: touch sample interrupt to indicate presense or release
				of fingers on the panel.
 - vdd-supply		: Power supply needed to power up the device
 - vcc_i2c-supply	: Power source required to power up i2c bus
 - mstar,irq-gpio	: irq gpio which is to provide interrupts to host,
				same as "interrupts" node. It will also
				contain active low or active high information.
 - mstar,reset-gpio	: reset gpio to control the reset of chip
 - mstar,display-coords : display coords in pixels. It is a four
				tuple consisting of min x, min y, max x and
				max y values
 - pinctrl-names : This should be defined if a target uses pinctrl framework.
			See "pinctrl" in Documentation/devicetree/bindings/pinctrl/msm-pinctrl.txt.
			Specify the names of the configs that pinctrl can install in driver.
			Following are the pinctrl configs that can be installed:
			"pmx_ts_active" : Active configuration of pins, this should specify active
			config defined in pin groups of interrupt and reset gpio.
			"pmx_ts_suspend" : Disabled configuration of pins, this should specify sleep
			config defined in pin groups of interrupt and reset gpio.
			"pmx_ts_release" : Release configuration of pins, this should specify
			release config defined in pin groups of interrupt and reset gpio.
 - mstar,num-max-touches: It defines the maximum number of touch supported by the controller.
 - mstar,hard-reset-delay-ms : hard reset delay in ms
 - mstar,post-hard-reset-delay-ms : post hard reset delay in ms

Optional properties:

 - mstar,button-map : button map of key codes. It is a three tuple consisting of key codes.
 - mstar,panel-coords : panel coords for the chip in pixels.
				It is a four tuple consisting of min x,
				min y, max x and max y values
 - mstar,ic-type : It defines the ic-type of the controller. Values are as folows:
			1 -> msg2133.
			2 -> msg21xxA.
			3 -> msg26xxM.

Example:
	i2c@78b9000 { /* BLSP1 QUP5 */
		mstar@26 {
			compatible = "mstar,msg21xx";
			reg = <0x26>;
			interrupt-parent = <&msm_gpio>;
			interrupts = <13 0x2008>;
			mstar,irq-gpio = <&msm_gpio 13 0x00000001>;
			mstar,reset-gpio = <&msm_gpio 12 0x0>;
			vdd-supply = <&pm8916_l17>;
			vcc_i2c-supply = <&pm8916_l6>;
			mstar,display-coords = <0 0 480 854>;
			pinctrl-names = "pmx_ts_active","pmx_ts_suspend";
			pinctrl-0 = <&ts_int_active &ts_reset_active>;
			pinctrl-1 = <&ts_int_suspend &ts_reset_suspend>;
			mstar,button-map = <172 139 158>;
			mstar,ic-type = <2>;
			mstar,num_max_touches = <2>;
			mstar,hard-reset-delay-ms = <100>;
			mstar,post-hard-reset-delay-ms = <100>;
		};
	};
```

## Documentation/devicetree/bindings/input/touchscreen/raydium_rm_ts_spidev.txt
```
raydium touch.

Required properties:
- compatible : should be "raydium,rm_ts_spidev".
- reg: Should contain registers location and length.
- interrupts: Should contain touch interrupts.
- rx-clk-tap-delay: should contain rx_clk_tap_delay in tegra_spi_device_controller_data
- tx-clk-tap-delay: should contain tx_clk_tap_delay in tegra_spi_device_controller_data
- reset-gpio: gpio spec for touch reset
- platform-id: value for spec platform_id in rm_spi_ts_platform_data
- name-of-clock: spec clock name for name_of_clock in rm_spi_ts_platform_data
- name-of-clock-con: spec clock name for name_of_clock_con in rm_spi_ts_platform_data

Example:

		spi-touch@0 {
			compatible = "raydium,rm_ts_spidev";
			reg = <0>; /* spi chip select 0 */
			spi-max-frequency = <12000000>;
			interrupt-parent = <&gpio>;
			interrupts = <82 0x01>; /* GPIO_PK2 */
			reset-gpio = <&gpio 84 0>; /* GPIO_PK4 */
			config = <0>;
			platform-id = <0x8>;
			name-of-clock = "clk_out_2";
			name-of-clock-con = "extern2";
		};
```

## Documentation/devicetree/bindings/input/touchscreen/raydium_ts.txt
```
Raydium WT030 touch controller

Please add this description here: The Raydium Touch controller is connected to the
host processor via I2C. The controller generates interrupts when the user touches
the panel. The host controller is expected to read the touch coordinates over I2C and
pass the coordinates to the rest of the system.

Required properties:

 - compatible                     : should be "raydium,raydium-ts".
 - reg                                : i2c slave address of the device.
 - interrupt-parent               : parent of interrupt.
 - raydium,irq-gpio               : irq gpio.
 - raydium,reset-gpio         : reset gpio.
 - vdd_ana-supply                         : analog voltage power supply needed to power device.
 - vcc_i2c-supply                         : i2c voltage power supply needed to power device.

Optional property:
 - raydium,max-num-touches   : addr of ub-i2c.
 - raydium,display-coords    : array of display coordinates.
 - raydium,x_max                    : maximal x value of the panel.
 - raydium,y_max                    : maximal y value of the panel.
 - raydium,fw_id             : firmare id.
 - raydium,soft-reset-delay-ms    : reset delay for controller (ms), default 100.
 - raydium,hard-reset-delay-ms    : reset delay for controller (ms), default 100.

Example:
       i2c@78b7000 {
               status = "ok";
               raydium_ts@39 {
                       compatible = "raydium,raydium-ts";
                       reg = <0x39>;
                       interrupt-parent = <&msm_gpio>;
                       interrupts = <13 0x2008>;
                       vdd_ana-supply = <&pm8916_l17>;
                       vcc_i2c-supply = <&pm8916_l6>;
                       pinctrl-names = "pmx_ts_active","pmx_ts_suspend","pmx_ts_release";
                       pinctrl-0 = <&ts_int_active &ts_reset_active>;
                       pinctrl-1 = <&ts_int_suspend &ts_reset_suspend>;
                       pinctrl-2 = <&ts_release>;
                       raydium,reset-gpio = <&msm_gpio 12 0x00>;
                       raydium,irq-gpio = <&msm_gpio 13 0x00>;
                       raydium,num-max-touches = <2>;
                       raydium,soft-reset-delay-ms = <50>;
                       raydium,hard-reset-delay-ms = <100>;
                       raydium,x_max = <390>;
                       raydium,y_max = <390>;
                       raydium,display-coords= <0  0 390 390>;
                       raydium,fw_id = <0x2202>
               };
       };
```

## Documentation/devicetree/bindings/input/touchscreen/synaptics_dsx_i2c.txt
```
Synaptics DSX touch controller

Required properties:

 - compatible		: should be "synaptics,dsx"
 - reg			: i2c slave address of the device
 - interrupt-parent	: parent of interrupt
 - interrupts		: touch sample interrupt to indicate presense or release
				of fingers on the panel.
 - synaptics,irq-gpio	: irq gpio
 - synaptics,reset-gpio	: reset gpio

Optional property:
 - vdd-supply			: digital voltage power supply needed to power device
 - avdd-supply			: analog voltage power supply needed to power device
 - synaptics,button-map		: virtual key code mappings to be used
 - synaptics,x-flip		: modify orientation of the x axis
 - synaptics,y-flip		: modify orientation of the y axis
 - synaptics,reset-delay-ms	: reset delay for controller (ms), default 100
 - synaptics,panel-coords	: touch panel min x, min y, max x and
					max y resolution
 - synaptics,display-coords	: display min x, min y, max x and
					max y resolution
 - synaptics,fw-name		: name of firmware .img file in /etc/firmware
 - synaptics,disable-gpios	: specify this to disable gpios in suspend
 - pinctrl-names		: This should be defined if a target uses pinctrl framework.
			See "pinctrl" in Documentation/devicetree/bindings/pinctrl/msm-pinctrl.txt.
			It should specify the names of the configs that pinctrl can install in driver.
			Following are the pinctrl configs that can be installed:
			"pmx_ts_active" : Active configuration of pins, this should specify active
			config defined in pin groups of interrupt and reset gpio.
			"pmx_ts_suspend" : Disabled configuration of pins, this should specify sleep
			config defined in pin groups of interrupt and reset gpio.
			"pmx_ts_release" : Release configuration of pins, this should specify
			release config defined in pin groups of interrupt and reset gpio.
 - synaptics,detect-device	: Define this property when two Synaptics Touchscreen controllers
				need to be supported without changing the DT. In this case, all
				such devices are placed as child nodes of Synaptics touchscreen
				node. Following are the properties that can be defined inside
				these child nodes:
				- synaptics-package-id
				- synaptics,panel-coords
				- synaptics-display-coords
				- synaptics,button-map
				- synaptics,key-codes
 - clocks			: Optional property that represents the clocks associated
				with the underlying bus when secure touch is enabled. This property
				is required only if secure touch is enabled and used with this driver.
 - clock-names:			: Clock names used for secure touch. The names are:
				"iface_clk", "core_clk".

Optional properties inside child node:
These properties are defined only when synaptics,detect-device property is defined in DT.
 - synaptics,package-id		: Specifies the Package Id of touch controller.
 - synaptics,panel-coords	: Specifies the Touch panel min x, min y, max x and max y
				resolution.
 - synaptics,display-coords	: Specifies the display min x, min y, max x and max y
				resolution.
 - synaptics,button-map		: Key code mappings to be used when device
				supports 0D buttons and directly sends key codes.
 - synaptics,key-codes		: Virtual key code mappings to be used when device
				supports 2D buttons and sends coordinates instead of
				key codes.
 - synaptics,bypass-sensor-coords-check : Bypass the comparison of sensor coordinates
				range read from DT and touch controller. Used when some
				touch panels in the field are unprogrammed and misprogrammed.

Example:
	i2c@f9927000 {
		synaptics@20 {
			compatible = "synaptics,dsx"
			reg = <0x20>;
			interrupt-parent = <&msmgpio>;
			interrupts = <17 0x2>;
			vdd-supply = <&pm8226_l19>;
			avdd-supply = <&pm8226_lvs1>;
			synaptics,reset-gpio = <&msmgpio 16 0x00>;
			synaptics,irq-gpio = <&msmgpio 17 0x00>;
			synaptics,reset-delay-ms = <100>;
			synaptics,x-flip;
			synaptics,y-flip;
			synaptics,disable-gpios;
			synaptics,fw-name = "PR1610974.img";
			pinctrl-names = "pmx_ts_active","pmx_ts_suspend", "pmx_ts_suspend";
			pinctrl-0 = <&ts_int_active &ts_reset_active>;
			pinctrl-1 = <&ts_int_suspend &ts_reset_suspend>;
			pinctrl-2 = <&ts_release>;
			synaptics,detect-device;
			synaptics,device1 {
				synaptics,package-id = <3202>;
				synaptics,button-map = <139 172 158>;
			};
			synaptics,device2 {
				synaptics,package-id = <3408>;
				synaptics,display-coords = <0 0 1079 1919>;
				synaptics,panel-coords = <0 0 1079 2084>;
				synaptics,key-codes = <139 172 158 217>;
			};
			clocks = <&clock_gcc clk_gcc_blsp1_ahb_clk>,
			 <&clock_gcc clk_gcc_blsp1_qup5_i2c_apps_clk>;
			clock-names = "iface_clk", "core_clk";
		};
	};
```
