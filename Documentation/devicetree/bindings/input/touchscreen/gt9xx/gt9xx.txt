## Documentation/devicetree/bindings/input/touchscreen/gt9xx/gt9xx.txt
```
Goodix GT9xx series touch controller

Required properties:

 - compatible		: Should be "goodix,gt9xx"
 - reg			: I2C slave address of the device.
 - interrupt-parent	: Parent of interrupt.
 - interrupts		: Configuration of touch panel controller interrupt
				GPIO.
 - goodix,product-id	: Product identification of the controller.
 - interrupt-gpios	: Interrupt gpio which is to provide interrupts to
				host, same as "interrupts" node.
 - reset-gpios		: Reset gpio to control the reset of chip.
 - goodix,display-coords	: Display coordinates in pixels. It is a four
				tuple consisting of min x, min y, max x and
				max y values.

Optional properties:

 - avdd-supply		: Power supply needed to power up the device, this is
				for fixed voltage external regulator.
 - vdd-supply		: Power supply needed to power up the device, when use
				external regulator, do not add this property.
 - vcc-i2c-supply	: Power source required to power up i2c bus.
				GT9xx series can provide 1.8V from internal
				LDO, add this properties base on hardware
				design.
 - goodix,panel-coords	: Panel coordinates for the chip in pixels.
				It is a four tuple consisting of min x,
				min y, max x and max y values.
 - goodix,i2c-pull-up	: To specify pull up is required.
 - goodix,force-update	: To specify force update is allowed.
 - goodix,enable-power-off	: Power off touchscreen during suspend.
 - goodix,button-map	: Button map of key codes. The number of key codes
				depend on panel.
 - goodix,cfg-data0	: Touch screen controller config data group 0. Ask vendor
				to provide that.
				Driver supports maximum six config groups. If more than one
				groups are defined, driver will select config group depending
				on hardware configuration. If only config group 0 is defined,
				it will be used for all hardware configurations.
				Touch screen controller will use its onchip default config data
				if this property is not present.
 - goodix,cfg-data1	: Touch screen controller config data group 1. Ask vendor
				to provide that.
 - goodix,cfg-data2	: Touch screen controller config data group 2. Ask vendor
				to provide that.
 - goodix,cfg-data3	: Touch screen controller config data group 3. Ask vendor
				to provide that.
 - goodix,cfg-data4	: Touch screen controller config data group 4. Ask vendor
				to provide that.
 - goodix,cfg-data5	: Touch screen controller config data group 5. Ask vendor
				to provide that.
 - goodix,fw-name	: Touch screen controller firmware file name.
Example:
i2c@f9927000 {
		goodix@5d {
			compatible = "goodix,gt9xx";
			reg = <0x5d>;
			interrupt-parent = <&msmgpio>;
			interrupts = <17 0x2008>;
			reset-gpios = <&msmgpio 16 0x00>;
			interrupt-gpios = <&msmgpio 17 0x00>;
			avdd-supply = <&tp_power>;
			goodix,panel-coords = <0 0 720 1200>;
			goodix,display-coords = <0 0 720 1080>;
			goodix,button-map= <158 102 139>;
			goodix,product-id = "915";
			goodix,cfg-data0 = [
				41 D0 02 00 05 0A 05 01 01 08
				12 58 50 41 03 05 00 00 00 00
				00 00 00 00 00 00 00 8C 2E 0E
				28 24 73 13 00 00 00 83 03 1D
				40 02 00 00 00 03 64 32 00 00
				00 1A 38 94 C0 02 00 00 00 04
				9E 1C 00 8D 20 00 7A 26 00 6D
				2C 00 60 34 00 60 10 38 68 00
				F0 50 35 FF FF 27 00 00 00 00
				00 01 1B 14 0C 14 00 00 01 00
				00 00 00 00 00 00 00 00 00 00
				00 00 02 04 06 08 0A 0C 0E 10
				12 14 16 18 1A 1C FF FF FF FF
				FF FF FF FF FF FF FF FF FF FF
				FF FF 00 02 04 06 08 0A 0C 0F
				10 12 13 14 16 18 1C 1D 1E 1F
				20 21 22 24 26 28 29 2A FF FF
				FF FF FF FF FF FF FF 22 22 22
				22 22 22 FF 07 01];
			goodix,fw_name = "gtp_fw.bin";
		};
};
```

## Documentation/devicetree/bindings/input/touchscreen/himax.txt
```
Himax touch controller

Required properties:

 - compatible			: Should be "himax,hxcommon"
 - reg					: i2c slave address of the device.
 - interrupt-parent		: parent of interrupt.
 - himax,irq-gpio       : irq gpio.
 - himax,reset-gpio		: reset gpio.
 - vdd-supply			: Power supply needed to power up the device.
 - avdd-supply			: Power source required to power up i2c bus.
 - himax,panel-coords 	: panel coordinates for the chip in pixels.
						  It is a four tuple consisting of min x,
						  min y, max x and max y values.
 - himax,display-coords : display coordinates in pixels. It is a four
						  tuple consisting of min x, min y, max x and
						  max y values

Optional properties:
 - himax,3v3-gpio		: gpio acting as 3.3 v supply.
 - report_type			: Multi-touch protocol type. Default 0.
						  0 for protocol A, 1 for protocol B.
```

## Documentation/devicetree/bindings/input/touchscreen/himax_i2c_ts.txt
```
Himax touch controller

Required properties:

 - compatible	: should be "himax,hxcommon"
 - reg			: i2c slave address of the device
 - interrupt-parent	: parent of interrupt
 - interrupts		: touch sample interrupt to indicate presense or release
				of fingers on the panel.
 - himax,irq-gpio	: irq gpio
 - himax,reset-gpio	: reset gpio

Optional property:
 - vdd-supply		: Analog power supply needed to power device
 - vcc_i2c-supply		: Power source required to pull up i2c bus
 - himax,i2c-pull-up	: specify to indicate pull up is needed
 - himax,disable-gpios	: specify to disable gpios in suspend (power saving)
 - himax,button-map		: virtual key code mappings to be used
 - himax,x-flip		: modify orientation of the x axis
 - himax,y-flip		: modify orientation of the y axis
 - himax,panel-coords	: touch panel min x, min y, max x and
					max y resolution
 - himax,display-coords	: display min x, min y, max x and
					max y resolution
 - himax,reset-delay	: reset delay for controller (ms), default 100
 - himax,fw-image-name	: name of firmware .img file in /etc/firmware
 - himax,power-down		: fully power down regulators in suspend
 - himax,do-lockdown	: perform one time lockdown procedure

Example:
	i2c@f9927000 { /* BLSP1 QUP5 */
		cell-index = <5>;
		compatible = "himax,hxcommon";
		#address-cells = <1>;
		#size-cells = <0>;
		reg-names = "qup_phys_addr";
		reg = <0xf9927000 0x1000>;
		interrupt-names = "qup_err_intr";
		interrupts = <0 99 0>;
		gpios = <&msmgpio 19 0>, /* SCL */
			<&msmgpio 18 0>; /* SDA */
		qcom,i2c-bus-freq = <100000>;
		qcom,i2c-src-freq = <19200000>;

		himax_ts@20 {
			compatible = "himax,hxcommon"
			reg = <0x20>;
			interrupt-parent = <&tlmm>;
			interrupts	= <255 0x2008>;
			vdd-supply 	= <&pm8994_l15>;
			avdd-supply = <&pm8994_l22>;
			himax,panel-coords = <0 720 0 1440>;
			himax,display-coords = <0 720 0 1440>;
			himax,irq-gpio = <&tlmm 255 0x2008>;
			himax,rst-gpio = <&tlmm 8 0x00>;
		};
	};
```

## Documentation/devicetree/bindings/input/touchscreen/hmxchipset.txt
```
Himax Touch Controller

Required properties:

 - compatible		: Should be "himax,hxcommon"
 - reg			: I2C slave address of the device.
 - interrupt-parent	: Parent of interrupt.
 - interrupts		: Configuration of touch panel controller interrupt
			GPIO.
 - interrupt-gpios	: Interrupt gpio which is to provide interrupts to
			host, same as "interrupts" node.
 - reset-gpios		: Reset gpio to control the reset of chip.
 - himax,display-coords	: Display coordinates in pixels. It is a four
			tuple consisting of min x, min y, max x and
			max y values.

Optional properties:

 - avdd-supply		: Power supply needed to power up the device, this is
			for fixed voltage external regulator.
 - vdd-supply		: Power supply needed to power up the device, when use
			external regulator, do not add this property.
 - himax,panel-coords	: Panel coordinates for the chip in pixels.
			It is a four tuple consisting of min x,
			min y, max x and max y values.

Example:
&i2c_3 {
	status = "okay";
	himax_ts@48 {
		compatible = "himax,hxcommon";
		reg = <0x48>;
		interrupt-parent = <&tlmm>;
		interrupts = <65 0x2>;
		vdd-supply = <&pm8953_l10>;
		avdd-supply = <&pm8953_l5>;
		pinctrl-names = "pmx_ts_active","pmx_ts_suspend","pmx_ts_release";
		pinctrl-0 = <&ts_int_active &ts_reset_active>;
		pinctrl-1 = <&ts_int_suspend &ts_reset_suspend>;
		pinctrl-2 = <&ts_release>;
		himax,panel-coords = <0 800 0 1280>;
		himax,display-coords = <0 800 0 1280>;
		himax,irq-gpio = <&tlmm 65 0x2008>;
		//himax,rst-gpio = <&tlmm 64 0x0>;
		report_type = <1>;
	};
};
```

## Documentation/devicetree/bindings/input/touchscreen/it7258_ts_i2c.txt
```
ITE Tech. touch controller

The ITE Tech. touch controller is connected to host processor
via i2c. The controller generates interrupts when the user
touches the panel. The host controller is expected to read
the touch coordinates over i2c and pass the coordinates to
the rest of the system.

Required properties:

 - compatible		: should be "ite,it7260_ts"
 - reg			: i2c slave address of the device
 - interrupt-parent	: parent of interrupt
 - interrupts		: touch sample interrupt to indicate presence or release
			  of fingers on the panel.
 - ite,irq-gpio		: irq gpio which is to provide interrupts to host,
			  same as "interrupts" node. It will also
			  contain active low or active high information.
 - ite,reset-gpio	: reset gpio to control the reset of chip
 - ite,reset-delay	: reset delay for controller (ms), default 20

Optional properties:
 - avdd-supply		: Analog power supply needed to power device
 - vdd-supply		: Power source required to pull up i2c bus
 - ite,wakeup		: boolean, use this to support touch-to-wake feature.
 - ite,palm-detect-en	: boolean, use this to send palm-detect-keycode when
			  palm is detected.
 - ite,fw-name		: Specify firmware file name in /etc/firmware
 - ite,cfg-name		: Specify config file name in /etc/firmware
 - ite,panel-coords	: touch panel min x, min y, max x and
			  max y resolution
 - ite,display-coords	: display min x, min y, max x and
			  max y resolution
 - ite,num-fingers	: number of fingers supported by the touch controller
 - pinctrl-names		: This should be defined if a target uses pinctrl framework.
			See "pinctrl" in Documentation/devicetree/bindings/pinctrl/msm-pinctrl.txt.
			It should specify the names of the configs that pinctrl can install in driver.
			Following are the pinctrl configs that can be installed:
			"pmx_ts_active" : Active configuration of pins, this should specify active
			config defined in pin groups of interrupt and reset gpio.
			"pmx_ts_suspend" : Disabled configuration of pins, this should specify sleep
			config defined in pin groups of interrupt and reset gpio.
			"pmx_ts_release" : Release configuration of pins, this should specify
			release config defined in pin groups of interrupt and reset gpio.
 - ite,low-reset	: boolean, if the controller needs low-state of the reset gpio while
			  initializing, and reset gpio should be made as high-state to reset the
			  controller. It means the controller needs "active-high" reset gpio.
 - ite,avdd-lpm-cur	: avdd lpm current value(mA) in suspend state.

Required properties palm-detect-en feature:
 - ite,palm-detect-keycode	: The keycode that is required to be sent when
			  palm is detected by the ITE tech driver.

Example:
	i2c@f9927000 {
		it7260@46 {
			compatible = "ite,it7260_ts";
			reg = <0x46>;
			interrupt-parent = <&msmgpio>;
			/* pins used by touchscreen */
			pinctrl-names = "pmx_ts_active","pmx_ts_suspend","pmx_ts_release";
			pinctrl-0 = <&ts_int_active &ts_reset_active>;
			pinctrl-1 = <&ts_int_suspend &ts_reset_suspend>;
			pinctrl-2 = <&ts_release>
			interrupts = <17 0x2>;
			avdd-supply = <&pm8226_l19>;
			vdd-supply = <&pm8226_lvs1>;
			ite,reset-gpio = <&msmgpio 16 0x00>;
			ite,irq-gpio = <&msmgpio 17 0x2008>;
			ite,wakeup;
			ite,palm-detect-en;
			ite,palm-detect-keycode = <142>;
			ite,fw-name = "ite7260_fw.bin";
			ite,cfg-name = "ite7260_cfg.bin";
			ite,panel-coords = <0 0 320 320>;
			ite,display-coords = <0 0 320 320>;
			ite,num-fingers = <2>;
			ite,reset-delay = <20>;
			ite,low-reset;
			ite,vdd-lpm-cur = <3000>;
		};
	};
```

## Documentation/devicetree/bindings/input/touchscreen/jdi-bu21150-ts.txt
```
JDI bu21150 touch AFE controller

Required properties:

 - compatible			: should be "jdi,bu21150"
 - reg					: SPI address of the device
 - interrupt-parent		: parent of interrupt
 - interrupts			: interrupt of touch AFE
 - vdd_ana-supply		: analog power supply for AFE panel
 - vdd_dig-supply		: digital power supply for AFE panel
 - pinctrl-names		: This should be defined if a target uses pinctrl framework.
				If GPIO config is used, this property should not be defined.
			See "pinctrl" in Documentation/devicetree/bindings/pinctrl/msm-
			pinctrl.txt. It should specify the names of the configs that
			pinctrl can install in driver. Following are the pinctrl
			configs that can be installed:
			"pmx_ts_active" : Required pinctrl name. Active configuration of pins,
					 this should specify active config defined in pin
					groups of interrupt and reset gpio.
			"pmx_ts_suspend" : Required pinctrl name. Disabled configuration of
					pins, this should specify sleep config defined in pin
					groups of interrupt and reset gpio.
			"afe_pwr_active" : Optional pinctrl name. Active configuration of AFE
					power pin. Do not define if GPIO config is used.
			"afe_pwr_suspend" : Optional pinctrl name. Disabled configuration of
					AFE power pin. Do not define if GPIO config is used.
			"mod_en_active" : Optional pinctrl name. Active configuration of AFE
					module enable pin. Do not define if GPIO config is
					used.
			"mod_en_suspend" : Optional pinctrl name. Disabled configuration of
					AFE module enable pin. Do not define if GPIO config
					is used.
			"disp_vsn_active" : Optional pinctrl name. Active configuration of
					display VSN pin. Do not define if GPIO config is used.
			"disp_vsn_suspend" : Optional pinctrl name. Disable configuration of
					display VSN pin. Do not define if GPIO config is used.
			"ddic_rst_active"  : Optional pinctrl name. Active configuration of
					DDIC reset pin. Do not define if GPIO config is used.
			"ddic_rst_suspend" : Optional pinctrl name. Disable configuration of
					DDIC reset pin. Do not define if GPIO config is used.
Optional properties:
 - irq-gpio 			: touch AFE(TAFE) irq gpio. This attribute should not be
				  defined if pinctrl is used.
 - rst-gpio			: touch AFE(TAFE) reset gpio. This attribute should not be
				  defined if pinctrl is used.
 - afe_pwr		: GPIO to control AFE power board. Do not define if pinctrl is used.
 - disp_vsn		: GPIO to control display -5.5V enablement. Do not define if pinctrl is
			  used.
 - mod_en		: GPIO to control module enablement. Do not define if pinctrl is used.
 - ddic_rst		: GPIO to control DDIC reset. Do not define if pinctrl is used.
 - jdi,panel-model		: string type for panel model number
 - jdi,afe-version		: string type for AFE version
 - jdi,pitch-type		: string type to indicate sensor pitch type, e.g. "fp" for fine pitch, "np" for normal pitch, etc..
 - jdi,afe-vendor		: string type to indicate AFE IC vendor, e.g. "rohm", "sitronix", etc..
 - jdi,wake-up		: Boolean type. This property specifies if device can wake up system from suspend.
 - jdi,timeout-enable	: Boolean type. This property specifies if device uses a timer to check responsiveness

Example:

	spi@f9966000 {
		jdi-bu21150@0 {
			compatible = "jdi,bu21150";
			reg = <0>;
			interrupt-parent = <&msmgpio>;
			interrupts = <61 0>;
			vdd_ana-supply = <&pm8916_l17>;
			vdd_dig-supply = <&pm8916_l6>;
			pinctrl-names = "pmx_ts_active","pmx_ts_suspend",
					"afe_pwr_active", "afe_pwr_suspend",
					"disp_vsn_active", "disp_vsn_suspend";
			pinctrl-0 = <&ts_int_active &ts_reset_active>;
			pinctrl-1 = <&ts_int_suspend &ts_reset_suspend>;
			pinctrl-2 = <&afe_pwr_active>;
			pinctrl-3 = <&afe_pwr_suspend>;
			pinctrl-4 = <&disp_vsn_active>;
			pinctrl-5 = <&disp_vsn_suspend>;
			jdi,panel-model = "fhd_5_A230ADEV";
			jdi,afe-version = "v3";
			jdi,pitch-type = "np";
			jdi,wake-up;
			jdi,timeout-enable;
		};
	};
```
