## Documentation/devicetree/bindings/interconnect/qcom,holi.txt
```
QTI HOLI Network-On-Chip interconnect driver binding
-----------------------------------------------------------

Required properties :
- compatible : shall contain only one of the following:
			"qcom,holi-bimc",
			"qcom,holi-system_noc",
			"qcom,holi-config_noc",
			"qcom,holi-clk_virt",
			"qcom,holi-mmnrt_virt",
			"qcom,holi-mmrt_virt",
- #interconnect-cells : should contain 1

reg : specifies the physical base address and size of registers
clocks : list of phandles and specifiers to all interconnect bus clocks
clock-names : clock names should include both "bus" and "bus_a"

The following are optional properties:

qcom,util-factor : Parameter that represents the DDR utilization factor
		to be used in aggregation scheme. It is represented as
		actual util-factor * 100.

Examples:

soc {
	...
	system_noc: interconnect@1880000 {
		reg = <0x1880000 0x5f080>;
		compatible = "qcom,holi-system_noc";
		qcom,util-factor = <142>;
		#interconnect-cells = <1>;
		clock-names = "bus", "bus_a";
		clocks = <&rpmcc RPM_SMD_SNOC_CLK>,
			<&rpmcc RPM_SMD_SNOC_A_CLK>;
	};

	config_noc: interconnect@1900000 {
		reg = <0x1900000 0x6200>;
		compatible = "qcom,holi-config_noc";
		#interconnect-cells = <1>;
		clock-names = "bus", "bus_a";
		clocks = <&rpmcc RPM_SMD_CNOC_CLK>,
			<&rpmcc RPM_SMD_CNOC_A_CLK>;
	};
};
```

## Documentation/devicetree/bindings/interconnect/qcom,lahaina.txt
```
Qualcomm Technologies, Inc. Lahaina Network-On-Chip interconnect driver binding
-----------------------------------------------------------

Lahaina interconnect providers support system bandwidth requirements through
RPMh hardware accelerators known as Bus Clock Manager (BCM). The provider is
able to communicate with the BCM through the Resource State Coordinator (RSC)
associated with each execution environment. Provider nodes must point to at
least one RPMh device child node pertaining to their RSC and each provider
can map to multiple RPMh resources.

Required properties :
- compatible : shall contain only one of the following:
			"qcom,lahaina-aggre1_noc",
			"qcom,lahaina-aggre2_noc",
			"qcom,lahaina-clk_virt",
			"qcom,lahaina-config_noc",
			"qcom,lahaina-dc_noc",
			"qcom,lahaina-gem_noc",
			"qcom,lahaina-lpass_ag_noc",
			"qcom,lahaina-mc_virt",
			"qcom,lahaina-mmss_noc",
			"qcom,lahaina-nsp_noc",
			"qcom,lahaina-system_noc",
- #interconnect-cells : should contain 1

Examples:

aggre1_noc: interconnect@16e0000 {
	compatible = "qcom,lahaina-aggre1_noc";
	interconnect-cells = <1>;
};
```

## Documentation/devicetree/bindings/interconnect/qcom,osm-l3.txt
```
Qualcomm Technologies, Inc. EPSS L3 interconnect driver binding
-----------------------------------------------------------

The EPSS L3 Interconnect provider supports the scaling of L3 cache
performance states of the CPU subsystem.

Required properties :
- compatible : shall contain only one of the following:
			"qcom,sdm845-osm-l3",
			"qcom,sm8150-osm-l3";
- reg : Address and length of the register set for the device
- clock-names: should contain "xo", "alternate"
- clocks: list of phandle and clock specifier pairs corresponding to
          entries in the clock-names property.
- #interconnect-cells : should contain 1

Examples:

osm_l3: interconnect@0x18321000 {
	reg = <0x18321000 0x1400>;
	compatible = "qcom,sm8150-osm-l3";
	clocks = <&rpmhcc RPMH_CXO_CLK>, <&gcc GPLL0>;
	clock-names = "xo", "alternate";
	#interconnect-cells = <1>;
};
```

## Documentation/devicetree/bindings/interconnect/qcom,qcs405.txt
```
QTI QCS405 Network-On-Chip interconnect driver binding
-----------------------------------------------------------

Required properties :
- compatible : shall contain only one of the following:
			"qcom,qcs405-bimc",
			"qcom,qcs405-pcnoc",
			"qcom,qcs405-snoc",
- #interconnect-cells : should contain 1

reg : specifies the physical base address and size of registers
clocks : list of phandles and specifiers to all interconnect bus clocks
clock-names : clock names should include both "bus" and "bus_a"

The following are optional properties:

qcom,util-factor : Parameter that represents the DDR utilization factor
		to be used in aggregation scheme. It is represented as
		actual util-factor * 100.

Examples:

soc {
	...
	system_noc: interconnect@580000 {
		reg = <0x580000 0x23080>;
		compatible = "qcom,qcs405-snoc";
		#interconnect-cells = <1>;
		clock-names = "bus", "bus_a";
		clocks = <&rpmcc RPM_SMD_SNOC_CLK>,
			<&rpmcc RPM_SMD_SNOC_A_CLK>,
	};

	pc_noc: interconnect@500000{
		reg = <0x500000 0x15080>;
		compatible = "qcom,qcs405-pcnoc";
		#interconnect-cells = <1>;
		clock-names = "bus", "bus_a";
		clocks = <&rpmcc RPM_SMD_PCNOC_CLK>,
			<&rpmcc RPM_SMD_PCNOC_A_CLK>;
	};

	bimc: interconnect@400000{
		reg = <0x400000 0x80000>;
		compatible = "qcom,qcs405-bimc";
		qcom,util-factor = <153>;
		#interconnect-cells = <1>;
		clock-names = "bus", "bus_a";
		clocks = <&rpmcc RPM_SMD_BIMC_CLK>,
			<&rpmcc RPM_SMD_BIMC_A_CLK>;
	};
};
```

## Documentation/devicetree/bindings/interconnect/qcom,yupik.txt
```
Qualcomm Technologies, Inc. Yupik Network-On-Chip interconnect driver binding
-----------------------------------------------------------

Yupik interconnect providers support system bandwidth requirements through
RPMh hardware accelerators known as Bus Clock Manager (BCM). The provider is
able to communicate with the BCM through the Resource State Coordinator (RSC)
associated with each execution environment. Provider nodes must point to at
least one RPMh device child node pertaining to their RSC and each provider
can map to multiple RPMh resources.

Required properties :
- compatible : shall contain only one of the following:
			"qcom,yupik-aggre1_noc",
			"qcom,yupik-aggre2_noc",
			"qcom,yupik-clk_virt",
			"qcom,yupik-config_noc",
			"qcom,yupik-cnoc2",
			"qcom,yupik-cnoc3",
			"qcom,yupik-dc_noc",
			"qcom,yupik-gem_noc",
			"qcom,yupik-lpass_ag_noc",
			"qcom,yupik-mc_virt",
			"qcom,yupik-mmss_noc",
			"qcom,yupik-nsp_noc",
			"qcom,yupik-system_noc",
- #interconnect-cells : should contain 1

Examples:

aggre1_noc: interconnect@16e0000 {
	compatible = "qcom,yupik-aggre1_noc";
	interconnect-cells = <1>;
};
```

## Documentation/devicetree/bindings/interrupt-controller/mediatek,intpol.txt
```
Mediatek 65xx/81xx GIC interrupt polarity extension

Mediatek SOCs contain controllable inverter for each GIC SPI interrupt,
these can be used as GIC interrupt polarity extension.

Required properties:
- compatible: Compatible property value should be "mediatek,mt6577-intpol"

- reg: Physical base address of the int pol registers and length of memory
  mapped region.

Example:
       intpol: intpol@10200100 {
               compatible = "mediatek,mt6577-intpol";
               reg = <0x10200100 0x1c>;
       };
```

## Documentation/devicetree/bindings/interrupt-controller/qti,mpm.txt
```
QTI MPM interrupt controller

MPM (MSM sleep Power Manager) is QTI's platform parent interrupt controller.
It manages subsystem wakeups and resources during sleep. This driver marks
the wakeup interrupts in APSS such that it monitors the interrupts when the
system is asleep, wakes up the APSS when one of these interrupts occur and
replays it to the subsystem interrupt controller after it becomes operational.

Platform interrupt controller MPM is next in hierarchy, followed by others.

This defines 2 interrupt controllers to monitor the interrupts when the system is asleep:

One to monitor the wakeup capable gic interrupts called wakegic.

Properties:

- compatible:
	Usage: required
	Value type: <string>
	Definition: Should contain "qcom,mpm-gic" and the respective target compatible flag
	from below ones.
		"qcom,mpm-gic-msm8953",
		"qcom,mpm-gic-msm8937",
		"qcom,mpm-gic-qcs405"
		"qcom,mpm-gic-trinket"
		"qcom,mpm-gic-mdm9607"
		"qcom,mpm-gic-sdm660"
		"qcom,mpm-gic-sdm429"

- interrupts:
	Usage: required
	Value type: <prop-encoded-array>
	Definition: should specify the IRQ used by remote processor to wakeup APSS.

- interrupt-parent:
	Usage: required
	Value type: <phandle>
	Definition: Specifies the interrupt parent necessary for hierarchical domain to operate.

- interrupt-controller:
	Usage: required
	Value type: <bool>
	Definition: Identifies the node as an interrupt controller.

- reg:
	Usage: required
	Value type: <prop-encoded-array>
	Definition: Specifies the base physical address to trigger an interrupt into remote processor.

-reg-names:
	Usage: required
	Value type: <string>, <string>
	Definition: Specifies the address field names.

- qcom,num-mpm-irqs:
	Usage: optional
	Value type: <value>
	Defination: Specifies the number of interrupts supported.

Example:

wakegic: wake-gic@7781b8 {
	compatible = "qcom,mpm-gic", "qcom,mpm-gic-msm8953";
	interrupts = <GIC_SPI 171 IRQ_TYPE_EDGE_RISING>;
	reg = <0x601d4 0x1000>,
	    <0xb011008 0x4>;  /* MSM_APCS_GCC_BASE 4K */
	reg-names = "vmpm", "ipc";
	interrupt-controller;
	interrupt-parent = <&intc>;
	#interrupt-cells = <3>;
};


One to monitor the wakeup capable gpio interrupts called wakegpio.

properties:

- compatible:
	Usage: required
	Value type: <string>
	Definition: Should contain "qcom,mpm-gpio" and the respective target compatible flag
	from below ones.
		"qcom,mpm-gpio-msm8953",
		"qcom,mpm-gpio-msm8937",
		"qcom,mpm-gpio-qcs405"
		"qcom,mpm-gpio-trinket",
		"qcom,mpm-gpio-mdm9607"
		"qcom,mpm-gpio-sdm660"
		"qcom,mpm-gpio-sdm429"

- interrupt-parent:
	Usage: required
	Value type: <phandle>
	Definition: Specifies the interrupt parent necessary for hierarchical domain to operate.

- interrupt-controller:
	Usage: required
	Value type: <bool>
	Definition: Identifies the node as an interrupt controller.

Example:

wakegpio: wake-gpio {
	compatible = "qcom,mpm-gpio", "qcom,mpm-gpio-msm8953";
	interrupt-controller;
	interrupt-parent = <&tlmm>;
	#interrupt-cells = <2>;
};
```
