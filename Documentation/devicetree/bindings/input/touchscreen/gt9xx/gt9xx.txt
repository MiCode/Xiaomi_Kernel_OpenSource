## Documentation/devicetree/bindings/input/touchscreen/synaptics_dsxv26_i2c.txt
```
Synaptics DSXV26 touch controller

Please add this description here: The Synaptics Touch controller is connected to the
host processor via I2C. The controller generates interrupts when the user touches
the panel. The host controller is expected to read the touch coordinates over I2C and
pass the coordinates to the rest of the system.

Required properties:

 - compatible		           : should be "synaptics,dsx-i2c".
 - reg			               : i2c slave address of the device.
 - interrupt-parent	           : parent of interrupt.
 - synaptics,irq-gpio	       : irq gpio.
 - synaptics,irq-flags         : irq flags.

Optional property:
 - vdd_ana-supply			   : digital voltage power supply needed to power device.
 - vcc_i2c-supply			   : analog voltage power supply needed to power device.
 - synaptics,pwr-reg-name	   : power reg name of digital voltage.
 - synaptics,bus-reg-name	   : bus reg name of analog voltage.
 - synaptics,do-not-disable-regulators	   : If specified, regulators cannot be disabled/enabled during suspend/resume.
 - synaptics,irq-on-state      : status of irq gpio.
 - synaptics,cap-button-codes  : virtual key code mappings to be used.
 - synaptics,vir-button-codes  : virtual key code and the response region on panel.
 - synaptics,wakeup-gestures-en: enable wakeup gestures.
 - synaptics,x-flip		       : modify orientation of the x axis.
 - synaptics,y-flip		       : modify orientation of the y axis.
 - synaptics,reset-delay-ms	   : reset delay for controller (ms), default 100.
 - synaptics,max-y-for-2d	   : maximal y value of the panel.
 - synaptics,bus-lpm-cur-uA	   : I2C bus idle mode current setting.
 - synaptics,fw-name		   : name of firmware .img file in /lib/firmware
 - clock-names			: Clock names used for secure touch. They are: "iface_clk", "core_clk"
 - clocks			: Defined if 'clock-names' DT property is defined. These clocks
				  are associated with the underlying I2C bus.

Example:
	i2c@78b7000 {
		status = "ok";
		synaptics@4b {
			compatible = "synaptics,dsx-i2c";
			reg = <0x4b>;
			interrupt-parent = <&tlmm>;
			interrupts = <65 0x2008>;
			vdd_ana-supply = <&pm8953_l17>;
			vcc_i2c-supply = <&pm8953_l6>;
			synaptics,pwr-reg-name = "vdd_ana";
			synaptics,bus-reg-name = "vcc_i2c";
			synaptics,irq-gpio = <&tlmm 65 0x2008>;
			synaptics,irq-on-state = <0>;
			synaptics,irq-flags = <0x2008>; /* IRQF_ONESHOT | IRQF_TRIGGER_LOW */
			synaptics,power-delay-ms = <200>;
			synaptics,reset-delay-ms = <200>;
			synaptics,max-y-for-2d = <1919>; /* remove if no virtual buttons */
			synaptics,cap-button-codes = <139 172 158>;
			synaptics,vir-button-codes = <139 180 2000 320 160 172 540 2000 320 160 158 900 2000 320 160>;
			/* Underlying clocks used by secure touch */
			clock-names = "iface_clk", "core_clk";
			clocks = <&clock_gcc clk_gcc_blsp1_ahb_clk>,
				<&clock_gcc clk_gcc_blsp1_qup3_i2c_apps_clk>;
		};
	};
```

## Documentation/devicetree/bindings/input/touchscreen/synaptics_i2c_rmi4.txt
```
Synaptics touch controller

Required properties:

 - compatible	: should be "synaptics,rmi4"
 - reg			: i2c slave address of the device
 - interrupt-parent	: parent of interrupt
 - interrupts		: touch sample interrupt to indicate presense or release
				of fingers on the panel.
 - synaptics,irq-gpio	: irq gpio
 - synaptics,reset-gpio	: reset gpio
 - pinctrl-names : This should be defined if a target uses pinctrl framework.
			See "pinctrl" in Documentation/devicetree/bindings/pinctrl/msm-pinctrl.txt.
			It should specify the names of the configs that pinctrl can install in driver.
			Following are the pinctrl configs that can be installed:
			"pmx_ts_active" : Active configuration of pins, this should specify active
			config defined in pin groups of interrupt and reset gpio.
			"pmx_ts_suspend" : Disabled configuration of pins, this should specify sleep
			config defined in pin groups of interrupt and reset gpio.
			"pmx_ts_release" : Release configuration of pins, this should specify
			release config defined in pin groups of interrupt and reset gpio.
Optional property:
 - vdd-supply		: Analog power supply needed to power device
 - vcc_i2c-supply		: Power source required to pull up i2c bus
 - synaptics,i2c-pull-up	: specify to indicate pull up is needed
 - synaptics,disable-gpios	: specify to disable gpios in suspend (power saving)
 - synaptics,button-map		: virtual key code mappings to be used
 - synaptics,modify-reso	: specify to modify X-Y Maximum coordinates from driver.
				This is used only if the panel-coordinates are defined.
 - synaptics,x-flip		: modify orientation of the x axis
 - synaptics,y-flip		: modify orientation of the y axis
 - synaptics,panel-coords	: touch panel min x, min y, max x and
					max y resolution
 - synaptics,display-coords	: display min x, min y, max x and
					max y resolution
 - synaptics,reset-delay	: reset delay for controller (ms), default 100
 - synaptics,fw-image-name	: name of firmware .img file in /etc/firmware
 - synaptics,power-down		: fully power down regulators in suspend
 - synaptics,do-lockdown	: perform one time lockdown procedure
 - synaptics,detect-device 	: Define this property when two Synaptics Touchscreen controllers
				need to be supported without changing the DT. In this case, all
				such devices are placed as child nodes of Synaptics touchscreen
				node. Following are the properties that can be defined inside
				these child nodes:
				- synaptics-package-id
				- synaptics,panel-coords
				- synaptics-display-coords
				- synaptics,button-map

Optional properties inside child node:
These properties are defined only when synaptics,detect-device property is defined in DT.
- synaptics,package-id		: Specifies the Package Id of touch controller.
- synaptics,panel-coords	: Specifies the Touch panel min x, min y, max x and max y
				resolution.
- synaptics,display-coords	: Specifies the display min x, min y, max x and max y
				resolution.
- synaptics,button-map		: virtual key code mappings to be used.

Example:
	i2c@f9927000 { /* BLSP1 QUP5 */
		cell-index = <5>;
		compatible = "qcom,i2c-qup";
		#address-cells = <1>;
		#size-cells = <0>;
		reg-names = "qup_phys_addr";
		reg = <0xf9927000 0x1000>;
		interrupt-names = "qup_err_intr";
		interrupts = <0 99 0>;
		gpios = <&msmgpio 19 0>, /* SCL */
			<&msmgpio 18 0>; /* SDA */
		qcom,i2c-bus-freq = <100000>;
		qcom,i2c-src-freq = <19200000>;

		synaptics@20 {
			compatible = "synaptics,rmi4"
			reg = <0x20>;
			interrupt-parent = <&msmgpio>;
			interrupts = <17 0x2>;
			vdd-supply = <&pm8226_l19>;
			vcc_i2c-supply = <&pm8226_lvs1>;
			pinctrl-names = "pmx_ts_active","pmx_ts_suspend","pmx_ts_release";
			pinctrl-0 = <&ts_int_active &ts_reset_active>;
			pinctrl-1 = <&ts_int_suspend &ts_reset_suspend>;
			pinctrl-1 = <&ts_release>;
			synaptics,reset-gpio = <&msmgpio 16 0x00>;
			synaptics,irq-gpio = <&msmgpio 17 0x00>;
			synaptics,i2c-pull-up;
			synaptics,modify-reso;
			synaptics,detect-device;
			synaptics,device1 {
				synaptics,package-id = <3202>;
				synaptics,button-map = <139 172 158>;
			};
			synaptics,device2 {
				synaptics,package-id = <3408>;
				synaptics,display-coords = <0 0 1079 1919>;
				synaptics,panel-coords = <0 0 1079 2084>;
			};
		};
	};
```

## Documentation/devicetree/bindings/input/touchscreen/synaptics_tcm_spi.txt
```
Synaptics TCM SPI touchscreen controller

Required properties:
 - compatible:
		should be "synaptics,tcm-spi"
 - reg:
		should be 0
 - spi-max-frequency:
		maximum spi clock frequency
 - interrupt-parent:
		hardware controller of interrupt signal
 - interrupts:
		gpio number and flags of interrupt signal
 - vdd-supply:
		digital power source
 - avdd-supply:
		analog power source
 - pinctrl-names:
 - pinctrl-0:
 - pinctrl-1:
		should be defined if using pinctrl framework
		"pmx_ts_active": active configuration of pins
		"pmx_ts_suspend": disabled configuration of pins
 - synaptics,bus-reg-name:
		name of digital power source regulator
 - synaptics,pwr-reg-name:
		name of analog power source regulator
 - synaptics,irq-gpio:
		interrupt hardware controller, gpio number, and flags
 - synaptics,irq-on-state:
		active state of interrupt signal

Optional properties:
 - synaptics,spi-mode:
		spi mode
 - synaptics,byte-delay-us:
		inter-byte delay time in us
 - synaptics,block-delay-us:
		inter-block delay time in us
 - synaptics,power-gpio:
		hardware controller and gpio number of power control signal
 - synaptics,power-delay-ms:
		delay time in ms after powering on device
 - synaptics,reset-gpio:
		hardware controller and gpio number of reset signal
 - synaptics,reset-delay-ms:
		delay time in ms after issuing reset to device
 - synaptics,reset-on-state:
		active state of reset signal
 - synaptics,reset-active-ms:
		active duration in ms of reset signal
 - synaptics,x-flip:
		flip x axis
 - synaptics,y-flip:
		flip y axis
 - synaptics,swap-axes:
		swap x and y axes
 - synaptics,ubl-max-freq:
		maximum spi clock frequency for microbootloader mode
 - synaptics,ubl-byte-delay-us:
		inter-byte delay time in us for microbootloader mode

Example:
	synaptics_tcm@0 {
			compatible = "synaptics,tcm-spi";
			reg = <0>;
			spi-max-frequency = <10000000>;
			interrupt-parent = <&msm_gpio>;
			interrupts = <65 0x2008>;
			vdd-supply = <&pm8994_lvs2>;
			avdd-supply = <&pm8994_l22>;
			pinctrl-names = "pmx_ts_active", "pmx_ts_suspend";
			pinctrl-0 = <&ts_active>;
			pinctrl-1 = <&ts_suspend>;
			synaptics,bus-reg-name = "vdd";
			synaptics,pwr-reg-name = "avdd";
			synaptics,irq-gpio = <&msm_gpio 65 0x2008>;
			synaptics,irq-on-state = <0>;
			synaptics,spi-mode = <3>;
			synaptics,byte-delay-us = <0>;
			synaptics,block-delay-us = <0>;
			synaptics,power-delay-ms = <200>;
			synaptics,reset-delay-ms = <200>;
			synaptics,ubl-max-freq = <5000000>;
			synaptics,ubl-byte-delay-us = <20>;
	};
```

## Documentation/devicetree/bindings/interconnect/mediatek,mmqos.txt
```
Mediatek MMQoS Network-On-Chip interconnect driver binding
=========================================

= MMQoS interconnect providers =

The Mediatek MMQoS(Multimedia Quality of Service) interconnect provider will
collect bandwidth requests from MM users, such as display, camera, mdp and
video codec. The collected bandwidth information is used to configure SMI
settings dynamically and pass the bandwidth information to dvfsrc.

About the SMI architecture, please refer to the following documents.
Documentation/devicetree/bindings/memory-controllers/mediatek,smi-common.txt
Documentation/devicetree/bindings/memory-controllers/mediatek,smi-larb.txt

About dvfsrc, please refer to
Documentation/devicetree/bindings/soc/mediatek/dvfsrc.txt.

Required properties:
- compatible: must contain only one of the following:
		"mediatek,mt6779-mmqos"
- #interconnect-cells: must be 1
- mediatek,larbs: contains a list of phandles of smi larbs
- clock, clock-names: clocks according to the common clock bindings.
		      These are clocks for smi common hardwares and they
		      should be in order of the index of smi common. For
		      example, the first element should be the clock
		      of SLAVE_COMMON(0) defined in the MMQoS driver, and the
		      second element should be the clock of SLAVE_COMMON(1).
- interconnects: contains interconnect paths to pass bandwidth to dvfsrc.
		  interconnect node id definition for dvfsrc is defined in:
		  include/dt-bindings/interconnect/mtk,mt6779-emi.h
- interconnect-names: path names in interconnects property.


Example:

	mmqos: interconnect {
		compatible = "mediatek,mt6779-mmqos";
		#interconnect-cells = <1>;
		mediatek,larbs = <&larb0 &larb1 &larb2 &larb3
				  &larb5 &larb7 &larb8 &larb9
				  &larb10 &larb11>;
		clocks = <&topckgen CLK_TOP_MM>;
		clock-names = "mm_sel";
		interconnects = <&ddr_emi MT6779_MASTER_MMSYS
				 &ddr_emi MT6779_SLAVE_DDR_EMI>;
		interconnect-names = "mmsys_path";
	};


= MMQoS interconnect consumers =

Required properties:
interconnects: contains interconnect paths to report bandwidth information
		Use some macros to define interconnet node ID and these macros
		are defined in:
			include/dt-bindings/interconnect/mtk,mmqos.h
		Source port:
			Use M4U port definition in:
				include/dt-bindings/memory/mt6779-larb-port.h
			Use MASTER_LARB_PORT macro to translate M4U port ID to
			interconnect node ID
		Destination port:
			mt6779: must be SLAVE_COMMON(0)
interconnect-names: path names for interconnects property


Example:

	vcodec_dec: vcodec@16000000 {
		...
		interconnects = <&mmqos MASTER_LARB_PORT(M4U_PORT_HW_VDEC_MC_EXT)
				 &mmqos SLAVE_COMMON(0)>,
				<&mmqos MASTER_LARB_PORT(M4U_PORT_HW_VDEC_UFO_EXT)
				 &mmqos SLAVE_COMMON(0)>;
		interconnect-names = "vdec_mc_ext", "vdec_ufo_ext";
	};
```

## Documentation/devicetree/bindings/interconnect/qcom,bcm-voter.txt
```
QTI BCM-Voter interconnect driver binding
-----------------------------------------------------------

The Bus Clock Manager (BCM) is a dedicated hardware accelerator
that manages shared system resources by aggregating requests
from multiple Resource State Coordinators (RSC). Interconnect
providers are able to vote for aggregated thresholds values from
consumers by communicating through their respective RSCs.

Required properties :
- compatible : shall contain only one of the following:
			"qcom,sdm845-bcm-voter",
			"qcom,bcm-voter",

Examples:

apps_rsc: interconnect@179c0000 {
	compatible = "qcom,rpmh-rsc";

	apps_bcm_voter: bcm_voter {
		compatible = "qcom,sdm845-bcm-voter";
	};
}

disp_rsc: interconnect@179d0000 {
	compatible = "qcom,rpmh-rsc";

	disp_bcm_voter: bcm_voter {
		compatible = "qcom,sdm845-bcm-voter";
	};
}
```

## Documentation/devicetree/bindings/interconnect/qcom,cpucp-l3.txt
```
Qualcomm Technologies, Inc. CPUCP L3 interconnect driver binding
-----------------------------------------------------------

The CPUCP L3 Interconnect provider supports the scaling of L3 cache
performance states of the CPU subsystem.

Required properties :
- compatible : shall contain only one of the following:
			"qcom,holi-cpucp-l3-shared",
			"qcom,holi-cpucp-l3-cpu";
- reg : Address and length of the register set for the device
- clock-names: should contain "xo", "alternate"
- clocks: list of phandle and clock specifier pairs corresponding to
          entries in the clock-names property.
- #interconnect-cells : should contain 1

Examples:

cpucp_l3_shared: l3_shared@fd90000 {
	reg = <0x0fd90000 0x3000>;
	compatible = "qcom,holi-cpucp-l3-shared";
	#interconnect-cells = <1>;
	clock-names = "xo", "alternate";
	clocks = <&rpmcc RPM_SMD_XO_CLK_SRC>,
		<&gcc GCC_GPLL0>;
};

cpucp_l3_cpu: l3_cpu@fd90000{
	reg = <0x0fd90000 0x3000>;
	compatible = "qcom,holi-cpucp-l3-cpu";
	#interconnect-cells = <1>;
	clock-names = "xo", "alternate";
	clocks = <&rpmcc RPM_SMD_XO_CLK_SRC>,
		<&gcc GCC_GPLL0>;
};
```
