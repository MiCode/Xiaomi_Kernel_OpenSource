## Documentation/devicetree/bindings/input/misc/mpu6050.txt
```
InvenSense MPU6050 6 Axis gyroscope+accelerometer combo driver

Required properties:

 - compatible		: Should be "invn,mpu6050" or "invn,mpu6880".
 - reg				: i2c slave address of the device.
 - pinctrl-names	: The pinctrl configration names of this sensor driver. Should be "mpu_default","mpu_sleep".
 - pinctrl-0		: The pinctrl node corresponding to "mpu_default", should be <&mpu6050_default>.
 - pinctrl-1		: The pinctrl node corresponding to "mpu_sleep", should be <&mpu6050_sleep>.
 - interrupt-parent	: Parent of interrupt.
 - interrupts		: Gyrometer sample interrupt to indicate new data ready.
 - vdd-supply		: Analog power supply needed to power device.
 - vlogic-supply	: Digital IO power supply needed for IO and I2C.
 - invn,place		: The placing of the accelerometer on board. There are 8
				patterns of placing described as below:
				"Portrait Up": Portrait Up
				"Landscape Right": Landscape Right
				"Portrait Down": Portrait Down
				"Landscape Left": Landscape Left
				"Portrait Up Back Side": Portrait Up (back side view)
				"Landscape Right Back Side": Landscape Right (back side view)
				"Portrait Down Back Side": Portrait Down (back side view)
				"Landscape Left Back Side": Landscape Left (back side view)

Optional properties:

 - vi2c-supply		: Digital IO Power supply needed for I2C.
 - invn,use-interrupt	: use device interrupt to trigger data acquisition
			instead of polling data.
 - invn,gpio-int	: GPIO used for interrupt.
 - invn,gpio-en		: GPIO used for power enabling.
 - invn,vdd-min-uv	: Minimum VDD supply voltage in micro-volts.

Example:
	i2c@f9925000 {
		mpu6050@68 {
			compatible = "invn,mpu6050";
			reg = <0x68>;
			pinctrl-names = "mpu_default","mpu_sleep";
			pinctrl-0 = <&mpu6050_default>;
			pinctrl-1 = <&mpu6050_sleep>;
			interrupt-parent = <&msm_gpio>;
			interrupts = <84 0x2>;
			vlogic-supply = <&pm8916_l17>;
			vdd-supply = <&pm8916_l6>;
			vi2c-supply = <&pm8916_l16>;
			invn,place = "Portrait Up";
		};
	};
```

## Documentation/devicetree/bindings/input/misc/stk-stk3x1x.txt
```
Sensortek stk301x, stk321x and stk331x ambient light/proximity 3-in-1 sensor

Required properties:

 - compatible		: Should be "stk,stk3x1x".
 - reg					: i2c slave address of the device.
 - interrupt-parent	: Parent of interrupt.
 - interrupts		: Sensor will issue interrupt when preset condition is met,
				typically when proximity sensor detect a change on near/far state.
 - vdd-supply		: Main power supply to power sensor.
 - vio-supply		: Power supply required to pullup I2C bus.
 - stk,irq-gpio	: irq gpio which is to provide interrupts to host, same as
				"interrupts" node.
 - stk,transmittance : Transmittance rate of glass above the ambient light
				detection window. The value may not be equal to real transmittance
				but just a relative value.
 - stk,state-reg	: The default setting of state register.
 - stk,psctrl-reg	: The default setting for proximity sensor.
 - stk,alsctrl-reg	: The default setting for ambient light sensor.
 - stk,ledctrl-reg	: The default setting for IR LED.
 - stk,wait-reg	: The default setting for wait time.
 - stk,ps-thdh	: High threshold for proximity sensor, sensor will report
				"near" if the proximity sensor reading is larger or equal to this
				value.
 - stk,ps-thdl	: Low threshold for proximity sensor, sensor will report
				"far" if the proximity sensor reading is larger than this value.

Optional properties:

 - stk,use-fir	: Boolean to enable light data jitter suppressing FIR filter.

Example:
	i2c@f9925000 {
		stk@48 {
			compatible = "stk,stk3x1x";
			reg = <0x48>;
			interrupt-parent = <&msmgpio>;
			interrupts = <80 0x2>;
			vdd-supply = <&pm8110_l19>;
			vio-supply = <&pm8110_l14>;
			stk,irq-gpio = <&msmgpio 80 0x02>;
			stk,transmittance = <500>;
			stk,state-reg = <0x00>;
			stk,psctrl-reg = <0x71>;
			stk,alsctrl-reg = <0x38>;
			stk,ledctrl-reg = <0xFF>;
			stk,wait-reg = <0x07>;
			stk,ps-thdh = <1700>;
			stk,ps-thdl = <1500>;
			stk,use-fir;
		};
```

## Documentation/devicetree/bindings/input/misc/stmvl53l0x.txt
```
STM VL53L0X Time-of-Flight ranging and gesture detection sensor driver

Description:

The VL53L0X is a new generation Time-of-Flight
(ToF) laser-ranging module housed in the
smallest package on the market today, providing
accurate distance measurement whatever the
target reflectances unlike conventional
technologies. It can measure absolute distances
up to 2m, setting a new benchmark in ranging
performance levels, opening the door to various
new applications.
The VL53L0X integrates a leading-edge SPAD
array (Single Photon Avalanche Diodes) and
embeds ST’s second generation FlightSenseTM
patented technology.
The VL53L0X’s 940 nm VCSEL emitter (Vertical
Cavity Surface-Emitting Laser), is totally invisible
to the human eye, coupled with internal physical
infrared filters, it enables longer ranging
distances, higher immunity to ambient light, and
better robustness to cover glass optical crosstalk.

Required properties:

 - compatible		: Should be "st,stmvl53l0".
 - reg			: i2c slave address of the device.

Example:
	i2c@f9925000 {
		vl53l0x@52 {
			compatible = "st,stmvl53l0";
			reg = <0x52>;
		};
	};
```

## Documentation/devicetree/bindings/input/pixart-pat9125-switch.txt
```
PixArt pat9125 rotating switch

The Pixart's PAT9125 controller is connected to the host processor via I2C.
It detects the rotation when user rotates the switch and generates interrupt
to the Host processor. The host processor reads the direction and number of
steps over I2C and passes the data to the rest of the system.

Required properties:
 - compatible	: should be "pixart,pat9125".
 - reg	: i2c slave address of the device.
 - interrupt-parent	: parent of interrupt.
 - interrupts	: interrupt to indicate motion of the rotating switch.
 - vdd-supply	: Power supply needed to power up the device.
 - vld-supply	: Power source required to power up I2C bus.

Optional properties:
 - pixart,inverse-x 	: boolean, use this to invert the x data before sending it to input framework
 - pixart,inverse-y 	: boolean, use this to invert the y data before sending it to input framework
 - pixart,press-enabled : boolean, use this to enable detection of pressing the button
 - pinctrl-names	: This should be defined if a target uses pinctrl framework.
			See "pinctrl" in Documentation/devicetree/bindings/pinctrl/msm-pinctrl.txt
			It should specify the names of the configs that pinctrl can
			install in driver.
			Following are the pinctrl configs that can be installed:
			"pmx_rot_switch_active" : Active configuration of pins,
						it should specify active config
						defined in pin groups of
						interrupt gpio.
			"pmx_rot_switch_suspend" : Disabled configuration of
						 pins, it should specify sleep
						 config defined in pin groups
						 of interrupt gpio.
			"pmx_rot_switch_release" : Release configuration of
						 pins, it should specify release
						 config defined in pin groups of
						 interrupt gpio.
 - pixart,irq-gpio	: This should be defined if a target doesn't use pinctrl framework.
			irq gpio, which is to provide interrupts to host, same as "interrupts" node.

Required properties if 'pixart,press-enabled' DT property is defined:
 - pixart,press-keycode	: keycode to be sent when press is detected by the driver.

Example:
	pixart_pat9125@75 {
		compatible = "pixart,pat9125";
		reg = <0x75>;
		interrupt-parent = <&msm_gpio>;
		interrupts = <98 0x2008>;
		vdd-supply = <&pm8110_l5>;
		vld-supply = <&pm8110_l17>;
		pixart,irq-gpio = <&msm_gpio 98 0x2008>;
		pinctrl-names = "pmx_rot_switch_active",
				"pmx_rot_switch_suspend",
				"pmx_rot_switch_release";
		pinctrl-0 = <&pix_int_active>;
		pinctrl-1 = <&pix_int_suspend>;
		pinctrl-2 = <&pix_release>;
	};
```

## Documentation/devicetree/bindings/input/qpnp-keypad.txt
```
Qualcomm QPNP keypad controller

The qpnp-keypad driver supports the PMIC keypad controller module
in the Qualcomm PMICs. This controller supports 10 x 8 (row x col)
configuration and is connected to the host processor on the
SPMI interface.

Required properties:
- compatible:		Must be "qcom,qpnp-keypad"
- reg:			Specifies the SPMI address and size for the keypad controller
- interrupts:		Specifies the interrupt associated with keypad controller
- interrupt-names: 	The names of the 2 interrupts assocaited with the keypad
			controller. They are - "kp-sense" and "kp-stuck".
- keypad,num-rows:	Number of rows used in the keypad configuration. These
			rows are the number of PMIC gpios configured as drive
			lines. Possible values: Max = 10, Min = 2.
- keypad,num-columns:	Number of columns used in the keypad configuration. These
			cols are number of PMIC gpios configured as sense lines.
			Possible values: Max = 8, Min = 1.
- linux,keymap:		Row-column-keycode mapping. It is an array of packed
			entries containing the equivalent of row, column and
			linux key-code. Each value represented as
			(row << 24 | column << 16 | key-code)

Optional Properties:
- qcom,scan-delay-ms:	Wait time in milliseconds before each keypad scan.
			This is used to determine if the key has been stuck.
			Possible values: 1, 2, 4, 8, 16, 32, 64, 128ms.
- qcom,row-hold-ns:	Wait time in nanoseconds between each row assertion.
			Configured based on last-row scan delay.
			Possible values: 31250, 62500, 125000, 250000ns.
- qcom,debounce-ms:	Wait time in milliseconds before the column data is
			sampled for key	press detection.
			Possible values: 5, 10, 15, 20ms.
- qcom,wakeup:		Configure the keypad as a wakeup source. This is a
			boolean property.
- linux,keypad-no-autorepeat:
			Disables the auto-repeat feature for the keys. This
			is a boolean property.

Example:

	qcom,keypad@a800 {
		compatible = "qcom,qpnp-keypad";
		reg = <0xA800 0x100>;
		interrupts = <0x1 0xA8 0x0>,
			     <0x1 0xA8 0x1>;
		interrupt-names = "kp-sense", "kp-stuck";
		keypad,num-rows = <2>;
		keypad,num-cols = <2>;
		qcom,scan-delay-ms = <128>;
		qcom,row-hold-ns = <31250>;
		qcom,debounce-ms = <20>;
		qcom,wakeup;
		linux,keymap = <0x00000001 0x00010002
			       0x01000003 0x01010004>;
	}
```
