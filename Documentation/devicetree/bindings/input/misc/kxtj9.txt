## Documentation/devicetree/bindings/input/misc/kxtj9.txt
```
Kionis KXTIK-series accelerometer driver

Required properties:

 - compatible		: Should be "kionix,kxtj9".
 - reg			: i2c slave address of the device.
 - interrupt-parent	: Parent of interrupt.
 - interrupts		: Accelerometer sample interrupt to indicate new data ready.
 - vdd-supply		: Analog power supply needed to power device.
 - vio-supply		: Digital IO power supply needed for IO and I2C.
 - kionix,min-interval	: Minimal data polling interval in millisecond.
 - kionix,init-interval	: Initial data polling interval in millisecond.
 - kionix,axis-map-x	: Select which data will be X-axis of reading.
				The sensor measures and reports three axis of
				data, this property selset which data will be
				interpretd as X-axis gravity data of phone.
				e.g. Give "0" to this property means the first
				measurement data will be used as X-axis data
 - kionix,axis-map-y	: Select which data will be Y-axis of reading.
				Similar to property above, this property selet
				Y-axis data.
 - kionix,axis-map-z	: Select which data will be Z-axis of reading.
				Similar to property above, this property selet
				Z-axis data.
 - kionix,g-range	: Select initial range of measurement. This define
				the initial configuration of maxinum
				measurement range of the sensor.Where 2 is 2G,
				4 is 4G, 8 is 8G, 2G will be used for any other
				values.

Optional properties:

 - kionix,negate-x	: Boolean to select negate of X-axis data is
				required, if this property is defined, X-axis
				data will be negated.
 - kionix,negate-y	: Boolean to select negate of Y-axis data is
				required, if this property is defined, Y-axis
				data will be negated.
 - kionix,negate-z	: Boolean to select negate of Z-axis data is
				required, if this property is defined, Z-axis
				data will be negated.
 - kionix,res-12bit;	: Boolean to select output data resolution, if this
				property is defined, sensor will be configured
				to output 12 bits of data, otherwise sensor will
				be configured to output 8 bits data.

Example:
	i2c@f9925000 { /* BLSP-1 QUP-3 */
		kionix@f {
			compatible = "kionix,kxtj9";
			reg = <0x0f>;
			interrupt-parent = <&msmgpio>;
			interrupts = <81 0x2>;
			vdd-supply = <&pm8110_l19>;
			vio-supply = <&pm8110_l14>;
			kionix,min-interval = <5>;
			kionix,init-interval = <200>;
			kionix,axis-map-x = <1>;
			kionix,axis-map-y = <0>;
			kionix,axis-map-z = <2>;
			kionix,g-range = <2>;
			kionix,negate-x;
			kionix,negate-y;
			kionix,negate-z;
			kionix,res-12bit;
		};
	};
```

## Documentation/devicetree/bindings/input/misc/lis3dh_acc.txt
```
ST LIS3DH 3-axis accelerometer sensor driver

Required properties:

 - compatible		: Should be "st,lis3dh".
 - reg			: i2c slave address of the device.
 - pinctrl-names	: The pinctrl configration names of this sensor driver. Should be
				"lis3dh_default" and "lis3dh_sleep".
 - pinctrl-0		: Should specify pin control groups used for this controller.
 - pinctrl-1		: Should specify pin control groups used for this controller.
 - interrupt-parent	: Parent of interrupt.
 - interrupts		: Accelerometer sample interrupt to indicate new data ready.
 - vdd-supply		: Analog power supply needed to power device.
 - vddio-supply		: Digital IO power supply needed for IO and I2C.
 - st,min-interval	: Minimal data polling interval in millisecond.
 - st,init-interval	: Initial data polling interval in millisecond.
 - st,axis-map-x	: Select which data will be X-axis of reading.
				The sensor measures and reports three axis of
				data, this property select which data will be
				interpretd as X-axis gravity data of phone.
				e.g. Give "0" to this property means the first
				measurement data will be used as X-axis data.
 - st,axis-map-y	: Select which data will be Y-axis of reading.
				Similar to property above, this property selet
				Y-axis data.
 - st,axis-map-z	: Select which data will be Z-axis of reading.
				Similar to property above, this property selet
				Z-axis data.
 - st,g-range	: Select initial range of measurement. This define
				the initial configuration of maxinum
				measurement range of the sensor.Where 2 is 2G,
				4 is 4G, 8 is 8G and 16 is 16G, 2G will be used for any
				other values.

Optional properties:

 - pinctrl-names: The names of the pinctrl states that used by the
				driver to configure the TLMM pins, it should contain
				only one value - "default".
 - pinctrl-<n>	: Pinctrl states as described in
				bindings/pinctrl/pinctrl-bindings.txt.
 - st,negate-x	: Boolean to select negate of X-axis data is
				required, if this property is defined, X-axis
				data will be negated.
 - st,negate-y	: Boolean to select negate of Y-axis data is
				required, if this property is defined, Y-axis
				data will be negated.
 - st,negate-z	: Boolean to select negate of Z-axis data is
				required, if this property is defined, Z-axis
				data will be negated.
 - st,gpio-int1	: 1st irq gpio which is to provide interrupts
				to host, interrupt events can be route to any of
				these two irq pins according device configuration.
 - st,gpio-int2	: 2nd irq gpio which is to provide interrupts
				to host.

Example:
	i2c@f9925000 { /* BLSP-1 QUP-3 */
		st@18 {
			compatible = "st,lis3dh";
			reg = <0x18>;
			pinctrl-names = "lis3dh_default","lis3dh_sleep";
			pinctrl-0 = <&lis3dh_int1_default>;
			pinctrl-1 = <&lis3dh_int1_sleep>;
			interrupt-parent = <&msm_gpio>;
			interrupts = <115 0x2002>;
			vdd-supply = <&pm8916_l17>;
			vddio-supply = <&pm8916_l6>;
			st,min-interval = <5>;
			st,init-interval = <200>;
			st,axis-map-x = <1>;
			st,axis-map-y = <0>;
			st,axis-map-z = <2>;
			st,g-range = <2>;
			st,gpio-int1 = <&msm_gpio 115 0x2002>;
			st,negate-x;
			st,negate-y;
			st,negate-z;
		};
	};
```

## Documentation/devicetree/bindings/input/misc/ltr553.txt
```
LTR-553ALS-01 optical sensor

LTR553 is an ambient light and proximity sensor. It connects to host SoC via
I2C bus.

Abbreviation:
ALS: ambient light sensor
PS: proximity sensor
ALPS: ambient light and proximity sensor

Required properties:
 - compatible		: Should be "liteon,ltr553".
 - reg			: i2c slave address of this device.
 - vdd-supply		: Analog power supply needed to power up this device.
 - vio-supply		: Digital IO power supply needed for IO and i2c.
 - interrupt-parent	: The interrupt controller this device is connected to.
 - interrupts		: L/P sample interrupt to indicate new data ready.
 - pinctrl-names	: pinctrl configuration names of this device. Should be
	"default" and "sleep".
 - pinctrl-0		: Should specify pin control groups used for this sensor.
 - pinctrl-1		: Should specify pin control groups used for this sensor.
 - liteon,irq-gpio	: GPIO pin for interrupt of this device.
 - liteon,als-ps-persist: The number of data out of range to trigger interrupt.
 - liteon,ps-led	: Proximity sensor LED settings.
 - liteon,ps-pulses	: Controls the number of LED pulses to be emitted.
 - liteon,als-integration-time	: ALS integration time configuration. The
	maximum value is 7.

 Optional properties:
 - liteon,ps-distance-table	: Proximity sensor ADC value to transfer into
	distance in centimeter.
 - liteon,als-equation-0	: Equation to convert ALS data into lux for
	light ratio below 0.45.
 - liteon,als-equation-1	: Equation to convert ALS data into lux for
	light ratio between 0.45 and 0.68.
 - liteon,als-equation-2	: Equation to convert ALS data into lux for
	light ratio between 0.68 and 0.99.
 - liteon,als-equation-3	: Equation to convert ALS data into lux for
	light ratio above 0.99.
 - liteon,wakeup-threshold	: Threshold in centimeter to wake up SoC in
	suspend mode when proximity is enabled.
 - liteon,als-sensitivity	: Ambient light sensitivity in lux. This array
	configures how much light intensity change will trigger a light sensor
	event under different als gain configuration. The array size must be 8.

 Example:

 i2c@78b5000 { /* BLSP1 QUP1 */
	 liteon@23 {
		 compatible = "liteon,ltr553";
		 reg = <0x23>;
		 vdd-supply = <&pm8916_l17>;
		 vio-supply = <&pm8916_l6>;
		 interrupt-parent = <&msm_gpio>;
		 interrupts = <113 0x2002>;
		 pinctrl-names = "default","sleep";
		 pinctrl-0 = <&ltr553_default>;
		 pinctrl-1 = <&ltr553_sleep>;
		 liteon,irq-gpio = <&msm_gpio 113 0x2002>;
		 liteon,als-ps-persist = <0>;
		 liteon,ps-led = <0x7f>;
		 liteon,ps-pulses = <4>;
		 liteon,wakeup-threshold = <4>;
		 liteon,als-integration-time = <0>;
		 liteon,als-sensitivity = <6000 3200 1600 800 0 0 130 1>;
	 };
 }
```

## Documentation/devicetree/bindings/input/misc/mc3xxx.txt
```
mCube mc3xxx 3-axis accelerometer sensor driver.

Required properties:

 - compatible		: Should be "mcube,mc3xxx".
 - reg			: i2c slave address of the device.
 - pinctrl-names	: Pinctrl configuration names of this sensor driver.
				Should be "default".
 - pinctrl-0		: The pinctrl node corresponding to "default",
				Should be <&mc3xxx_default>.
 - interrupt-parent	: Parent of interrupt.
 - interrupts		: Accelerometer interrupt to indicate new data ready or events.
 - vdd-supply		: Analog power supply needed to power device.
 - vio-supply		: Digital IO power supply needed for IO and I2C.
 - mcube,position	: The orientation of the accelerometer on the board. There
				are 8 possible ways of positioning it:
				0: top, left-down
				1: top, right-down
				2: top, right-up
				3: top, left-up
				4: bottom, left-down
				5: bottom, right-down
				6: bottom, right-up
				7: bottom, left-up

Example:
&i2c_0 { /* BLSP1 QUP2 */
	 mcube@4c { /* Accelerometer sensor */
		compatible = "mcube,mc3xxx";
		reg = <0x4c>;
		pinctrl-names = "default";
		pinctrl-0 = <&mc3xxx_default>;
		interrupt-parent = <&msm_gpio>;
		interrupts = <115 0x2002>;
		vdd-supply = <&pm8916_l17>;
		vio-supply = <&pm8916_l6>;
		mcube,position = <1>;
	};
};
```

## Documentation/devicetree/bindings/input/misc/mma8x5x.txt
```
Freescale MMA8x5x 3-Axis Orientation/Motion Detection Sensor series
(MMA8451/MMA8452/MMA8453/MMA8652/MMA8653)

The Freescale 3-Axis Orientation/Motion Detection Sensor is
connected to host processor via i2c.
The sensor can be polling for acceleration data or configure to
generates interrupts when a motion is detected.

Required properties:

 - compatible		: should be "fsl,mma8x5x"
 - reg			: i2c slave address of the device
 - vdd-supply : power supply needed to power up the device.
 - vio-supply	: power supply needed for device IO and to pullup i2c bus.
 - fsl,sensors-position	: select from 0 to 7 depends on how the sensor is
				 mounting on the board, this will decide how the 3-axis reading
				 of data will be translated to X/Y/Z axis of acceleration data.

Optional properties:
 Sensor can work on polling mode or interrupt mode, following interrupt
 is required if the sensor need to work on interrupt mode.
 - interrupt-parent	: parent of interrupt.
 - interrupts		: sensor signal interrupt to indicate new data ready or
				 a motion is detected.
 - fsl,irq-gpio	: First irq gpio which is to provide interrupts to host, same
				 as "interrupts" node. It will also contain active low or active
				 high information.

Example:
	fsl@1c {
		compatible = "fsl,mma8x5x";
		reg = <0x1c>;
		interrupt-parent = <&msmgpio>;
		interrupts = <81 0x2>;
		vdd-supply = <&pm8110_l19>;
		vio-supply = <&pm8110_l14>;
		fsl,sensors-position = <5>;
		fsl,irq-gpio = <&msmgpio 0x81 0x02>;
	};
```

## Documentation/devicetree/bindings/input/misc/mmc3416x.txt
```
MEMSIC MMC3416x 3-axis magnetic sensor

The MEMSIC 3-axis magnetic sensor is a complete 3-axis magnetic sensor with
on-chip signal processing and intergrated i2c bus. It can be connected to host
processor via i2c. It can measure magnetic fields within the full scale range
from -16 Gauss to +16 Gauss.

Required properties:

 - compatible		: Should be "memsic,mmc3416x".
 - reg			: i2c address of the device.
 - vdd-supply		: Analog power supply needed to power up the device.
 - vio-supply		: Digital IO power supply needed for IO and I2C.
 - memsic,dir		: String value of the direction of the ecompass sensor
	chip. There are 8 patterns of direction:


       x > 0 /___________o
               /        /|
              /        / |* 1st pin is here
             /________/ /|
             |_______/|/ |/ z > 0
                    /
                  |/ y > 0


		The above graph shows the coordinate of the sensor chip. Specify the
		following string to memsic,dir to convert it into Android coordinate.
		Note the definition of sensor placement on target board is relative to
		Android portrait mode.

						left	right	up	down
		obverse-x-axis-forward	Y+	Y-	X+	X-
		obverse-x-axis-rightward	X-	X+	Y+	Y-
		obverse-x-axis-backward	Y-	Y+	X-	X+
		obverse-x-axis-leftward	X+	X-	Y-	Y+
		reverse-x-axis-forward	Y-	Y+	X+	X-
		reverse-x-axis-rightward	X-	X+	Y-	Y+
		reverse-x-axis-backward	Y+	Y-	X-	X+
		reverse-x-axis-leftward	X+	X-	Y+	Y-

Optional properites:

 - memsic,auto-report	: Boolean value to indicate if enable auto-report mode.

 Example:
	A chip on 8916 platform with the pattern as the above graph:
	&i2c_0 { /* BLSP1 QUP2 */
		memsic@30 {
				compatible = "memsic,mmc3416x";
				reg = <0x30>;
				vdd-supply = <&pm8916_l17>;
				vio-supply = <&pm8916_l6>;
				memsic,dir = "obverse-x-axis-forward";
				memsic,auto-report;
		};
	};
```

## Documentation/devicetree/bindings/input/misc/mpu3050.txt
```
InvenSense MPU30X0-series gyrometer driver

Required properties:

 - compatible		: Should be "invn,mpu3050".
 - reg				: i2c slave address of the device.
 - interrupt-parent	: Parent of interrupt.
 - interrupts		: Gyrometer sample interrupt to indicate new data ready.
 - vdd-supply		: Analog power supply needed to power device.
 - vlogic-supply	: Digital IO power supply needed for IO and I2C.
 - invn,gpio-int	: GPIO used for interrupt.
 - invn,gpio-en		: GPIO used for power enabling.
 - invn,poll-interval	: Initial data polling interval in milliseconds.

Example:
	i2c@f9925000 {
		mpu3050@68 {
			#address-cells = <1>;
			#size-cells = <0>;
			status = "okay";
			reg = <0x68>;
			compatible = "invn,mpu3050";
			interrupt-parent = <&msmgpio>;
			interrupts = <84 0x2>;
			vlogic-supply = <&pm8110_l14>;
			vdd-supply = <&pm8110_l19>;
			invn,gpio-int = <&msmgpio 84 0x2>;
			invn,gpio-en = <&pm8110_gpios 2 0x2>;
			invn,poll-interval = <200>;
		};
	};
```
