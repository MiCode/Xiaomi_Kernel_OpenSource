## Documentation/devicetree/bindings/input/touchscreen/atmel-maxtouch-ts.txt
```
Atmel touch controller

Required properties:

 - compatible	: should be "atmel,maxtouch-ts"
 - reg			: i2c slave address of the device
 - interrupt-parent	: parent of interrupt
 - interrupts		: touch sample interrupt to indicate presense or release
				of fingers on the panel.
 - atmel,panel-coords	: touch panel minimum x, minimum y, maximum x and
				maximum y resolution
 - atmel,display-coords : LCD display minimum x, minimum y, maximum x and
				maximum y resolution
 - vdd-supply		: digital power supply. It powers up the digital
			block of the controller to enable i2c communication.
 - avdd-supply		: analog Power supply. It powers up the analog
			channel block of the controller to detect the touches.
 - atmel,irq-gpio	: irq gpio
 - atmel,reset-gpio	: reset gpio

Optional property:
 - atmel,ignore-crc	: Boolean flag to ignore cyclic redundancy check (CRC) on
			configuration
 - xvdd-supply		: x-line drive voltage supply. It is used for charging
			the capacitors on the touch panel.
 - atmel,bl-addr	: bootloader address, by default is looked up
				in mxt_slave_addresses structure
 - atmel,key-codes	: key codes corresponding to keyarray object
 - atmel,i2cmode-gpio	: i2cmode gpio. This pin is used for selecting the i2c communication mode.
			Pull the line low for HID and high for STANDARD i2c.
 - pinctrl-names	: This should be defined if a target uses pinctrl framework.
			See "pinctrl" in Documentation/devicetree/bindings/pinctrl/msm-pinctrl.txt.
			It should specify the names of the configs that pinctrl can install in driver.
			Following are the pinctrl configs that can be installed:
			"pmx_ts_active" : Active configuration of pins, this should specify active
			config defined in pin groups of interrupt, i2cmode and reset gpio.
			"pmx_ts_suspend" : Disabled configuration of pins, this should specify sleep
			config defined in pin groups of interrupt, i2cmode and reset gpio.
 - clocks		: specify the clocks associated with the underlying bus when secure touch
			is enabled.
			This property is required only if secure touch is enabled and used with
			this driver.
 - clock-names:		: clock names used for secure touch. The names are:
			"iface_clk", "core_clk".

Example:
	i2c@f9966000 {
		atmel_maxtouch_ts@4a {
			compatible = "atmel,maxtouch-ts";
			reg = <0x4a>
			interrupt-parent = <&msmgpio>
			interrupts = <48 0x0>;
			vdd-supply = <&pm8941_l18>;
			avdd-supply = <&pm8941_lvs1>;
			xvdd-supply = <&pm8941_s4>;
			atmel,panel-coords = <0 0 479 799>;
			atmel,display-coords = <0 0 479 799>;
			atmel,irq-gpio = <&msmgpio 48 0>;
			atmel,reset-gpio = <&msmgpio 26 0>;
			atmel,i2cmode-gpio = <&msmgpio 27 0>;
			atmel,ignore-crc;
			pinctrl-names = "pmx_ts_active","pmx_ts_suspend";
			pinctrl-0 = <&ts_int_active &ts_reset_active &ts_i2cmode_active>;
			pinctrl-1 = <&ts_int_suspend &ts_reset_suspend &ts_i2cmode_suspend>;
			/* Underlying clocks used by secure touch */
			clock-names = "iface_clk", "core_clk";
			clocks = <&clock_gcc clk_gcc_blsp1_ahb_clk>,
				 <&clock_gcc clk_gcc_blsp1_qup2_i2c_apps_clk>;
		};
	};
```

## Documentation/devicetree/bindings/input/touchscreen/atmel-mxt-ts.txt
```
Atmel touch controller

Required properties:

 - compatible	: should be "atmel,mxt-ts"
 - reg			: i2c slave address of the device
 - interrupt-parent	: parent of interrupt
 - interrupts		: touch sample interrupt to indicate presense or release
				of fingers on the panel.
 - atmel,panel-coords	: touch panel minimum x, minimum y, maximum x and
				maximum y resolution
 - atmel,display-coords : LCD display minimum x, minimum y, maximum x and
				maximum y resolution
 - vdd_ana-supply	: Analog power supply needed to power device
 - atmel,irq-gpio	: irq gpio
 - atmel,reset-gpio	: reset gpio
 - atmel,family-id	: family identification of the controller
 - atmel,variant-id	: variant identification of the controller
 - atmel,version	: firmware version of the controller
 - atmel,build		: firmware build number of the controller

Required for firmware update only:
 - atmel,fw-name		: firmware name to use for flashing firmware
 - atmel,bootldr-id		: bootloader identification of the controller

Optional property:
 - atmel,bl-addr		: bootloader address, by default is looked up
					in mxt_slave_addresses structure
 - atmel,config			: configuration parameter for the controller
 - atmel,i2c-pull-up		: specify to indicate pull up is needed
 - vcc_i2c-supply		: Power source required to pull up i2c bus
 - atmel,dig-reg-support	: specify to indicate digital regulator is
					needed
 - atmel,need-calibration	: specify to indicate whether calibration is
					needed during wakeup.
 - atmel,no-force-update	: flag that signifies whether force configuration
					update is applicable or not
 - atmel,no-lpm-support		: flag that signifies whether low power mode is
					supported or not on this platform
 - atmel,i2cmode-gpio		: specify gpio number for i2cmode, which provides
					internal pull-ups to i2c bus in case there
					is no hardware pull-up support

Example:
	i2c@f9966000 {
		cell-index = <3>;
		compatible = "qcom,i2c-qup";
		reg = <0xf9966000 0x1000>;
		#address-cells = <1>;
		#size-cells = <0>;
		reg-names = "qup_phys_addr";
		interrupts = <0 104 0>;
		interrupt-names = "qup_err_intr";
		qcom,i2c-bus-freq = <100000>;
		qcom,i2c-src-freq = <24000000>;

		atmel_mxt_ts@4a {
			compatible = "atmel,mxt-ts";
			reg = <0x4a>
			interrupt-parent = <&msmgpio>
			interrupts = <48 0x0>;
			vdd_ana-supply = <&pm8941_l18>;
			vcc_i2c-supply = <&pm8941_lvs1>;
			atmel,panel-coords = <0 0 479 799>;
			atmel,display-coords = <0 0 479 799>;
			atmel,i2c-pull-up;
			atmel,no-force-update;
			atmel,dig-reg-support;
			atmel,key-codes = <
				102 139 0 0 0 0 0 0
				0 158 217 0 0 0 0 0
				0 0 0 0 0 0 0 0
				0 0 0 0 0 0 0 0 >;
			atmel,irq-gpio = <&msmgpio 48 0>;
			atmel,reset-gpio = <&msmgpio 26 0>;
			atmel,cfg_1 {
				atmel,family-id = <0x81>;
				atmel,variant-id = <0x01>;
				atmel,version = <0x10>;
				atmel,build = <0xaa>;
				atmel,config = [
					/* Object 6, Instance = 0 */
					00 00 00 00 00 00
					/* Object 38, Instance = 0 */
					15 00 02 10 08 0C 00 00
					/* Object 7, Instance = 0 */
					FF FF 32 03
					/* Object 8, Instance = 0 */
					0F 00 0A 0A 00 00 0A 00 00 00
					/* Object 9, Instance = 0 */
					83 00 00 18 0E 00 70 32 02 01
					00 03 01 01 05 0A 0A 0A 90 05
					F8 02 00 00 0F 0F 00 00 48 2D
					07 0C 00 00 00 00
					/* Object 15, Instance = 0 */
					00 00 00 00 00 00 00 00 00 00
					00
					/* Object 18, Instance = 0 */
					00 00
					/* Object 19, Instance = 0 */
					00 00 00 00 00 00
					/* Object 23, Instance = 0 */
					00 00 00 00 00 00 00 00 00 00
					00 00 00 00 00
					/* Object 25, Instance = 0 */
					00 00 00 00 00 00 00 00 00 00
					00 00 00 00 00
					/* Object 40, Instance = 0 */
					00 00 00 00 00
					/* Object 42, Instance = 0 */
					00 00 00 00 00 00 00 00 00 00
					/* Object 46, Instance = 0 */
					00 00 10 10 00 00 03 00 00 01
					/* Object 47, Instance = 0 */
					08 0A 28 0A 02 0A 00 8C 00 20
					00 00 00
					/* Object 55, Instance = 0 */
					00 00 00 00 00 00
					/* Object 56, Instance = 0 */
					03 00 01 18 05 05 05 05 05 05
					05 05 05 05 05 05 05 05 05 05
					05 05 05 05 05 05 05 05 00 00
					00 00 00 00 00 00 00 00 00 00
					00 00
					/* Object 57, Instance = 0 */
					00 00 00
					/* Object 61, Instance = 0 */
					00 00 00 00 00
					/* Object 61, Instance = 1 */
					00 00 00 00 00
					/* Object 62, Instance = 0 */
					7F 03 00 16 00 00 00 00 00 00
					04 08 10 18 05 00 0A 05 05 50
					14 19 34 1A 64 00 00 04 40 00
					00 00 00 00 30 32 02 00 01 00
					05 00 00 00 00 00 00 00 00 00
					00 00 0C 00
					];
			}

		}
	};
```

## Documentation/devicetree/bindings/input/touchscreen/cyttsp5.txt
```
* Cypress cyttsp5 touchscreen controller

Required properties:
 - compatible		: must be "cy,cyttsp5_i2c_adapter"
 - reg			: Device I2C address or SPI chip select number
 - interrupt-parent	: the phandle for the gpio controller
			  (see interrupt binding[0]).
 - interrupts		: (gpio) interrupt to which the chip is connected
			  (see interrupt binding[0]).
 - vcc_i2c-supply	: power supply
 - vdd-supply		: power supply
 - cy,mt		: multi-touch

Optional properties:
 - cy,btn		: button

[0]: Documentation/devicetree/bindings/interrupt-controller/interrupts.txt
[1]: Documentation/devicetree/bindings/gpio/gpio.txt

Example:
	&i2c1 {
		/* ... */
		tsc@24 {
			compatible = "cy,cyttsp5_i2c_adapter";
			reg = <0x24>;
			interrupt-parent = <&msm_gpio>;
			interrupts = <13 0x2008>;
			cy,adapter_id = "cyttsp5_i2c_adapter";
			vcc_i2c-supply = <&pm8916_l6>;
			vdd-supply = <&pm8916_l17>;

			cy,core {
				cy,name = "cyttsp5_core";
				cy,irq_gpio = <13>;
				cy,rst_gpio = <12>;
				cy,hid_desc_register = <1>;
				cy,flags = <4>;
				cy,easy_wakeup_gesture = <1>;
				cy,btn_keys = <172 139 158 217 114 115 212 116>;
				cy,btn_keys-tag = <0>;

				cy,mt {
					cy,name = "cyttsp5_mt";
					cy,inp_dev_name = "cyttsp5_mt";
					cy,flags = <0x28>;
					cy,abs =
						<0x35 0 320 0 0
						0x36 0 360 0 0
						0x3a 0 255 0 0
						0xffff 0 255 0 0
						0x39 0 15 0 0
						0x30 0 255 0 0
						0x31 0 255 0 0
						0x34 0xffffff81 127 0 0
						0x37 0 1 0 0
						0x3b 0 255 0 0>;

					cy,vkeys_x = <320>;
					cy,vkeys_y = <360>;

					cy,virtual_keys =
						/* KEY_BACK */
						<158 1360 90 160 180
						/* KEY_MENU */
						139 1360 270 160 180
						/* KEY_HOMEPAGE */
						172 1360 450 160 180
						/* KEY SEARCH */
						217 1360 630 160 180>;
				};

				cy,btn {
					cy,name = "cyttsp5_btn";

					cy,inp_dev_name = "cyttsp5_btn";
				};

				cy,proximity {
					cy,name = "cyttsp5_proximity";

					cy,inp_dev_name = "cyttsp5_proximity";
					cy,abs = <0x19 0 1 0 0>;
				};
			};
		};

		/* ... */
	};
```

## Documentation/devicetree/bindings/input/touchscreen/elants_i2c.txt
```
Elan Ektf3xx series touch controller

   Required properties:

		- compatible				: Should be "elan,ekth3500"
		- reg				        : I2C slave address of the device.
		- interrupt-parent			: Parent of interrupt.
		- interrupts				: Configuration of touch panel controller interrupt GPIO.
		- elan,irq-gpio				: Interrupt gpio which is to provide interrupts to
										host, same as "interrupts" node.It will also contain
										active low or active high information

  Optional properties:

		- vdd-supply				: Power supply needed to power up the device, when use
										external regulator, do not add this property.
		- vccio-supply				: Power source required to power up i2c bus.
										Ekth3500 series can provide 1.8V from internal
										LDO, add this properties base on hardware design.
		- reset-gpio			    : Reset gpio to control the reset of chip.

  Example:
		i2c@f9923000{
			elan_ktf@10 {
				compatible = "elan,ekth3500";
				reg = <0x10>;
				vdd-supply = <&pm8110_l19>;
				vccio-supply = <&pm8110_l14>;
				reset-gpio = <&msmgpio 0 GPIO_ACTIVE_LOW>;
				interrupt-parent = <&msmgpio>;
				interrupts = <1 0x2>;
				elan,irq-gpio = <&tlmm 65 0x2008>;>
			};
		};
```

## Documentation/devicetree/bindings/input/touchscreen/focaltech-ts.txt
```
FocalTech touch controller

The focaltech controller is connected to host processor via i2c. The controller generates interrupts when the user touches the panel. The host controller is expected to read the touch coordinates over i2c and pass the coordinates to the rest of the system.

Required properties:
 - compatible		: should be "focaltech,fts_ts"
 - reg			: i2c slave address of the device, should be <0x38>; For spi interface, means cs number, always be 0
 - interrupt-parent	: parent of interrupt
 - interrupts		: irq gpio, "0x02" stands for that the irq triggered by falling edge.
 - focaltech,irq-gpio	: irq gpio, same as "interrupts" node.
 - focaltech,reset-gpio	: reset gpio
 - focaltech,num-max-touches	: maximum number of touches support
 - focaltech,display-coords 	: display resolution in pixels. A four tuple consisting of minX, minY, maxX and maxY.

Optional properties:
 - focaltech,have-key		: specify if virtual keys are supported
 - focaltech,key-number		: number of keys
 - focaltech,keys		: virtual key codes mapping to the coords
 - focaltech,key-x-coords	: constant x coordinates of keys, depends on the x resolution
 - focaltech,key-y-coords	: constant y coordinates of keys, depends on the y resolution

Example:
I2C Interface:
	i2c@f9927000 {
		focaltech@38{
			compatible = "focaltech,fts_ts";
			reg = <0x38>;
			interrupt-parent = <&msm_gpio>;
			interrupts = <13 0x02>;
			focaltech,reset-gpio = <&msm_gpio 12 0x01>;
			focaltech,irq-gpio = <&msm_gpio 13 0x02>;
			focaltech,max-touch-number = <10>;
			focaltech,display-coords =  <0 0 1080 1920>;

			pinctrl-names = "pmx_ts_active","pmx_ts_suspend","pmx_ts_release";
			pinctrl-0 = <&ts_int_active &ts_reset_active>;
			pinctrl-1 = <&ts_int_suspend &ts_reset_suspend>;
			pinctrl-2 = <&ts_release>;

			/*
			focaltech,have-key;
			focaltech,key-number = <3>;
			focaltech,keys = <139 102 158>;
			focaltech,key-x-coords = <200 600 800>;
			focaltech,key-y-coords = <2000 2000 2000>;
			*/
		};
	};

SPI Interface:
	spi@78b9000 {
		focaltech@0 {
			compatible = "focaltech,fts_ts";
			reg = <0x0>;
			spi-max-frequency = <6000000>;
			interrupt-parent = <&msm_gpio>;
			interrupts = <13 0x2>;
			focaltech,reset-gpio = <&msm_gpio 12 0x01>;
			focaltech,irq-gpio = <&msm_gpio 13 0x02>;
			focaltech,max-touch-number = <10>;
			focaltech,display-coords =  <0 0 1080 1920>;

			pinctrl-names = "pmx_ts_active","pmx_ts_suspend","pmx_ts_release";
			pinctrl-0 = <&ts_int_active &ts_reset_active>;
			pinctrl-1 = <&ts_int_suspend &ts_reset_suspend>;
			pinctrl-2 = <&ts_release>;
		};
	};
```

## Documentation/devicetree/bindings/input/touchscreen/focaltech.txt
```
FocalTech touch controller

Required properties:

 - compatible			: Should be "focaltech,5x06"
```
