## Documentation/devicetree/bindings/input/qti-haptics.txt
```
Qualcomm Technologies, Inc. Haptics driver

Haptics peripheral in QTI PMICs can support different type of actuators or
vibrators:
  1) Eccentric Rotation Mass (ERM);
  2) Linear Resonant Actuator (LRA).
This binding document describes the properties for this module.

Properties:

- compatible
  Usage:      required
  Value type: <string>
  Definition: It can be one of the following:
		"qcom,haptics",
		"qcom,pm660-haptics",
		"qcom,pm8150b-haptics".

- reg
  Usage:      required
  Value type: <u32>
  Definition: Base address of haptics peripheral.

- interrupts
  Usage:      required
  Value type: <prop-encoded-array>
  Definition: Peripheral interrupt specifier.

- interrupt-names
  Usage:      required
  Value type: <stringlist>
  Definition: Interrupt names.  This list must match up 1-to-1 with the
		interrupts specified in the 'interrupts' property. Following
		interrupts are required: "hap_play_irq", "hap_sc_irq".

- qcom,actuator-type
  Usage:      optional
  Value type: <string>
  Definition: Specifies the type of the actuator connected on the output of
		haptics module. Allowed values: "erm", "lra". If this is
		not specified, then LRA type will be used by default.

- qcom,vmax-mv
  Usage:      optional
  Value type: <u32>
  Definition: Specifies the maximum allowed output voltage in millivolts
		for the actuator. Value specified here will be rounded
		off to the closest multiple of 116 mV. Allowed values:
		0 to 3596. If this is not specified, then 1800 mV will be
		used by default.

- qcom,play-rate-us
  Usage:      optional
  Value type: <u32>
  Definition: Specifies the period at which each sample of the 8-byte waveform
		registers is played. For ERM, this period is flexible and it
		can be chosen based on the desired shape of the pattern.
		For LRA, it should be set equal to the resonance period
		specified in the LRA actuator datasheet. Allowed values are:
		0 to 20475. If this is not specified, 5715us play rate is used.

- qcom,external-waveform-source
  Usage:      optional
  Value type: <string>
  Definition: The haptics module supports to play with internal constant
		Vmax strength or play with patterns specified in its internal
		8-bytes waveform buffer. It can also play with the audio
		LINE-IN signal or PWM waveform coming from LINE-IN/PWM pin.
		This property specify the kind of the waveform resources
		on the LINE-IN/PWM pins. Allowed values are: "audio", "pwm".
		If this is not specified, internal signals (Vmax or buffer)
		will be selected according to the requriement of the playing
		waveforms.

- vdd-supply
  Usage:      optional
  Value type: <phandle>
  Definition: Specifies the phandle of the regulator device which supplies
		haptics module through VDD_HAP pin. This is only needed if VDD_HAP
		is supplied from an external boost regulator instead of VPH_PWR.

- qcom,haptics-ext-pin-twm
  Usage:      optional
  Value type: <empty>
  Definition: A boolean property which configures haptics into external-pin
		control during TWM entry.

Following properties are specific only when LRA actuator is used:

- qcom,lra-resonance-sig-shape
  Usage:      optional
  Value type: <string>
  Definition: Specifies the shape of the LRA resonance drive signal. Allowed
		values: "sine", "square". If this is not specified, sinusoid
		resonance driver signal is used.

- qcom,lra-allow-variable-play-rate
  Usage:      optional
  Value type: <empty>
  Definition: If specified, "qcom,wf-play-rate-us" for LRA defined in each
		effect could be different with the resonance period of the
		LRA actuator.

- qcom,lra-auto-resonance-mode
  Usage:      optional
  Value type: <string>
  Definition: Specifies the auto resonance technique for LRA. Allowed values are:
		"zxd": zero crossing based discontinuous method;
		"qwd": quarter wave drive method;

Following properties could be specified in child nodes for defining vibrating
waveforms/effects:

- qcom,effect-id
  Usage:      required
  Value type: <u32>
  Definition: Specifies the effect ID that the client can request to play the
		corresponding waveform defined in this child node. The ID is
		normaly defined and sent from userspace for certain user
		notification event.

- qcom,wf-pattern
  Usage:      required
  Value type: <prop-encoded-array>
  Definition: Specifies the waveform pattern in a byte array that will be
		played for the effect-id. The bit fields of each byte are:
		 [7]: drive direction, 0 - forward; 1 - reverse
		 [6]: overdrive, 0 -- 1x drive; 1 -- 2x drive
		 [5:1]: waveform amplitude
		 [0]: reserved.

- qcom,wf-vmax-mv
  Usage:      optional
  Value type: <u32>
  Definition: Specifies the maximum allowed output voltage in millivolts
		for this effect. Value specified here will be rounded
		off to the closest multiple of 116 mV. Allowed values:
		0 to 3596. If this is not specified, the value defined in
		"qcom,vmax-mv" will be applied.

- qcom,wf-play-rate-us
  Usage:      optional
  Value type: <u32>
  Definition: Specifies the play period in microseconds for each byte pattern.
		Allowed values are: 0 to 20475. For LRA actuator, if
		"qcom,lra-allow-variable-play-rate" is defined, it could be
		set to other values not equal to the resonance period of the
		LRA actuator.

- qcom,wf-repeat-count
  Usage:      optional
  Value type: <u32>
  Definition: Specifies the repeat times for the waveform pattern. Allowed
		values are: 1, 2, 4, 8, 16, 32, 64, 128.

- qcom,wf-s-repeat-count
  Usage:      optional
  Value type: <u32>
  Definition: Specifies the repeat times for each sample defined in
		qcom,wf-pattern. Allowed values are: 1, 2, 4, 8.

- qcom,wf-brake-pattern
  Usage:      optional
  Value type: <prop-encoded-array>
  Definition: Specifies the brake pattern with 4 elements used to enable the
		internal reverse braking. Allowed values for each element are:
			0: no brake
			1: brake with (Vmax / 2) strength
			2: brake with Vmax strength
			3: brake with (2 * Vmax) strength
		If this property is specified with an array of non-zero values,
		then the brake pattern is applied at the end of the playing
		waveform.

- qcom,lra-auto-resonance-disable
  Usage:      optional
  Value type: <empty>
  Definition: If specified, the hardware feature of LRA auto resonance detection
		is disabled.

Example:
  qcom,haptics@c000 {
	compatible = "qcom,haptics";
	reg = <0xc000 0x100>;
	interrupts = <0x3 0xc0 0x0 IRQ_TYPE_EDGE_BOTH>,
		     <0x3 0xc0 0x1 IRQ_TYPE_EDGE_BOTH>;
	interrupt-names = "hap-sc-irq", "hap-play-irq";
	qcom,actuator-type = "lra";
	qcom,vmax-mv = <1800>;
	qcom,play-rate-us = <8000>;
	qcom,lra-resonance-sig-shape = "sine";
	qcom,lra-auto-resonance-mode = "qwd";
	qcom,lra-allow-variable-play-rate;

	wf_0 {
		/* CLICK effect */
		qcom,effect-id = <0>;
		qcom,wf-play-rate-us = <6250>;
		qcom,wf-pattern = [3e 3e 3e];
		qcom,lra-auto-resonance-disable;
	};

	wf_5 {
		/* HEAVY_CLICK effect */
		qcom,effect-id = <5>;
		qcom,wf-play-rate-us = <6250>;
		qcom,wf-pattern = [7e 7e 7e];
	};
  };
```

## Documentation/devicetree/bindings/input/sensors/bmi160.txt
```
The BMI160 is a highly integrated, low power inertial measurement unit (IMU)
that provides precise acceleration and angular rate (gyroscopic) measurement.

Required properties:

 - compatible    : Should be "bosch-sensortec,bmi160".
 - reg           : the Chip select ID.
 - gpios         : BMI GPIO in the format described by ../gpio/gpio.txt

Optional properties:
 - bmi,init-interval:
 - bmi,place   :


Example:
	bmi160@68{
		compatible = "bosch-sensortec,bmi160";
		reg = <0x68>;
		pinctrl-names = "default";
		pinctrl-0 = <&bmi160_int1_default &bmi160_int2_default>;
		interrupt-parent = <&tlmm_pinmux>;
		interrupts = <78 0x2002>;
		bmi,init-interval = <200>;
		bmi,place = <1>;
		bmi,gpio_irq = <&tlmm_pinmux 78 0x2002>;
	};
```

## Documentation/devicetree/bindings/input/sensors/smi130.txt
```
The SMI130 is a highly integrated, low power inertial measurement unit (IMU)
that provides precise acceleration and angular rate (gyroscopic) measurement.

To enable driver probing, add the smi130_gyro and smi130_acc node to the platform
device tree as described below.

Required properties:

- compatible: "smi130_gyro", "smi130_acc"
- reg: the I2C address or SPI chip select the device will respond to
- interrupt-parent: phandle to the parent interrupt controller as documented in [interrupts][4]
- interrupts: interrupt mapping for IRQ as documented in [interrupts][4]

Recommended properties for SPI bus usage:
- spi-max-frequency: maximum SPI bus frequency as documented in [SPI][3]

Optional properties:
- smi130_gyro,gpio_irq: MEMS sensor interrupt line to use (default 1)

I2C example (based on Raspberry PI 3):

        &i2c0 {
                status = "ok";
                #address-cells = <0x1>;
                #size-cells = <0x0>;
                smi130_gyro@68 {
                        compatible = "smi130_gyro";
                        reg = <0x68>;
                        interrupt-parent = <&gpio>;
                        interrupts = <26 IRQ_TYPE_EDGE_RISING>;
                };
                smi130_acc@18 {
                        compatible = "smi130_acc";
                        reg = <0x18>;
                        interrupt-parent = <&gpio>;
                        interrupts = <25 IRQ_TYPE_EDGE_RISING>;
                };

SPI example (based on Raspberry PI 3):

        &spi0 {
                status = "ok";
                #address-cells = <0x1>;
                #size-cells = <0x0>;
                smi130_gyro@68 {
                        compatible = "smi130_gyro";
                        reg = <0x68>;
                        interrupt-parent = <&gpio>;
                        interrupts = <26 IRQ_TYPE_EDGE_RISING>;
                };
                smi130_acc@18 {
                        compatible = "smi130_acc";
                        reg = <0x18>;
                        interrupt-parent = <&gpio>;
                        interrupts = <25 IRQ_TYPE_EDGE_RISING>;
                };
```

## Documentation/devicetree/bindings/input/solteam-jsa1127.txt
```
* Solteam Opto Light Sensor JSA-1127

Required properties:
- compatible: should be from the list below
  "solteam-opto,jsa1127"
- reg: I2C Address
- solteam-opto,rint: resistor for adjusting integration time
- solteam-opto,integration-time: integration time
- solteam-opto,use-internal-integration-time: switch to en/disable
  using internal integration time
  0: disable
  1: enable
- solteam-opto,tint-coeff: integration time coefficient
- solteam-opto,noisy: noisy option will make driver report values in
  random variations to make ALS's applications working normally
  0: disable
  1: enable

Example:

jsa1127@39 {
	compatible = "solteam-opto,jsa1127";
	reg = <0x39>;
	solteam-opto,rint = <100>;
	solteam-opto,integration-time = <200>;
	solteam-opto,use-internal-integration-timing = <1>;
	solteam-opto,tint-coeff = <22>;
	solteam-opto,noisy = <1>;
};
```

## Documentation/devicetree/bindings/input/sprd-keypad.yaml
```yaml
# SPDX-License-Identifier: (GPL-2.0 OR BSD-2-Clause)

$id: http://devicetree.org/schemas/input/sprd-keypad.yaml#
$schema: http://devicetree.org/meta-schemas/core.yaml#

title: Device-Tree bindings for GPIO attached keys

maintainers:
  - Orson Zhai <orsonzhai@gmail.com>
  - Baolin Wang <baolin.wang7@gmail.com>
  - Chunyan Zhang <zhang.lyra@gmail.com>

description: |
    Keypad controller is used to interface a SoC with a matrix-keypad device.
    The keypad controller supports multiple row and column lines.
    A key can be placed at each intersection of a unique row and a unique column.
    The keypad controller can sense a key-press and key-release and report the
    event using a interrupt to the cpu.

properties:
    compatible:
    const: sprd,sc9860-keypad

    reg:
        maxItems: 1

    interrupts:
        maxItems: 1

    keypad,num-rows:
    description: Number of row lines connected to the keypad controller.

    keypad,num-columns:
    description: Number of column lines connected to the keypad.

    debounce-interval:
    description:
        Debouncing interval time in milliseconds. If not specified defaults to 5.
    $ref: /schemas/types.yaml#/definitions/uint32

    default: 5

    linux,keymap:
    description: An array of packed 1-cell entries containing the equivalent
        of row, column and linux key-code. The 32-bit big endian cell is packed.

required:
        - compatible
        - reg
        - keypad,num-rows
        - keypad,num-columns
        - linux,keymap

unevaluatedProperties: false


examples:
  - |
	keypad@40250000 {
		compatible = "sprd,sc9860-keypad";
		reg = 	<0x40250000 0x1000>;
		interrupts = <GIC_SPI 36 IRQ_TYPE_LEVEL_HIGH>;
		clocks = <&aonapb_gate CLK_KPD_EB>,
			<&aonapb_gate CLK_KPD_RTC_EB>;
		clock-names = "enable", "rtc";
		keypad,num-rows= <3>;
		keypad,num-columns = <3>;
		debounce-interval = <5>;
		linux,keymap = < 0x00000001
				 0x01000002
				 0x00020003>;
		status = "okay";
	};
...
```
