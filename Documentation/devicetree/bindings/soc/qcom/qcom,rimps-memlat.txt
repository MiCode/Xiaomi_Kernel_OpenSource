## Documentation/devicetree/bindings/soc/qcom/qcom,rimps-memlat.txt
```
RIMPS memory latency

RIMPS memlat is a device that represents the use of the PMU in ARM cores
to measure the parameters for latency driven memory access patterns in rimps.

Required structure:
An instance of rimps-memlat must be described in two levels of device nodes.
The first level describes the controller while the second level describes the
monitors that the controller manages. At least one monitor is required per
controller.

[First Level Nodes]
Required properties:
- compatible:			Must be "qcom,rimps-memlat-cpugrp"
- qcom,cpulist:			List of CPU phandles to be monitored in a
				cluster. Must be a superset of cpulists
				described in second level nodes.
- reg-names:			pmu-base addresses need to store the pmu events
				during LPM and hotplug scenario.

[Second Level Nodes]
Required properties:
- compatible:			Must be "qcom,rimps-memlat-mon-l3"
- qcom,core-dev-table:		A mapping table of core frequency to a required
				bandwidth vote at the given core frequency.
				A phandle that contains this property may be
				provided instead (to share tables across nodes).
- qcom,cachemiss-ev:		The cache miss event that this monitor is
				supposed to measure. Optional for compute only.
- reg-names:				ftbl_base address required to populate
				L3 frequency and perf_base address required to know the current
				L3 frequency set.
Optional properties:
- qcom,cpulist:			List of CPU phandles to be monitored in a
				cluster. Must be a subset of the cpulist
				described in first level node. Defaults to
				cpulist in first level node if not specified.
- qcom,inst-ev:			The instruction count event that this monitor is
				supposed to measure. Defaults to 0x08 if not
				specified.
- qcom,stall-cycle-ev:		The stall cycle count that this monitor is
				supposed to measure. Assumes 100% stall if not
				specified.

Example:

	cpu0_grp: qcom,cpu0_grp {
		compatible = "qcom,rimps-memlat-cpugrp";
		qcom,cpulist = <&CPU0 &CPU1 &CPU2 &CPU3>;
		#address-cells = <1>;
		#size-cells = <1>;
		ranges;
		reg = <0x0fd04900 0x1000>;
		reg-names = "pmu-base";

		cpu0_rimps_l3_latmon: qcom,cpu0-rimps-l3-latmon {
			#address-cells = <1>;
			#size-cells = <1>;
			ranges;
			compatible = "qcom,rimps-memlat-mon-l3";
			qcom,cpulist = <&CPU0 &CPU1 &CPU2 &CPU3>;
			qcom,cachemiss-ev = <0x17>;
			reg = <0x18590100 0xa0>, <0x18590320 0x4>;
			reg-names = "ftbl-base", "perf-base";

			qcom,core-dev-table =
				<  300000  300000000 >,
				<  403200  403200000 >,
				<  499200  499200000 >,
				<  691200  614400000 >,
				<  806400  710400000 >,
				<  998400  806400000 >,
				< 1190400  998400000 >,
				< 1286400 1094400000 >,
				< 1459200 1248000000 >,
				< 1728000 1344000000 >,
				< 1804800 1440000000 >,
				< 1900800 1516800000 >;
		};
	};
```

## Documentation/devicetree/bindings/soc/qcom/qcom,spcom.txt
```
Qualcomm Technologies, Inc. Secure Proccessor Communication (spcom)

Required properties:
-compatible : should be "qcom,spcom"
-qcom,spcom-ch-names: predefined channels name string
-qcom,spcom-sp2soc-rmb-reg-addr: Secure Processor to SOC shared
                                 register physical address
-qcom,spcom-sp2soc-rmb-initdone-bit: bit indicating Secure
                                     Processor init-done
-qcom,spcom-sp2soc-rmb-pbldone-bit: bit indicating Secure
                                    Processor bootloader-done
-qcom,spcom-soc2sp-rmb-reg-addr: SOC to Secure Processor shared
                                 register physical address
-qcom,spcom-soc2sp-rmb-sp-ssr-bit: bit indicating Secure
                                   Processor subsystem reset

Example:
    qcom,spcom {
            compatible = "qcom,spcom";
            qcom,spcom-ch-names = "sp_kernel" , "sp_ssr";
            qcom,spcom-sp2soc-rmb-reg-addr = <0x01881020>;
            qcom,spcom-sp2soc-rmb-initdone-bit = <24>;
            qcom,spcom-sp2soc-rmb-pbldone-bit = <25>;
            qcom,spcom-soc2sp-rmb-reg-addr = <0x01881030>;
            qcom,spcom-soc2sp-rmb-sp-ssr-bit = <0>;
    };
```

## Documentation/devicetree/bindings/soc/qcom/qcom,virt-minidump.txt
```
Qualcomm Technologies, Inc. Virtual Minidump

Virtual minidump allows various clients on virtual machine to register memory
regions that need to be collected at system bad state.

Required properties:
- compatible:		Must be "qcom,virt-minidump".
- reg:			Must contain register address and length.

Example:
	virt_minidump@1cb00000 {
		compatible = "qcom,virt-minidump";
		reg = <0x1cb00000 0x1000>;
	}
```

## Documentation/devicetree/bindings/soc/qcom/qpnp-haptic.txt
```
QPNP Haptic

QPNP (Qualcomm Technologies Plug N Play) Haptic is a peripheral on
Qualcomm Technologies PMICs.  The PMIC is connected to Host processor
via SPMI bus.

This device can be operated in four modes - direct, buffer,
pwm(pulse width modulation) and audio.

Required Properties:
 - compatible: must be "qcom,qpnp-haptic"
 - reg: address of device
 - qcom,pmic-revid : phandle to fetch PMIC revid
 - qcom,actuator-type: must be one of "erm" or "lra"
 - qcom,play-mode : must be one of "buffer", "direct", "pwm" or "audio"

Optional Properties:
 - qcom,timeout-ms: timeout in ms.
 - qcom,vmax-mv : maximum output voltage in milli volts
 - qcom,ilim-ma : maximum output current limit threshold in milli amps
 - qcom,int-pwm-freq-khz : frequency for internal pwm
 - qcom,en-brake : specify to enable internal reverse braking
 - qcom,brake-pattern : 4 byte active brake pattern. Each pattern represents
		2-bit amplitude control 0x00: 0, 0x01: vmax/4, 0x02: vmax/2,
		0x03: vmax. Default values are 0x00.
 - qcom,sc-deb-cycles : short circuit debounce in internal pwm switching clock cycles
 - interrupts:	Specifies the interrupt associated with Haptics. The available
		interrupts are play and short circuit. The values for play and
		short circuit are <0x3 0xc0 0x0> and <0x3 0xc0 0x1>.
 - interrupt-names: Specify the interrupt names associated with interrupts. Must be
		    one of "play-irq" or "sc-irq"
 - vcc_pon-supply: power-on driver regulator

Optional properties for buffer play mode:
 - qcom,wave-samples : 8 byte buffer representing the wave. The bits in each sample
		are represented as follows- bit 0: reserved, bits 1 to 5: amplitude
		of the waveform, bit 6: over drive and bit 7: direction.
 - qcom,wave-shape : must be "sine" or "square"
 - qcom,wave-rep-cnt : repetition count for wave form
 - qcom,wave-samp-rep-cnt : repetition count for each sample of wave
 - qcom,wave-play-rate-us : duration at which each sample to be played in micro seconds

Required properties for pwm play mode:
 - qcom,pwm-channel: pwm channel the led will operate on
 - qcom,period-us: pwm period in us
 - qcom,duty-us: pwm duty cycle in us
 - qcom,ext-pwm-dtest-line: dtest line to used with pwm

Optional properties for pwm play mode:
 - qcom,ext-pwm-freq-khz : frequency for external pwm in kilo HZ

Optional properties when qcom,actuator-type is "lra"
 - qcom,correct-lra-drive-freq : boolean, use this to ensure LRA is driven at correct resonant
				 frequency, which may change due to operating conditions.
 - qcom,pmic-misc		: phandle of misc device using which the clock
				  trim error can be read from.
 - qcom,misc-clk-trim-error-reg	: Address offset of MISC_TRIM_ERROR_RC19P2_CLK
				  register if present in MISC module. This
				  holds the frequency error in 19.2 MHz clock.
 - qcom,lra-auto-res-mode : auto resonance technique, four different modes
			"none" : no auto resonance
			"zxd" : zero crossing based discontinuous method
			"qwd" : quarter wave drive method
			"max-qwd" : Maximum QWD
			"zxd-eop" : ZXD + End of pattern (This is the Default)
 - qcom,lra-high-z : High Z configuration for auto resonance. Possible string values are
			"none", "opt1", "opt2" and "opt3" (default). For PM660,
			"opt0" is valid value for 1 LRA period.
 - qcom,lra-qwd-drive-duration : Drive duration of LRA in QWD mode for PM660.
			Possible values are: 0: 1/4 LRA PERIOD and 1: 3/8 LRA PERIOD
 - qcom,lra-calibrate-at-eop : To calibrate at End of Pattern for PM660.
			Possible values are: 0 to disable and 1 to enable Calibration
			at End of Pattern
 - qcom,lra-res-cal-period : Auto resonance calibration period. The values range from
			4 to 32(default)
 - qcom,perform-lra-auto-resonance-search : boolean, define this property if:
		a) the underlying PMI chip does not have a register in the MISC block to
		read the error percentage in RC clock
		b) the actuator type is LRA
		Defining this causes the auto resonance search algorithm to be be performed
		for such devices.
		c) This property is not defined by default.

- qcom,drive-period-code-max-limit-percent-variation: RATE_CFG1 and RATE_CFG2 registers will
			be updated with the values from AUTO_RES_LO and AUTO_RES_HI registers
			only if the variation from the resonant frequency is within the value
			mentioned by this property on the higher side.
			The default value is 25, which means if the drive period code resulting
			from AUTO_RES register's is more than 25 percent of the existing drive
			period code, then driver does not update RATE_CFG registers.
- qcom,drive-period-code-min-limit-percent-variation: RATE_CFG1 and RATE_CFG2 registers will
			be updated with the values from AUTO_RES_LO and AUTO_RES_HI registers
			only if the variation from the resonant frequency is within the value
			mentioned by this property on the lower side.
                        The default value is 25, which means if the drive period code resulting
                        from AUTO_RES register's is less than 25 percent of the existing drive
                        period code, then driver does not update RATE_CFG registers.

Optional properties when qcom,lra-auto-res-mode is "qwd"
 - qcom,time-required-to-generate-back-emf-us: Time period required to generate sufficient
			back-emf (in case of QWD mode only) in us. For auto resonance
			detection to work properly,sufficient back-emf has to be
			generated. In general, back-emf takes some time to build up.
			When the auto resonance  mode is chosen as QWD, high-z will
			be applied for every LRA cycle and hence there won't be
			enough back-emf at the start-up. So we need to drive the
			motor for a few LRA cycles. Hence, auto resonance detection
			is enabled after this delay period after the PLAY bit is
			asserted. The default value is 20000us.

Example:
		qcom,haptic@c000 {
			status = "disabled";
			compatible = "qcom,qpnp-haptic";
			reg = <0xc000 0x100>;
			interrupts = <0x3 0xc0 0x0>,
				     <0x3 0xc0 0x1>;
			interrupt-names = "sc-irq", "play-irq";
			qcom,pmic-revid = <&pm660_revid>;
			vcc_pon-supply = <&pon_perph_reg>;
			qcom,pmic-misc = <&pmi8998_misc>;
			qcom,misc-clk-trim-error-reg = <0xf3>;
			qcom,play-mode = "direct";
			qcom,wave-play-rate-us = <5263>;
			qcom,actuator-type = "lra";
			qcom,wave-shape = "square";
			qcom,vmax-mv = <2000>;
			qcom,ilim-ma = <800>;
			qcom,sc-deb-cycles = <8>;
			qcom,int-pwm-freq-khz = <505>;
			qcom,en-brake;
			qcom,brake-pattern = [03 03 00 00];
			qcom,wave-samples = [3e 3e 3e 3e 3e 3e 3e 3e];
			qcom,wave-rep-cnt = <1>;
			qcom,wave-samp-rep-cnt = <1>;
			qcom,lra-high-z = "opt1";
			qcom,lra-auto-res-mode = "qwd";
			qcom,lra-res-cal-period = <4>;
			qcom,time-required-to-generate-back-emf-us = <20000>;
		};
```

## Documentation/devicetree/bindings/soc/qcom/qpnp-pbs.txt
```
QPNP PBS

QPNP (Qualcomm Technologies, Inc. Plug N Play) PBS is programmable boot sequence
and this driver is for helping the client drivers triggering such sequence
to be configured in PMIC.

This document describes the bindings for QPNP PBS driver.

=======================
Required Node Structure
=======================

- compatible
	Usage:      required
	Value type: <string>
	Definition: should be "qcom,qpnp-pbs".

- reg
	Usage:      required
	Value type: <prop-encoded-array>
	Definition:  Base address of the PBS registers.


=======
Example
=======
	pm660l_pbs: qcom,pbs@7300 {
		compatible = "qcom,qpnp-pbs";
		reg = <0x7300 0x100>;
	};
```

## Documentation/devicetree/bindings/soc/qcom/soc-sleep-stats.txt
```
* SoC Sleep Stats

Always On Processor/Resource Power Manager maintains statistics of the SoC
sleep modes involving lowering or powering down of the backbone rails - Cx
and Mx and the oscillator clock XO.

Statistics includes SoC sleep mode type, number of times low power mode were
entered, time of last entry, time of last exit and accumulated sleep duration.
SoC Sleep Stats driver provides sysfs interface to display this information.

Properties:

- compatible:
	Usage: required
	Value type: <string>
	Definition: Should be "qcom,rpmh-sleep-stats" or "qcom,rpm-sleep-stats".

- reg:
	Usage: required
	Value type: <prop-encoded-array>
	Definition: The base address on the Always On Processor or Resource Power
		    Manager from where the stats are read.

EXAMPLE 1:

	rpmh_sleep_stats: soc-sleep-stats@c3f0000 {
		compatible = "qcom,rpmh-sleep-stats";
		reg = <0 0xc3f0000 0 0x400>;
	};

EXAMPLE 2:

	rpm_sleep_stats: soc-sleep-stats@4690000 {
		compatible = "qcom,rpm-sleep-stats";
		reg = <0 0x04690000 0 0x400>;
	};
```

## Documentation/devicetree/bindings/soc/sprd/sprd,seth.yaml
```yaml
# SPDX-License-Identifier: (GPL-2.0 OR BSD-2-Clause)

$id: "http://devicetree.org/schemas/soc/sprd/sprd,seth.yaml#"
$schema: "http://devicetree.org/meta-schemas/core.yaml#"

title: Unisoc seth bindings

description: This is only for virtual network interface controller that dealing with tcpip data transferring.

Required properties:
  compatible:
    - "sprd,seth": for network interface controller
    - "sprd,name": for name of nic
    - "sprd,dst": for id of destination
    - "sprd,channel": for id of channel
    - "sprd,blknum": for number of blocks
    - "sprd,poolsize": for the pool size of sipc
```

## Documentation/devicetree/bindings/soc/sprd/sprd,sfp.yaml
```yaml
# SPDX-License-Identifier: (GPL-2.0 OR BSD-2-Clause)

$id: "http://devicetree.org/schemas/soc/sprd/sprd,sfp.yaml#"
$schema: "http://devicetree.org/meta-schemas/core.yaml#"

title: Unisoc sfp bindings

description: SFP stands for soft fast path, it is a module to configure IPA route rule or do a soft IP acceleration.

Required properties:
  compatible:
    - "sprd,sfp": soft fast path
```
