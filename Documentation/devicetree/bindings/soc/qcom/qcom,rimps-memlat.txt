## Documentation/devicetree/bindings/sound/aqt1000_codec.txt
```
Qualcomm Technologies, Inc.

AQT1000 audio CODEC

Required properties:

- compatible: "qcom,aqt1000-i2c-codec" for AQT1000 Codec

- qcom,aqt-rst-gpio-node: Phandle reference to the DT node having codec reset gpio
                          configuration. If this property is not defined,
                          codec will not get registered.

- reg: Address of the codec. If this property is not defined then I2C will
       not be able to get AQT1000 address.

- qcom,cdc-static-supplies: Static VREG_BOB Supply for AQT1000 codec.
                            All other supplies are derived from this.
                            If this property is not defined,
                            codec will not power up.

-qcom,cdc-micbias1-mv: micbias1 output voltage in milli volts.
                       This is used when cfilt is not user configurable
                       and micbias1 is directly controlled with a register
                       write.
-qcom,cdc-ext-clk-rate: External clock frequency used for AQT1000.
                        All internal clocks for AQT1000 are derived from this clock.
                        If this property is not defined then default external
                        clock rate of 9.6M will be provided.
-qcom,cdc-mclk-clk-rate: Specifies the master clock rate in Hz required for
                         codec.
-qcom,aqt-irq: Phandle reference to DT node having codec interrupt gpio
               configuration. If this property is not defined,
               interrupt will not be enabled.

- clock-names : clock name defined for external clock.
- clocks : external clock defined for codec clock.

- interrupt-controller : Mark this device node as an interrupt controller
- #interrupt-cells : Should be 1
- interrupt-parent : Parent interrupt controller
- qcom,gpio-connect: GPIO that connects to parent interrupt controller

- pinctrl-names: Pinctrl state names for each pin group configuration.
- pinctrl-x: Defines pinctrl state for each pin group.

Optional properties:

- cdc-vdd-rxtx-supply: phandle of rxtx supply's regulator device tree node.
- qcom,cdc-vdd-rxtx-voltage: rxtx supply's voltage level min and max in mV.
- qcom,cdc-vdd-rxtx-current: rxtx supply's max current in mA.

- cdc-vdd-buck-supply: phandle of buck supply's regulator device tree node.
- qcom,cdc-vdd-buck-voltage: buck supply's voltage level min and max in mV.
- qcom,cdc-vdd-buck-current: buck supply's max current in mA.

- cdc-vdd-vbat-supply: phandle of vbat supply's regulator device tree node.
- qcom,cdc-vdd-vbat-voltage: vbat supply's voltage level min and max in mV.
- qcom,cdc-vdd-vbat-current: vbat supply's max current in mA.

Example:
i2c@a88000 {
        status = "ok";
        aqt1000_cdc: aqt1000-i2c-codec@d {
                compatible = "qcom,aqt1000-i2c-codec";
                reg = <0x0d>;
                qcom,aqt-rst-gpio-node = <&aqt_rst_gpio>;
                clock-names = "aqt_clk";
                clocks = <&clock_audio_lnbb AUDIO_PMIC_LNBB_CLK>;
                interrupt-controller;
                #interrupt-cells = <1>;
                interrupt-parent = <&tlmm>;
                qcom,gpio-connect = <&tlmm 125 0>;
                pinctrl-names = "default";
                pinctrl-0 = <&aqt_intr_default>;

                cdc-vdd-rxtx-supply = <&pm8150_s4>;
                qcom,cdc-vdd-rxtx-voltage = <1800000 1800000>;
                qcom,cdc-vdd-rxtx-current = <33300>;

                cdc-vdd-buck-supply = <&pm8150_s4>;
                qcom,cdc-vdd-buck-voltage = <1800000 1800000>;
                qcom,cdc-vdd-buck-current = <650000>;

                cdc-vdd-vbat-supply = <&pm81501_bob>;
                qcom,cdc-vdd-vbat-voltage = <3300000 3300000>;
                qcom,cdc-vdd-vbat-current = <5000>;

                qcom,cdc-static-supplies = "cdc-vdd-rxtx",
                                           "cdc-vdd-buck",
                                           "cdc-vdd-vbat";

                qcom,cdc-ext-clk-rate = <19200000>;
                qcom,cdc-mclk-clk-rate = <9600000>;
                qcom,cdc-micbias1-mv = <1800>;
        };
};
```

## Documentation/devicetree/bindings/sound/aw8896.txt
```
AW8896 SmartpA

Required properties:

  - compatible : "awinic,aw8896_smartpa"

  - reg : I2C address of the device

  - reset-gpio : gpio used for HW reset

  - dvdd-supply : Power supply for PA's dvdd

  - dvdd-voltage : Minimum and maximum voltage in uV to set for power supply

  - dvdd-current : dvdd's max current in uA

Optional properties:

  - irq-gpio: gpio used for irq indicator

Examples:

	i2c_smartpa@34 {
		compatible = "awinic,i2c_smartpa";
		reg = <0x34>;
		reset-gpio = <&tlmm 68 0>;
		dvdd-supply = <&pm660_l9>;
		dvdd-voltage = <1800000 1800000>;
		dvdd-current = <15000>;
	};
```

## Documentation/devicetree/bindings/sound/ep92a6.txt
```
EP92A6 HDMI bridge chip

This device supports I2C mode only.

Required properties:
  - compatible : "explore,ep92a6"
  - reg : the I2C address of the device

Optional properties:
  - interrupts : interrupt line that signals state update

Example:

ep92a6: ep92a6@64 {
   compatible = "explore,ep92a6";
   reg = <0x64>;
};
```

## Documentation/devicetree/bindings/sound/mt6359p-accdet.txt
```
* Mediatek Technologies mt6359p ALSA SoC audio accdet driver

This node models the Mediatek Technologies mt6359p ALSA SoC audio accdet driver

Required properties:

  - compatible : One of "mediatek,mt6359p-accdet", "mediatek,pmic-accdet"

  - accdet-name : named as "mt63xx-accdet" for snd_soc_card_jack

  - accdet-mic-vol : accdet micbias voltage
			0x09:2.85v 0x08:2.8v 0x07:2.7v 0x05:2.5v 0x02:1.9v

  - accdet-mic-mode : value as 1, 2, 6 to indicate ACC/DCC mode.
            default is DCC mode 2
			1:ACC mode, 2:low cost without in bias, 6:low cost with in bias

  - eint_use_ext_res : select VTH to 2v and 500k, default 0 use internal resistance.

  - headset-mode-setting : Indicates customized pwm, debounce setting
			accdet pwm_width, pwm_thresh, fall_delay, rise_delay
			debounce0, debounce1, debounce3, debounce4
			eint pwm_width, eint pwm_thresh
			eint deb(debounce0, debounce1, debounce2, debounce3), inv_debounce

  - headset-three-key-threshold :  For 3key CDD device and define its threshold.
			0--MD_MAX--UP_MAX--DW_MAX

  - io-channels : declare which iio channel accdet used.

  - io-channel-names : named as "pmic_accdet"

  - nvmem : reference to pmic efuse node

  - nvmen-names : named as "mt63xx-accdet-efuse"

Optional properties:

  - accdet-plugout-debounce : For using ap gpio eint only, it is sw debounce time.

  - headset-three-key-threshold-CDD : For 3key CDD device and define its threshold.
			threshold: 0--MD_MAX--UP_MAX--DW_MAX
  - headset-four-key-threshold : For 4key device and define its threshold.
			threshold: 0--MD_MAX--VOICE_MAX--UP_MAX--DW_MAX
Example:
&pwrap {
	pmic: pmic {
		accdet: accdet {
			compatible = "mediatek,mt6359p-accdet";
			accdet-name = "mt63xx-accdet";
			accdet-mic-vol = <8>;
			accdet-plugout-debounce = <1>;
			accdet-mic-mode = <2>;
			eint_use_ext_res = <0>;
			headset-mode-setting = <0x500 0x500 1 0x1f0
						0x800 0x800 0x20 0x44
						0x4 0x1
						0x5 0x3 0x3 0x5 0xe>;
			headset-use-ap-eint = <0>;
			headset-eint-num = <0>;
			headset-eint-trig-mode = <1>;
			headset-key-mode = <0>;
			headset-three-key-threshold = <0 80 220 400>;
			headset-three-key-threshold-CDD = <0 121 192 600>;
			headset-four-key-threshold = <0 58 121 192 400>;
			io-channels = <&pmic_auxadc AUXADC_ACCDET>;
			io-channel-names = "pmic_accdet";
			nvmem = <&pmic_efuse>;
			nvmem-names = "mt63xx-accdet-efuse";
			status = "okay";
		};
	};
};
```

## Documentation/devicetree/bindings/sound/mtk-sndcard.txt
```
Mediatek mt6755 soc driver

Required properties:
- compatible = "mediatek,mt_soc_codec_63xx";
- compatible = "mediatek,mt_soc_codec_dummy";
- compatible = "mediatek,mt_soc_dai_routing";
- compatible = "mediatek,mt_soc_dai_stub";
- compatible = "mediatek,audio_snd_card";
- compatible = "mediatek,mt_soc_offload_common";
- compatible = "mediatek,mt_soc_pcm_anc";
- compatible = "mediatek,mt_soc_btcvsd_rx_pcm";
- compatible = "mediatek,mt_soc_btcvsd_tx_pcm";
- compatible = "mediatek,mt_soc_pcm_bt_dai";
- compatible = "mediatek,mt_soc_pcm_capture2";
- compatible = "mediatek,mt_soc_pcm_capture";
- compatible = "mediatek,mt_soc_pcm_deep_buffer_dl";
- compatible = "mediatek,mt_soc_pcm_dl1_awb";
- compatible = "mediatek,mt_soc_pcm_dl1_bt";
- compatible = "mediatek,mt_soc_pcm_dl1";
- compatible = "mediatek,mt_soc_pcm_dl1_i2s0";
- compatible = "mediatek,mt_soc_pcm_dl1_i2s0dl1";
- compatible = "mediatek,mt_soc_pcm_dl1_scp_spk";
- compatible = "mediatek,mt_soc_pcm_dl2";
- compatible = "mediatek,mt_soc_pcm_dummy";
- compatible = "mediatek,mt_soc_pcm_fm_i2s_awb";
- compatible = "mediatek,mt_soc_pcm_fm_i2s";
- compatible = "mediatek,mt_soc_pcm_fmtx";
- compatible = "mediatek,mt_soc_pcm_hdmi";
- compatible = "mediatek,mt_soc_pcm_hp_impedance";
- compatible = "mediatek,mt_soc_pcm_i2s0_awb";
- compatible = "mediatek,mt_soc_pcm_i2s2_adc2;
- compatible = "mediatek,mt_soc_pcm_mrgrx_awb";
- compatible = "mediatek,mt_soc_pcm_mrgrx";
- compatible = "mediatek,mt_soc_pcm_routing";
- compatible = "mediatek,mt_soc_pcm_uldlloopback";
- compatible = "mediatek,mt_soc_pcm_voice_md1_bt";
- compatible = "mediatek,mt_soc_pcm_voice_md1";
- compatible = "mediatek,mt_soc_pcm_voice_md2_bt";
- compatible = "mediatek,mt_soc_pcm_voice_md2";
- compatible = "mediatek,mt_soc_pcm_voice_scp";
- compatible = "mediatek,mt_soc_pcm_voice_ultra";
- compatible = "mediatek,mt_soc_tdm_capture";
- use_hp_depop_flow: using headphone depop flow
- use_ul_260k: using uplink 260k sample rate
- use_mtkaif_ver: mtk interface version

Example:

	mt_soc_codec_name {
		compatible = "mediatek,mt_soc_codec_63xx";
		use_hp_depop_flow = <0>;
		/* select 1: use, 0: not use */
		use_ul_260k = <0>;
		/* select 1: use, 0: not use */
		use_mtkaif_ver = <1>;
		/* select 1: 1.5, 0: 1.0*/
	};

	btcvsd@10000000 {
		compatible = "mediatek,audio_bt_cvsd";
		offset =<0xf00 0x800 0xfd0 0xfd4 0xfd8>;
		reg=<0 0x10000000 0 0x1000>,
			/* INFRACFG_AO BASE ADDRESS*/
			  <0 0x19000000 0 0x10000>,
			/*PKV_PHYSICAL_BASE*/
			  <0 0x19080000 0 0x8000>;
			/*SRAM_BANK2*/
		interrupts = <GIC_SPI 317 IRQ_TYPE_LEVEL_LOW>;
	};

	audio: audio@10c00000 {
		compatible = "mediatek,audio", "syscon";
		reg = <0 0x10c00000 0 0x1000>;
		interrupts = <GIC_SPI 175 IRQ_TYPE_LEVEL_LOW>;
		#clock-cells = <1>;
	};

	audgpio: mt_soc_dl1_pcm@10c00000 {
		compatible = "mediatek,mt_soc_pcm_dl1";
		reg = <0 0x10c00000 0 0x1000>;
		interrupts = <GIC_SPI 175 IRQ_TYPE_LEVEL_LOW>;
		clocks = <&audio CLK_AUDIO_AFE>,
			<&audio CLK_AUDIO_I2S>,
			<&audio CLK_AUDIO_DAC>,
			<&audio CLK_AUDIO_DAC_PREDIS>,
			<&audio CLK_AUDIO_ADC>,
			<&audio CLK_AUDIO_ADDA6_ADC>,
			<&audio CLK_AUDIO_22M>,
			<&audio CLK_AUDIO_24M>,
			<&audio CLK_AUDIO_APLL_TUNER>,
			<&audio CLK_AUDIO_APLL2_TUNER>,
			<&audio CLK_AUDIO_TML>,
			<&audio CLK_AUDIO_ADC_HIRES>,
			<&audio CLK_AUDIO_ADDA6_ADC_HIRES>,
			<&audio CLK_AUDIO_ADC_HIRES_TML>,
			<&scpsys SCP_SYS_AUD>,
			<&infracfg_ao CLK_INFRA_AUDIO>,
			<&topckgen CLK_TOP_AUDIO_SEL>,
			<&topckgen CLK_TOP_SYSPLL3_D4>,
			<&topckgen CLK_TOP_AUD_INTBUS_SEL>,
			<&topckgen CLK_TOP_SYSPLL1_D4>,
			<&topckgen CLK_TOP_SYSPLL1_D2>,
			<&topckgen CLK_TOP_F_FAUD26M_EN>,
			<&clk26m>;
		clock-names = "aud_afe_clk",
			"aud_i2s_clk",
			"aud_dac_clk",
			"aud_dac_predis_clk",
			"aud_adc_clk",
			"aud_adda6_adc_clk",
			"aud_apll22m_clk",
			"aud_apll24m_clk",
			"aud_apll1_tuner_clk",
			"aud_apll2_tuner_clk",
			"aud_tml_clk",
			"aud_adc_hires_clk",
			"aud_adda6_adc_hires_clk",
			"aud_adc_hires_tml_clk",
			"scp_sys_audio",
			"aud_infra_clk",
			"top_mux_audio",
			"top_sys_pll3_d4",
			"top_mux_audio_int",
			"top_sys_pll1_d4",
			"top_sys_pll1_d2",
			"top_sys_audio26m",
			"top_clk26m_clk";
	};

	audio_sram@10c01000 {
		compatible = "mediatek,audio_sram";
		reg = <0 0x10c01000 0 0x15400>;
	};

	audio_snd_card {
		compatible = "mediatek,audio_snd_card";
	};

	mt_soc_btcvsd_rx_pcm {
		compatible = "mediatek,mt_soc_btcvsd_rx_pcm";
	};

	mt_soc_btcvsd_tx_pcm {
		compatible = "mediatek,mt_soc_btcvsd_tx_pcm";
	};

	mt_soc_deep_buffer_dl_pcm {
		compatible = "mediatek,mt_soc_pcm_deep_buffer_dl";
	};

	mt_soc_ul1_pcm {
		compatible = "mediatek,mt_soc_pcm_capture";
	};

	mt_soc_voice_md1 {
		compatible = "mediatek,mt_soc_pcm_voice_md1";
	};

	mt_soc_hdmi_pcm {
		compatible = "mediatek,mt_soc_pcm_hdmi";
	};

	mt_soc_uldlloopback_pcm {
		compatible = "mediatek,mt_soc_pcm_uldlloopback";
	};

	mt_soc_i2s0_pcm {
		compatible = "mediatek,mt_soc_pcm_dl1_i2s0";
	};

	mt_soc_mrgrx_pcm {
		compatible = "mediatek,mt_soc_pcm_mrgrx";
	};

	mt_soc_mrgrx_awb_pcm {
		compatible = "mediatek,mt_soc_pcm_mrgrx_awb";
	};

	mt_soc_fm_i2s_pcm {
		compatible = "mediatek,mt_soc_pcm_fm_i2s";
	};

	mt_soc_fm_i2s_awb_pcm {
		compatible = "mediatek,mt_soc_pcm_fm_i2s_awb";
	};

	mt_soc_i2s0dl1_pcm {
		compatible = "mediatek,mt_soc_pcm_dl1_i2s0dl1";
	};

	mt_soc_dl1_awb_pcm {
		compatible = "mediatek,mt_soc_pcm_dl1_awb";
	};

	mt_soc_voice_md1_bt {
		compatible = "mediatek,mt_soc_pcm_voice_md1_bt";
	};

	mt_soc_voip_bt_out {
		compatible = "mediatek,mt_soc_pcm_dl1_bt";
	};

	mt_soc_voip_bt_in {
		compatible = "mediatek,mt_soc_pcm_bt_dai";
	};

	mt_soc_tdmrx_pcm {
		compatible = "mediatek,mt_soc_tdm_capture";
	};

	mt_soc_fm_mrgtx_pcm {
		compatible = "mediatek,mt_soc_pcm_fmtx";
	};

	mt_soc_ul2_pcm {
		compatible = "mediatek,mt_soc_pcm_capture2";
	};

	mt_soc_i2s0_awb_pcm {
		compatible = "mediatek,mt_soc_pcm_i2s0_awb";
	};

	mt_soc_voice_md2 {
		compatible = "mediatek,mt_soc_pcm_voice_md2";
	};

	mt_soc_routing_pcm {
		compatible = "mediatek,mt_soc_pcm_routing";
		/*i2s1clk-gpio = <7 6>;*/
		/*i2s1dat-gpio = <5 6>;*/
		/*i2s1mclk-gpio = <9 6>;*/
		/*i2s1ws-gpio = <6 6>;*/
	};

	mt_soc_voice_md2_bt {
		compatible = "mediatek,mt_soc_pcm_voice_md2_bt";
	};

	mt_soc_hp_impedance_pcm {
		compatible = "mediatek,mt_soc_pcm_hp_impedance";
	};

	mt_soc_codec_name {
		compatible = "mediatek,mt_soc_codec_63xx";
		use_hp_depop_flow = <0>;
		/* select 1: use, 0: not use */
		use_ul_260k = <0>;
		/* select 1: use, 0: not use */
		use_mtkaif_ver = <1>;
		/* select 1: 1.5, 0: 1.0*/
	};

	mt_soc_dummy_pcm {
		compatible = "mediatek,mt_soc_pcm_dummy";
	};

	mt_soc_codec_dummy_name {
		compatible = "mediatek,mt_soc_codec_dummy";
	};

	mt_soc_routing_dai_name {
		compatible = "mediatek,mt_soc_dai_routing";
	};

	mt_soc_dai_name {
		compatible = "mediatek,mt_soc_dai_stub";
	};

	mt_soc_dl2_pcm {
		compatible = "mediatek,mt_soc_pcm_dl2";
	};

	mt_soc_anc_pcm {
		compatible = "mediatek,mt_soc_pcm_anc";
	};

	mt_soc_pcm_voice_ultra {
		compatible = "mediatek,mt_soc_pcm_voice_ultra";
	};

	mt_soc_pcm_voice_usb {
		compatible = "mediatek,mt_soc_pcm_voice_usb";
	};

	mt_soc_pcm_voice_usb_echoref {
		compatible = "mediatek,mt_soc_pcm_voice_usb_echoref";
	};
```

## Documentation/devicetree/bindings/sound/nvidia,tegra124-adx.txt
```
NVIDIA Tegra124 ADX controller

Required properties:
- compatible : "nvidia,tegra124-adx"
- reg : Should contain ADX registers location and length

Example:

amx@70303800 {
	compatible = "nvidia,tegra124-adx";
	reg = <0x70303800 0x100>;
};
```
