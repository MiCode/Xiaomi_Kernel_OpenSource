## Documentation/devicetree/bindings/soc/qcom/blocknames.txt
```
* rename block devices

Required properties:

- compatible:	"qcom,blkdev-rename" compatibility string
- actual-dev:	Name of the  disk assigned by generic driver
- rename-dev:	Re-name of the disk to set for disks

Example:

rename_blk: rename_blk {
		compatible = "qcom,blkdev-rename";
		actual-dev = "vda", "vdb", "vdc",
				"vdd", "vde", "vdf",
				"vdg", "vdh";
		rename-dev = "la_system", "la_userdata", "la_vendor",
				"la_persist", "modem", "bluetooth",
				"la_misc", "vbmeta";
```

## Documentation/devicetree/bindings/soc/qcom/cdsprm.txt
```
Qualcomm Technologies, Inc. CDSP Request Manager driver

CDSP Request Manager driver implements an rpmsg interface with
CDSP subsystem to serve L3 frequency and CPU QoS requests from CDSP.
It also interacts with NPU, Camera modules for Cx iPeak mitigations and
thermal module via CDSP/HVX cooling devices for thermal mitigation of
CDSP core.

Required properties:
- compatible: Must be "qcom,msm-cdsprm-rpmsg"
- qcom,glink-channels: Glink channel for communication with CDSP
- qcom,intents: A list of <number of intents, size of each intent>

- qcom,msm-cdsp-rm: A sub-device node to define CDSPM RM, Cx iPeak mitigation
		driver and CDSP core thermal cooling device
	Required properties:
	- compatible: Must be "qcom,msm-cdsp-rm"
	- qcom,qos-latency-us: pm_qos latency vote to be applied on CDSP request in
				micro seconds
	- qcom,qos-maxhold-ms: Maximum hold time for pm_qos latency vote from CDSP
				in milli seconds
	- qcom,compute-cx-limit-en: To enable CX ipeak limit management for compute
				subsystem
	- qcom,compute-priority-mode: when Cx iPeak mitigation is enabled,
				this field sets desired compute priority mode
				for AIX and HVX concurrency cases based on
				following values, where in HVX and NPU cores,
				if required, are throttled in concurrency based
				on the selected priority mode
				1 : HVX_MAX - Allows HVX to run at maximum possible
						frequency during concurrency with NPU
				2 : AIX_MAX - Allows NPU to run at maximum possible
						frequency during concurrency with HVX
				3 : HVX_OVER_AIX - Allows HVX to run at a higher
						frequency than NPU during concurrency
				4 : AIX_OVER_HVX - Allows NPU to run at a higher
						frequency than HVX during concurrency
	- #cooling-cells: Number of cooling cells for CDSP cooling device based on
			CDSP Q6 core clock throttling

- qcom,msm-hvx-rm: A sub-device node to define HVX based thermal cooling device
	Required properties:
	- compatible: Must be "qcom,msm-hvx-rm"
	- #cooling-cells: Number of cooling cells for CDSP cooling device based on
			HVX hardware throttling

- qcom,cdsp-l3: A sub-device node to define CDSP L3 target device for L3
		clock voting
	Required properties:
	- compatible: Must be "qcom,cdsp-l3"
	- qcom,target-dev: The DT device that corresponds to the CDSP L3
			devfreq-simple-dev

Example:
	qcom,msm_cdsprm_rpmsg {
		compatible = "qcom,msm-cdsprm-rpmsg";
		qcom,glink-channels = "cdsprmglink-apps-dsp";
		qcom,intents = <0x14 64>;

		qcom,cdsp-l3 {
			compatible = "qcom,cdsp-l3";
			qcom,target-dev = <&cdsp-cdsp-l3-lat>;
		};

		qcom,msm_cdsp_rm {
			compatible = "qcom,msm-cdsp-rm";
			qcom,qos-latency-us = <100>;
			qcom,qos-maxhold-ms = <20>;
			qcom,compute-cx-limit-en;
			qcom,compute-priority-mode = <2>;
			#cooling-cells = <2>;
		};

		 msm_hvx_rm: qcom,msm_hvx_rm {
			compatible = "qcom,msm-hvx-rm";
			#cooling-cells = <2>;
		};
	};
```

## Documentation/devicetree/bindings/soc/qcom/dcc.txt
```
* Data Capture and Compare (DCC)

DCC (Data Capture and Compare) is a DMA engine, which is used to save
configuration data or system memory contents during catastrophic failure or
SW trigger.
It can also perform CRC over the same configuration or memory space.

Required properties:

- compatible : name of the component used for driver matching, should be
	       "qcom,dcc" or "qcom,dcc-v2"

- reg : physical base address and length of the register set(s), SRAM and XPU
	of the component.

- reg-names : names corresponding to each reg property value.
	      dcc-base: Base address for DCC configuration reg
	      dcc-ram-base: Start of HLOS address space in SRAM
	      dcc-xpu-base: Base address for XPU configuration reg

- dcc-ram-offset: Address offset from the start of the SRAM address space.

Optional properties:

- clocks: phandle reference to the parent clock.

- clock-names: Name of the clock that needs to be enabled for the HW to run.
	       Turned off when the subsystem is disabled.

- qcom,save-reg: boolean, To save dcc registers state in memory after dcc
		 enable and disable

- qcom,data-sink: string, To specify default data sink for dcc, should be one
		  of the following:
		  "atb"	  : To send captured data over ATB to a trace sink
		  "sram"  : To save captured data in dcc internal SRAM.

- qcom,curr-link-list: int, To specify the link list to use for the default list.

- qcom,link-list: The values to be programmed into the default link list.
		  The enum values for DCC operations is defined in dt-bindings/soc/qcom,dcc_v2.h
		  The following gives basic structure to be used for each operation:
		  <DCC_operation addr val apb_bus>
		  val is to be interpreted based on what operation is to be performed.

Example:

	dcc: dcc@4b3000 {
		compatible = "qcom,dcc";
		reg = <0x4b3000 0x1000>,
		      <0x4b4000 0x2000>,
		      <0x4b0000 0x1>;
		reg-names = "dcc-base", "dcc-ram-base", "dcc-xpu-base";

		clocks = <&clock_gcc clk_gcc_dcc_ahb_clk>;
		clock-names = "dcc_clk";

		qcom,curr-link-list = <2>;
		qcom,link-list = <DCC_READ 0x1740300 6 0>,
				 <DCC_READ 0x1620500 4 0>,
				 <DCC_READ 0x7840000 1 0>,
				 <DCC_READ 0x7841010 12 0>,
				 <DCC_READ 0x7842000 16 0>,
				 <DCC_READ 0x7842500 2 0>;
		qcom,save-reg;
	};
```

## Documentation/devicetree/bindings/soc/qcom/guest_shm.txt
```
QVM Guest Shared Memory

guest_shm is a device that enables linux as a guest operating system
to allocate shared memory between virtual machines and send notifications
of updates to other virtual machines.

Required properties:
- compatible:		Must be "qvm,guest_shm".
- interrupt-parent:	Parent interrupt controller.
- interrupts:		Should contain QVM interrupt.
- reg:			Physical address of the guest factory and length.

Example:
	qvm,guest_shm {
		compatible = "qvm,guest_shm";
		interrupt-parent = <&gic>;
		interrupts = <6 4>;
		reg = <0x1c050000 0x1000>;
	};
```

## Documentation/devicetree/bindings/soc/qcom/hab.txt
```
* HAB

HAB(Hypervisor ABstraction) is meant to be a cross-platform abstraction layer
for utilizing the underlying hypervisor system. This API can be accessed from
both user and kernel sides.
The intended users of this are primarily the multimedia drivers who want to
communicate with the host OS to use the multimedia hardware.

Required properties:
- compatible: Must be "qcom,hab"
- vmid: the local VM's ID
  It should be unique in a system, and host's ID should be 0. Here is an
  example for a system as qvm host + agl gvm + android gvm, and such below
  setting is proper,
    qvm host's vmid: 0
    agl gvm's vmid: 1
    android gvm's vmid: 2
- mmid group properties:
  - grp-start-id: mmid group starting ID, eg, 100 is for MM_AUD_1~4
  - role: the local role of this group, and must be "fe" or "be"
  - remote-vmids: When the local role is "fe", this is to tell which VM is the
    relevant BE. When it is "be", this is to tell which VMs it will support as
    BE.

Example:
	qcom,hab {
		compatible = "qcom,hab";
		vmid = <2>;

		mmid100: mmid-grp@100 {
			grp-start-id = <100>;
			role = "fe";
			remote-vmids = <0>;
		};

		mmid200: mmid-grp@200 {
			grp-start-id = <200>;
			role = "fe";
			remote-vmids = <0>;
		};
	}
```

## Documentation/devicetree/bindings/soc/qcom/hgsl-tcsr.txt
```
Top Control and Status Register(TCSR) for HGSL

TCSR hardware contains compute signal sub-block, which allows drivers in hypervisor
Linux to communicate with GPU hardware directly. This HGSL TCSR driver is to enable
the TCSR compute signal hardware. There are multiple instances of compute signal.
Each instance is either a signal sender or signal receiver.

The HGSL TCSR driver is built on top of generic TCSR driver, refer to
Documentation/devicetree/bindings/mfd/qcom,tcsr.txt for the generic TCSR driver.

Required properties:
- compatible : Must be "qcom,hgsl-tcsr-sender" or "qcom,hgsl-tcsr-receiver"
- syscon     : Point to the generic TCSR compute signal node
- syscon-glb : Point to the generice TCSR node for compute signal global control.
	       This is only needed by signal sender.
- interrupts : Specify IRQ information used by the compute signal.
	       This is only needed by signal receiver.

Examples:
	hgsl_tcsr_sender0: hgsl_tcsr_sender0 {
		compatible = "qcom,hgsl-tcsr-sender";
		syscon = <&tcsr_compute_signal_sender0>;
		syscon-glb = <&tcsr_compute_signal_glb>;
	};

	hgsl_tcsr_receiver0: hgsl_tcsr_receiver0 {
		compatible = "qcom,hgsl-tcsr-receiver";
		syscon = <&tcsr_compute_signal_receiver0>;
		interrupts = <0 238 0>;
	};
```

## Documentation/devicetree/bindings/soc/qcom/msm-early-cam.txt
```
* Qualcomm Technologies Inc MSM BA

[Root level node]
==================
Required properties:
- compatible: Must be "qcom,early-cam".

[Subnode]
==========
- qcom,early-cam-input-profile-#: Defines child nodes for the profiles supported
              by early camera driver. Each profile should have properties
              "mmagic-supply", "gdscr-supply", "vfe0-vdd-supply",
              "qcom,cam-vreg-name", "clocks", "clock-names",
              "qcom,clock-rates".
Required properties:
- mmagic-supply : should contain mmagic regulator used for mmagic clocks.
- gdscr-supply : should contain gdsr regulator used for cci clocks.
- vfe0-vdd-supply: phandle to vfe0 regulator.
- qcom,cam-vreg-name : name of the voltage regulators required for the device.
- clocks: List of clock handles. The parent clocks of the input clocks to the
	devices in this power domain are set to oscclk before power gating
	and restored back after powering on a domain. This is required for
	all domains which are powered on and off and not required for unused
	domains.
- clock-names: name of the clock used by the driver.
- qcom,clock-rates: clock rate in Hz.
Example:

    qcom,early-cam {
		cell-index = <0>;
		compatible = "qcom,early-cam";
		status = "ok";
		mmagic-supply = <&gdsc_mmagic_camss>;
		gdscr-supply = <&gdsc_camss_top>;
		vfe0-vdd-supply = <&gdsc_vfe0>;
		qcom,cam-vreg-name = "mmagic", "gdscr", "vfe0-vdd";
		clocks = <&clock_mmss clk_mmss_mmagic_ahb_clk>,
			<&clock_mmss clk_camss_top_ahb_clk>,
			<&clock_mmss clk_cci_clk_src>,
			<&clock_mmss clk_camss_cci_ahb_clk>,
			<&clock_mmss clk_camss_cci_clk>,
			<&clock_mmss clk_camss_ahb_clk>,
			<&clock_mmss clk_mmagic_camss_axi_clk>,
			<&clock_mmss clk_camss_vfe_ahb_clk>,
			<&clock_mmss clk_camss_vfe0_ahb_clk>,
			<&clock_mmss clk_camss_vfe_axi_clk>,
			<&clock_mmss clk_camss_vfe0_stream_clk>,
			<&clock_mmss clk_smmu_vfe_axi_clk>,
			<&clock_mmss clk_smmu_vfe_ahb_clk>,
			<&clock_mmss clk_camss_csi_vfe0_clk>,
			<&clock_mmss clk_vfe0_clk_src>,
			<&clock_mmss clk_camss_csi_vfe0_clk>,
			<&clock_mmss clk_camss_csi2_ahb_clk>,
			<&clock_mmss clk_camss_csi2_clk>,
			<&clock_mmss clk_camss_csi2phy_clk>,
			<&clock_mmss clk_csi2phytimer_clk_src>,
			<&clock_mmss clk_camss_csi2phytimer_clk>,
			<&clock_mmss clk_camss_csi2rdi_clk>,
			<&clock_mmss clk_camss_ispif_ahb_clk>,
			<&clock_mmss clk_camss_vfe0_clk>;
		clock-names =
			"mmss_mmagic_ahb_clk",
			"camss_top_ahb_clk",
			"cci_clk_src",
			"camss_cci_ahb_clk",
			"camss_cci_clk",
			"camss_ahb_clk",
			"mmagic_camss_axi_clk",
			"camss_vfe_ahb_clk",
			"camss_vfe0_ahb_clk",
			"camss_vfe_axi_clk",
			"camss_vfe0_stream_clk",
			"smmu_vfe_axi_clk",
			"smmu_vfe_ahb_clk",
			"camss_csi_vfe0_clk",
			"vfe0_clk_src",
			"camss_csi_vfe0_clk",
			"camss_csi2_ahb_clk",
			"camss_csi2_clk",
			"camss_csi2phy_clk",
			"csi2phytimer_clk_src",
			"camss_csi2phytimer_clk",
			"camss_csi2rdi_clk",
			"camss_ispif_ahb_clk",
			"clk_camss_vfe0_clk";

		qcom,clock-rates = <19200000
						19200000
						19200000
						19200000
						19200000
						19200000
						0
						0
						0
						320000000
						0
						0
						0
						0
						19200000
						0
						0
						200000000
						200000000
						200000000
						200000000
						200000000
						0
	};
```

## Documentation/devicetree/bindings/soc/qcom/msm_power.txt
```
MSM power device

msm_power is a device that monitors the frequency of various resources
(e.g. CPU and GPU) to manage other system resources (e.g. DDR frequency)
more efficiently.

Required properties:
- compatible:		Must be "qcom,msm-power"
- clocks:		Array of clock phandle and clock specifier pairs
			(per clock-bindings doc) for all clocks that are
			to be managed by this device (e.g. GPU clock).

Example:
	qcom,msm-power {
		compatible = "qcom,msm-power";
		clock-names = "gpu_clk";
		clocks = <&clock_gpu clk_gpu_gx_gfx3d_clk>;
	};
```

## Documentation/devicetree/bindings/soc/qcom/qcom,altmode-glink.txt
```
* QTI Type-C Alternate Mode over GLINK bindings

The Qualcomm Technologies, Inc. Type-C Alternate (alt) Mode GLINK device
provides an interface for Type-C alternate mode clients to receive data such as
Pin Assignment Notifications from the Type-C stack running on a remote
subsystem (e.g. DSP) via the PMIC GLINK interface.

Please refer to Documentation/devicetree/bindings/soc/qcom/qcom,pmic-glink.txt
for information on the "qcom,pmic_glink" device used in the example below.

REQUIRED PROPERTIES:

- compatible:
	Usage: required
	Value type: <stringlist>
	Definition: must be "qcom,altmode-glink"

- #altmode-cells:
	Usage: required
	Value type: <u32>
	Definition: must be <1>

EXAMPLE of altmode node definition:

&soc {
	qcom,pmic_glink {
		...
		altmode: qcom,altmode {
			compatible = "qcom,altmode-glink";
			#altmode-cells = <1>;
		};
		...
	};
};

Altmode client bindings:

REQUIRED PROPERTIES:

- qcom,altmode-dev:
	Usage: required
	Value type: <phandle>
	Definition: must be <phandle_to_altmode_node, N> where N is port index

EXAMPLE of altmode client node definition:

altmode-client {
	...
	qcom,altmode-dev = <&altmode 0>;
	...
}
```

## Documentation/devicetree/bindings/soc/qcom/qcom,cx_ipeak.txt
```
* Cx iPeak driver to handle requests from various multimedia clients.

Cx ipeak HW module is used to limit the current drawn by various subsystem
blocks on Cx power rail. Each client needs to set their
bit in tcsr register if it is going to cross its own threshold. If all
clients are going to cross their thresholds then Cx ipeak hw module will raise
an interrupt to cDSP block to throttle cDSP's fmax.

Required properties:

- compatible : name of the component used for driver matching, should be
	       "qcom,cx-ipeak-sdm660"

- reg : physical base address and length of the register set(s), SRAM and XPU
	of the component.

Example:

	cx_ipeak_lm: cx_ipeak@1fe5040 {
		compatible = "qcom,cx-ipeak-sdm660";
		reg = <0x01fe5040 0x28>;
	};
```

## Documentation/devicetree/bindings/soc/qcom/qcom,glink-bgcom-xprt.txt
```
Qualcomm Technologies, Inc GLINK BGCOM transport (glink_bgcom_xprt) binding

This binding describes the Qualcomm Technologies, Inc glink bgcom transport
driver, a bgcom-spi based communication channel for sending data between the
various subsystems in Qualcomm Technologies, Inc platforms.

- compatible:
	Usage: required
	Value type: <stringlist>
	Definition: must be "qcom,glink-bgcom-xprt"

- label:
	Usage: required
	Value type: <stringlist>
	Definition: must be "bg"

= EXAMPLE

The following example reprsents a glink_bgcom node.

	qcom,glink-bgcom-xprt-bg {
		compatible = "qcom,glink-bgcom-xprt";
		label = "bg";
	};
```
