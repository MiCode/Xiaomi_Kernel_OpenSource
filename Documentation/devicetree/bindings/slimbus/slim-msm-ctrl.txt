## Documentation/devicetree/bindings/soc/qcom/qcom,glink-pkt.txt
```
Qualcomm Technologies, Inc. G-Link Packet Driver (glinkpkt)

[Root level node]
Required properties:
-compatible : should be "qcom,glinkpkt"

[Second level nodes]
qcom,glinkpkt-channel-names
Required properties:
-qcom,glinkpkt-transport : the glinkpkt transport layer
-qcom,glinkpkt-edge : the remote subsystem name
-qcom,glinkpkt-ch-name : the glink channel name
-qcom,glinkpkt-dev-name : the glinkpkt device name

Example:

         qcom,glink_pkt {
                 compatible = "qcom,glinkpkt";

                 qcom,glinkpkt-at-mdm0 {
                         qcom,glinkpkt-transport = "smd_trans";
                         qcom,glinkpkt-edge = "mpss";
                         qcom,glinkpkt-ch-name = "DS";
                         qcom,glinkpkt-dev-name = "at_mdm0";
                 };

                 qcom,glinkpkt-loopback-cntl {
                         qcom,glinkpkt-transport = "lloop";
                         qcom,glinkpkt-edge = "local";
                         qcom,glinkpkt-ch-name = "LOCAL_LOOPBACK_CLNT";
                         qcom,glinkpkt-dev-name = "glink_pkt_loopback_ctrl";
                 };

                 qcom,glinkpkt-loopback-data {
                         qcom,glinkpkt-transport = "lloop";
                         qcom,glinkpkt-edge = "local";
                         qcom,glinkpkt-ch-name = "glink_pkt_lloop_CLNT";
                         qcom,glinkpkt-dev-name = "glink_pkt_loopback";
                 };
         };
```

## Documentation/devicetree/bindings/soc/qcom/qcom,glink_probe.txt
```
Qualcomm Technologies, Inc. GLINK Probe

This binding describes the GLINK Probe driver, a device
that initializes the GLINK edge pairs within the system.

- compatible :
	Usage: required
	Value type: <stringlist>
	Definition: must be "qcom,glink"

= SUBNODES
The GLINK probe node must contain subnodes that describes the
edge-pairs. See qcom,glink.txt for details on how to describe them.

In addition to the properties in qcom,glink.txt, The GLINK Probe driver
requires the remote-pid and transport type to be specified in the subnodes.

- transport :
	Usage: required
	Value type: <stringlist>
	Definition: must be "smem", "mbox", or "spi"

- qcom,remote-pid :
	Usage: required
	Value type: <prop-encoded-array>
	Definition: specifies the identifier of the remote proc of this edge.

= EXAMPLE
qcom,glink {
	compatible = "qcom,glink";
	modem {
		transport = "smem";
		qcom,remote-pid = <1>;
		mboxes = <&apcs_glb 8>;
		mbox-names = "mpss_smem";
		interrupts = <GIC_SPI 449 IRQ_TYPE_EDGE_RISING>;
	};
};
```

## Documentation/devicetree/bindings/soc/qcom/qcom,ipcc-self-ping-test.txt
```
The document describes the device tree binding for testing the IPCC
(Inter-Processor Communication Controller) driver. The test driver triggers a
self-ping onto itself. The expected behavior would be the driver raising
an interrupt using the mailbox interface onto the IPCC driver, which in turn
raises an interrupt on the IPCC hardware. Since the test driver is configured
as loopback, the interrupt generated should come back and hit the APPS
(Application Processor Subsystem). The IPCC driver would hear this interrupt
and forwards it to the IPCC test driver. Hence, the test exercises the inbound
and outbound paths of the driver.

For details on the IPCC driver, please see qcom,ipcc.txt

- compatible:
  Usage: required
  Value type: <string>
  Definition: Must be "qcom,ipcc-self-ping"

- interrupts-extended:
  Usage: required
  Value type: <prop-encoded-array>
  Definition: One entry specifying the phandle to the IPCC protocol, the APPS'
		client-id, signal-id and IRQ type.

- mboxes:
  Usage: required
  Value type: <prop-encoded-array>
  Definition: One entry specifying the phandle to the IPCC protocol, the APPS'
		client-id and the signal-id (same as interrupts-extended).

Example
-------
	ipcc_self_ping: ipcc-self-ping {
		compatible = "qcom,ipcc-self-ping";
		interrupts-extended = <&ipcc_mproc IPCC_CLIENT_APSS
				IPCC_MPROC_SIGNAL_SMP2P IRQ_TYPE_LEVEL_HIGH>;
		mboxes = <&ipcc_mproc IPCC_CLIENT_APSS IPCC_MPROC_SIGNAL_SMP2P>;
	};
```

## Documentation/devicetree/bindings/soc/qcom/qcom,msm-eud.txt
```
* Qualcomm Technologies Inc Embedded USB Debugger (EUD)

The EUD (Embedded USB Debugger) is a mini-USB hub implemented
on chip to support the USB-based debug and trace capabilities.

Required properties:

 - compatible:  Should be "qcom,msm-eud"
 - interrupt-names:  Should be "eud_irq"
 - interrupts:  Interrupt number
 - reg: Should be address and size of EUD register space
 - reg-names: Should be "eud_base"

Optional properties:
 - reg-names: Can be "eud_mode_mgr2" for secure eud
 - qcom,secure-eud-en: To enable secure eud

Driver notifies clients via extcon for VBUS spoof attach/detach
and charger enable/disable events. Clients registered for these
notifications should have extcon property set to eud.

An example for EUD device node:

	eud: qcom,msm-eud@88e0000 {
		compatible = "qcom,msm-eud";
		interrupt-names = "eud_irq";
		interrupts = <GIC_SPI 492 IRQ_TYPE_LEVEL_HIGH>;
		reg = <0x88e0000 0x4000>;
		reg-names = "eud_base";
	};

An example for EUD extcon client:

	usb3 {
		extcon = <&eud>;
	};
```
