## Documentation/devicetree/bindings/slimbus/slim-msm-ctrl.txt
```
 Qualcomm Technologies,Inc SLIMBUS controller
 Qualcomm Technologies,Inc implements 2 type of slimbus controllers:
1. "qcom,slim-msm": This controller is used if applications processor
	driver is controlling slimbus master component. This driver is
	responsible for communicating with slave HW directly using
	messaging interface, and doing data channel management. Driver
	also communicates with satellite component (driver implemented
	by other execution environment, such as ADSP) to get its
	requirements for data channel and bandwidth requirements.
2. "qcom,slim-ngd": This controller is used if applications processor
	driver is controlling slimbus satellite component (also known as
	Non-ported Generic Device, or NGD). This is light-weight slimbus
	controller responsible for communicating with slave HW directly
	over bus messaging interface, and communicating with master component
	(driver residing on other execution environment, such as ADSP)
	for bandwidth and data channel management.

Required properties:

 - reg : Offset and length of the register region(s) for the device
 - reg-names : Register region name(s) referenced in reg above
	 Required register resource entries are:
	 "slimbus_physical": Physical adderss of controller register blocks
	 "slimbus_bam_physical": Physical address of Bus Access Module (BAM)
				 for this controller
 - compatible : should be "qcom,slim-msm" if this is master component driver
 - compatible : should be "qcom,slim-ngd" if this is satellite component driver
 - cell-index : SLIMBUS number used for this controller
 - interrupts : Interrupt numbers used by this controller
 - interrupt-names : Required interrupt resource entries are:
	"slimbus_irq" : Interrupt for SLIMBUS core
	"slimbus_bam_irq" : Interrupt for controller core's BAM

Optional property:
 - reg entry for slew rate : If slew rate control register is provided, this
	 entry should be used.
 - reg-name for slew rate: "slimbus_slew_reg"
 - reg entry for LPASS memory: If LPASS memory is to be used instead of DDR by
		 slimbus, this entry should be used.
 - reg-names for LPASS memory: "slimbus_lpass_mem"
 - qcom,min-clk-gear : Minimum clock gear at which this controller can be run
		 (range: 1-10)
		 Default value will be 1 if this entry is not specified
 - qcom,max-clk-gear: Maximum clock gear at which this controller can be run
		 (range: 1-10)
		 Default value will be 10 if this entry is not specified
 - qcom,rxreg-access: This boolean indicates that slimbus RX should use direct
		 register access to receive data. This flag is only needed if
		 BAM pipe is not available to receive data from slimbus
 - qcom,apps-ch-pipes: This value represents BAM pipe-mask used by application
		 processor for data channels. If this property is not defined,
		 default mask of 0 is used indicating that application
		 processor does not use BAM pipes for data channels.
 - qcom,ea-pc: This value represents product code (PC) field of enumeration
		 address (EA) for the QTI slimbus controller hardware.
		 This value is needed if data-channels originating from apps
		 are to be used, so that application processor can query
		 logical address of the ported generic device to be used.
		 Other than PC, fields of EA are same across platforms.
 - qcom,slim-mdm: This value provides the identifier of slimbus component on
		 external mdm. This property enables the slimbus driver to
		 register and receive subsytem restart notification from mdm
		 and follow appropriate steps to ensure communication on the bus
		 can be resumed after mdm-restart.
 - qcom,subsys-name: This value provides the subsystem name where slimbus master
		 is present. This property enables the slimbus driver to
		 register and receive subsytem restart notification from subsystem
		 and follow appropriate steps to ensure communication on the bus
		 can be resumed after subsytem restart. By default slimbus driver
		 register with ADSP subsystem.
 - qcom,iommu-s1-bypass: Boolean flag to bypass IOMMU stage 1 translation.

Optional subnodes:
qcom,iommu_slim_ctrl_cb : Child node representing the Slimbus controller
                          context bank.

Subnode Required properties:
- compatible : Must be "qcom,slim-ctrl-cb";
- iommus : A list of phandle and IOMMU specifier pairs that
           describe the IOMMU master interfaces of the device.

Example:
	slim@fe12f000 {
		cell-index = <1>;
		compatible = "qcom,slim-msm";
		reg = <0xfe12f000 0x35000>,
		      <0xfe104000 0x20000>;
		reg-names = "slimbus_physical", "slimbus_bam_physical";
		interrupts = <0 163 0 0 164 0>;
		interrupt-names = "slimbus_irq", "slimbus_bam_irq";
		qcom,min-clk-gear = <10>;
		qcom,rxreg-access;
		qcom,apps-ch-pipes = <0x60000000>;
		qcom,ea-pc = <0x30>;

		iommu_slim_ctrl_cb: qcom,iommu_slim_ctrl_cb {
			compatible = "qcom,iommu-slim-ctrl-cb";
			iommus = <&apps_smmu 0x1 0x0>;
		};
	};
```

## Documentation/devicetree/bindings/smcinvoke/smcinvoke.txt
```
* SMCInvoke driver to provide transport between TZ and Linux

Required properties:
- compatible : Should be "qcom,smcinvoke"
- qcom,support-legacy_smc : indicates that secure side uses QCOM_SCM_SMCINVOKE_INVOKE_LEGACY (value = 0x00) for smcinvoke
			    functionality.

Example:
	qcom_smcinvoke: smcinvoke@87900000 {
		compatible = "qcom,smcinvoke";
	};

Example: For targets where secure side runs with QCOM_SCM_SMCINVOKE_INVOKE_LEGACY cmd id
	qcom_smcinvoke: smcinvoke@87900000 {
                compatible = "qcom,smcinvoke";
		qcom,support-legacy_smc;
        };
```

## Documentation/devicetree/bindings/soc/mediatek/dvfsrc.txt
```
MediaTek DVFSRC

The Dynamic Voltage and Frequency Scaling Resource Collector (DVFSRC) is a
HW module which is used to collect all the requests from both software and
hardware and turn into the decision of minimum operating voltage and minimum
DRAM frequency to fulfill those requests.

Required Properties:
- compatible: Should be one of the following
	- "mediatek,mt8183-dvfsrc": For MT8183 SoC
- reg: Address range of the DVFSRC unit
- clock-names: Must include the following entries:
	"dvfsrc": DVFSRC module clock
- clocks: Must contain an entry for each entry in clock-names.

Example:

	dvfsrc@10012000 {
		compatible = "mediatek,mt8183-dvfsrc";
		reg = <0 0x10012000 0 0x1000>;
		clocks = <&infracfg CLK_INFRA_DVFSRC>;
		clock-names = "dvfsrc";
	};
```

## Documentation/devicetree/bindings/soc/mediatek/mmdvfs.txt
```
Mediatek MMDVFS driver binding
=========================================

The Mediatek MMDVFS(Multimedia Dynamic Voltage and Frequency Scaling) driver
is used to set clk for Mediatek multimedia hardwares, such as display, camera,
mdp and video codec. MMDVFS driver reads which clock muxes and clock sources
are used on this platform from DTS, and set current clock according to current
voltage changed by dvfsrc_vcore.


Required properties:
- compatible : shall contain "mediatek,mmdvfs".
- operating-points-v2: contains any one of opp tables for multimedia modules.
                       MMDVFS uses it to get voltage setting on this platform.
- mediatek,support_mux: contains a list of clock mux names defined
                        in clock-names.
- mediatek,mux_*: a series of properties with mediatek,mux_ prefix.
		  Each property represents one clock mux, and its value is a
		  list of all the clock sources for it. The postfix * and every
		  item in the property must be from the clock-names.
- clock, clock-names: list all clock muxes and clock sources for multimedia
		      hardwares.

Optional properties:
If the platform needs frequency hopping for some clock sources, these following
properties should be set.

- mediatek,support_hopping: a list of clock names supporting frequency hopping.
- mediatek,hopping_*: a cell with the same size as opp numbers of an opp table
		      for any MM module and each entry represents the clock
		      rate for each opp. For example, the first entry is the
		      clock rate set in opp-0, and the second entry is the
		      clock rate set in opp-1.
- mediatek,action: a cell with one entry.
		   It represents the action taken when setting clocks.
		   0 or this property is not set:
		   	Do not set frequency hopping and just set clock mux.
		   1:
		   	If the voltage is increasing, set frequency hopping
		   	first. If the voltage is decreasing, set clock mux
		   	first.

Example:
	opp_table_mm: opp-table-mm {
		compatible = "operating-points-v2";

		opp-0 {
			opp-hz = /bits/ 64 <315000000>;
			opp-microvolt = <650000>;
		};
		opp-1 {
			opp-hz = /bits/ 64 <450000000>;
			opp-microvolt = <725000>;
		};
		opp-2 {
			opp-hz = /bits/ 64 <606000000>;
			opp-microvolt = <825000>;
		};
	};

	opp_table_cam: opp-table-cam {
		compatible = "operating-points-v2";

		opp-0 {
			opp-hz = /bits/ 64 <315000000>;
			opp-microvolt = <650000>;
		};
		opp-1 {
			opp-hz = /bits/ 64 <416000000>;
			opp-microvolt = <725000>;
		};
		opp-2 {
			opp-hz = /bits/ 64 <560000000>;
			opp-microvolt = <825000>;
		};
	};
	.... /* Other opp tables for multimedia modules */

	mmdvfs {
		compatible = "mediatek,mmdvfs";

		operating-points-v2 = <&opp_table_mm>;

		mediatek,support_mux = "mm", "cam", "img", "ipe",
			"venc", "vdec", "dpe", "ccu";

		mediatek,mux_mm = "clk_mmpll_d5_d2",
			"clk_mmpll_d7", "clk_tvdpll_mainpll_d2_ck";
		mediatek,mux_cam = "clk_mmpll_d5_d2",
			"clk_univpll_d3", "clk_adsppll_d5";
		mediatek,mux_img = "clk_mmpll_d5_d2",
			"clk_univpll_d3", "clk_tvdpll_mainpll_d2_ck";
		mediatek,mux_ipe = "clk_mmpll_d5_d2",
			"clk_univpll_d3", "clk_mainpll_d2";
		mediatek,mux_venc = "clk_mainpll_d3",
			"clk_mmpll_d7", "clk_mmpll_d5";
		mediatek,mux_vdec = "clk_univpll_d2_d2",
			"clk_univpll_d3", "clk_univpll_d2";
		mediatek,mux_dpe = "clk_mainpll_d3",
			"clk_mmpll_d7", "clk_mainpll_d2";
		mediatek,mux_ccu = "clk_mmpll_d5_d2",
			"clk_univpll_d3", "clk_adsppll_d5";

		mediatek,support_hopping = "clk_mmpll_ck";
		mediatek,hopping_clk_mmpll_ck = <630000000 630000000 650000000>;
		mediatek,action = <1>;


		clocks = <&topckgen CLK_TOP_MM>,
			<&topckgen CLK_TOP_CAM>,
			<&topckgen CLK_TOP_IMG>,
			<&topckgen CLK_TOP_IPE>,
			<&topckgen CLK_TOP_VENC>,
			<&topckgen CLK_TOP_VDEC>,
			<&topckgen CLK_TOP_DPE>,
			<&topckgen CLK_TOP_CCU>,
			<&topckgen CLK_TOP_MMPLL_D5>,
			<&topckgen CLK_TOP_UNIVPLL_D2>,
			<&topckgen CLK_TOP_TVDPLL_MAINPLL_D2_CK>,
			<&topckgen CLK_TOP_ADSPPLL_D5>,
			<&topckgen CLK_TOP_MAINPLL_D2>,
			<&topckgen CLK_TOP_MMPLL_D6>,
			<&topckgen CLK_TOP_MMPLL_D7>,
			<&topckgen CLK_TOP_UNIVPLL_D3>,
			<&topckgen CLK_TOP_MAINPLL_D3>,
			<&topckgen CLK_TOP_MMPLL_D5_D2>,
			<&topckgen CLK_TOP_UNIVPLL_D2_D2>,
			<&topckgen CLK_TOP_MMPLL_CK>;
		clock-names = "mm",
			"cam",
			"img",
			"ipe",
			"venc",
			"vdec",
			"dpe",
			"ccu",
			"clk_mmpll_d5",
			"clk_univpll_d2",
			"clk_tvdpll_mainpll_d2_ck",
			"clk_adsppll_d5",
			"clk_mainpll_d2",
			"clk_mmpll_d6",
			"clk_mmpll_d7",
			"clk_univpll_d3",
			"clk_mainpll_d3",
			"clk_mmpll_d5_d2",
			"clk_univpll_d2_d2",
			"clk_mmpll_ck";
	};
```

## Documentation/devicetree/bindings/soc/mediatek/mtk-lpm.txt
```
MediaTek Low Power Manager (MTK-LPM)


MediaTek SoC low power manager, which is control the communication
between platform and resource mcu and also the suitable power stage.

The devicetree representation of mtk-lpm should be -
Required properties:

- compatible: Must be "mediatek,mtk-lpm"
```

## Documentation/devicetree/bindings/soc/qcom/avtimer.txt
```
* avtimer

Avtimer provides an interface for clients to enable avtimer block
on qdsp6. 64 bit AVtimer exposed by qdsp6 is used for audio and video
stream synchronization during capture and playback usecases.

Required properties:
- reg : physical address and length of avtimer register
- reg-names : AVtimer register name
  Required register resource entries are:
  "avtimer_lsb_addr" : AVtimer lsb physical address
  "avtimer_msb_addr" : AVtimer msb physical address
- compatible : Must be "qcom,avtimer"

Optional properties:
- clk-div : Divisor to divide the ticks value to get msec value.
 If the clock is at 27MHz, the ticks value read from AVTimer
 registers will have to be divided by 27, to achieve the msec value.
- clk-mult : Multiplier to multiply the ticks value in order to avoid
 a floating point operation if the clock is of decimal value.
 E.g. To get msec out of ticks from a 19.2MHz clock source, the ticks
 value will have to be divided by 19.2, which will then become a
 floating point operation. However, to avoid using a floating point
 operation, the msec can be calculated by multiplying ticks with 10
 and dividing the result by 192. i.e. msec = (ticks * 10) / 192;

Example:
	qcom,avtimer@90f7000 {
		compatible = "qcom,avtimer";
		reg = <0x90f700c 0x4>,
		      <0x90f7010 0x4>;
		reg-names = "avtimer_lsb_addr", "avtimer_msb_addr";
		qcom,clk-div = <27>;
		qcom,clk-mult = <10>;
	};
```

## Documentation/devicetree/bindings/soc/qcom/bg_daemon.txt
```
Qualcomm Technologies Inc. bg-daemon

BG-Daemon : When Modem goes down, to re-establish the connections,
BG-Daemon toggles the bg-reset gpio to reset BG.

Required properties:
- compatible : should be "qcom,bg-daemon"
- qcom,bg-reset-gpio : gpio for the apps processor use to soft reset BG
- ssr-reg1-supply : Power supply needed to power up the BG device.
                When BG brought up this regulator will be in normal power mode.
- ssr-reg2-supply : Power supply needed to power up the BG device.
                When BG BG brought up this regulator will be in normal power mode.

Example:
	qcom,bg-daemon {
		compatible = "qcom,bg-daemon";
		qcom,bg-reset-gpio = <&pm660_gpios 5 0>;
		ssr-reg1-supply = <&pm660_l3>;
		ssr-reg2-supply = <&pm660_l9>;
	};
```

## Documentation/devicetree/bindings/soc/qcom/bg_rsb.txt
```
Qualcomm technologies, Inc. bg-rsb

BG-RSB : bg-rsb is used to communicate with Blackghost over
Glink to configure the RSB events. bg-rsb enable/disable
LDO11 and LDO15 before making any communication to BG
regarding RSB. It also provides an input device, which is
used to send the RSB/Button events to input framework.

Required properties:
- compatible : should be "qcom,bg-rsb"
- vdd-ldo1-supply : for powering main supply
- vdd-ldo2-supply : for powering sensor

Example:
	qcom,bg-rsb {
		compatible = "qcom,bg-rsb";
		vdd-ldo1-supply = <&pm660_l11>;
		vdd-ldo2-supply = <&pm660_l15>;
	};
```

## Documentation/devicetree/bindings/soc/qcom/bg_spi.txt
```
Qualcomm technologies Inc bg-spi

BG-COM SPI : bg-spi is used for the  communication with Blackghost
chipset. It uses SPI protocol for communication.
BG-COM: bgcome is a thin transport layer over glink which provides
the read/write APIs to communicate with Blackghost chipset.

Required properties:
- compatible : should be "qcom,bg-spi"
- spi-max-frequency : Maximum SPI clocking speed of device in Hz
- qcom,irq-gpio : GPIO pin
- reg : Register set

Example:
	spi@78b6000 { /* BLSP1 QUP2 */
		status = "ok";
		qcom,bg-spi {
			compatible = "qcom,bg-spi";
			reg = <0>;
			spi-max-frequency = <19200000>;
			interrupt-parent = <&msm_gpio>;
			qcom,irq-gpio = <&msm_gpio 110 1>;
		};
	};
```

## Documentation/devicetree/bindings/soc/qcom/bgrsb_rpmsg.txt
```
Qualcomm technologies, Inc. bgrsb-rpmsg

BGRSB-RPMSG : bgrsb-rpmsg is used as an interface between
BG-RSB and Blackghost for Glink communication. bg-rsb is
used to communicate with Blackghost over Glink to
configure the RSB events.

Required properties:
- compatible : should be "qcom,bgrsb-rpmsg"
- glink-channels : RSB_CTRL
- glinkpkt-edge : bg
- intents : <0x200 20>

Example:
	qcom,bg-rsb {
		compatible = "qcom,bgrsb-rpmsg";
		qcom,glink-channels = "RSB_CTRL";
		qcom,glinkpkt-edge = "bg";
		intents = <0x200 20>;
	};
```
