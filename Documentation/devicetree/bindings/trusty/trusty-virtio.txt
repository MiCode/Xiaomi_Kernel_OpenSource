## Documentation/devicetree/bindings/trusty/trusty-virtio.txt
```
Trusty virtio interface

Trusty virtio is communication channel between secure and non-secure world..

Required properties:
- compatible: "android,trusty-virtio-v1"
```

## Documentation/devicetree/bindings/tty/serial/msm_serial.txt
```
* Qualcomm MSM UART

Required properties:
- compatible :
	- "qcom,msm-uart", and one of "qcom,msm-hsuart" or
	  "qcom,msm-lsuart".
- reg : offset and length of the register set for the device
	for the hsuart operating in compatible mode, there should be a
	second pair describing the gsbi registers.
- interrupts : should contain the uart interrupt.

There are two different UART blocks used in MSM devices,
"qcom,msm-hsuart" and "qcom,msm-lsuart".  The msm-serial driver is
able to handle both of these, and matches against the "qcom,msm-uart"
as the compatibility.

The registers for the "qcom,msm-hsuart" device need to specify both
register blocks, even for the common driver.

Example:

	uart@19c400000 {
		compatible = "qcom,msm-hsuart", "qcom,msm-uart";
		reg = <0x19c40000 0x1000>,
		      <0x19c00000 0x1000>;
		interrupts = <195>;
	};

* Qualcomm MSM HSUART

Required properties:
- compatible : one of:
	- "qcom,msm-lsuart-v14"
- reg : offset and length of the register set for the device.
- interrupts : should contain the uart interrupt.

Aliases:
An alias may optionally be used to bind the serial device to a tty device
(ttyHSLx) with a given line number. Aliases are of the form serial<n> where <n>
is an integer representing the line number to use. On systems with multiple
serial devices present it is recommended that an alias be defined for each such
device.

Example:
	aliases {
		serial0 = &uart0;       // This device will be called ttyHSL0
	};

	uart0: serial@19c400000 {
		compatible = "qcom,msm-lsuart-v14"
		reg = <0x19c40000 0x1000">;
		interrupts = <195>;
	};
```

## Documentation/devicetree/bindings/tty/serial/msm_serial_hs.txt
```
* Qualcomm MSM HSUART

Required properties:
- compatible :
	- "qcom,msm-hsuart-v14" to be used for UARTDM Core v1.4
- reg : offset and length of the register set for both the device,
	uart core and bam core
- reg-names :
	- "core_mem" to be used as name of the uart core
	- "bam_mem" to be used as name of the bam core
- interrupts : interrupts for both the device,uart core and bam core
- interrupt-names :
	- "core_irq" to be used as uart irq
	- "bam irq" to be used as bam irq
- #interrupt-cells: Specifies the number of cells needed to encode an interrupt
		source. The type shall be a <u32> and the value shall be 1
- #address-cells: Specifies the number of cells needed to encode an address.
		The type shall be <u32> and the value shall be 0
- interrupt-parent = It is needed for interrupt mapping
- bam-tx-ep-pipe-index : BAM TX Endpoint Pipe Index for HSUART
- bam-rx-ep-pipe-index : BAM RX Endpoint Pipe Index for HSUART

BLSP has a static pipe allocation and assumes a pair-pipe for each uart core.
Pipes [2*i : 2*i+1] are allocated for UART cores where i = [0 : 5].
Hence, Minimum and Maximum permitted value of endpoint pipe index to be used
with uart core is 0 and 11 respectively.

There is one HSUART block used in MSM devices,
"qcom,msm-hsuart-v14". The msm-serial-hs driver is
able to handle this, and matches against the "qcom,msm-hsuart-v14"
as the compatibility.

The registers for the "qcom,msm-hsuart-v14" device need to specify both
register blocks - uart core and bam core.

Example:

	uart7: uart@f995d000 {
		compatible = "qcom,msm-hsuart-v14";
		reg = <0xf995d000 0x1000>,
		      <0xf9944000 0x5000>;
		reg-names = "core_mem", "bam_mem";
		interrupt-names = "core_irq", "bam_irq";
		#address-cells = <0>;
		interrupt-parent = <&uart7>;
		interrupts = <0 1>;
		#interrupt-cells = <1>;
		interrupt-map = <0 &intc 0 113 0
				1 &intc 0 239 0>
		qcom,bam-tx-ep-pipe-index = <0>;
		qcom,bam-rx-ep-pipe-index = <1>;
		/* enable out of band sleep support */
		qcom,msm-obs;
	};

Optional properties:
- qcom,<gpio-name>-gpio : handle to the GPIO node, see "gpios property" in
Documentation/devicetree/bindings/gpio/gpio.txt.
"gpio-name" can be "tx", "rx", "cts" and "rfr" based on number of UART GPIOs
need to configured.
Gpio's are optional if it is required to be not configured by UART driver or
case where there is nothing connected and we want to use internal loopback mode
for uart.
- qcom, wakeup_irq : UART RX GPIO IRQ line to be configured as wakeup source.
- qcom,inject-rx-on-wakeup : inject_rx_on_wakeup enables feature where on
receiving interrupt with UART RX GPIO IRQ line (i.e. above wakeup_irq property),
HSUART driver injects provided character with property rx_to_inject.
- qcom, rx-char-to-inject : The character to be inserted on wakeup.
- qcom, no-suspend-delay : This decides system to go to suspend immediately
or not
- qcom,msm-obs : This flag is used to support out of band sleep mechanism.

- Refer to "Documentation/devicetree/bindings/arm/msm/msm_bus.txt" for
below optional properties:
    - qcom,msm_bus,name
    - qcom,msm_bus,num_cases
    - qcom,msm_bus,active_only
    - qcom,msm_bus,num_paths
    - qcom,msm_bus,vectors

Aliases :
An alias may be optionally used to bind the UART device to a TTY device
(ttyHS<alias_num>) with a given alias number. Aliases are of the form
uart<n> where <n> is an integer representing the alias number to use.
On systems with multiple UART devices present, an alias may optionally be
defined for such devices. The alias value should be from 0 to 255.

Example:

	aliases {
		uart4 = &uart7; // This device will be enumerated as ttyHS4
	};

	uart7: uart@f995d000 {
		compatible = "qcom,msm-hsuart-v14"
		reg = <0x19c40000 0x1000">,
		      <0xf9944000 0x5000>;
		reg-names = "core_mem", "bam_mem";
		interrupt-names = "core_irq", "bam_irq", "wakeup_irq";
		#address-cells = <0>;
		interrupt-parent = <&uart7>;
		interrupts = <0 1 2>;
		#interrupt-cells = <1>;
		interrupt-map-mask = <0xffffffff>;
		interrupt-map = <0 &intc 0 113 0
				1 &intc 0 239 0
				2 &msmgpio 42 0>;
		qcom,tx-gpio = <&msmgpio 41 0x00>;
		qcom,rx-gpio = <&msmgpio 42 0x00>;
		qcom,cts-gpio = <&msmgpio 43 0x00>;
		qcom,rfr-gpio = <&msmgpio 44 0x00>;
		qcom,inject-rx-on-wakeup = <1>;
		qcom,rx-char-to-inject = <0xFD>;

		qcom,bam-tx-ep-pipe-index = <0>;
		qcom,bam-rx-ep-pipe-index = <1>;

		qcom,msm-bus,name = "uart7";
		qcom,msm-bus,num-cases = <2>;
		qcom,msm-bus,num-paths = <1>;
		qcom,msm-bus,vectors-KBps =
				<84 512 0 0>,
				<84 512 500 800>;
	};
```

## Documentation/devicetree/bindings/ufs/ufs-msm.txt
```
* MSM Universal Flash Storage (UFS) PHY

UFSPHY nodes are defined to describe on-chip UFS PHY hardware macro.
Each UFS PHY node should have its own node.

To bind UFS PHY with UFS host controller, the controller node should
contain a phandle reference to UFS PHY node.

Required properties:
- compatible        : compatible list, contains "qcom,ufs-msm-phy-qmp-28nm"
                      or "qcom,ufs-msm-phy-qmp-20nm" according to the relevant
                      phy in use
- reg               : <registers mapping>
- #phy-cells         : This property shall be set to 0
- vdda-phy-supply   : phandle to main PHY supply for analog domain
- vdda-pll-supply   : phandle to PHY PLL and Power-Gen block power supply

Optional properties:
- vdda-phy-max-microamp : specifies max. load that can be drawn from phy supply
- vdda-pll-max-microamp : specifies max. load that can be drawn from pll supply

Example:

	ufsphy1: ufsphy@0xfc597000 {
		compatible = "qcom,ufs-msm-phy-qmp-28nm";
		reg = <0xfc597000 0x800>;
		#phy-cells = <0>;
		vdda-phy-supply = <&pma8084_l4>;
		vdda-pll-supply = <&pma8084_l12>;
		vdda-phy-max-microamp = <50000>;
		vdda-pll-max-microamp = <1000>;
	};

	ufshc@0xfc598000 {
		...
		phys = <&ufsphy1>;
	};
```

## Documentation/devicetree/bindings/ufs/ufs-qcom.txt
```
* Qualcomm Technologies Inc Universal Flash Storage (UFS) PHY

UFSPHY nodes are defined to describe on-chip UFS PHY hardware macro.
Each UFS PHY node should have its own node.

To bind UFS PHY with UFS host controller, the controller node should
contain a phandle reference to UFS PHY node.

Required properties:
- compatible        : compatible list, contains one of the following -
			"qcom,ufs-phy-qmp-14nm" for legacy 14nm ufs phy,
			"qcom,ufs-phy-qmp-v3" for V3 ufs phy present
			 on msmcobalt platform,
			"qcom,ufs-phy-qmp-v4" for V4 ufs phy present
			 on sm8150 platform,
			"qcom,ufs-phy-qrbtc-sdm845" for phy support
			 for sdm845 emulation
		        "qcom,ufs-phy-qmp-v3-falcon" for phy support
			 for msmfalcon
			"qcom,msm8996-ufs-phy-qmp-14nm" for 14nm ufs phy
			 present on MSM8996 chipset
			"qcom,ufs-phy-qmp-v3-660" for V3 phy support on
			 sm6150 platform

- reg               : should contain PHY register address space (mandatory),
- reg-names         : indicates various resources passed to driver (via reg proptery) by name.
                      Required "reg-names" is "phy_mem".
- #phy-cells        : This property shall be set to 0
- vdda-phy-supply   : phandle to main PHY supply for analog domain
- vdda-pll-supply   : phandle to PHY PLL and Power-Gen block power supply
- clocks	    : List of phandle and clock specifier pairs
- clock-names       : List of clock input name strings sorted in the same
		      order as the clocks property. "ref_clk_src",
		      "tx_iface_clk" & "rx_iface_clk" are mandatory but
		      "ref_clk_parent" and "ref_clk" are optional

Optional properties:
- vdda-phy-max-microamp : specifies max. load that can be drawn from phy supply
- vdda-pll-max-microamp : specifies max. load that can be drawn from pll supply
- vddp-ref-clk-supply   : phandle to UFS device ref_clk pad power supply
- vddp-ref-clk-max-microamp : specifies max. load that can be drawn from this supply
- vddp-ref-clk-min-uV : specifies min voltage that can be set for reference clock supply
- vddp-ref-clk-max-uV : specifies max voltage that can be set for reference clock supply
- qcom,disable-lpm : disable various LPM mechanisms in UFS for platform compatibility
  (limit link to PWM Gear-1, 1-lane slow mode; disable hibernate, and avoid suspend/resume)
- vccq-parent-supply   : phandle to UFS device's VCCQ parent power supply
- vccq-parent-max-microamp : specifies max. load that can be drawn from the VCCQ's parent supply

Example:

	ufsphy1: ufsphy@0xfc597000 {
		compatible = "qcom,ufs-phy-qmp-14nm";
		reg = <0xfc597000 0x800>;
		reg-names = "phy_mem";
		#phy-cells = <0>;
		lanes-per-direction = <1>;
		vdda-phy-supply = <&pma8084_l4>;
		vdda-pll-supply = <&pma8084_l12>;
		vdda-phy-max-microamp = <50000>;
		vdda-pll-max-microamp = <1000>;
		clock-names = "ref_clk_src",
			"ref_clk_parent",
			"ref_clk",
			"tx_iface_clk",
			"rx_iface_clk";
		clocks = <&clock_rpm clk_ln_bb_clk>,
			<&clock_gcc clk_pcie_1_phy_ldo >,
			<&clock_gcc clk_ufs_phy_ldo>,
			<&clock_gcc clk_gcc_ufs_tx_cfg_clk>,
			<&clock_gcc clk_gcc_ufs_rx_cfg_clk>;
	};

	ufshc@0xfc598000 {
		...
		phys = <&ufsphy1>;
		phy-names = "ufsphy";
	};
```
