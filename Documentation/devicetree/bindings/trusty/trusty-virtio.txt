## Documentation/devicetree/bindings/unisoc_platform/sprd,autotest.yaml
```yaml
# SPDX-License-Identifier: (GPL-2.0 OR BSD-2-Clause)

$id: "http://devicetree.org/schemas/unisoc_platform/sprd,autotest.yaml#"
$schema: "http://devicetree.org/meta-schemas/core.yaml#"

title: Spreadtrum autotest bindings

description: autotest driver, which will provide an interface for userspace to oprate gpio.


Required properties:
- compatible: Should be sprd,autotest
- sprd,pinctrl: pinctrl for gpio function

examples:
  - |
    autotest: autotest {
      compatible              = "sprd,autotest";
      sprd,pinctrl            = <&pin_controller>;
    };
```

## Documentation/devicetree/bindings/unisoc_platform/sprd,pmic_syscon.txt
```
SOC PMIC Syscon Driver

The driver is developed for UNISOC platform's PMIC, which is used by PMIC's
multi modules for finding PMIC's address easier.

Required properties:
-compatible:
 -"sprd,sc27xx-syscon" for SC27XX series pmic syscon
 -"sprd,ump962x-syscon" for UMP962x main pmic syscon
 -"sprd,ump9621-syscon" for UMP9621 sub-pmic syscon
 -"sprd,ump9622-syscon" for UMP9622 sub-pmic syscon
- reg: Specifies the PMIC's physical global address.

Example:
syscon@1800 {
	compatible = "sprd,sc2731-syscon", "sprd,sc27xx-syscon";
	reg = <0x1800>, <0x1ba0>, <0x1b98>;
};
```

## Documentation/devicetree/bindings/usb/dwc3.txt
```
synopsys DWC3 CORE

DWC3- USB3 CONTROLLER. Complies to the generic USB binding properties
      as described in 'usb/generic.txt'

Required properties:
 - compatible: must be "snps,dwc3"
 - reg : Address and length of the register set for the device
   Required regs are:
   - "core_base" : USB DWC3 controller register set.
   - "ahb2phy_base" : AHB2PHY register base. It is used to update read/write
                      wait cycle for accessing PHY.
 - interrupts: Interrupts used by the dwc3 controller.

Optional properties:
 - usb-phy : array of phandle for the PHY device.  The first element
   in the array is expected to be a handle to the USB2/HS PHY and
   the second element is expected to be a handle to the USB3/SS PHY
 - phys: from the *Generic PHY* bindings
 - phy-names: from the *Generic PHY* bindings
 - tx-fifo-resize: determines if the FIFO *has* to be reallocated.
 - snps,usb3_lpm_capable: determines if platform is USB3 LPM capable
 - snps,disable_scramble_quirk: true when SW should disable data scrambling.
	Only really useful for FPGA builds.
 - snps,has-lpm-erratum: true when DWC3 was configured with LPM Erratum enabled
 - snps,lpm-nyet-threshold: LPM NYET threshold
 - snps,u2exit_lfps_quirk: set if we want to enable u2exit lfps quirk
 - snps,u2ss_inp3_quirk: set if we enable P3 OK for U2/SS Inactive quirk
 - snps,req_p1p2p3_quirk: when set, the core will always request for
			P1/P2/P3 transition sequence.
 - snps,del_p1p2p3_quirk: when set core will delay P1/P2/P3 until a certain
			amount of 8B10B errors occur.
 - snps,del_phy_power_chg_quirk: when set core will delay PHY power change
			from P0 to P1/P2/P3.
 - snps,lfps_filter_quirk: when set core will filter LFPS reception.
 - snps,rx_detect_poll_quirk: when set core will disable a 400us delay to start
			Polling LFPS after RX.Detect.
 - snps,tx_de_emphasis_quirk: when set core will set Tx de-emphasis value.
 - snps,tx_de_emphasis: the value driven to the PHY is controlled by the
			LTSSM during USB3 Compliance mode.
 - snps,dis_u3_susphy_quirk: when set core will disable USB3 suspend phy.
 - snps,dis_u2_susphy_quirk: when set core will disable USB2 suspend phy.
 - snps,dis_enblslpm_quirk: when set clears the enblslpm in GUSB2PHYCFG,
			disabling the suspend signal to the PHY.
 - snps,is-utmi-l1-suspend: true when DWC3 asserts output signal
			utmi_l1_suspend_n, false when asserts utmi_sleep_n
 - snps,hird-threshold: HIRD threshold
 - snps,hsphy_interface: High-Speed PHY interface selection between "utmi" for
   UTMI+ and "ulpi" for ULPI when the DWC_USB3_HSPHY_INTERFACE has value 3.
 - snps,quirk-frame-length-adjustment: Value for GFLADJ_30MHZ field of GFLADJ
	register for post-silicon frame length adjustment when the
	fladj_30mhz_sdbnd signal is invalid or incorrect.
 - snps,nominal-elastic-buffer: When set, the nominal elastic buffer setting
	is used. By default, the half-full setting is used.
 - snps,usb3-u1u2-disable: If present, disable u1u2 low power modes for DWC3 core
	controller in SS mode.
 - snps,disable-clk-gating: If present, disable controller's internal clock gating. Default it is enabled.
 - snps,bus-suspend-enable: If present then controller supports low power mode
	during bus suspend.
 - snps,num-normal-evt-buffs: If present, specifies number of normal event buffers. Default is 1.
 - snps,num-gsi-evt-buffs: If present, specifies number of GSI based hardware accelerated event buffers.
	1 event buffer is needed per h/w accelerated endpoint.
 - xhci-imod-value: Interrupt moderation interval for host mode (in increments of 250nsec).

This is usually a subnode to DWC3 glue to which it is connected.

dwc3@4a030000 {
	compatible = "snps,dwc3";
	reg = <0x07600000 0xfc000>,
		<0x7416000 0x400>;
	reg-names = "core_base",
		    "ahb2phy_base";
	interrupts = <0 92 4>
	usb-phy = <&usb2_phy>, <&usb3,phy>;
	tx-fifo-resize;
	snps,usb3-u1u2-disable;
	snps,num-gsi-evt-buffs = <0x2>;
	xhci-imod-value = <4000>;
};
```

## Documentation/devicetree/bindings/usb/ice40-hcd.txt
```
ICE40 FPGA based SPI-USB bridge

Documentation/devicetree/bindings/spi/spi-bus.txt provides the details
of the required and optional properties of a SPI slave device node.

The purpose of this document is to provide the additional properties
that are required to use the ICE40 FPGA based SPI slave device as a
USB host controller.

Required properties:
- compatible : should be "lattice,ice40-spi-usb"
- <supply-name>-supply: handle to the regulator device tree node
  Required "supply-name" is "core-vcc" and "spi-vcc"
- reset-gpio: gpio used to assert the bridge chip reset
- config-done-gpio: gpio used to indicate the configuration status
- vcc-en-gpio: gpio used to enable the chip power supply
- pinctrl-names : List of pin configuration strings. "default" and "sleep"
  states are supported.
- pinctrl-0 : Phandle of "default" pin config state
- pinctrl-1 : Phandle of "sleep" pin config state

Optional properties:
- interrupts: IRQ lines used by this controller
- clocks: List of clock phandles.
- clock-names: List of clock names. Supported clock name string is
  "xo"
- clk-en-gpio: gpio used to enable the 19.2 MHZ clock to the bridge
  chip. If it is not present, assume that the clock is available on
  the bridge chip board.
- <supply-name>-supply: handle to the regulator device tree node
  Optional "supply-name" is "gpio" used to power up the gpio bank
  used by this device

	spi@f9923000 {
		lattice,spi-usb@3 {
			compatible = "lattice,ice40-spi-usb";
			reg = <3>;
			spi-max-frequency = <50000000>;
			spi-cpol = <1>;
			spi-cpha = <1>;
			interrupt-parent = <&msmgpio>;
			interrupts = <121 0x8>;
			core-vcc-supply = <&pm8226_l2>;
			spi-vcc-supply = <&pm8226_l5>;
			lattice,reset-gpio = <&msmgpio 114 0>;
			lattice,config-done-gpio = <&msmgpio 115 0>;
			lattice,vcc-en-gpio = <&msmgpio 117 0>;

			clocks = <&clock_rpm clk_bb_clk2_pin>;
			clock-names = "xo";
			pinctrl-names = "default", "sleep";
			pinctrl-0 = <&ice40_default>;
			pinctrl-1 = <&ice40_sleep>;
		};
	};
```

## Documentation/devicetree/bindings/usb/msm-android-usb.txt
```
ANDROID USB:

This describes the device tree node for the Android USB gadget device.
This works in conjunction with a USB Device Controller (UDC) to provide
a dynamically configurable composition of functions to be exposed when
connected to a USB host.

Required properties:
- compatible: should be "qcom,android-usb"

Optional properties :
- reg  : offset and length of memory region that is used by device to
  update USB PID and serial numbers used by bootloader in DLOAD mode.
- qcom,pm-qos-latency : This property must be a list of three integer values
  (perf, normal, sleep) where each value respresents DMA latency in microsecs.
  First value represents DMA latency to vote with pm_qos when back to back USB
  transfers are happening and it requires USB thoughput to be maximum.
  Second value represents value to vote when not many USB transfers are
  happening and it is OK to have higher DMA latency to save power.
  Third value represents DMA latency to vote when USB BUS is IDLE and absolutely
  no transfers are happening. It should allow transition to lowest power state.
- qcom,streaming-func : add list of usb function name. If mention usb function
  is being enable as part of USB composition, streaming mode is enable with
  usb device controller to get better throughput. NOTE: Inverted CRC and
  turnaround timeout is observed on enabling streaming. Hence it is required
  to see these errors and number of erros on enabling this at USB level to make
  final decision to enable this feature or not.
- qcom,usb-core-id: Index to refer USB hardware core to bind android gadget driver
  with UDC if multiple USB peripheral controllers are present. If unspecified,
  core is set to zero by default.
- qcom,supported-func: Represents list of supported function drivers. If this
  property is present android USB driver dynamically creats the list of
  supported function drivers and uses this list instead of statically defined default
  supported function driver list.
Example Android USB device node :
	android_usb@fc42b0c8 {
		compatible = "qcom,android-usb";
		reg = <0xfc42b0c8 0xc8>;
		qcom,pm-qos-latency = <2 1001 12701>;
		qcom,streaming-func = "rndis","mtp";
		qcom,supported-func = "rndis_gsi","ecm_gsi","rmnet_gsi";
		qcom,usb-core-id = <1>;
	};
```

## Documentation/devicetree/bindings/usb/msm-dbm.txt
```
MSM DBM (Device Bus Manager)

Required properties :
- compatible : must be one of "qcom,usb-dbm-1p4", or "qcom,usb-dbm-1p5"
- reg : offset and length of the register set in the memory map.

Optional properties :
- qcom,reset-ep-after-lpm-resume: If present, dbm requires ep reset after
	going to lpm

Example MSM DBM (Device Bus Manager) device node :
	dbm_1p4: dbm@f92f8000 {
		compatible = "qcom,usb-dbm-1p4";
		reg = <0xf92f8000 0x1000>;
	};
```
