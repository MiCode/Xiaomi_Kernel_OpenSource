## Documentation/devicetree/bindings/dma/qcom_gpi.txt
```
Qualcomm Technologies Inc GPI DMA controller

QCOM GPI DMA controller provides DMA capabilities for
peripheral buses such as I2C, UART, and SPI.

==============
Node Structure
==============

Main node properties:

- #dma-cells
  Usage: required
  Value type: <u32>
  Definition: Number of parameters client will provide.  Must be set to 5.
	1st parameter: channel index, 0 for TX, 1 for RX
	2nd parameter: serial engine index
	3rd parameter: bus protocol, 1 for SPI, 2 for UART, 3 for I2C
	4th parameter: channel ring length in transfer ring elements
	5th parameter: event processing priority, set to 0 for lowest latency

- compatible
  Usage: required
  Value type: <string>
  Definition: "qcom,gpi-dma"

- reg
  Usage: required
  Value type: Array of <u32>
  Definition: register address space location and size

- reg-name
  Usage: required
  Value type: <string>
  Definition: register space name, must be "gpi-top"

- interrupts
  Usage: required
  Value type: Array of <u32>
  Definition: Array of tuples which describe interrupt line for each GPII
	instance.

- qcom,max-num-gpii
  Usage: required
  Value type: <u32>
  Definition: Total number of GPII instances available for this controller.

- qcom,gpii-mask
  Usage: required
  Value type: <u32>
  Definition: Bitmap of supported GPII instances in hlos.

- qcom,ev-factor
  Usage: required
  Value type: <u32>
  Definition: Event ring transfer size compare to channel transfer ring. Event
	ring length = ev-factor * transfer ring size

- iommus
  Usage: required
  Value type: <phandle u32 u32>
  Definition: phandle for apps smmu controller and SID, and mask
	for the controller.  For more detail please check binding
	documentation arm,smmu.txt

- qcom,smmu-cfg
  Usage: required
  Value type: <u32>
  Definition: Determine whether GPI driver require to configure SMMU that
	sits behind GPI controller.
	Bit mask:
	BIT(0) : Attach address mapping to endpoint device
	BIT(1) : Set SMMU attribute S1_BYPASS
	BIT(2) : Set SMMU attribute FAST
	BIT(3) : Set SMMU attribute ATOMIC

- qcom,iova-range
  Usage: required if SMMU S1 translation is enabled
  Value type: Array of <u64>
  Definition: Pair of values describing iova base and size to allocate.

Optional property:
- qcom,gpi-ee-offset
  Usage: optional
  Value type: u64
  Definition: Specifies the gsi ee register offset for the QUP.

========
Example:
========
gpi_dma0: qcom,gpi-dma@0x800000 {
	#dma-cells = <5>;
	compatible = "qcom,gpi-dma";
	reg = <0x800000 0x60000>;
	reg-names = "gpi-top";
	interrupts = <0 244 0>, <0 245 0>, <0 246 0>, <0 247 0>,
                <0 248 0>, <0 249 0>, <0 250 0>, <0 251 0>,
                <0 252 0>, <0 253 0>, <0 254 0>, <0 255 0>,
                <0 256 0>;
	qcom,max-num-gpii = <13>;
	qcom,gpii-mask = <0xfa>;
	qcom,ev-factor = <2>;
	iommus = <&apps_smmu 0x0016 0x0>;
	qcom,smmu-cfg = <0x1>
	qcom,iova-range = <0x0 0x100000 0x0 0x100000>;
	status = "ok";
};
```

## Documentation/devicetree/bindings/dma/sps/sps.txt
```
SPS (Smart Peripheral Switch) may be used as a DMA engine to move data
in either the Peripheral-to-Peripheral (a.k.a. BAM-to-BAM) mode or the
Peripheral-to-Memory (a.k.a. BAM-System) mode. SPS includes BAM (Bus
Access Module) hardware block, BAM DMA peripheral, and pipe memory.

Required property:
  - compatible: should be "qcom,msm_sps" or "qcom,msm_sps_4k"

Optional properties:
  - reg: offset and size for the memory mapping, including maps for
    BAM DMA BAM, BAM DMA peripheral, pipe memory and reserved memory.
  - reg-names: indicates various resources passed to driver (via reg
    property) by name. "reg-names" examples are "bam_mem", "core_mem"
    , "pipe_mem" and "res_mem".
  - interrupts: IRQ line
  - qcom,device-type: specify the device configuration of BAM DMA and
    pipe memory. Can be one of
        1 - With BAM DMA and without pipe memory
        2 - With BAM DMA and with pipe memory
        3 - Without BAM DMA and without pipe memory
  - qcom,pipe-attr-ee: BAM pipes are attributed to a specific EE, with
    which we can know the pipes belong to apps side and can have the
    error interrupts at the pipe level.
  - clocks: This property shall provide a list of entries each of which
    contains a phandle to clock controller device and a macro that is
    the clock's name in hardware.These should be "clock_rpm" as clock
    controller phandle and "clk_pnoc_sps_clk" as macro for "dfab_clk"
    and "clock_gcc" as clock controller phandle and "clk_gcc_bam_dma_ahb_clk"
    as macro for "dma_bam_pclk".
  - clock-names: This property shall contain the clock input names used
    by driver in same order as the clocks property.These should be "dfab_clk"
    and "dma_bam_pclk".

Example:

	qcom,sps@f9980000 {
		compatible = "qcom,msm_sps";
		reg = <0xf9984000 0x15000>,
		      <0xf9999000 0xb000>,
		      <0xfe803000 0x4800>;
		interrupts = <0 94 0>;
		qcom,device-type = <2>;
		qcom,pipe-attr-ee;
		clocks = <&clock_rpm clk_pnoc_sps_clk>,
			 <&clock_gcc clk_gcc_bam_dma_ahb_clk>;
		clock-names = "dfab_clk", "dma_bam_pclk";
	};
```

## Documentation/devicetree/bindings/drm/msm/hdmi-display.txt
```
Qualcomm Technologies,Inc. Adreno/Snapdragon hdmi display manager

Required properties:
- compatible: "qcom,hdmi-display"
- label: label of this display manager

Optional properties:
- qcom,display-type: display type of this manager. It could be "primary",
  "secondary", "tertiary", etc.
- qcom,display-topology-control: display topology control. It could be
  "force-mixer", "force-tiling"
- qcom,non-pluggable: Boolean to indicate if display is non pluggable.
- qcom,skip_ddc: Boolean to indicate if display skips ddc function.
- qcom,customize-modes: Customized modes when it's non pluggable display.
- qcom,customize-mode-id: Customized mode node.
- qcom,mode-name: String which indicates the mode name which shall be used
   by the connector in non pluggable mode. Refer the example below for details.
   In pluggable mode, the modes shall be filled up
   after edid parsing.
- qcom,mode-h-active: Horizontal active pixels for this mode.
- qcom,mode-h-front-porch: Horizontal front porch in pixels for this mode.
- qcom,mode-h-pulse-width: Horizontal sync width in pixels for this mode.
- qcom,mode-h-back-porch: Horizontal back porch in pixels for this mode.
- qcom,mode-h-active-high: Boolean to indicate if mode horizontal polarity is active high.
- qcom,mode-v-active: Vertical active lines for this mode.
- qcom,mode-v-front-porch: Vertical front porch in lines for this mode.
- qcom,mode-v-pulse-width: Vertical sync width in lines for this mode.
- qcom,mode-v-back-porch: Vertical back porch in lines for this mode.
- qcom,mode-v-active-high: Boolean to indicate if mode vertical polarity is active high.
- qcom,mode-refersh-rate: Mode refresh rate in hertz.
- qcom,mode-clock-in-khz: Mode pixel clock in KHz.

Example:

/ {
	...

	hdmi_display: qcom,hdmi-display {
		compatible = "qcom,hdmi-display";
		label = "hdmi_display";
		qcom,display-type = "secondary";
		qcom,display-topology-control = "force-mixer";
		qcom,non-pluggable;
		qcom,customize-modes {
			qcom,customize-mode-id@0 {
				qcom,mode-name = "3840x2160@30Hz";
				qcom,mode-h-active = <3840>;
				qcom,mode-h-front-porch = <176>;
				qcom,mode-h-pulse-width = <88>;
				qcom,mode-h-back-porch = <296>;
				qcom,mode-h-active-high;
				qcom,mode-v-active = <2160>;
				qcom,mode-v-front-porch = <8>;
				qcom,mode-v-pulse-width = <10>;
				qcom,mode-v-back-porch = <72>;
				qcom,mode-v-active-high;
				qcom,mode-refresh-rate = <30>;
				qcom,mode-clock-in-khz = <297000>;
			};
		};
	};

};
```

## Documentation/devicetree/bindings/drm/msm/mdp.txt
```
Qualcomm Technologies,Inc. Adreno/Snapdragon display controller

Required properties:

Optional properties:
- contiguous-region: reserved memory for HDMI and DSI buffer.
- qcom,sde-plane-id-map: plane id mapping for virtual plane.
- qcom,sde-plane-id: each virtual plane mapping node.
- reg: reg property.
- qcom,display-type: display type this plane is mapped to. It could be
 "primary", "secondary" and "tertiary".
- qcom,display-topology-control: display topology control. It could be
  "force-mixer", "force-tiling"
- qcom,plane-name: plane name array for this virtual plane. It could be
 "rgb0", "rgb1", "rgb2", "rgb3", "vig0", "vig1", "vig2", "vig3", "dma0", "dma1",
 "dma2", "dma3", "cursor0", "cursor1".
- qcom,plane-type: virtual plane type. It could be "primary", "overlay",
 "cursor".

Example:

&mdss_mdp {
	contiguous-region = <&cont_splash_mem &cont_splash_mem_hdmi>;

	qcom,sde-plane-id-map {
		qcom,sde-plane-id@0 {
			reg = <0x0>;
			qcom,display-type = "primary";
			qcom,plane-name = "rgb0", "rgb1";
			qcom,plane-type = "primary";
		};

		qcom,sde-plane-id@1 {
			reg = <0x1>;
			qcom,display-type = "primary";
			qcom,plane-name = "vig0", "vig1";
			qcom,plane-type = "overlay";
		};

		qcom,sde-plane-id@2 {
			reg = <0x2>;
			qcom,display-type = "primary";
			qcom,plane-name = "cursor0", "cursor1";
			qcom,plane-type = "cursor";
		};
	};
};
```

## Documentation/devicetree/bindings/drm/msm/sde-dp-sim.txt
```
QTI Snapdragon Display Engine (SDE) DP-MST sideband message emulation driver

Required properties:
- compatible:		"qcom,dp-mst-sim"

Optional properties:
- qcom,dpcd-max-rate:     A u32 property defines dpcd reg 0x1.
- qcom,dpcd-max-lane:     A u32 property defines dpcd reg 0x2.
- qcom,dpcd-mst:          A u32 property defines dpcd reg 0x21.
- qcom,dpcd-regs:         A <addr,val> array property defines dpcd reg addr
                          and val.
- qcom,voltage-swing:     A u32 property that overwrite dpcd reg 0x103~0x106.
- qcom,pre-emphasis:      A u32 property that overwrite dpcd reg 0x103~0x106.
- qcom,link-training-cnt: A u32 property defines physical link training cnt
                          before switching to simulation mode.
- qcom,skip-edid:         A boolean property defines if edid will read from
                          internal edid buffer.
- qcom,skip-dpcd-read:    A boolean property defines if dpcd will read from
                          internal dpcd buffer.
- qcom,skip-link-training: A boolean property defines if link training will
                          be skipped.
- qcom,skip-dpcd-write:   A boolean property defines if dpcd write will be
                          ignored.
- qcom,skip-hpd:          A boolean property defines if HPD will be ignored
                          and always set high.
- qcom,skip-mst:          A boolean property defines if MST sideband message
                          need to be simulated.

Each child node represents a port at root branch, with properties:
- qcom,edid:               A u8 array property defines EDID raw data. Once
                           defined, below properties will be ignored. For any
                           mode with horizontal width > 4095, only EDID raw
                           data format is supported.
- qcom,mode-h-active:      A u32 property defines the horizontal active size.
- qcom,mode-h-front-porch: A u32 property defines the horizontal front porch.
- qcom,mode-h-pulse-width: A u32 property defines the horizontal pulse.
- qcom,mode-h-back-porch:  A u32 property defines the horizontal back porch.
- qcom,mode-h-active-high: A boolean property if horizontal polarity is high.
- qcom,mode-v-active:      A u32 property defines the vertical active size.
- qcom,mode-v-front-porch: A u32 property defines the vertical front portch.
- qcom,mode-v-pulse-width: A u32 property defines the vertical pulse width.
- qcom,mode-v-back-porch:  A u32 property defines the vertical back porch.
- qcom,mode-v-active-high: A boolean property if vertical polarity is high.
- qcom,mode-refresh-rate:  A u32 property defines vertial refresh rate.
- qcom,mode-clock-in-khz:  A u32 property defines clock in kHz.

Example:

/ {
	...

	sde_dp_mst_sim: qcom,dp-mst-sim {
		compatible = "qcom,dp-mst-sim";

		port@0 {
			qcom,mode-h-active = <1920>;
			qcom,mode-h-front-porch = <88>;
			qcom,mode-h-pulse-width = <44>;
			qcom,mode-h-back-porch = <148>;
			qcom,mode-h-active-high;
			qcom,mode-v-active = <1080>;
			qcom,mode-v-front-porch = <4>;
			qcom,mode-v-pulse-width = <5>;
			qcom,mode-v-back-porch = <36>;
			qcom,mode-v-active-high;
			qcom,mode-refresh-rate = <60>;
			qcom,mode-clock-in-khz = <148500>;
		};

		port@1 {
			qcom,mode-h-active = <1920>;
			qcom,mode-h-front-porch = <88>;
			qcom,mode-h-pulse-width = <44>;
			qcom,mode-h-back-porch = <148>;
			qcom,mode-h-active-high;
			qcom,mode-v-active = <1080>;
			qcom,mode-v-front-porch = <4>;
			qcom,mode-v-pulse-width = <5>;
			qcom,mode-v-back-porch = <36>;
			qcom,mode-v-active-high;
			qcom,mode-refresh-rate = <60>;
			qcom,mode-clock-in-khz = <148500>;
		};
	};
};
```
