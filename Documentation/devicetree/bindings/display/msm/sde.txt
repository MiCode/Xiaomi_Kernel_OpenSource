## Documentation/devicetree/bindings/drm/msm/sde-shd.txt
```
QTI Snapdragon Display Engine (SDE) shared display

Snapdragon Display Engine shared display provids the capability to virtualize
one physical connector to multiple virtual connectors sit at different blend
stages. Each virtual connector can be attached to different CRTCs and commit
independently.

This device must be added to the connectors list of qcom,sde-kms device.

Required properties:
- compatible:		"qcom,shared-display"
- qcom,shared-display-base: node handle of qcom,shared-display-base, see below.
- qcom,blend-stage-range: A pair of u32 property <start size> defines the blend
			stage start and size for the shared display. For example
			<4 5> indicates this shared display's blending stage starts
			from 4 and there are 5 stages in total. Different shared
			display located on the same base display should not overlap
			with their blend stages. The maximum stages should be within
			the range of layer mixer hardware capability.

Optional properties:
- qcom,shared-display-src-mode: source resolution of the shared display, which is also
			the framebuffer size. It contains two properties:
			qcom,mode-h-active: A u32 property defines horizontal resolution.
			qcom,mode-v-active: A u32 property defines vertical resolution.
			If qcom,shared-display-src-mode is not defined, horizontal and
			vertical resolution will be the same as base display, and
			qcom,shared-display-dst-mode will be ignored.
- qcom,shared-display-dst-mode: destination rectangle in the shared display, which also
			includes the padding lines if line padding feature is enabled.
			It contains 4 properties:
			qcom,mode-x-offset: A u32 property of x offset.
			qcom,mode-y-offset: A u32 property of y offset.
			qcom,mode-width: A u32 property of width.
			qcom,mode-height: A u32 property of height, including line padding.
- qcom,shared-display-name:  A string used as a descriptive name of the shared display.
			If qcom,shared-display-name is not defined, a system auto-generated
			name will be used like DSI-X or DP-X.

qcom,shared-display-base properties:

Required properties:
- qcom,shared-display-base-intf: A u32 property defines intf index of the base display.
			If qcom,shared-display-base-intf is defined,
			qcom,shared-display-base-connector will be ignored.
- qcom,shared-display-base-connector: A string property defines connector name of the base
			display. It is another way to identify the base connector when
			qcom,shared-display-base-intf is not defined.

Optional properties:
- qcom,shared-display-base-mst: A u32 property defines the DP MST branch port, needed if
			the base display sits on DP MST display. Only used when
			qcom,shared-display-base-intf is defined.
- qcom,shared-display-base-mode: timing of the physical base display, contains the
			following properties:
			qcom,mode-h-active: A u32 property defines the horizontal active size.
			qcom,mode-h-front-porch: A u32 property defines the horizontal front porch.
			qcom,mode-h-pulse-width: A u32 property defines the horizontal pulse.
			qcom,mode-h-back-porch: A u32 property defines the horizontal back porch.
			qcom,mode-h-active-high: A boolean property defines if horizontal polarity
						is high.
			qcom,mode-v-active: A u32 property defines the vertical active size.
			qcom,mode-v-front-porch: A u32 property defines the vertical front portch.
			qcom,mode-v-pulse-width: A u32 property defines the vertical pulse width.
			qcom,mode-v-back-porch: A u32 property defines the vertical back porch.
			qcom,mode-v-active-high: A boolean property defines if vertical polarity
						is high.
			qcom,mode-refresh-rate: A u32 property defines vertial refresh rate.
			qcom,mode-clock-in-khz: A u32 property defines clock in kHz.
			If qcom,shared-display-base-mode is not defined, auto-detected mode
			from panel will be used as base mode.

Example of static mode using intf to select base connector:

/ {
	...

	sde_sh_base0: qcom,shared-display-base@0 {
		qcom,shared-display-base-intf = <0>;
		qcom,shared-display-base-mode {
			qcom,mode-h-active = <3840>;
			qcom,mode-h-front-porch = <176>;
			qcom,mode-h-pulse-width = <88>;
			qcom,mode-h-back-porch = <296>;
			qcom,mode-h-active-high;
			qcom,mode-v-active = <2160>;
			qcom,mode-v-front-porch = <8>;
			qcom,mode-v-pulse-width = <10>;
			qcom,mode-v-back-porch = <72>;
			qcom,mode-v-active-high;
			qcom,mode-refresh-rate = <30>;
			qcom,mode-clock-in-khz = <297000>;
		};
	};

	sde_sh0: qcom,shared-display@0 {
		compatible = "qcom,shared-display";
		qcom,shared-display-base = <&sde_sh_base0>;
		qcom,blend-stage-range = <0 5>;
		qcom,shared-display-name = "shared-disp-0";
		qcom,shared-display-src-mode {
			qcom,mode-h-active = <1920>;
			qcom,mode-v-active = <2160>;
		};
		qcom,shared-display-dst-mode {
			qcom,mode-x-offset = <0>;
			qcom,mode-y-offset = <0>;
			qcom,mode-width = <1920>;
			qcom,mode-height = <2160>;
		};
	};

	sde_sh1: qcom,shared-display@1 {
		compatible = "qcom,shared-display";
		qcom,shared-display-base = <&sde_sh_base0>;
		qcom,blend-stage-range = <5 5>;
		qcom,shared-display-name = "shared-disp-1";
		qcom,shared-display-src-mode {
			qcom,mode-h-active = <1920>;
			qcom,mode-v-active = <2160>;
		};
		qcom,shared-display-dst-mode {
			qcom,mode-x-offset = <1920>;
			qcom,mode-y-offset = <0>;
			qcom,mode-width = <1920>;
			qcom,mode-height = <2160>;
		};
	};
};

Example of dynamic mode using name to select base connector:

/ {
	...

	sde_sh_base0: qcom,shared-display-base@0 {
		qcom,shared-display-base-connector = "DSI-1";
	};

	sde_sh0: qcom,shared-display@0 {
		compatible = "qcom,shared-display";
		qcom,shared-display-base = <&sde_sh_base0>;
		qcom,blend-stage-range = <0 5>;
		qcom,shared-display-name = "shared-disp-0";
	};

	sde_sh1: qcom,shared-display@1 {
		compatible = "qcom,shared-display";
		qcom,shared-display-base = <&sde_sh_base0>;
		qcom,blend-stage-range = <5 5>;
		qcom,shared-display-name = "shared-disp-1";
	};
};
```

## Documentation/devicetree/bindings/drm/msm/sde-shp.txt
```
QTI Snapdragon Display Engine (SDE) shared plane

This driver allows to create multiple virtual planes from the same
physical plane. Only one plane can be activated at a time.

This device must be added to the connectors list of qcom,sde-kms device.

Required properties:
- compatible:		"qcom,sde-shared-plane"
- qcom,add-planes:	Shared planes to add to the DRM system. Each child
			represents a new plane, which has the properties of:
	qcom,plane-parent: required string, name of parent plane
			where this plane is created from.
	qcom,plane-name: required string, name of the new plane.
	qcom,plane-virt-name: optional string, name of the new multi-rect plane.
	qcom,plane-init-handoff: optional boolean, if set, the plane is inited
			to handoff state at system bootup.
	qcom,plane-init-active: optional boolean, if set, the plane is inited to
			active state at system bootup.
	qcom,plane-detach-handoff: optional boolean, if set, and when the plane
			set handoff to true and crtc to null, the plane will
			immediately become inaccessible and handoff will reset
			to false.


Example:

/ {
	...

	qcom,sde-shared-plane {
		compatible = "qcom,sde-shared-plane";
		qcom,add-planes {
			plane@0 {
				qcom,plane-name = "plane-0-splash";
				qcom,plane-parent = "plane-0";
			};
			plane@1 {
				qcom,plane-name = "plane-1-splash";
				qcom,plane-parent = "plane-1";
			};
		};
	};
};
```

## Documentation/devicetree/bindings/drm/msm/sde-wb.txt
```
QTI Snapdragon Display Engine (SDE) writeback display

sde-wb is the writeback display which supports memory write back
through QTI SDE hardware.

Required properties:
- compatible:		"qcom,wb-display"

Optional properties:
- cell-index:		Index of writeback device instance.
			Default to 0 if not specified.
- label:		String to describe this writeback display.
			Default to "unknown" if not specified.

Example:

/ {
	...

	sde_wb: qcom,wb-display {
		compatible = "qcom,wb-display";
		cell-index = <2>;
		label = "wb_display";
	};

};
```

## Documentation/devicetree/bindings/edac/gic600-edac.txt
```
* GIC EDAC node:

GIC EDAC node is defined to describe on-chip error or fault detection and correction
for GIC RAM. GICT(GIC trace and debug) register map describes the syndrome information
and GICT support is available from GIC-600 onwards.

GIC EDAC reports all Single Bit Error and Double Bit Error found in GIC RAM.
Current GIC ECC implementation is interrupt based. GIC scrub feature helps
to avoid potential errors accumulation of particular error location by a write-back
of all valid RAM entries periodically.

GICT identifies software programming errors, correctable and uncorrectable
errors of Shared Peripheral Interrupt(SPI) RAM, Software Generated Interrupt(SGI) RAM,
Private Peripheral Interrupt(PPI) RAM, Locality-Specific Peripheral Interrupt(LPI) RAM
and Interrupt Translation Service (ITS) RAM.
For every error record following information available -
	ERRXSTATUS - Error Record Status Register
	ERRXMISC0 - Error Record Miscellaneous Register 0
	ERRXMISC1 - Error Record Miscellaneous Register 1
	ERRXADDR  - Error Record Address Resister

The following section describes the DT node binding for gic-erp.

Required properties:
- compatible		: "arm,gic-600-erp".
- reg-names		: GIC Trace, GIC Distributor, GIC Redistributor bases
- interrupt-config	: SPI interrupt numbers of Fault and Error interrupts
			  to configure GICT_ERRORQCR0, GICT_ERRORQCR1 registers respectively.
- interrupts		: Interrupts for Fault and Error IRQs

gict: gict@17a20000 {
	compatible = "arm,gic-600-erp";
	reg = <0x17a20000 0x10000>;	/* GICT */
	reg-names = "gict-base";
	interrupt-config = <46, 17>;
	interrupt-names = "gict-fault", "gict-err";
	interrupts = <GIC_SPI 46 IRQ_TYPE_LEVEL_HIGH>,
		     <GIC_SPI 17 IRQ_TYPE_LEVEL_HIGH>;
};
```

## Documentation/devicetree/bindings/edac/kryo-edac.txt
```
* Kryo EDAC node

Kryo EDAC node is defined to describe on-chip error detection and correction
for the Kryo core.

Kryo will report all SBE and DBE found in L1/L2/L3/SCU caches in two registers:
	ERRXSTATUS - Error Record Primary Status Register
	ERRXMISC0 - Error Record Miscellaneous Register

Current implementation of Kryo ECC mechanism is based on interrupts.

The following section describes the DT node binding for kryo_cpu_erp.

Required properties:
- compatible		: Shall be "arm,arm64-kryo-cpu-erp".
- interrupts		: Interrupt-specifier for L1/L2, L3/SCU error IRQ(s)
- interrupt-names	: Descriptive names of the interrupts

Example:

	kryo-erp {
		compatible = "arm,arm64-kryo-cpu-erp";
		interrupts = <1 6 4>,
			<1 7 4>,
			<0 34 4>,
			<0 35 4>;

		interrupt-names = "l1-l2-faultirq",
				"l1-l2-errirq",
				"l3-scu-errirq",
				"l3-scu-faultirq";
	};
```

## Documentation/devicetree/bindings/edac/kryo-edac.yaml
```yaml
%YAML 1.2
---
$id: http://devicetree.org/schemas/bindings/edac/kryo-edac.yaml#
$schema: http://devicetree.org/meta-schemas/core.yaml#

title: Kryo EDAC(Error Detection and Correction) node binding

maintainers:
  - Murali Nalajala <mnalajal@quicinc.com>

description: |+
  Kryo EDAC node is defined to describe on-chip error detection and correction
  for the Kryo core.

  Kryo will report all SBE and DBE found in L1/L2/L3/SCU caches in two registers:
    ERRXSTATUS - Error Record Primary Status Register
    ERRXMISC0 - Error Record Miscellaneous Register

  Current implementation of Kryo ECC mechanism is based on interrupts.
  The following section describes the DT node binding for kryo_cpu_erp.

properties:
  compatible:
      const: arm,arm64-kryo-cpu-erp
      description:
        Implements cache error detection and correction for Kryo CPUs.

  interrupts:
    description: Interrupt-specifier for L1/L2, L3/SCU error IRQ(s)

  interrupt-names:
    description: Descriptive names of the interrupts

required:
  - compatible
  - interrupts
  - interrupt-names

examples:
  - |
    kryo-erp {
      compatible = "arm,arm64-kryo-cpu-erp";
      interrupts = <GIC_PPI 6 IRQ_TYPE_LEVEL_HIGH>,
        <GIC_PPI 7 IRQ_TYPE_LEVEL_HIGH>,
        <GIC_SPI 34 IRQ_TYPE_LEVEL_HIGH>,
        <GIC_SPI 35 IRQ_TYPE_LEVEL_HIGH>;

      interrupt-names = "l1-l2-faultirq",
          "l1-l2-errirq",
          "l3-scu-errirq",
          "l3-scu-faultirq";
    };
```

## Documentation/devicetree/bindings/edac/kryo3xx-edac.txt
```
* Kryo 3xx EDAC node

Kryo3xx EDAC node is defined to describe on-chip error detection and correction
for the Kryo3xx core.

Kryo3xx will report all SBE and DBE found in L1/L2/L3/SCU caches in two registers:
	ERRXSTATUS - Error Record Primary Status Register
	ERRXMISC0 - Error Record Miscellaneous Register

Current implementation of Kryo 3xx ECC mechanism does not have interrupts setup,
and so requires polling of the registers to check if a error has been reported.

The following section describes the DT node binding for kryo_3xx_cpu_erp.

Required properties:
- compatible		: Shall be "arm,arm64-kryo3xx-cpu-erp".
- interrupts		: Interrupt-specifier for L1/L2, L3/SCU error IRQ(s)
- interrupt-names	: Descriptive names of the interrupts

Example:

	kryo3xx-erp {
		compatible = "arm,arm64-kryo3xx-cpu-erp";
		interrupts = <1 6 4>,
			<1 7 4>,
			<0 34 4>,
			<0 35 4>;

		interrupt-names = "l1-l2-faultirq",
				"l1-l2-errirq",
				"l3-scu-errirq",
				"l3-scu-faultirq";
	};
```

## Documentation/devicetree/bindings/edp/sysedp_batmon_calc.txt
```
System-EDP Battery Monitor

Required properties:
- compatible : "nvidia,tegra124-sysedp_batmon_calc"
- ocv_lut: The property contains several sets of combinations of
  capacity battery remained and battery open-circuit-voltage (in uV).
  Take <60 7641110> for exmaple, it means the battery
  open-circuit-voltage is 7641.11mV when battery remained capacity is
  60%. Entries must be in descending order wrt capacity and last entry
  must be <0 ...>.
- update_interval: The defines the period (in ms) for system to update the
  available power budget.
- ibat_lut: This defines the maximum allowed current (in mA) from the
  battery under specific temperature. The property contains several
  sets of combinations of temperature and current with the format of
  <C mA>. C is the temperature in Celcius, negative values reprented
  with 2's complement. mA is the maximum current battery can supply
  under this temperature. Take <60 6150> for example, this means that
  battery can supply 6150mA when temperature is 60 degree
  Celsius. Entries must be in descending order wrt temperature and
  last entry must be <... 0>.
- rbat_data: An array of battery impedance (in uOhm) under different temperatures
  and capacity.
- temp_axis: An array of different temperatures. Negative values are
  represented with 2's complement
- capacity_axis: An array of capacity battery remains.
- power_supply : The name of system power supply.
- r_const: This value describes the system impedance(in uOhm).
- vsys_min: The minmum voltage (in uV) needed for PMIC.

Example:
	sysedp_batmon_calc {
		compatible = "nvidia,tegra124-sysedp_batmon_calc";
		update_interval = <30000>;
		ocv_lut = <
			100 8372010
			60 7641110
			0 5999850
		>;
		ibat_lut = <
			60 6150
			40 6150
			0 6150
			S32_TO_U32(-30) 0
		>;
		rbat_data = <
			70000
			70000
			90000
		>;
		temp_axis = <25>;
		capacity_axis = <100 13 0>;
		power_supply = "battery";
		r_const = <60000>;
		vsys_min = <2900000>;
	};
```
