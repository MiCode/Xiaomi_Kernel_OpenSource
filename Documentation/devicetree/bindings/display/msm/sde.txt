## Documentation/devicetree/bindings/esoc/esoc_client.txt
```
== Introduction ==

In case of multiple external socs each exposing more than one interface to a
primary SOC, it is possible for the different interface drivers/clients to
expect notifications regarding the state of the external soc that they are
interested in. In some cases clients may need notifications of the status of
multiple external socs. The bindings referred to below enable a client device
to register for notifications from multiple external socs.

== Esoc client devices ==

For each esoc client device, every external soc that it is associated with, is
assigned an integer id. These ids start at 0 and are contiguous. Each id
represents a unique external soc. Each external soc is additionally assigned a
name. An additional property is used to spcify the names. A mapping is
performed from the name to the id.

Required properties:
esoc-0:		A phandle pointing to the esoc node that the esoc client is
		interested in.

esoc-names:	A list of string names for all the esocs that a given client
		is interested in. Must have atleast one name corresponding to
		esoc-0.

Optional properties:
esoc-1:		A phandle to the external soc, mapping to the second name in
		esoc-names.
...
esoc-n:		A phandle to the nth external soc mapping to the nth name in
		the esoc-names

== Example ==

esoc_a {
	compatible = "esoc_mdm";
	....
	...
	..
};

esoc_b {
	compatible = "esoc_wlan";
	..
	..
};

pcie@0x0001 {
	compatible = "esoc-pcie-client"
	....
	..
	..
	esoc-names = "mdm", "wlan";
	esoc-0 = <&esoc_a>;
	esoc-1 = <&esoc_b>;
	..
	..
};
```

## Documentation/devicetree/bindings/extcon/extcon-gpio.txt
```
GPIO Extcon device

This is a virtual device used to generate USB cable states from the USB ID pin
connected to a GPIO pin.

Required properties:
- compatible: Should be "extcon-gpio"
- extcon-id: The unique id of specific external connector.
	     Valid range is 0 (EXTCON_NONE) to 63 (EXTCON_NUM).
	     Refer include/linux/extcon.h for details.
- gpio: Specify GPIO (see gpio binding)
- debounce-ms: Debounce time for GPIO IRQ in ms
- irq-flags: interrupt flags (edge/level). Refer to "include/dt-bindings/interrupt-controller/irq.h"
- pinctrl-names, pinctrl-0, pinctrl-1,.. pinctrl-n: Refer to "Documentation/devicetree/bindings/pinctrl/pinctrl-bindings.txt"
  for these optional properties

Example:
	extcon_storage_cd {
		compatible = "extcon-gpio";
		extcon-id = <62>; /* EXTCON_MECHANICAL */
		gpio = <&tlmm 126 GPIO_ACTIVE_LOW>;
		debounce-ms = <200>;
		irq-flags = <IRQ_TYPE_EDGE_BOTH>;
	}

	&ufshc_card {
		extcon = <&extcon_storage_cd>;
	};

	&sd_card {
		extcon = <&extcon_storage_cd>;
	};
```

## Documentation/devicetree/bindings/extcon/extcon-storage-cd-gpio.txt
```
Storage card detect GPIO based Extcon device

This is a virtual device used to generate GPIO states from the GPIO ID pin
connected to a GPIO pin.

Required properties:
- compatible: Should be "extcon-storage-cd-gpio"
- extcon-id: The unique id of specific external connector.
	     Valid range is 0 (EXTCON_NONE) to 63 (EXTCON_NUM).
	     Refer include/linux/extcon.h for details.
- gpio: Specify GPIO (see gpio binding)
- irq-flags: interrupt flags (edge/level). Refer to "include/dt-bindings/interrupt-controller/irq.h"
- pinctrl-names, pinctrl-0, pinctrl-1,.. pinctrl-n: Refer to "Documentation/devicetree/bindings/pinctrl/pinctrl-bindings.txt"
  for these optional properties

Example:
	extcon_storage_cd {
		compatible = "extcon-storage-cd-gpio";
		extcon-id = <62>; /* EXTCON_MECHANICAL */
		gpio = <&tlmm 126 GPIO_ACTIVE_LOW>;
		irq-flags = <IRQ_TYPE_EDGE_BOTH>;
	}

	&ufshc_card {
		extcon = <&extcon_storage_cd>;
	};

	&sd_card {
		extcon = <&extcon_storage_cd>;
	};
```

## Documentation/devicetree/bindings/fb/adv7533.txt
```
ADV7533 DSI to HDMI bridge


Required properties:
- compatible:				Must be "adv7533"
- reg:					Main I2C slave ID (for I2C host driver)
- adi,video-mode:			Excepted a number and possible inputs are 0 to 3, while:
					3 = 1080p
					2 = 720p
					1 = 480p
					0 = 1080p pattern
- adi,main-addr:			Main I2C slave ID
- adi,cec-dsi-addr:			CEC DSI I2C slave ID

Optional properties:
- adi,enable-audio:
- adi,disable-gpios:
- adi,irq-gpio:				Main IRQ gpio mapping
- adi,hpd-irq-gpio:			HPD IRQ gpio mapping
- adi,switch-gpio:			DSI switch gpio mapping
- qcom,supply-names:			Regulator names that supply 5v to bridge chip
- qcom,min-voltage-level		Minimum voltage level to be supplied to bridge chip
- qcom,max-voltage-level		Maximum voltage level to be supplied to bridge chip
- qcom,enable-load			Load current to bridge chip when enabled
- qcom,disable-load			Load current to bridge chip when disabled

Example:
&soc {
	i2c@78b8000 {
		adv7533@39 {
			compatible = "adv7533";
			reg = <0x39>;
			adi,video-mode = <3>; /* 3 = 1080p */
			adi,main-addr = <0x39>;
			adi,cec-dsi-addr = <0x3C>;
			adi,enable-audio;
			pinctrl-names = "pmx_adv7533_active","pmx_adv7533_suspend";
			pinctrl-0 = <&adv7533_int_active &adv7533_hpd_int_active &adv7533_switch_active>;
			pinctrl-1 = <&adv7533_int_suspend &adv7533_hpd_int_suspend &adv7533_switch_suspend>;
			adi,irq-gpio = <&msm_gpio 31 0x2002>;
			adi,hpd-irq-gpio = <&msm_gpio 20 0x2003>;
			adi,switch-gpio = <&msm_gpio 32 0x0>;
			hpd-5v-en-supply = <&adv_vreg>;
			qcom,supply-names = "hpd-5v-en";
			qcom,min-voltage-level = <0>;
			qcom,max-voltage-level = <0>;
			qcom,enable-load = <0>;
			qcom,disable-load = <0>;
		};
	};
};
```
