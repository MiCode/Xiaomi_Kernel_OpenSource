## Documentation/devicetree/bindings/regulator/qpnp-regulator.txt
```
Qualcomm QPNP Regulators

qpnp-regulator is a regulator driver which supports regulators inside of PMICs
that utilize the MSM SPMI implementation.

Required properties:
- compatible:      Must be "qcom,qpnp-regulator"
- reg:             Specifies the SPMI address and size for this regulator device
		   Note, this is the only property which can be used within a
		   subnode of a node which has specified spmi-dev-container.
- regulator-name:  A string used as a descriptive name for regulator outputs
- parent-supply:   phandle to the parent supply/regulator node

Required structure:
- A qcom,qpnp-regulator node must be a child of an SPMI node that has specified
	the spmi-slave-container property

Optional properties:
- interrupts:                  List of interrupts used by the regulator.
- interrupt-names:             List of strings defining the names of the
				interrupts in the 'interrupts' property 1-to-1.
				Supported values are "ocp" for voltage switch
				type regulators.  If an OCP interrupt is
				specified, then the voltage switch will be
				toggled off and back on when OCP triggers in
				order to handle high in-rush current.
- qcom,system-load:            Load in uA present on regulator that is not
				captured by any consumer request
- qcom,enable-time:            Time in us to delay after enabling the regulator
- qcom,auto-mode-enable:       1 = Enable automatic hardware selection of
				regulator mode (HPM vs LPM); not available on
				boost type regulators
			       0 = Disable auto mode selection
- qcom,bypass-mode-enable:     1 = Enable bypass mode for an LDO type regulator
				so that it acts like a switch and simply outputs
				its input voltage
			       0 = Do not enable bypass mode
- qcom,ocp-enable:             1 = Allow over current protection (OCP) to be
				enabled for voltage switch type regulators so
				that they latch off automatically when over
				current is detected.  OCP is enabled when in
				HPM or auto mode.
			       0 = Disable OCP
- qcom,ocp-max-retries:        Maximum number of times to try toggling a voltage
				switch off and back on as a result of
				consecutive over current events.
- qcom,ocp-retry-delay:        Time to delay in milliseconds between each
				voltage switch toggle after an over current
				event takes place.
- qcom,pull-down-enable:       1 = Enable output pull down resistor when the
				regulator is disabled
			       0 = Disable pull down resistor
- qcom,soft-start-enable:      1 = Enable soft start for LDO and voltage switch
				type regulators so that output voltage slowly
				ramps up when the regulator is enabled
			       0 = Disable soft start
- qcom,boost-current-limit:    This property sets the current limit of boost
				type regulators; supported values are:
					0 =  300 mA
					1 =  600 mA
					2 =  900 mA
					3 = 1200 mA
					4 = 1500 mA
					5 = 1800 mA
					6 = 2100 mA
					7 = 2400 mA
- qcom,pin-ctrl-enable:        Bit mask specifying which hardware pins should be
				used to enable the regulator, if any; supported
				bits are:
					0 = ignore all hardware enable signals
					BIT(0) = follow HW0_EN signal
					BIT(1) = follow HW1_EN signal
					BIT(2) = follow HW2_EN signal
					BIT(3) = follow HW3_EN signal
- qcom,pin-ctrl-hpm:           Bit mask specifying which hardware pins should be
				used to force the regulator into high power
				mode, if any; supported bits are:
					0 = ignore all hardware enable signals
					BIT(0) = follow HW0_EN signal
					BIT(1) = follow HW1_EN signal
					BIT(2) = follow HW2_EN signal
					BIT(3) = follow HW3_EN signal
					BIT(4) = follow PMIC awake state
- qcom,vs-soft-start-strength: This property sets the soft start strength for
				voltage switch type regulators; supported values
				are:
					0 = 0.05 uA
					1 = 0.25 uA
					2 = 0.55 uA
					3 = 0.75 uA
- qcom,hpm-enable:             1 = Enable high power mode (HPM), also referred
				to as NPM.  HPM consumes more ground current
				than LPM, but it can source significantly higher
				load current.  HPM is not available on boost
				type regulators.  For voltage switch type
				regulators, HPM implies that over current
				protection and soft start are active all the
				time.  This configuration can be overwritten
				by changing the regulator's mode dynamically.
			       0 = Do not enable HPM
- qcom,force-type: 	       Override the type and subtype register values. Useful for some
				regulators that have invalid types advertised by the hardware.
				The format is two unsigned integers of the form <type subtype>.
- spmi-dev-container:	       Specifies that all the device nodes specified
				within this node should have their resources coalesced into a
				single spmi_device.  This is used to specify all SPMI peripherals
				that logically make up a single regulator device.

Note, if a given optional qcom,* binding is not present, then the qpnp-regulator
driver will leave that feature in the default hardware state.

All properties specified within the core regulator framework can also be used.
These bindings can be found in regulator.txt.

Example:
	qcom,spmi@fc4c0000 {
		#address-cells = <1>;
		#size-cells = <0>;
		interrupt-controller;
		#interrupt-cells = <3>;

		qcom,pm8941@1 {
			spmi-slave-container;
			reg = <0x1>;
			#address-cells = <1>;
			#size-cells = <1>;

			regulator@1400 {
				regulator-name = "8941_s1";
				spmi-dev-container;
				#address-cells = <1>;
				#size-cells = <1>;
				compatible = "qcom,qpnp-regulator";
				reg = <0x1400 0x300>;
				regulator-min-microvolt = <1300000>;
				regulator-max-microvolt = <1400000>;

				qcom,ctl@1400 {
					reg = <0x1400 0x100>;
				};
				qcom,ps@1500 {
					reg = <0x1500 0x100>;
				};
				qcom,freq@1600 {
					reg = <0x1600 0x100>;
				};
			};

			regulator@4000 {
				regulator-name = "8941_l1";
				reg = <0x4000 0x100>;
				compatible = "qcom,qpnp-regulator";
				regulator-min-microvolt = <1225000>;
				regulator-max-microvolt = <1300000>;
				qcom,pull-down-enable = <1>;
			};
		};
	};
```

## Documentation/devicetree/bindings/regulator/regulator.txt
```
Voltage/Current Regulators

Optional properties:
- regulator-name: A string used as a descriptive name for regulator outputs
- regulator-min-microvolt: smallest voltage consumers may set
- regulator-max-microvolt: largest voltage consumers may set
- regulator-microvolt-offset: Offset applied to voltages to compensate for voltage drops
- regulator-min-microamp: smallest current consumers may set
- regulator-max-microamp: largest current consumers may set
- regulator-always-on: boolean, regulator should never be disabled
- regulator-boot-on: bootloader/firmware enabled regulator
- <name>-supply: phandle to the parent supply/regulator node
- regulator-ramp-delay: ramp delay for regulator(in uV/uS)
- regulator-init-microvolt: Initial microvolt need to be set during registration
- regulator-enable-ramp-delay: The time taken, in microseconds, for the supply
  rail to reach the target voltage, plus/minus whatever tolerance the board
  design requires. This property describes the total system ramp time
  required due to the combination of internal ramping of the regulator itself,
  and board design issues such as trace capacitance and load on the supply.

Deprecated properties:
- regulator-compatible: If a regulator chip contains multiple
  regulators, and if the chip's binding contains a child node that
  describes each regulator, then this property indicates which regulator
  this child node is intended to configure. If this property is missing,
  the node's name will be used instead.

Consumer name support from DT:
To support the consumer list of the rails from DT to map the power tree
so that driver who uses the regualtor can still be non-dt, adding following
properties.
The consumer list will be provided under subnode of each regualtor called
"consumer". The consumer list has the supply name and device name. This can
be set with properties:
regulator-consumer-supply: Consumer supply name.
regulator-consumer-device: Consumer device name.
The properties will be passed as
	consumers {
		c1 {
			regulator-consumer-supply = "vana";
			regulator-consumer-device = "2-0010";
		};

		c2 {
			regulator-consumer-supply = "vana";
			regulator-consumer-device = "2-0036";
		};

Example:

	xyzreg: regulator@0 {
		regulator-min-microvolt = <1000000>;
		regulator-max-microvolt = <2500000>;
		regulator-always-on;
		vin-supply = <&vin>;
	};

Regulator Consumers:
Consumer nodes can reference one or more of its supplies/
regulators using the below bindings.

- <name>-supply: phandle to the regulator node

These are the same bindings that a regulator in the above
example used to reference its own supply, in which case
its just seen as a special case of a regulator being a
consumer itself.

Example of a consumer device node (mmc) referencing two
regulators (twl_reg1 and twl_reg2),

	twl_reg1: regulator@0 {
		...
		...
		...
	};

	twl_reg2: regulator@1 {
		...
		...
		...
	};

	mmc: mmc@0x0 {
		...
		...
		vmmc-supply = <&twl_reg1>;
		vmmcaux-supply = <&twl_reg2>;
	};


Example: Consumer list from DT
	ldo3 {
		regulator-name = "vdd_rtc";
		regulator-min-microvolt = <800000>;
		regulator-max-microvolt = <800000>;
		regulator-always-on;
		ams,enable-tracking;
		consumers {
			c1 {
				regulator-consumer-supply = "vdd_rtc";
			};
		};
	};

	ldo4 {
		regulator-name = "avdd_cam";
		regulator-min-microvolt = <2700000>;
		regulator-max-microvolt = <2700000>;
		regulator-always-on;
		consumers {
			c1 {
				regulator-consumer-supply = "vana";
				regulator-consumer-device = "2-0010";
			};
			c2 {
				regulator-consumer-supply = "vana";
				regulator-consumer-device = "2-0036";
			};
		};
	};
```

## Documentation/devicetree/bindings/regulator/richtek.rt5133.yaml
```yaml
# SPDX-License-Identifier: GPL-2.0
%YAML 1.2
---
$id: http://devicetree.org/schemas/regulator/mediatek,rt5133.yaml#
$schema: http://devicetree.org/meta-schemas/core.yaml#

title: Richtek RT5133 voltage regulator

maintainers:
  - Jeff Chang <jeff_chang@richtek.com>
  - Tina Yang <tina_yang@richtek.com>

description: |
  Richtek RT5133 is a integrated IC that includes 8 LDOs and 3 output only
  GPIO. There's a limit for GPIO output. It tied to LDO1 output. For example,
  if LDO1 is 1.8V, the GPIO output high level will be 1.8V.

properties:
  compatible:
    const: mediatek,rt5133

  reg:
    maxItems: 1

  wakeup-source: true

  interrupts:
    maxItems: 1

  enable-gpio:
    maxItems: 1
    description: A connection of the 'enable' gpio line.

  gpio-controller: true

  gpio-supply: true

  "#gpio-cells":
    const: 2

  regulators:
    type: object

    patternProperties:
      "BASE":
        type: object
        $ref: "regulator.yaml#"

        properties:
          oc_shutdown_all:
            description: |
              If any LDO OC event occurred, to disable all LDOs or not.
            $ref: "/schemas/types.yaml#/definitions/uint32"
            minimum: 0
            maximum: 1
            default: 0

          pgb_shutdown_all:
            description: |
              If any LDO PGB event occurred, to disable all LDOs or not.
            $ref: "/schemas/types.yaml#/definitions/uint32"
            minimum: 0
            maximum: 1
            default: 0

        unevaluatedProperties: false

      "^LDO[1-8]$":
        type: object
        $ref: "regulator.yaml#"

        properties:
          oc_ptsel:
            description: Specify OC protect behavior.
            $ref: "/schemas/types.yaml#/definitions/uint32"
            minimum: 0
            maximum: 1
            default: 1

          pgb_ptsel:
            description: Specify PGB protect behavior.
            $ref: "/schemas/types.yaml#/definitions/uint32"
            minimum: 0
            maximum: 1
            default: 1

          soft_start_time_sel:
            description: Specify soft start time selection.
            $ref: "/schemas/types.yaml#/definitions/uint32"
            minimum: 0
            maximum: 3
            default: 1

        unevaluatedProperties: false

    additionalProperties: false

additionalProperties: false

examples:
  - |
    #include <dt-bindings/interrupt-controller/irq.h>
    i2c {
      #address-cells = <1>;
      #size-cells = <0>;

      rt5133@18 {
        compatible = "mediatek,rt5133-regulator";
        reg = <0x18>;
        wakeup-source;
        interrupts-extend = <&gpio26 2 IRQ_TYPE_LEVEL_LOW>;
        enable-gpio = <&gpio26 3 0>;
        gpio-supply = <&ldo1>;
        gpio-controller;
        #gpio-cells = <2>;

        regulators {
          BASE {
            regulator-name = "rt5133,base";
            oc_shutdown_all = <0>;
            pgb_shutdown_all = <0>;
          };
          ldo1: LDO1 {
            regulator-name = "rt5133,ldo1";
            regulator-min-microvolt = <1800000>;
            regulator-max-microvolt = <3200000>;
            oc_ptsel = <1>;
            pgb_ptsel = <1>;
            soft_start_time_sel = <1>;
          };
          LDO2 {
            regulator-name = "rt5133,ldo2";
            regulator-min-microvolt = <1800000>;
            regulator-max-microvolt = <3200000>;
            oc_ptsel = <1>;
            pgb_ptsel = <1>;
            soft_start_time_sel = <1>;
          };
          LDO3 {
            regulator-name = "rt5133,ldo3";
            regulator-min-microvolt = <1700000>;
            regulator-max-microvolt = <3000000>;
            oc_ptsel = <1>;
            pgb_ptsel = <1>;
            soft_start_time_sel = <1>;
          };
          LDO4 {
            regulator-name = "rt5133,ldo4";
            regulator-min-microvolt = <1700000>;
            regulator-max-microvolt = <3000000>;
            oc_ptsel = <1>;
            pgb_ptsel = <1>;
            soft_start_time_sel = <1>;
          };
          LDO5 {
            regulator-name = "rt5133,ldo5";
            regulator-min-microvolt = <1700000>;
            regulator-max-microvolt = <3000000>;
            oc_ptsel = <1>;
            pgb_ptsel = <1>;
            soft_start_time_sel = <1>;
          };
          LDO6 {
            regulator-name = "rt5133,ldo6";
            regulator-min-microvolt = <1700000>;
            regulator-max-microvolt = <3000000>;
            oc_ptsel = <1>;
            pgb_ptsel = <1>;
            soft_start_time_sel = <1>;
          };
          LDO7 {
            regulator-name = "rt5133,ldo7";
            regulator-min-microvolt = <900000>;
            regulator-max-microvolt = <1800000>;
            oc_ptsel = <1>;
            pgb_ptsel = <1>;
            soft_start_time_sel = <1>;
          };
          LDO8 {
            regulator-name = "rt5133,ldo8";
            regulator-min-microvolt = <900000>;
            regulator-max-microvolt = <1800000>;
            oc_ptsel = <1>;
            pgb_ptsel = <1>;
            soft_start_time_sel = <1>;
          };
        };
      };
    };
...
```
