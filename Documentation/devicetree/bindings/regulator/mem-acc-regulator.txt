## Documentation/devicetree/bindings/regulator/tps65132-regulator.txt
```
TPS65132 Voltage Regulators

Required properties:
  - compatible:		Must be "ti,tps65132"
  - reg:		I2C slave address

Required nodes:
  - regulators: 	A node that contains child nodes for each regulator in the
			device. Each sub-node is identified using the node's name.
			Supported regulator sub-node names: pos-boost and neg-boost

Optional properties:
  - vin-supply:		The phandle of the parent regulator that supplies the power to
			the chip
  - i2c-pwr-supply:	The power supply for i2c bus pull-up resistors
  - pinctrl-names:	The state name of the pin configuration. Only
			support: "default"
  - pinctrl-0:		The phandles of the pin configuration node in
			pinctrl for EN-pins.
			For details of pinctrl properties, please refer to:
			"Documentation/devicetree/bindings/pinctrl/pinctrl-bindings.txt"
  - ti,en-gpio-lpm:	A boolean flag to indicate if the enable pin is configured
			to low power mode (LPM) when the output is disabled.

Regulator child node required properties:
  - regulator-name:	A string used as a descriptive name for the regulator
  - regulator-min-microvolt:
  - regulator-max-microvolt:
			The smallest and largest voltage that regulator can
			support.
			The supported values for regulator-min-microvolts and
			regulator-max-microvolt are 4000000 to 6000000 uV in
			100000 uV steps.
  - ti,en-gpio:		The gpio pin used for enabling the regulator output

Regulator child node optional properties:
  - ti,discharge-enable:A boolean flag to indicated if the regulator will
			be actively discharged to ground when it is disabled
  - ti,current-limit: 	Regulator output current limit in microamps
			 Supported values:
			    for pos-boost: 200000 only
			    for neg-boost: 40000 or 80000
			 If this property is not specified, then the current
			 limit for positive boost regulator is 200000uA and
			 for negative boost regulator is 40000uA.
  - ti,enable-time:	Time in us to delay after enabling the regulator. If
			this property is not present, a default value 800
			microseconds delay will be applied.
  - regulator-always-on:
  - regulator-boot-on:
			These properties are defined in core regulator framework. These
			bindings can be found in regulator.txt.

Example:

tps65132@3e {
	compatible = "ti,tps65132";
	reg = <0x3e>;
	i2c-pwr-supply = <&pm8916_l6>;

	regulators {
		tps65132_pos: pos-boost {
			regulator-name  = "tps65132_pos";
			regulator-min-microvolt = <5400000>;
			regulator-max-microvolt = <5400000>;
			ti,discharge-enable;
			ti,enable-time = <800>;
			ti,current-limit = <200000>;
			ti,en-gpio = <&msm_gpio 97 0>;
		};

		tps65132_neg: neg-boost {
			regulator-name = "tps65132_neg";
			regulator-min-microvolt = <5400000>;
			regulator-max-microvolt = <5400000>;
			ti,discharge-enable;
			ti,enable-time = <800>;
			ti,current-limit = <40000>;
			ti,en-gpio = <&msm_gpio 32 0>;
		};
	};
};
```

## Documentation/devicetree/bindings/rtc/qpnp-rtc.txt
```
* msm-qpnp-rtc

msm-qpnp-rtc is a RTC driver that supports 32 bit RTC housed inside PMIC.
Driver utilizes MSM SPMI interface to communicate with the RTC module.
RTC device is divided into two sub-peripherals one which controls basic RTC
and other for controlling alarm.

[PMIC RTC Device Declarations]

-Root Node-

Required properties :
 - compatible:		Must be "qcom,qpnp-rtc"
 - #address-cells:	The number of cells dedicated to represent an address
			This must be set to '1'.
 - #size-cells:		The number of cells dedicated to represent address
			space range of a peripheral. This must be set to '1'.

Optional properties:
 - qcom,qpnp-rtc-write:		This property enables/disables rtc write
				operation. If not mentioned rtc driver keeps
				rtc writes disabled.
				0 = Disable rtc writes.
				1 = Enable rtc writes.
 - qcom,qpnp-rtc-alarm-pwrup:	This property enables/disables feature of
				powering up phone (from power down state)
				through alarm interrupt.
				If not mentioned rtc driver will disable
				feature of powring-up phone through alarm.
				0 = Disable powering up of phone through
				alarm interrupt.
				1 = Enable powering up of phone through
				alarm interrupt.

-Child Nodes-

Required properties :
 - reg :		Specify the spmi offset and size for device.
 - interrupts:		Specifies alarm interrupt, only for rtc_alarm
			sub-peripheral.

Example:
	qcom,pm8941_rtc {
		compatible = "qcom,qpnp-rtc";
		#address-cells = <1>;
		#size-cells = <1>;
		qcom,qpnp-rtc-write = <0>;
		qcom,qpnp-rtc-alarm-pwrup = <0>;

		qcom,pm8941_rtc_rw@6000 {
			reg = <0x6000 0x100>;
		};

		qcom,pm8941_rtc_alarm@6100 {
			reg = <0x6100 0x100>;
			interrupts = <0x0 0x61 0x1>;
		};
	};
```

## Documentation/devicetree/bindings/scheduler/energy.txt
```
* Scheduler Energy Driver

Scheduler Energy Driver updates capacities in the scheduler group energy array.
The array contains power cost at each CPU operating points so energy aware
scheduler (EAS) can utilize it for task placement.

Required properties:
- compatible:		Must be "sched-energy"

Example:
	energy-costs {
		compatible = "sched-energy";
	}
```

## Documentation/devicetree/bindings/scheduler/sched_hmp.txt
```
* HMP scheduler

This file describes the bindings for an optional HMP scheduler
node (/sched-hmp).

Required properties:

Optional properties:

- boost-policy: The HMP scheduler has two types of task placement boost
policies.

(1) boost-on-big policy make use of all big CPUs up to their full capacity
before using the little CPUs. This improves performance on true b.L systems
where the big CPUs have higher efficiency compared to the little CPUs.

(2) boost-on-all policy place the tasks on the CPU having the highest
spare capacity. This policy is optimal for SMP like systems.

The scheduler sets the boost policy to boost-on-big on systems which has
CPUs of different efficiencies. However it is possible that CPUs of the
same micro architecture to have slight difference in efficiency due to
other factors like cache size. Selecting the boost-on-big policy based
on relative difference in efficiency is not optimal on such systems.
The boost-policy device tree property is introduced to specify the
required boost type and it overrides the default selection of boost
type in the scheduler.

The possible values for this property are "boost-on-big" and "boost-on-all".

Example:

sched-hmp {
	boost-policy = "boost-on-all"
}
```

## Documentation/devicetree/bindings/serial/nvidia,tegra20-hsuart.txt
```
NVIDIA Tegra20/Tegra30 high speed (DMA based) UART controller driver.

Required properties:
- compatible : Must be one of following:
	"nvidia,tegra114-hsuart",
	"nvidia,tegra30-hsuart",
	"nvidia,tegra20-hsuart".
	"nvidia,tegra114-hs-serial"
	"nvidia,tegra20-hs-serial"
	"nvidia,tegra30-hs-serial"
	There is no differece in nvidia,tegra114-hsuart and
        nvidia,tegra114-hs-serial. Two separate names are provided for
	ease of usage only.
- reg: Should contain UART controller registers location and length.
- interrupts: Should contain UART controller interrupts.
- nvidia,dma-request-selector : The Tegra DMA controller's phandle and
  request selector for this UART controller.

Optional properties:
- nvidia,enable-modem-interrupt: Enable modem interrupts. Should be enable
		only if all 8 lines of UART controller are pinmuxed.

Example:

serial@70006000 {
	compatible = "nvidia,tegra30-hsuart", "nvidia,tegra20-hsuart";
	reg = <0x70006000 0x40>;
	reg-shift = <2>;
	interrupts = <0 36 0x04>;
	nvidia,dma-request-selector = <&apbdma 8>;
	nvidia,enable-modem-interrupt;
	status = "disabled";
};
```

## Documentation/devicetree/bindings/shared_memory/msm_shared_memory.txt
```
MSM Shared memory driver

msm-shared-memory driver is responsible for calling into the secure environemnt
to allow clients to use the HLOS memory that is assigned to them, which is
locked by the secure world.

Required Properties for shared memory:
- compatible:		   Must be "qcom,msm-shared-memory"
- qcom,proc-id :	   The id of the processor that needs access to the
			   HLOS memory
- linux,contiguous-region: phandle reference to a CMA region.

Example:
	adsp_heap {
		compatible = "qcom,msm-shared-memory";
		qcom,proc-id = <1>;
		linux,contiguous-region = <&adsp_mem>;
	};
```
