## Documentation/devicetree/bindings/regulator/qcom,pm8008-regulator.txt
```
Qualcomm Technologies, Inc. PM8008 Regulator

PM8008 is an I2C based PMIC regulator chip.

=======================
Required Node Structure
=======================

==============================================
PM8008 chip specific device
==============================================
PM8008 chip specific properties:

- compatible:
  Usage: required
  Value type: <string>
  Definition: must be "qcom,pm8008-chip"

- pinctrl-names:
  Usage: required
  Value type: <string>
  Definition: must be "default"

- pinctrl-0:
  Usage: required
  Value type: <phandle>
  Definition: pinctrol handle for chip enable GPIO.

- regulator sub-node:
  Usage: required
  Value type: <child sub node>
  Definition: Chip enable regulator device to control chip enable
		functionality. Must be "qcom,pm8008-chip-en".
Example:
	qcom,pm8008-chip@900 {
		compatible = "qcom,pm8008-chip";
		pinctrl-names = "default";
		pinctrl-0 = <&pincontrol handle>; // chip enable GPIO

		PM8008_EN: qcom,pm8008-chip-en {
			regulator-name = "pm8008-chip-en";
		};
	};


========================================================
PM8008 regulator device
========================================================
PM8008 chip regulator specific properties:

- compatible:
  Usage: required
  Value type: <string>
  Definition: must be "qcom,pm8008-regulator"

- <pin>-supply:
  Usage: optional
  Value type: <phandle>
  Definition: Reference to parent regulator supplying the input pin, as
		described in the data sheet.
		Must be one of the following:
		vdd_l1_l2-supply: supply for LDO1/LDO2 of PM8008
		vdd_l3_l4-supply: supply for LDO3/LDO4 of PM8008
		vdd_l5-supply: supply for LDO5 of PM8008
		vdd_l6-supply: supply for LDO6 of PM8008
		vdd_l7-supply: supply for LDO7 of PM8008

- pm8008_en-supply:
  Usage: required
  Value type: <phandle>
  Definition: Reference to PM8008 chip enable regulator, which manages
		chip enable functionlity of PM8008.

============================================================================
Second Level Nodes - PM8008 regulator peripherals of PM8008 regulator device
============================================================================

- qcom,hpm-min-load:
  Usage: optional
  Value type: <u32>
  Definition: Load current in uA which corresponds to the minimum load
		which requires the regulator to be in high power mode.

- qcom,min-dropout-voltage:
  Usage: optional
  Value type: <u32>
  Definition: Specifies the minimum voltage in microvolts that the parent
		supply regulator must output above the output of this
		regulator.  It is only meaningful if the corresponding parent
		supply property has been specified in the first level node.

- qcom,init-voltage
  Usage:      optional
  Value type: <u32>
  Definition: Specifies the initial voltage in microvolts to for a regulator.

- qcom,strong-pd
  Usage:      optional
  Value type: <bool>
  Definition: Property if present enables strong pull-down.

The content of each sub-node is defined by the standard binding for regulators -
see regulator.txt - with additional custom properties described below:

Example:

	qcom,pm8008-regulator {
		compatible = "qcom,pm8008-regulator";

		pm8008_en-supply = <&PM8008_EN>;
		vdd_l1_l2-supply = <&parent-supply>;
		...

		L1: qcom,pm8008-l1@4000 {
			reg = /bits/ 16 <0x4000>;
			regulator-name = "pm8008_l1";
			regulator-min-microvolt = <2900000>;
			regulator-max-microvolt = <3100000>;
			qcom,min-dropout-voltage = <100000>;
			qcom,hpm-min-load = <10000>;
		}

		.....
	};
```

## Documentation/devicetree/bindings/regulator/qcom,refgen.txt
```
Qualcomm Technologies, Inc. REFGEN Regulator

Some Qualcomm Technologies, Inc. SoCs utilize reference bias generators for
various internal PHY blocks.  These are called REFGENs.

Supported properties:
- compatible
	Usage:      required
	Value type: <string>
	Definition: Must be "qcom,refgen-regulator".

- reg
	Usage:      required
	Value type: <prop-encoded-array>
	Definition: Address and size of the REFGEN registers.

- regulator-name
	Usage:      required
	Value type: <string>
	Definition: Specifies the name for this REFGEN regulator.

- regulator-enable-ramp-delay
	Usage:      optional
	Value type: <u32>
	Definition: REFGEN enable time in microseconds.

- parent-supply
	Usage:      optional
	Value type: <phandle>
	Definition: phandle to the parent supply/regulator node if one exists.

Example:

refgen-regulator@ff1000 {
	compatible = "qcom,refgen-regulator";
	reg = <0xff1000 0x60>;
	regulator-name = "refgen";
};
```

## Documentation/devicetree/bindings/regulator/qpnp-amoled-regulator.txt
```
QPNP AMOLED Triple power supply regulator devices

QPNP OLEDB module provides AVDD voltage rail output for bias and QPNP AB/IBB
module provides ELVDD/ELVSS voltage rail output to power up AMOLED panels.

For PM8150A, allowed voltage levels are as below:
AVDD - Programmable output from 4.925 V to 8.1 V.
ELVDD  - Programmable output from 4.6 V to 6.1 V.
ELVSS  - Programmable output from -0.8 V to -5.4 V.


This document describes the bindings for AMOLED regulator devices.

=======================
Required Node Structure
=======================

AMOLED regulator device must be described in two level of device nodes.

- compatible:
	Usage:      required
	Value type: <string>
	Definition: should be "qcom,qpnp-amoled-regulator"

==========================================
Second Level Nodes - OLEDB/AB/IBB specific
==========================================

Subnode common properties for OLEDB and AB/IBB regulator devices.

- reg:
	Usage:      required
	Value type: <prop-encoded-array>
	Definition: Register base and length for OLEDB, AB and IBB modules
		    which are represented as child nodes.

- reg-names:
	Usage:      required
	Value type: <string>
	Definition: The name of the register defined in the reg property.

- regulator-name:
	Usage:      required
	Value type: <string>
	Definition: A string used to describe the regulator.

- regulator-min-microvolt:
	Usage:      required
	Value type: <u32>
	Definition: Minimum voltage (in uV) supported by the regulator.

- regulator-max-microvolt:
	Usage:      required
	Value type: <u32>
	Definition: Maximum voltage (in uV) supported by the regulator.

- qcom,swire-control:
	Usage:	    optional
	Value type: <empty>
	Definition: A boolean property to specify that the regulator output is
		    controlled by SWIRE signal. When this is specified, output
		    voltage of the regulator is not controlled by SW.

Example:

pm8150a_amoled: oledb@e000 {
	compatible = "qcom,qpnp-amoled-regulator";

	oledb_vreg: oledb@e000 {
		reg = <0xe000 0x100>;
		reg-names = "oledb_base";
		regulator-name = "oledb_vreg";
		regulator-min-microvolt = <4925000>;
		regulator-max-microvolt = <8100000>;
		qcom,swire-control;
	};

	ab_vreg: ab@de00 {
		reg = <0xde00 0x100>;
		reg-names = "ab_base";
		regulator-name = "ab_vreg";
		regulator-min-microvolt = <4600000>;
		regulator-max-microvolt = <6100000>;
		qcom,swire-control;
	};

	ibb_vreg: ibb@dc00 {
		reg = <0xdc00 0x100>;
		reg-names = "ibb_base";
		regulator-name = "ibb_vreg";
		regulator-min-microvolt = <800000>;
		regulator-max-microvolt = <5400000>;
		qcom,swire-control;
	};
};
```
