## Documentation/devicetree/bindings/regulator/msm_gfx_ldo.txt
```
Qualcomm Technologies, Inc. GFX LDO for Graphics

The GPU core on MSM TITANIUM can be powered by an internal (on-die)
MSM LDO or BHS based on its operating corner.

This document describes the bindings that apply for the GFX LDO regulator.

- compatible
	Usage:      required
	Value type: <string>
	Definition: should be "qcom,msmtitanium-gfx-ldo" for MSMTITANIUM.

- reg
	Usage:      required
	Value type: <prop-encoded-array>
	Definition: Addresses and sizes for the memory of the GFX ldo

- reg-names
	Usage:      required
	Value type: <stringlist>
	Definition: Address names. "ldo_addr", "efuse_addr". Must be
		    specified in the same order as the corresponding addresses
		    are specified in the reg property.

- regulator-name
	Usage:      required
	Value type: <string>
	Definition: A string used to describe the regulator.

- regulator-min-microvolt
	Usage:      required
	Value type: <u32>
	Definition: Minimum corner value which should be 1 to represent the
		    lowest supported corner.

- regulator-max-microvolt
	Usage:      required
	Value type: <u32>
	Definition: Maximum corner value which should be equal to qcom,num-corners.

- qcom,num-corners
	Usage:      required
	Value type: <u32>
	Definition: Number of voltage corners present. Many other
		    properties are sized based upon this value.

- qcom,num-ldo-corners
	Usage:      required
	Value type: <u32>
	Definition: Number of voltage corners defined for the ldo. It is a
		    subset of qcom,num-corners (i.e. 1 to qcom,num-ldo-corners
		    are the corners for ldo operation)

- qcom,init-corner
	Usage:      required
	Value type: <u32>
	Definition: The initial-corner at which the GFX rail is powered on.

- qcom,ldo-enable-corner-map
	Usage:      required
	Value type: <prop-encoded-array>
	Definition: Integer values ( / 0) which indicate the GFX corners in which
		    ldo is to enabled. The length of this property
		    should be equal to qcom,num-corners.

- qcom,ldo-voltage-ceiling
	Usage:      required
	Value type: <prop-encoded-array>
	Definition: Array of ceiling voltages in microvolts for voltage corners
		    ordered from lowest voltage corner to highest voltage corner.
		    This property must be of length defined by qcom,num-ldo-corners.

- qcom,ldo-voltage-floor
	Usage:      required
	Value type: <prop-encoded-array>
	Definition: Array of floor voltages in microvolts for voltage corners
		    ordered from lowest voltage corner to highest voltage corner.
		    This property must be of length defined by qcom,num-ldo-corners.

- vdd-cx-supply
	Usage:      optional
	Value type: <phandle>
	Definition: Parent regulator supply to the ldo.

- qcom,vdd-cx-corner-map
	Usage:      required if vdd-cx-supply is specified.
	Value type: <prop-encoded-array>
	Definition: Array of integers which define the mapping of the VDD_CX corner
		    to the corresponding GFX voltage corner. The elements in
		    the array are ordered from lowest voltage corner to highest
		    voltage corner.  The length of this property must be equal to
		    the value defined by qcom,num-corners.
- mem-acc-supply
	Usage:      optional
	Value type: <phandle>
	Definition: Regulator to vote for the memory accelerator configuration.
		    Not Present: memory accelerator configuration not supported.

- qcom,mem-acc-corner-map:
	Usage:      optional
	Value type: <prop-encoded-aray>
	Definition: Array of integer which defines the mapping from mem-acc
		    corner value for each gfx corner. The elements in the array
		    are ordered from lowest voltage corner to highest voltage corner.

=======
Example
=======

	gfx_vreg_corner: ldo@0185f000 {
		compatible = "qcom,msmtitanium-gfx-ldo";
		reg = <0x0185f000 0x30>, <0xa0000 0x1000>;
		reg-names = "ldo_addr", "efuse_addr";

		regulator-name = "msm_gfx_ldo";
		regulator-min-microvolt = <1>;
		regulator-max-microvolt = <7>;

		qcom,ldo-voltage-ceiling = <500000 700000 900000>;
		qcom,ldo-voltage-floor = <400000 600000 800000>;

		qcom,num-corners = <7>;
		qcom,num-ldo-corners = <3>;
		qcom,ldo-enable-corner-map = <1 1 1 0 0 0 0>;
		qcom,init-corner = <5>;

		vdd-cx-supply = <&pmtitanium_s2_level>;
		qcom,vdd-cx-corner-map = <RPM_SMD_REGULATOR_LEVEL_LOW_SVS>,
					<RPM_SMD_REGULATOR_LEVEL_LOW_SVS>,
					<RPM_SMD_REGULATOR_LEVEL_LOW_SVS>,
					<RPM_SMD_REGULATOR_LEVEL_SVS>,
					<RPM_SMD_REGULATOR_LEVEL_NOM>,
					<RPM_SMD_REGULATOR_LEVEL_NOM_PLUS>,
					<RPM_SMD_REGULATOR_LEVEL_TURBO>;

		mem-acc-supply = <&gfx_mem_acc>;
		qcom,mem-acc-corner-map = <1 1 2 2 2 2 2>;
	};
```

## Documentation/devicetree/bindings/regulator/mt6357-regulator.txt
```
Mediatek MT6357 Regulator Driver

Required properties:
- compatible: "mediatek,mt6357-regulator"
- mt6357regulator: List of regulators provided by this controller. It is named
  according to its regulator type, buck_<name> and ldo_<name>.
  The definition for each of these nodes is defined using the standard binding
  for regulators at Documentation/devicetree/bindings/regulator/regulator.txt.

Optional properties in the sub-node:
- mediatek,oc-irq-enable-delay-ms: Time to delay in milliseconds between
  re-enable over current interrupt after it triggered and be disabled.
  If it's not specified, the default value of this property is set to 10.

The valid names for regulators are:
BUCK:
  buck_vs1, buck_vmodem, buck_vcore, buck_vproc, buck_vpa
LDO:
  ldo_vfe28, ldo_vxo22, ldo_vrf18, ldo_vrf12, ldo_vefuse, ldo_vcn33_bt,
  ldo_vcn33_wifi, ldo_vcn28, ldo_vcn18, ldo_vcama, ldo_vcamd, ldo_vcamio,
  ldo_vldo28, ldo_vsram_others, ldo_vsram_proc, ldo_vaux18, ldo_vaud28,
  ldo_vio28, ldo_vio18, ldo_vdram, ldo_vmc, ldo_vmch, ldo_vemc, ldo_vsim1,
  ldo_vsim2, ldo_vibr, ldo_vusb33

Example:
	pmic {
		compatible = "mediatek,mt6357";

		mt6357regulator: mt6357regulator {
			compatible = "mediatek,mt6357-regulator";

			mt6357_vs1_reg: buck_vs1 {
				regulator-name = "vs1";
				regulator-min-microvolt = <1200000>;
				regulator-max-microvolt = <2200000>;
				regulator-ramp-delay = <12500>;
				regulator-enable-ramp-delay = <220>;
				regulator-always-on;
			};

			mt6357_vmodem_reg: buck_vmodem {
				regulator-name = "vmodem";
				regulator-min-microvolt = <500000>;
				regulator-max-microvolt = <1193750>;
				regulator-ramp-delay = <6250>;
				regulator-enable-ramp-delay = <220>;
				regulator-always-on;
			};

			mt6357_vcore_reg: buck_vcore {
				regulator-name = "vcore";
				regulator-min-microvolt = <518750>;
				regulator-max-microvolt = <1312500>;
				regulator-ramp-delay = <6250>;
				regulator-enable-ramp-delay = <220>;
				regulator-always-on;
			};

			mt6357_vproc_reg: buck_vproc {
				regulator-name = "vproc";
				regulator-min-microvolt = <518750>;
				regulator-max-microvolt = <1312500>;
				regulator-ramp-delay = <6250>;
				regulator-enable-ramp-delay = <220>;
				regulator-always-on;
			};

			mt6357_vpa_reg: buck_vpa {
				regulator-name = "vpa";
				regulator-min-microvolt = <500000>;
				regulator-max-microvolt = <3650000>;
				regulator-ramp-delay = <50000>;
				regulator-enable-ramp-delay = <220>;
			};

			mt6357_vfe28_reg: ldo_vfe28 {
				compatible = "regulator-fixed";
				regulator-name = "vfe28";
				regulator-min-microvolt = <2800000>;
				regulator-max-microvolt = <2800000>;
				regulator-enable-ramp-delay = <264>;
			};

			mt6357_vxo22_reg: ldo_vxo22 {
				regulator-name = "vxo22";
				regulator-min-microvolt = <2200000>;
				regulator-max-microvolt = <2400000>;
				regulator-enable-ramp-delay = <110>;
				regulator-always-on;
			};

			mt6357_vrf18_reg: ldo_vrf18 {
				compatible = "regulator-fixed";
				regulator-name = "vrf18";
				regulator-min-microvolt = <1800000>;
				regulator-max-microvolt = <1800000>;
				regulator-enable-ramp-delay = <110>;
			};

			mt6357_vrf12_reg: ldo_vrf12 {
				compatible = "regulator-fixed";
				regulator-name = "vrf12";
				regulator-min-microvolt = <1200000>;
				regulator-max-microvolt = <1200000>;
				regulator-enable-ramp-delay = <110>;
			};

			mt6357_vefuse_reg: ldo_vefuse {
				regulator-name = "vefuse";
				regulator-min-microvolt = <1200000>;
				regulator-max-microvolt = <3300000>;
				regulator-enable-ramp-delay = <264>;
			};

			mt6357_vcn33_bt_reg: ldo_vcn33_bt {
				regulator-name = "vcn33_bt";
				regulator-min-microvolt = <3300000>;
				regulator-max-microvolt = <3500000>;
				regulator-enable-ramp-delay = <264>;
			};

			mt6357_vcn33_wifi_reg: ldo_vcn33_wifi {
				regulator-name = "vcn33_wifi";
				regulator-min-microvolt = <3300000>;
				regulator-max-microvolt = <3500000>;
				regulator-enable-ramp-delay = <264>;
			};

			mt6357_vcn28_reg: ldo_vcn28 {
				compatible = "regulator-fixed";
				regulator-name = "vcn28";
				regulator-min-microvolt = <2800000>;
				regulator-max-microvolt = <2800000>;
				regulator-enable-ramp-delay = <264>;
			};

			mt6357_vcn18_reg: ldo_vcn18 {
				compatible = "regulator-fixed";
				regulator-name = "vcn18";
				regulator-min-microvolt = <1800000>;
				regulator-max-microvolt = <1800000>;
				regulator-enable-ramp-delay = <264>;
			};

			mt6357_vcama_reg: ldo_vcama {
				regulator-name = "vcama";
				regulator-min-microvolt = <2500000>;
				regulator-max-microvolt = <2800000>;
				regulator-enable-ramp-delay = <264>;
			};

			mt6357_vcamd_reg: ldo_vcamd {
				regulator-name = "vcamd";
				regulator-min-microvolt = <1000000>;
				regulator-max-microvolt = <1800000>;
				regulator-enable-ramp-delay = <264>;
			};

			mt6357_vcamio_reg: ldo_vcamio {
				compatible = "regulator-fixed";
				regulator-name = "vcamio";
				regulator-min-microvolt = <1800000>;
				regulator-max-microvolt = <1800000>;
				regulator-enable-ramp-delay = <264>;
			};

			mt6357_vldo28_reg: ldo_vldo28 {
				regulator-name = "vldo28";
				regulator-min-microvolt = <2800000>;
				regulator-max-microvolt = <3000000>;
				regulator-enable-ramp-delay = <264>;
			};

			mt6357_vsram_others_reg: ldo_vsram_others {
				regulator-name = "vsram_others";
				regulator-min-microvolt = <518750>;
				regulator-max-microvolt = <1312500>;
				regulator-ramp-delay = <6250>;
				regulator-enable-ramp-delay = <110>;
				regulator-always-on;
			};

			mt6357_vsram_proc_reg: ldo_vsram_proc {
				regulator-name = "vsram_proc";
				regulator-min-microvolt = <518750>;
				regulator-max-microvolt = <1312500>;
				regulator-ramp-delay = <6250>;
				regulator-enable-ramp-delay = <110>;
				regulator-always-on;
			};

			mt6357_vaux18_reg: ldo_vaux18 {
				compatible = "regulator-fixed";
				regulator-name = "vaux18";
				regulator-min-microvolt = <1800000>;
				regulator-max-microvolt = <1800000>;
				regulator-enable-ramp-delay = <264>;
				regulator-always-on;
			};

			mt6357_vaud28_reg: ldo_vaud28 {
				compatible = "regulator-fixed";
				regulator-name = "vaud28";
				regulator-min-microvolt = <2800000>;
				regulator-max-microvolt = <2800000>;
				regulator-enable-ramp-delay = <264>;
				regulator-always-on;
			};

			mt6357_vio28_reg: ldo_vio28 {
				compatible = "regulator-fixed";
				regulator-name = "vio28";
				regulator-min-microvolt = <2800000>;
				regulator-max-microvolt = <2800000>;
				regulator-enable-ramp-delay = <264>;
				regulator-always-on;
			};

			mt6357_vio18_reg: ldo_vio18 {
				compatible = "regulator-fixed";
				regulator-name = "vio18";
				regulator-min-microvolt = <1800000>;
				regulator-max-microvolt = <1800000>;
				regulator-enable-ramp-delay = <264>;
				regulator-always-on;
			};

			mt6357_vdram_reg: ldo_vdram {
				regulator-name = "vdram";
				regulator-min-microvolt = <1100000>;
				regulator-max-microvolt = <1200000>;
				regulator-enable-ramp-delay = <3300>;
				regulator-always-on;
			};

			mt6357_vmc_reg: ldo_vmc {
				regulator-name = "vmc";
				regulator-min-microvolt = <1800000>;
				regulator-max-microvolt = <3300000>;
				regulator-enable-ramp-delay = <44>;
			};

			mt6357_vmch_reg: ldo_vmch {
				regulator-name = "vmch";
				regulator-min-microvolt = <2900000>;
				regulator-max-microvolt = <3300000>;
				regulator-enable-ramp-delay = <44>;
			};

			mt6357_vemc_reg: ldo_vemc {
				regulator-name = "vemc";
				regulator-min-microvolt = <2900000>;
				regulator-max-microvolt = <3300000>;
				regulator-enable-ramp-delay = <44>;
				regulator-always-on;
			};

			mt6357_vsim1_reg: ldo_vsim1 {
				regulator-name = "vsim1";
				regulator-min-microvolt = <1700000>;
				regulator-max-microvolt = <3100000>;
				regulator-enable-ramp-delay = <264>;
			};

			mt6357_vsim2_reg: ldo_vsim2 {
				regulator-name = "vsim2";
				regulator-min-microvolt = <1700000>;
				regulator-max-microvolt = <3100000>;
				regulator-enable-ramp-delay = <264>;
			};

			mt6357_vibr_reg: ldo_vibr {
				regulator-name = "vibr";
				regulator-min-microvolt = <1200000>;
				regulator-max-microvolt = <3300000>;
				regulator-enable-ramp-delay = <44>;
			};

			mt6357_vusb33_reg: ldo_vusb33 {
				regulator-name = "vusb33";
				regulator-min-microvolt = <3000000>;
				regulator-max-microvolt = <3100000>;
				regulator-enable-ramp-delay = <264>;
			};
		};
	};
```

## Documentation/devicetree/bindings/regulator/mt6359-regulator.txt
```
Mediatek MT6359 Regulator

Required properties:
- compatible: "mediatek,mt6359-regulator"
- mt6359regulator: List of regulators provided by this controller. It is named
  according to its regulator type, buck_<name> and ldo_<name>.
  The definition for each of these nodes is defined using the standard binding
  for regulators at Documentation/devicetree/bindings/regulator/regulator.txt.

The valid names for regulators are::
BUCK:
  buck_vs1, buck_vgpu11, buck_vmodem, buck_vpu, buck_vcore, buck_vs2,
  buck_vpa, buck_vproc2, buck_vproc1
LDO:
  ldo_vaud18, ldo_vsim1, ldo_vibr, ldo_vrf12, ldo_vusb, ldo_vsram_proc2,
  ldo_vio18, ldo_vcamio, ldo_vcn18, ldo_vfe28, ldo_vcn13, ldo_vcn33_1_bt,
  ldo_vcn13_1_wifi, ldo_vaux18, ldo_vsram_others, ldo_vefuse, ldo_vxo22,
  ldo_vrfck, ldo_vbif28, ldo_vio28, ldo_vemc, ldo_vcn33_2_bt, ldo_vcn33_2_wifi,
  ldo_va12, ldo_va09, ldo_vrf18, ldo_vsram_md, ldo_vufs, ldo_vm18, ldo_vbbck,
  ldo_vsram_proc1, ldo_vsim2

Example:
	pmic {
		compatible = "mediatek,mt6359";

		mt6359regulator: mt6359regulator {
			compatible = "mediatek,mt6359-regulator";

			mt6359_vs1_buck_reg: buck_vs1 {
				regulator-name = "vs1";
				regulator-min-microvolt = <800000>;
				regulator-max-microvolt = <2200000>;
				regulator-enable-ramp-delay = <0>;
				regulator-always-on;
			};
			mt6359_vgpu11_buck_reg: buck_vgpu11 {
				regulator-name = "vgpu11";
				regulator-min-microvolt = <400000>;
				regulator-max-microvolt = <1193750>;
				regulator-enable-ramp-delay = <200>;
				regulator-always-on;
				regulator-allowed-modes = <0 1 2>;
			};
			mt6359_vaud18_ldo_reg: ldo_vaud18 {
				compatible = "regulator-fixed";
				regulator-name = "vaud18";
				regulator-min-microvolt = <1800000>;
				regulator-max-microvolt = <1800000>;
				regulator-enable-ramp-delay = <240>;
			};
			mt6359_vsim1_ldo_reg: ldo_vsim1 {
				regulator-name = "vsim1";
				regulator-min-microvolt = <1700000>;
				regulator-max-microvolt = <3100000>;
				regulator-enable-ramp-delay = <480>;
			};
		};
	};
```
