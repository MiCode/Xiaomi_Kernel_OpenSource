## Documentation/devicetree/bindings/regulator/qpnp-lcdb-regulator.txt
```
QPNP LCDB (LCD Bias) Regulator

QPNP LCDB module provides voltage bias to the LCD display panel. The biases
are positive (VDISP - supported by LDO) and negative (VDISN - supported by
NCP) voltage signals. The module also supports TTW (touch-to-wake) capability.

This document describes the bindings for QPNP LCDB module.

=======================
Required Node Structure
=======================

LCDB module must be described in two level of device nodes.

==============================
First Level Node - LCDB module
==============================

- compatible
	Usage:      required
	Value type: <string>
	Definition: should be "qcom,qpnp-lcdb-regulator"

- reg
	Usage:      required
	Value type: <prop-encoded-array>
	Definition:  Base address of the LCDB SPMI peripheral.

- qcom,pmic-revid
	Usage:      required
	Value type: <phandle>
	Definition:  Phandle to the PMIC's revid node

Touch-to-wake (TTW) properties:

TTW supports 2 modes of operation - HW and SW. In the HW mode the enable/disable
logic is controlled by an external signal (pin) where as in the SW mode it is
is controlled by a pre-configured timer (ton/toff) programmed in the TTW
register.

Properties below are specific to TTW mode only. They are sepecified in the
main node.

- qcom,ttw-enable
	Usage:      optional
	Value type:  <bool>
	Definition: Touch to wake-up support enabled.

- qcom,ttw-mode-sw
	Usage:      optional
	Value type:  <bool>
	Definition: Touch to wake supported in SW mode.
		    If not defined, ttw is enabled by HW pin.

- qcom,attw-toff-ms
	Usage:      required if 'qcom,ttw-mode-sw' is true.
	Value type:  <bool>
	Definition: Off time (in mS) for the VDISP/VDISN signals.
		    Possible values are 4, 8, 16, 32.

- qcom,attw-ton-ms
	Usage:      required if 'qcom,ttw-mode-sw' is true.
	Value type:  <bool>
	Definition: ON time (in mS) for the VDISP/VDISN signals.
		    Possible values are 4, 8, 16, 32.

========================================
Second Level Nodes - LDO/NCP/BOOST block
========================================

LDO / NCP subnode common properties:

Properties below are common to the LDO and NCP bias.

- label
	Usage:      required
	Value type: <string>
	Definition: A string used to describe the bias type.
		    Possible values are ldo, ncp, bst.

- regulator-name
	Usage:      required
	Value type: <string>
	Definition: A string used to describe the regulator.

- regulator-min-microvolt
	Usage:      required
	Value type: <u32>
	Definition: Minimum voltage (in uV) supported by the bias.

- regulator-max-microvolt
	Usage:      required
	Value type: <u32>
	Definition: Maximum voltage (in uV) supported by the bias.


LDO subnode properties:

Properties below are specific to LDO bias only.

- qcom,ldo-voltage-mv
	Usage:      optional
	Value type:  <u32>
	Definition: Voltage (in mV) progammed for the LDO (VDISP).
		    Possile values are 4000mV to 6000mV. The range
		    4000mV to 4900mV is in 100mV steps and 4900mV to
		    6000mV is in 50mV steps.

- qcom,ldo-pd
	Usage:      optional
	Value type:  <u32>
	Definition: Pull-down configuration of LDO. Possible values are:
		    1 - Enable pull-down
		    0 - Disable pull-down

- qcom,ldo-pd-strength
	Usage:      optional
	Value type:  <u32>
	Definition: Pull-down strength. Possible values are:
		    0 - Weak pull-down
		    1 - Strong pull-down

- qcom,ldo-ilim-ma
	Usage:      optional
	Value type:  <u32>
	Definition:  Current limit (in mA) of the LDO bias.
		     Possible values are 110, 160, 210, 260, 310, 360, 410, 460.

- qcom,ldo-soft-start-us
	Usage:      optional
	Value type:  <u32>
	Definition:  Soft-start time (in uS) of the LDO bias.
		     Possible values are 0, 500, 1000, 2000.


NCP subnode properties:

Properties below are specific to NCP bias only.

- qcom,ncp-voltage-mv
	Usage:      optional
	Value type:  <u32>
	Definition: Voltage (in mV) progammed for the NCP (VDISN).
		    Possile values are 4000mV to 6000mV. The range
		    4000mV to 4900mV is in 100mV steps and 4900mV to
		    6000mV is in 50mV steps.

- qcom,ncp-pd
	Usage:      optional
	Value type:  <u32>
	Definition: Pull-down configuration of NCP. Possible values are:
		    1 - Enable pull-down
		    0 - Disable pull-down

- qcom,ncp-pd-strength
	Usage:      optional
	Value type:  <u32>
	Definition: Pull-down strength. Possible values are:
		    0 - Weak pull-down
		    1 - Strong pull-down

- qcom,ncp-ilim-ma
	Usage:      optional
	Value type:  <u32>
	Definition:  Current limit (in mA) of the NCP bias.
		     Possible values are 260, 460, 640, 810.

- qcom,ncp-soft-start-us
	Usage:      optional
	Value type:  <u32>
	Definition:  Soft-start time (in uS) of the NCP bias.
		     Possible values are 0, 500, 1000, 2000.


BOOST subnode properties:

Properties below are specific to BOOST subnode only.

- qcom,bst-pd
	Usage:      optional
	Value type:  <bool>
	Definition: Pull-down configuration of BOOST. Possible values are:
		    1 - Enable pull-down
		    0 - Disable pull-down

- qcom,bst-pd-strength
	Usage:      optional
	Value type:  <u32>
	Definition: Pull-down strength. Possible values are:
		    0 - Weak pull-down
		    1 - Strong pull-down

- qcom,bst-ps
	Usage:      optional
	Value type:  <u32>
	Definition: Pulse-skip configuration for boost. Possible values are:
		    1 - Enable Pulse-skip
		    0 - Disable Pulse-skip

- qcom,bst-ps-threshold-ma
	Usage:      optional
	Value type:  <u32>
	Definition: Current threshold (in mA) at which pulse-skip is entered.
		    Possible values are 50, 60, 70, 80.

- qcom,bst-ilim-ma
	Usage:      optional
	Value type:  <u32>
	Definition:  Current limit (in mA) of the BOOST rail.
		     Possible values are 200 to 1600mA in 200mA steps.

- qcom,bst-headroom-mv
	Usage:      optional
	Value type:  <u16>
	Definition:  Headroom of the boost (in mV). The minimum headroom is
		     200mV and if not specified defaults to 200mV.

=======
Example
=======

pm660l_lcdb: qpnp-lcdb@ec00 {
	compatible = "qcom,qpnp-lcdb-regulator";
	#address-cells = <1>;
	#size-cells = <1>;
	reg = <0xec00 0x100>;

	qcom,ttw-enable;

	lcdb_ldo_vreg: ldo {
		label = "ldo";
		regulator-name = "lcdb_ldo";
		regulator-min-microvolt = <4000000>;
		regulator-max-microvolt = <6000000>;

		qcom,ldo-voltage-mv = <5400>;
		qcom,ldo-pd = <1>;
		qcom,ldo-pd-strength = <1>;
	};

	lcdb_ncp_vreg: ncp {
		label = "ncp";
		regulator-name = "lcdb_ncp";
		regulator-min-microvolt = <4000000>;
		regulator-max-microvolt = <6000000>;

		qcom,ncp-voltage-mv = <5400>;
		qcom,ncp-pd = <1>;
		qcom,ncp-pd-strength = <1>;
	};

	lcdb_bst: bst {
		label = "bst";

		qcom,bst-pd = <1>;
		qcom,bst-pd-strength = <1>;
		qcom,bst-ps = <1>;
		qcom,bst-ps-threshold-ma = <50>;
		qcom,bst-headroom-mv = <200>;
	};
};
```

## Documentation/devicetree/bindings/regulator/qpnp-oledb-regulator.txt
```
QPNP OLEDB (AMOLED AVDD Bias) Regulator

QPNP OLEDB module provides AVDD voltage bias to the AMOLED display panel.
The supported voltage range is 5V to 8.1V.

This document describes the bindings for QPNP OLEDB module.

=======================
Required Node Structure
=======================

- compatible
	Usage:      required
	Value type: <string>
	Definition: should be "qcom,qpnp-oledb-regulator".

- reg
	Usage:      required
	Value type: <prop-encoded-array>
	Definition:  Base address of the OLEDB SPMI peripheral.

- label
	Usage:      required
	Value type: <string>
	Definition: A string used to describe the bias type(oledb).

- regulator-name
	Usage:      required
	Value type: <string>
	Definition: A string used to describe the regulator.

- regulator-min-microvolt
	Usage:      required
	Value type: <u32>
	Definition: Minimum voltage (in uV) supported by the bias (5000000uV).

- regulator-max-microvolt
	Usage:      required
	Value type: <u32>
	Definition: Maximum voltage (in uV) supported by the bias (8100000uV).

- qcom,swire-control
	Usage:      optional
	Value type: <bool>
	Definition: Enables the voltage programming through SWIRE signal.

 qcom,ext-pin-control
	Usage:      optional
	Value type: <bool>
	Definition: Configures the OLED module to be enabled by a external pin.

 qcom,dynamic-ext-pinctl-config
	Usage:      optional
	Value type: <bool>
	Definition:  Used to dynamically enable/disable the OLEDB module
		     using external pin to avoid the glitches on the voltage
		     rail.  This property is applicable only if qcom,ext-pin-ctl
		     property is specified and it is specific to PM660A.

 qcom,pbs-control
	Usage:      optional
	Value type: <bool>
	Definition: PMIC PBS logic directly configures the output voltage update
		    and pull down control.

 qcom,oledb-init-voltage-mv
	Usage:      optional
	Value type: <u32>
	Definition: Sets the AVDD bias voltage (in mV) when the module is
		    already enabled. Applicable only if the qcom,swire-control
		    property is not specified. Supported values are from 5.0V
		    to 8.1V with a step of 100mV.

qcom,oledb-default-voltage-mv
	Usage:      optional
	Value type: <u32>
	Definition: Sets the default AVDD bias voltage (in mV) before module
		    enable. Supported values are from 5.0V to 8.1V with the
		    step of 100mV.

qcom,bias-gen-warmup-delay-ns
	Usage:      optional
	Value type: <u32>
	Definition: Bias generator warm-up time (ns). Supported values are
		    6700, 13300, 267000, 534000.

qcom,peak-curr-limit-ma
	Usage:      optional
	Value type: <u32>
	Definition: Peak current limit (in mA). Supported values are 115, 265,
		    415, 570, 720, 870, 1020, 1170.

qcom,pull-down-enable
	Usage:      optional
	Value type: <u32>
	Definition: Pull down configuration of OLEDB.
		    1 - Enable pull-down
		    0 - Disable pull-down

qcom,negative-curr-limit-enable
	Usage:      optional
	Value type: <u32>
	Definition: negative current limit enable/disable.
			1 = enable negative current limit
			0 = disable negative current limit

qcom,negative-curr-limit-ma
	Usage:      optional
	Value type: <u32>
	Definition: Negative current limit (in mA). Supported values are
		    170, 300, 420, 550.

qcom,enable-short-circuit
	Usage:      optional
	Value type: <u32>
	Definition: Short circuit protection enable/disable.
			1 = enable short circuit protection
			0 = disable short circuit protection

qcom,short-circuit-dbnc-time
	usage:      optional
	Value type: <u32>
	Definitioan: Short circuit debounce time (in Fsw). Supported
		     values are 2, 4, 8, 16.

Fast precharge properties:
-------------------------

qcom,fast-precharge-ppulse-enable
	usage:      optional
	Value type: <u32>
	Definitioan: Fast precharge pfet pulsing enable/disable.
			1 = enable fast precharge pfet pulsing
			0 = disable fast precharge pfet pulsing

qcom,precharge-debounce-time-ms
	usage:      optional
	Value type: <u32>
	Definitioan: Fast precharge debounce time (in ms). Supported
		     values are 1, 2, 4, 8.

qcom,precharge-pulse-period-us
	usage:      optional
	Value type: <u32>
	Definitioan: Fast precharge pulse period (in us). Supported
		     values are 3, 6, 9, 12.

qcom,precharge-pulse-on-time-us
	usage:      optional
	Value type: <u32>
	Definitioan: Fast precharge pulse on time (in ns). Supported
		     values are 1200, 1800, 2400, 3000.

Pulse Skip Modulation (PSM) properties:
--------------------------------------

qcom,psm-enable
	Usage:      optional
	Value type: <u32>
	Definition: Pulse Skip Modulation mode.
		    1 - Enable PSM mode
		    0 - Disable PSM mode

qcom,psm-hys-mv
	Usage:      optional
	Value type: <u32>
	Definition: PSM hysterysis voltage (in mV).
		    Supported values are 13mV and 26mV.

qcom,psm-vref-mv
	Usage:      optional
	Value type: <u32>
	Definition: Reference voltage(in mV) control for PSM comparator.
		    Supported values are 440, 510, 580, 650, 715, 780, 850,
		    and 920.

Pulse Frequency Modulation (PFM) properties:
-------------------------------------------

qcom,pfm-enable
	Usage:      optional
	Value type: <u32>
	Definition: Pulse Frequency Modulation mode.
		    1 - Enable PFM mode
		    0 - Disable PFM mode

qcom,pfm-hys-mv
	Usage:      optional
	Value type: <u32>
	Definition: PFM hysterysis voltage (in mV).
		    Supported values are 13mV and 26mV.

qcom,pfm-curr-limit-ma
	Usage:      optional
	Value type: <u32>
	Definition: PFM current limit (in mA).
		    Supported values are 130, 200, 270, 340.

qcom,pfm-off-time-ns
	Usage:      optional
	Value type: <u32>
	Definition: NFET off time at PFM (in ns).
		    Supported values are 110, 240, 350, 480.

=======
Example
=======

pm660a_oledb: qpnp-oledb@e000 {
	compatible = "qcom,qpnp-oledb-regulator";
	#address-cells = <1>;
	#size-cells = <1>;
	reg = <0xe000 0x100>;

	label = "oledb";
	regulator-name = "regulator-oledb";
	regulator-min-microvolt = <5000000>;
	regulator-max-microvolt = <8100000>;

	qcom,swire-control;
	qcom,ext-pin-control;

	qcom,oledb-default-voltage-mv = <5000>;
	qcom,bias-gen-warmup-delay-ns = <6700>;
	qcom,pull-down-enable = <1>;
	qcom,peak-curr-limit-ma = <570>;

	qcom, enable-psm = <1>;
	qcom,psm-hys-mv = <13>;
};
```
