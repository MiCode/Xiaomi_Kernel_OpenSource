## Documentation/devicetree/bindings/clock/qcom,dummycc.txt
```
Qualcomm Technologies, Inc. Dummy Clock Controller Binding

Qualcomm Technologies, Inc. dummy clock controller devices provide
clock API support for driver development during pre-silicon stage.
The clock driver always returns a dummy clock that has no effect on
hardware.

Required properties:
- compatible:		Must be "qcom,dummycc"
- #clock-cells:		Must be <1>. This will allow the common clock device
			tree framework to recognize _this_ device node as a
			clock provider.

Optional properties:
- clock-output-names:	Name of the clock or the clock type.
- #reset-cells:		Must be <1>. This will allow the common reset device
			tree framework to recognize _this_ device node as a
			reset controller provider.

Example:
	clock_gcc: qcom,gcc {
		compatible = "qcom,dummycc";
		clock-output-names = "gcc_clocks";
		#clock-cells = <1>;
		#reset-cells = <1>;
	};
```

## Documentation/devicetree/bindings/clock/qcom,gcc-dbg.txt
```
Qualcomm Technologies Inc Global Clock Debug Controller Binding
---------------------------------------------------------------

Required properties :
- compatible:	shall contain the following:
			"qcom,gcc-debug-sdm660"

- reg:		shall contain global clock controller
	        base register offset location and length.
- reg-name:	"dbg_offset"
- #clock-cells:	shall contain 1
- qcom,cc-count: shall contain a non-zero value(min 1). This
		 indicates the number of debug clock controllers
		 available.
- clocks:	XO clock phandle.
- clock-names:  Name of the clock.
- qcom,gcc:	The syscon phandle for GCC clock controller.

Optional properties :
In the case where "qcom,cc-count" is > 1, the below needs to be defined.
- qcom,gpu : The syscon phandle for Graphics debug controller.
- qcom,cpu : The syscon phandle for CPU debug controller.
- qcom,mmss : The syscon phandle for Multimedia debug controller.

Example:
	clock_gcc: clock-controller@100000 {
		compatible = "qcom,gcc-sdm660", "syscon";
		....
	};

	cpu_debug: syscon@1791101c {
		compatible = "syscon";
		reg = <0x1791101c 0x4>;
	};

	gpu_debug: syscon@5065120 {
		compatible = "syscon";
		reg = <0x5065120 0x4>;
	};

	mmss_debug: syscon@c8c0900 {
		compatible = "syscon";
		reg = <0xc8c0900 0x4>;
	};

	clock_debug: qcom,cc-debug@62000 {
		compatible = "qcom,gcc-debug-sdm660";
		reg = <0x62000 0x4>;
		reg-names = "cc_offset";
		clocks = <&clock_rpmcc  RPM_XO_CLK_SRC>;
		clock-names = "xo_clk_src";
		qcom,cc-count = <4>;
		qcom,gcc = <&clock_gcc>;
		qcom,cpu = <&cpu_debug>;
		qcom,gpu = <&gpu_debug>;
		qcom,mmss = <&mmss_debug>;
		#clock-cells = <1>;
	};
```

## Documentation/devicetree/bindings/clock/qcom,gpucc.txt
```
Qualcomm Technologies, Inc. Graphics Clock & Reset Controller Binding
--------------------------------------------------------------------

Required properties :
- compatible: shall contain one of the following:
		"qcom,gpucc-kona"
		"qcom,lito-gpucc".
		"qcom,bengal-gpucc"
		"qcom,lagoon-gpucc",
		"qcom,gpu-sdm660",
		"qcom,gpucc-sdm660",
		"qcom,gpucc-sdm630".

- reg: shall contain base register offset and size.
- reg-names: names of registers listed in the same order as in the reg property.
		Must contain "cc_base".
- #clock-cells: from common clock binding, shall contain 1.
- #reset-cells: from common reset binding, shall contain 1.
- vdd_cx-supply: The vdd_cx logic rail supply.
- vdd_mx-supply: The vdd_mx logic rail supply.

Optional properties :
- #power-domain-cells : from generic power domain binding, shall contain 1.

Example:

	clock_gpucc: clock-controller@3d90000 {
		compatible = "qcom,gpucc-kona";
		reg = <0x3d90000 0x9000>;
		reg-names = "cc_base";
		vdd_cx-supply = <&VDD_CX_LEVEL>;
		vdd_mx-supply = <&VDD_MX_LEVEL>;
		#clock-cells = <1>;
		#reset-cells = <1>;
	};
```

## Documentation/devicetree/bindings/clock/qcom,krait-cc.txt
```
Krait Clock Controller

PROPERTIES

- compatible:
	Usage: required
	Value type: <string>
	Definition: must be one of:
			"qcom,krait-cc-v1"
			"qcom,krait-cc-v2"

- #clock-cells:
	Usage: required
	Value type: <u32>
	Definition: must be 1

Example:

	kraitcc: clock-controller {
		compatible = "qcom,krait-cc-v1";
		#clock-cells = <1>;
	};
```

## Documentation/devicetree/bindings/clock/qcom,msm-clock-controller.txt
```
Qualcomm Technologies MSM Clock Controller

Required properties :
- compatible : shall contain "qcom,msm-clock-controller"
- reg : shall contain base register location and length
- reg-names: names of registers listed in the same order as in
		the reg property.
- #clock-cells : shall contain 1
- #reset-cells : shall contain 1

Optional properties :
- vdd_<rail>-supply: The logic rail supply.

Example:
	clock_gcc: qcom,gcc@1800000 {
		compatible = "qcom,msm-clock-controller";
		reg = <0x1800000 0x80000>;
		reg-names = "cc-base";
		#clock-cells = <1>;
		clock-names = "a7_debug_clk";
		clocks = <&clock_a7pll clk_a7_debug_mux>;
	};
```

## Documentation/devicetree/bindings/clock/qcom,npucc.txt
```
Qualcomm Technologies, Inc. NPU Clock & Reset Controller Bindings
-----------------------------------------------------------------

Required properties:
- compatible:		Should be "qcom,npucc-kona",
				  "qcom,npucc-kona-v2",
				  "qcom,lito-npucc",
				  "qcom,lito-npucc-v2",
				  "qcom,lagoon-npucc".
- reg:			Shall contain base register addresses and sizes.
- reg-names:		Names of the register bases listed in the same order as
			in the reg property.  Shall include: "cc", "qdsp6ss",
			and "qdsp6ss_pll".
- vdd_cx-supply:	Phandle of the VDD_CX regulator supply rail that needs
			to be voted on behalf of the NPU CC clocks.
- #clock-cells:		Shall contain 1.
- #reset-cells:		Shall contain 1.

Optional properties:
- nvmem-cells: list of phandle to the nvmem data cells.
- nvmem-cell-names: names for the each nvmem-cells specified.

Example:

clock_npucc: qcom,npucc@9980000 {
	compatible = "qcom,npucc-kona";
	reg = <0x9980000 0x10000>,
		<0x9800000 0x10000>,
		<0x9810000 0x10000>;
	reg-names = "cc", "qdsp6ss", "qdsp6ss_pll";
	vdd_cx-supply = <&VDD_CX_LEVEL>;
	nvmem-cells = <&npu_efuse>;
	nvmem-cell-names = "npu-bin";
	#clock-cells = <1>;
	#reset-cells = <1>;
};
```

## Documentation/devicetree/bindings/clock/qcom,qcs405-cpucc.txt
```
Qualcomm Technologies, Inc. QCS405 CPU clock driver
---------------------------------------------------

It is the clock controller driver which provides higher frequency
clocks and allows CPU frequency scaling on qcs405 based platforms.

Required properties:
- compatible:	Shall contain following:
		"qcom,cpu-qcs405"
		"qcom,cpu-sdxprairie"
- clocks:	Phandle to the clock device.
- clock-names:	Names of the used clocks. Shall contain following:
		"xo_ao", "gpll0_ao"
- reg:	Shall contain base register offset and size.
- reg-names:	Names of the bases for the above registers. Shall contain following:
		"apcs_cmd", "apcs_pll"
- vdd_dig_ao-supply:	The regulator(active only) powering the digital logic of APSS PLL.
- vdd_hf_pll-supply:	The regulator(active only) powering the Analog logic of APSS PLL.
- cpu-vdd-supply:	The regulator powering the APSS RCG.
- qcom,speedX-bin-vZ:	A table of CPU frequency (Hz) to regulator voltage (uV) mapping.
			Format: <freq uV>
			This represents the max frequency possible for each possible
			power configuration for a CPU that's binned as speed bin X,
			speed bin revision Z. Version can be between [0-3].
- #clock-cells:	Shall contain 1.

Optional properties:
- reg-names:	"efuse"
- qcom,cpucc-init-rate:	Initial rate which needs to be set from cpu driver.

Example:
	clock_cpu: qcom,clock-cpu@0b011050 {
		compatible = "qcom,cpu-qcs405";
		clocks = <&clock_rpmcc RPM_SMD_XO_A_CLK_SRC>,
			<&clock_gcc GPLL0_AO_OUT_MAIN>;
		clock-names = "xo_ao", "gpll0_ao" ;
		qcom,cpucc-init-rate = <960000000>;
		reg = <0x0b011050 0x8>,
			<0xb016000 0x34>;
		reg-names = "apcs_cmd" , "apcs_pll";
		cpu-vdd-supply = <&apc_vreg_corner>;
		vdd_dig_ao-supply = <&pmd9655_s1_level_ao>;
		vdd_hf_pll-supply = <&pms405_l5_ao>;
		qcom,speed0-bin-v0 =
			< 0         0>,
			< 960000000  1>,
			< 1113600000 2>,
			< 1267200000 3>,
			< 1382400000 4>;
		#clock-cells = <1>;
	};

	clock_cpu: qcom,clock-cpu@17808100 {
		compatible = "qcom,cpu-sdxprairie";
		clocks = <&clock_rpmh RPMH_CXO_CLK>>;
		clock-names = "&clock_rpmh RPMH_CXO_CLK";
		reg = <0x17810008 0x8>,
			<0x17808100 0x44>;
		reg-names = "apcs_cmd" , "apcs_pll";
		vdd-lucid-pll-supply = <&VDD_CX_LEVEL_AO>;
		cpu-vdd-supply = <&VDD_CX_LEVEL_AO>;
		qcom,speed0-bin-v0 =
			<          0 RPMH_REGULATOR_LEVEL_OFF>,
			<  345600000 RPMH_REGULATOR_LEVEL_LOW_SVS>,
			<  576000000 RPMH_REGULATOR_LEVEL_SVS>,
			< 1094400000 RPMH_REGULATOR_LEVEL_NOM>,
			< 1555200000 RPMH_REGULATOR_LEVEL_TURBO>;
		#clock-cells = <1>;
	};
```

## Documentation/devicetree/bindings/clock/qcom,rpmh-clk.txt
```
Qualcomm Technologies, Inc. RPMh Clocks
-------------------------------------------------------

Resource Power Manager Hardened (RPMh) manages shared resources on
some Qualcomm Technologies Inc. SoCs. It accepts clock requests from
other hardware subsystems via RSC to control clocks.

Required properties :
- compatible : Shall contain one of the following:
		"qcom,kona-rpmh-clk",
		"qcom,sdm845-rpmh-clk"
		"qcom,lito-rpmh-clk"

- #clock-cells : must contain 1

Example :

#include <dt-bindings/clock/qcom,rpmh.h>

	&apps_rsc {
		rpmhcc: clock-controller {
			compatible = "qcom,sdm845-rpmh-clk";
			#clock-cells = <1>;
		};
	};

	&apps_rsc {
		rpmhcc: clock-controller {
			compatible = "qcom,kona-rpmh-clk";
			#clock-cells = <1>;
		};
	};
```

## Documentation/devicetree/bindings/clock/qcom,rpmh.txt
```
Qualcomm Technologies, Inc. RPMh Clocks

Required properties:
- compatible:	Must contain one of the following:
		"qcom,rpmh-clk-sm6150",
		"qcom,rpmh-clk-sm8150",
		"qcom,rpmh-clk-sdmshrike",
		"qcom,rpmh-clk-sdmmagpie"
		"qcom,rpmh-clk-sdxprairie",
		"qcom,rpmh-clk-atoll".
- #clock-cells:	Must contain 1.
- mboxes:	List of RPMh mailbox phandle and channel identifier tuples.
- mbox-names:	List of names to identify the RPMh mailboxes used.
		Must contain "apps".  May optionally contain "display" if
		the RPMh mailbox phandle for the Display RSC is specified
		in the mboxes property.

Example:
	qcom,rpmhclk {
		compatible = "qcom,rpmh-clk-sm8150";
		#clock-cells = <1>;
		mboxes = <&apps_rsc 0>, <&disp_rsc 0>;
		mbox-names = "apps", "display";
	};
```

## Documentation/devicetree/bindings/clock/qcom,scc.txt
```
Qualcomm Technologies, Inc. Sensor Clock Controller Bindings

Required properties:
- compatible: shall contain "qcom,scc-sm8150" or "qcom,scc-sm8150-v2" or
		"qcom,scc-sm6150" or "qcom,scc-sa6155" or "qcom,scc-sa8195" or
		"qcom,scc-sa8155" or "qcom,scc-sa8155-v2".
- reg: shall contain base register location and length.
- vdd_scc_cx-supply: the logic rail supply.
- #clock-cells: shall contain 1.

Example:
	qcom,scc@2b10000 {
		compatible = "qcom,scc-sm8150";
		reg = <0x2b10000 0x30000>;
		vdd_scc_cx-supply = <&VDD_CX_LEVEL>;
		#clock-cells = <1>;
	};
```

## Documentation/devicetree/bindings/clock/qcom,sdm-cpucc.txt
```
Qualcomm Technologies, Inc. SDM CPU clock driver
---------------------------------------------------

It is the clock controller driver which provides higher frequency
clocks and allows CPU frequency scaling on sdm based platforms.

Required properties:
- compatible:	Shall contain following:
		"qcom,cpu-clock-sdm"
- clocks:	Phandle to the clock device.
- clock-names:	Names of the used clocks. Shall contain following:
		"xo_ao", "gpll0_ao"
- reg:	Shall contain base register offset and size.
- reg-names:	Names of the bases for the above registers. Shall contain following:
		"apcs-c1-rcg-base", "apcs-cci-rcg-base", "apcs_pll", "efuse"
- vdd_dig_ao-supply:	The regulator(active only) powering the digital logic of APSS PLL.
- vdd_hf_pll-supply:	The regulator(active only) powering the Analog logic of APSS PLL.
- cpu-vdd-supply:	The regulator powering the APSS C1 RCG and APSS CCI RCG.
- qcom,speedX-bin-vY-Z:	A table of CPU frequency (Hz) to regulator voltage (uV) mapping.
			Format: <freq uV>
			This represents the max frequency possible for each possible
			power configuration for a CPU that's binned as speed bin X,
			speed bin revision Y. Version can be between [0-3]. Z
			is the mux id c1 or cci.
- #clock-cells:	Shall contain 1.

Example:
	clock_cpu: qcom,clock-cpu@0b011050 {
		compatible = "qcom,cpu-clock-sdm";
		clocks = <&rpmcc RPM_SMD_XO_A_CLK_SRC>,
			<&gcc GPLL0_AO_OUT_MAIN>;
		clock-names = "xo_ao", "gpll0_ao" ;
		reg =   <0xb011050 0x8>,
			<0xb1d1050 0x8>,
			<0xb016000 0x34>,
			<0x00a412c 0x8>;
		reg-names = "apcs-c1-rcg-base",
			"apcs-cci-rcg-base", "apcs_pll", "efuse";
		cpu-vdd-supply = <&apc_vreg_corner>;
		vdd_dig_ao-supply = <&L12A_AO;
		vdd_hf_pll-supply = <&VDD_CX_LEVEL_AO>;
		qcom,speed0-bin-v0-c1 =
			<          0 0>,
			<  960000000 1>,
			< 1305600000 1>,
			< 1497600000 2>,
			< 1708800000 3>,
			< 1958400000 5>;

		qcom,speed0-bin-v0-cci =
			<          0 0>,
			<  400000000 1>,
			<  533333333 3>;

		qcom,speed1-bin-v0-c1 =
			<          0 0>,
			<  960000000 1>,
			< 1305600000 1>,
			< 1497600000 2>,
			< 1708800000 3>,
			< 1804800000 5>;

		qcom,speed1-bin-v0-cci =
			<          0 0>,
			<  400000000 1>,
			<  533333333 3>;

		qcom,speed4-bin-v0-c1 =
			<          0 0>,
			<  960000000 1>,
			< 1305600000 1>,
			< 1497600000 2>,
			< 1708800000 3>,
			< 1958400000 5>,
			< 2016000000 6>;

		qcom,speed4-bin-v0-cci =
			<          0 0>,
			<  400000000 1>,
			<  533333333 3>;

		qcom,speed5-bin-v0-c1 =
			<          0 0>,
			<  960000000 1>,
			< 1305600000 1>,
			< 1497600000 2>,
			< 1708800000 3>;

		qcom,speed5-bin-v0-cci =
			<          0 0>,
			<  400000000 1>,
			<  533333333 3>;

		#clock-cells = <1>;
	};
```

## Documentation/devicetree/bindings/clock/qcom,sdxlemur-apsscc.txt
```
Qualcomm Technologies, Inc. SDXLEMUR CPU clock driver
-----------------------------------------------------

It is the clock controller driver which provides higher frequency
clocks and allows CPU frequency scaling on qcs405 based platforms.

Required properties:
- compatible:	Shall contain following:
		"qcom,sdxlemur-apsscc"
		"qcom,sdxnightjar-apsscc"
- clocks:	Phandle to the clock device.
- clock-names:	Names of the used clocks. Shall contain following:
		"xo_ao", "gpll0_ao"
- reg:	Shall contain base register offset and size.
- reg-names:	Names of the bases for the above registers. Shall contain following:
		"apcs_cmd", "apcs_pll"
- vdd-pll-supply:	The regulator(active only) powering the Analog logic of APSS PLL.
- cpu-vdd-supply:	The regulator(active only) powering the APSS RCG.
- qcom,speedX-bin-vZ:	A table of CPU frequency (Hz) to regulator voltage (uV) mapping.
			Format: <freq uV>
			This represents the max frequency possible for each possible
			power configuration for a CPU that's binned as speed bin X,
			speed bin revision Z. Version can be between [0-3].
- #clock-cells:	Shall contain 1.

Optional properties:
- reg-names:	"efuse"

Example:
	clock_cpu: qcom,clock-cpu@17808100 {
		compatible = "qcom,sdxlemur-apsscc";
		clocks = <&rpmhcc RPMH_CXO_CLK>>;
			  <&gcc GPLL0_AO_OUT_MAIN>;;
		clock-names = "xo_ao", "gpll0_ao" ;
		reg = <0x17810008 0x8>, <0x17808100 0x44>;
		reg-names = "apcs_cmd" , "apcs_pll";
		vdd-pll-supply = <&VDD_CX_LEVEL_AO>;
		cpu-vdd-supply = <&VDD_CX_LEVEL_AO>;
		qcom,speed0-bin-v0 =
			<          0 RPMH_REGULATOR_LEVEL_OFF>,
			<  345600000 RPMH_REGULATOR_LEVEL_LOW_SVS>,
			<  576000000 RPMH_REGULATOR_LEVEL_SVS>,
			< 1094400000 RPMH_REGULATOR_LEVEL_NOM>,
			< 1555200000 RPMH_REGULATOR_LEVEL_TURBO>;
		#clock-cells = <1>;
	};
```
