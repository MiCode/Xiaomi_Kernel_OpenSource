## Documentation/devicetree/bindings/cpufreq/cpufreq-qcom-hw-debug.txt
```
Qualcomm Technologies, Inc. CPUFREQ Hardware Debug Bindings
--------------------------------------------------------------------

CPUFREQ HW debug provide support to print the CPUFREQ_HW debug
registers.

Required Properties:
- compatible: shall contain the following:
		"qcom,cpufreq-hw-debug" or "qcom,cpufreq-hw-epss-debug".
- reg: shall contain base register location and length.
- reg-names: shall contain the frequency domain name.

Optional Properties:
- qcom,freq-hw-domain: phandle to the frequency domain device node.

Usage :
The following debug node would get created under qcom-cpufreq-hw directory.

- print_cpufreq_debug_regs
Function:	Print cpufreq hardware debug registers
Input:		cat print_cpufreq_debug_regs

Example:
	cpufreq_hw_debug: qcom,cpufreq-hw-debug@18591000 {
		compatible = "qcom,cpufreq-hw-debug";
		reg = <0x18591000 0x800>;
		reg-names = "domain-top";
		qcom,freq-hw-domain = <&cpufreq_hw 0>, <&cpufreq_hw 1>,
					<&cpufreq_hw 2>;
	};
```

## Documentation/devicetree/bindings/cpufreq/cpufreq-sprd-hw.yaml
```yaml
# SPDX-License-Identifier: (GPL-2.0-only OR BSD-2-Clause)
%YAML 1.2
---
$id: http://devicetree.org/schemas/cpufreq/cpufreq-sprd-hw.yaml#
$schema: http://devicetree.org/meta-schemas/core.yaml#

title: Spreadtrum CPUFREQ HW Bindings

description:
 CPUFREQ HW driver enable hardware to manage the voltage and frequency
 for DSU cluster and cores in sprd platforms.

properties:
  compatible:
    const: sprd,cpufreq-v2

  "#freq-domain-cells":
    description:
      Number of cells in a freqency domain specifier
    const: 1

  sprd,multi-version:
    description:
      A boolean property to illustrate whether there are multi-version of the same SOC

  sprd,transition-delay:
    description:
      Number the Schedutil governor to adjust the frequency interval

  sprd,pmic-type:
    description:
      Number of the PMIC type that provided power for current cpu cluster

  sprd,cpufreq-boost:
    description:
      A boolean property to illustrate whether the current cpu cluster supports boost

  sprd,temp-threshold:
    description:
      Number of the current cluster temp threshold list

  nvmem-cell-names:
    description:
      String from common nvmem binding

  sprd,temp-threshold:
    description:
      Phandle from common nvmem binding

  sprd,thmzone-names:
    description:
      String from common thermal zone binding
    enum:
      - soc-thmzone
      - cpu-thmzone

  sprd,voltage-step:
    description:
      Number of the dcdc step voltage limit vol

  sprd,voltage-margin:
    description:
      Number of the dcdc delay margin

required:
  - compatible
  - "#freq-domain-cells"

additionalProperties: false

examples:
  - |
    cpus {
            CPU0: cpu@0 {
                device_type = "cpu";
                compatible = "arm,cortex-a55";
                reg = <0x0 0x0>;
                enable-method = "psci";
                cpu-idle-states = <&CORE_PD>;
                capacity-dmips-mhz = <544>;
                dynamic-power-coefficient = <102>;
                sprd,freq-domain = <&cpufreq_clus0 0>;
            };

            /* ... */

            CPU6: cpu@600 {
                device_type = "cpu";
                compatible = "arm,cortex-a75";
                reg = <0x0 0x600>;
                enable-method = "psci";
                cpu-idle-states = <&CORE_PD>;
                capacity-dmips-mhz = <1024>;
                dynamic-power-coefficient = <501>;
                sprd,freq-domain = <&cpufreq_clus1 1>;
            };
    };

    apcpu_dvfs: apcpu-dvfs {
            compatible = "sprd,cpufreq-v2";

            cpufreq_clus0: cpufreq-clus0 {
                    sprd,temp-threshold = <65>;
                    nvmem-cell-names = "dvfs_bin";
                    nvmem-cells = <&dvfs_bin_cpu0>;
                    sprd,multi-version;
                    sprd,cpufreq-boost;
                    sprd,pmic-type = <0>;
                    sprd,transition-delay = <500>;
                    sprd,thmzone-names = "soc-thmzone";

                    #freq-domain-cells = <1>;
            };

            cpufreq_clus1: cpufreq-clus1 {
                    sprd,temp-threshold = <65>;
                    nvmem-cell-names = "dvfs_bin";
                    nvmem-cells = <&dvfs_bin_cpu1>;
                    sprd,multi-version;
                    sprd,cpufreq-boost;
                    sprd,pmic-type = <0>;
                    sprd,transition-delay = <500>;
                    sprd,thmzone-names = "soc-thmzone";

                    #freq-domain-cells = <1>;
            };
    };
```

## Documentation/devicetree/bindings/cpufreq/msm-cpufreq.txt
```
Qualcomm MSM CPUfreq device

msm-cpufreq is a device that represents the list of usable CPU frequencies
and provides a device handle for the CPUfreq driver to get the CPU and cache
clocks.

Required properties:
- compatible:		Must be "qcom,msm-cpufreq"
- qcom,cpufreq-table, or qcom,cpufreq-table-<X>:
			A list of usable CPU frequencies (KHz).
			Use "qcom,cpufreq-table" if all CPUs in the system
			should share same list of frequencies.
			Use "qcom,cpufreq-table-<cpuid>" to describe
			different CPU freq tables for different CPUs.
			The table should be listed only for the first CPU
			if multiple CPUs are synchronous.

Optional properties:
- clock-names:		When DT based binding of clock is available, this
			provides a list of CPU subsystem clocks.
			"cpuX_clk" for every CPU that's present.
			"l2_clk" when an async cache/CCI is present.

Optional properties:
- qcom,governor-per-policy:	This property denotes that governor tunables
				should be associated with each cpufreq policy
				group instead of being global.

Example:
	qcom,msm-cpufreq {
		compatible = "qcom,msm-cpufreq";
		qcom,cpufreq-table =
			<  300000 >,
			<  422400 >,
			<  652800 >,
			<  729600 >,
			<  883200 >,
			<  960000 >,
			< 1036800 >,
			< 1190400 >,
			< 1267200 >,
			< 1497600 >,
			< 1574400 >,
			< 1728000 >,
			< 1958400 >,
			< 2265600 >;
	};
```
