## Documentation/devicetree/bindings/clock/qcom,videocc.txt
```
Qualcomm Video Clock & Reset Controller Binding
-----------------------------------------------

Required properties :
- compatible : shall contain "qcom,sdm845-videocc", "qcom,videocc-kona",
		"qcom,videocc-kona-v2", "qcom,lito-videocc" or
		"qcom,lagoon-videocc"
- reg : shall contain base register location and length
- clock-names : Shall contain "cfg_ahb_clk"
- clocks : phandle + clock reference to the GCC AHB clock.

- #clock-cells : from common clock binding, shall contain 1.
- #power-domain-cells : from generic power domain binding, shall contain 1.

Required properties (kona only):
- vdd_mm-supply : phandle of the voltage regulator supplying the logic rail
- vdd_mx-supply : phandle of the voltage regulator supplying the memory rail

Optional properties :
- #reset-cells : from common reset binding, shall contain 1.
- nvmem-cells: list of phandle to the nvmem data cells.
- nvmem-cell-names: names for the each nvmem-cells specified.

Example:
	videocc: clock-controller@ab00000 {
		compatible = "qcom,sdm845-videocc";
		reg = <0xab00000 0x10000>;
		#clock-cells = <1>;
		#power-domain-cells = <1>;
		};

Example with vdd mm/mx supply:
	clock_videocc: qcom,videocc@abf0000 {
		compatible = "qcom,videocc-kona";
		reg = <0xabf0000 0x10000>;
		reg-names = "cc_base";
		vdd_mm-supply = <&pm8150a_s5_level>;
		vdd_mx-supply = <&pm8150a_s5_level>;
		clock-names = "cfg_ahb_clk";
		clocks = <&clock_gcc GCC_VIDEO_AHB_CLK>;
		#clock-cells = <1>;
		#reset-cells = <1>;
	};
```

## Documentation/devicetree/bindings/clock/qcom,virt.txt
```
Qualcomm Technologies, Inc. Virtual Clocks

Required properties:
- compatible:	Shall contain one of the following:
		"qcom,virt-clk-sm8150-gcc",
		"qcom,virt-clk-sm8150-scc",
		"qcom,virt-clk-sm6150-gcc",
		"qcom,virt-clk-sm6150-scc".

- #clock-cells:	Shall contain 1.
- #reset-cells:	Shall contain 1.

Example:
	qcom,virtclk {
		compatible = "qcom,virt-clk-sm8150-gcc";
		#clock-cells = <1>;
		#reset-cells = <1>;
	};
```

## Documentation/devicetree/bindings/clock/qcom,virtclk-front.txt
```
QTI Virtual Clock Frontend Binding
------------------------------------------------

Required properties :
- compatible : shall contain:
		"qcom,virtclk-frontend-8996"

- #clock-cells : shall contain 1
- #reset-cells : shall contain 1

Example:
	virtclk-frontend@0 {
		compatible = "qcom,virtclk-frontend-8996";
		#clock-cells = <1>;
		#reset-cells = <1>;
	};
```

## Documentation/devicetree/bindings/clock/sprd,ums512-clk.yaml
```yaml
# SPDX-License-Identifier: (GPL-2.0-only OR BSD-2-Clause)
# Copyright 2019 Unisoc Inc.
%YAML 1.2
---
$id: "http://devicetree.org/schemas/clock/sprd,ums512-clk.yaml#"
$schema: "http://devicetree.org/meta-schemas/core.yaml#"

title: UMS512 Clock Control Unit Device Tree Bindings

maintainers:
  - Orson Zhai <orsonzhai@gmail.com>
  - Baolin Wang <baolin.wang7@gmail.com>
  - Chunyan Zhang <zhang.lyra@gmail.com>

properties:
  "#clock-cells":
    const: 1

  compatible:
    enum:
      - sprd,ums512-apahb-gate
      - sprd,ums512-ap-clk
      - sprd,ums512-aonapb-clk
      - sprd,ums512-pmu-gate
      - sprd,ums512-g0-pll
      - sprd,ums512-g2-pll
      - sprd,ums512-g3-pll
      - sprd,ums512-gc-pll
      - sprd,ums512-aon-gate
      - sprd,ums512-audcpapb-gate
      - sprd,ums512-audcpahb-gate
      - sprd,ums512-gpu-clk
      - sprd,ums512-mm-clk
      - sprd,ums512-mm-gate-clk
      - sprd,ums512-apapb-gate

  clocks:
    minItems: 1
    maxItems: 4
    description: |
      The input parent clock(s) phandle for this clock, only list fixed
      clocks which are declared in devicetree.

  clock-names:
    minItems: 1
    maxItems: 4
    items:
      - const: ext-26m
      - const: ext-32k
      - const: ext-4m
      - const: rco-100m

  reg:
    maxItems: 1

required:
  - compatible
  - '#clock-cells'

if:
  properties:
    compatible:
      enum:
      - sprd,ums512-ap-clk
      - sprd,ums512-aonapb-clk
      - sprd,ums512-mm-clk
then:
  required:
    - reg

else:
  description: |
    Other UMS512 clock nodes should be the child of a syscon node in
    which compatible string should be:
            "sprd,ums512-glbregs", "syscon", "simple-mfd"

    The 'reg' property for the clock node is also required if there is a sub
    range of registers for the clocks.

additionalProperties: false

examples:
  - |
    ap_clk: clock-controller@20200000 {
      compatible = "sprd,ums512-ap-clk";
      reg = <0x20200000 0x1000>;
      clocks = <&ext_26m>;
      clock-names = "ext-26m";
      #clock-cells = <1>;
    };

  - |
    ap_apb_regs: syscon@71000000 {
      compatible = "sprd,ums512-glbregs", "syscon", "simple-mfd";
      reg = <0x71000000 0x3000>;
      #address-cells = <1>;
      #size-cells = <1>;
      ranges = <0 0x71000000 0x3000>;

      apahb_gate: apahb-gate@0 {
        compatible = "sprd,ums512-apahb-gate";
        reg = <0x0 0x2000>;
        #clock-cells = <1>;
      };
    };
...
```

## Documentation/devicetree/bindings/cnss/cnss-sdio-wlan.txt
```
* Qualcomm Connectivity SubSystem Platform Driver

This platform driver adds support for the CNSS subsystem used for SDIO
based Wi-Fi devices. It also adds support to manage two 1.8V voltage
regulators and WLAN power enable 3.3V regulators. The main purpose of this
device tree entry below is to invoke the CNSS SDIO platform driver
and provide handle to the WLAN power enable 3.3V pmic GPIO and two 1.8V
PMIC voltage regulator resources.

Required properties:
  - compatible: "qcom,cnss_sdio"
  - reg: memory resource to save firmware dump, optional.
  - reg-names: memory resource name.
  - subsys-name: cnss sdio subsytem device name, required.
  - vdd-wlan-supply: phandle to the WLAN vdd regulator device tree node.
  - vdd-wlan-dsrc-supply: phandle to the WLAN dsrc vdd regulator device tree node.
  - vdd-wlan-io-supply: phandle to the WLAN IO regulator device tree node.
  - vdd-wlan-xtal-supply: phandle to the WLAM XTAL regulator device tree node.

Optional properties:
  - pinctrl-names: Names corresponding to the numbered pinctrl states
  - pinctrl-<n>: Pinctrl states as described in
                bindings/pinctrl/pinctrl-bindings.txt
  - qcom,is-antenna-shared: Enabled for Platforms with both sdio and pcie QCA
                           Chipsets are attached.
  - qcom,cnss-enable-bus-bandwidth: Boolean - Define this property when target
					support to vote for bus bandwidth.
  - qcom,msm-bus,name: client name for msm bus register.
  - qcom,msm-bus,num-cases: number of cases for bus scaling.
  - qcom,msm-bus,num-paths: number of paths for bus scale vector.
  - qcom,msm-bus,vectors-KBps: bus scale vector table.
  - qcom,skip-wlan-en-toggle: Boolean property to be enabled for platforms where
                           wlan_en toggling is not supported.
Example:
	qcom,cnss-sdio {
		compatible = "qcom,cnss_sdio";
		reg = <0x87a00000, 0x200000>;
		reg-names = "ramdump";
		subsys-name = "AR6320";
		vdd-wlan-supply = <&rome_vreg>;
		vdd-wlan-dsrc-supply = <&sdcard_ext_vreg>;
		vdd-wlan-io-supply = <&mdm9607_l11>;
		vdd-wlan-xtal-supply = <&mdm9607_l2>;
		qcom,is-antenna-shared;
		pinctrl-names = "active", "sleep";
		pinctrl-0 = <&cnss_sdio_active>;
		pinctrl-1 = <&cnss_sdio_sleep>;
		qcom,cnss-enable-bus-bandwidth;
		qcom,msm-bus,name = "msm-cnss";
		qcom,msm-bus,num-cases = <4>;
		qcom,msm-bus,num-paths = <1>;
		qcom,msm-bus,vectors-KBps =
				<79 512 0 0>,			/* No vote */
				<79 512 6250 200000>,		/* 50 Mbps */
				<79 512 25000 200000>,		/* 200 Mbps */
				<79 512 2048000 4096000>;	/* MAX */
	};
```

## Documentation/devicetree/bindings/cnss/cnss-wlan.txt
```
* Qualcomm Technologies, Inc. ConNectivity SubSystem Platform Driver

This platform driver adds support for the CNSS subsystem used for PCIe
based Wi-Fi devices. It also adds support to integrate PCIe WLAN module
to subsystem restart framework. Apart from that, it also manages the
3.3V voltage regulator, WLAN Enable GPIO signal and PCIe link dynamically
with support for suspend and resume by retaining the PCI config space
states when PCIe link is shutdown. The main purpose of this device tree
entry below is to invoke the CNSS platform driver and provide handle to
the WLAN enable GPIO, 3.3V fixed voltage regulator resources. It also
provides the reserved RAM dump memory location and size.

Required properties:
  - compatible: "qcom,cnss" for QCA6174 device
                "qcom,cnss-qca6290" for QCA6290 device
                "qcom,cnss-qca6390" for QCA6390 device
                "qcom,cnss-qca-converged" for converged QCA devices
  - wlan-en-gpio: WLAN_EN GPIO signal specified by the chip specifications
  - vdd-wlan-supply: phandle to the regulator device tree node
  - pinctrl-names: Names corresponding to the numbered pinctrl states
  - pinctrl-<n>: Pinctrl states as described in
                 bindings/pinctrl/pinctrl-bindings.txt
  - qcom,wlan-rc-num: PCIe root complex number which WLAN chip is attached to

Optional properties:
  - qcom,notify-modem-status: Boolean property to decide whether modem
                              notification should be enabled or not in this
                              platform
  - wlan-soc-swreg-supply: phandle to the external 1.15V regulator for QCA6174
  - wlan-ant-switch-supply: phandle to the 2.7V regulator for the antenna
                            switch of QCA6174
  - qcom,wlan-uart-access: Boolean property to decide whether QCA6174
                           has exclusive access to UART.
  - vdd-wlan-io-supply: phandle to the 1.8V IO regulator for QCA6174
  - vdd-wlan-xtal-supply: phandle to the 1.8V XTAL regulator for QCA6174
  - vdd-wlan-xtal-aon-supply: phandle to the LDO-4 regulator. This is needed
                              on platforms where XTAL regulator depends on
                              always on regulator in VDDmin.
  - vdd-wlan-ctrl1-supply: phandle to the DBU1 - 1.8V for QCA6595 or 3.3V for
                           QCA6174 on auto platform.
  - vdd-wlan-ctrl2-supply: phandle to the DBU4 - 2.2V for QCA6595 or 3.85V for
                           QCA6696 on auto platform.
  - vdd-wlan-core-supply: phandle to the 1.3V CORE regulator for QCA6174
  - vdd-wlan-sp2t-supply: phandle to the 2.7V SP2T regulator for QCA6174
  - qcom,smmu-s1-enable: Boolean property to decide whether to enable SMMU
                         S1 stage or not
  - qcom,wlan-smmu-iova-address: I/O virtual address range as <start length>
                                 format to be used for allocations associated
                                 between WLAN/PCIe and SMMU
  - qcom,wlan-ramdump-dynamic: To enable CNSS RAMDUMP collection
                               by providing the size of CNSS DUMP
  - reg: Memory regions defined as starting address and size
  - reg-names: Names of the memory regions defined in reg entry
  - wlan-bootstrap-gpio: WLAN_BOOTSTRAP GPIO signal specified by QCA6174
                         which should be drived depending on platforms
  - qcom,is-dual-wifi-enabled: Boolean property to control wlan enable(wlan-en)
                               gpio on dual-wifi platforms.
  - vdd-wlan-en-supply: WLAN_EN fixed regulator specified by QCA6174
                        specifications.
  - qcom,wlan-en-vreg-support: Boolean property to decide the whether the
                               WLAN_EN pin is a gpio or fixed regulator.
  - qcom,mhi: phandle to indicate the device which needs MHI support.
  - qcom,cap-tsf-gpio: WLAN_TSF_CAPTURED GPIO signal specified by the chip
                       specifications, should be drived depending on products.
  - cnss-daemon-support: Boolean property to decide whether cnss_daemon
                         userspace QMI client is supported.
  - qcom,converged-dt: Boolean property to decide whether it supports multiple
                       chips.
  - qcom,bus-type: U32 property to specify the bus type, is required when
                   'qcom,converged-dt' being present.
  - wlan_vregs: String array to decide which vregs are required, is required
                when 'qcom,converged-dt' being present.
  - <supply-name>-supply: phandle to the regulator device tree node.
                          optional "supply-name" is "vdd-wlan-rfa".
  - qcom,<supply-name>-info: Specifies configuration for supply. Should be
                             specified in <min_uV max_uV load_uA delay_us>.
  - pcie-disable-l1: Boolean property to decide whether to disable PCIe L1 PM.
  - pcie-disable-l1ss: Boolean property to decide whether to disable PCIe L1ss.
  - qcom,set-wlaon-pwr-ctrl: Boolean property to indicate if set
                             WLAON_QFPROM_PWR_CTRL_REG register during power on
                             and off sequences.

List of chip specific sub nodes:
  - chip_cfg@X: represent chip specific configurations
    Each sub node has the following required properties:
       - wlan_vregs: String array to decide which vregs are required, property
                     being present but no values means no additional vregs.
       - supported-ids: U32 array to decide which device ids are supported by
                        sub node.

Example:

    qcom,cnss@0d400000 {
        compatible = "qcom,cnss";
        reg = <0x0d400000 0x200000>;
        reg-names = "ramdump";
        qcom,wlan-ramdump-dynamic = <0x200000>;
        wlan-en-gpio = <&msmgpio 82 0>;
        vdd-wlan-supply = <&wlan_vreg>;
        qcom,notify-modem-status;
        wlan-soc-swreg-supply = <&pma8084_l27>;
        pinctrl-names = "default";
        pinctrl-0 = <&cnss_default>;
        qcom,wlan-rc-num = <0>;
        qcom,wlan-smmu-iova-address = <0 0x10000000>;
        qcom,mhi = <&mhi_wlan>;
        qcom,cap-tsf-gpio = <&tlmm 126 1>;
    };

    qcom,cnss-qca-converged {
        compatible = "qcom,cnss-qca-converged";
        qcom,converged-dt;
        qcom,bus-type=<0>;

        vdd-wlan-ctrl1-supply = <&vreg_conn_pa>;
        vdd-wlan-ctrl2-supply = <&vreg_conn_1p8>;
        vdd-wlan-supply = <&vreg_wlan>;
        wlan_vregs = "vdd-wlan-ctrl1", "vdd-wlan-ctrl2";
        qcom,vdd-wlan-ctrl1-info = <0 0 0 0>;
        qcom,vdd-wlan-ctrl2-info = <0 0 0 0>;
        wlan-en-gpio = <&tlmm 169 0>;
        pinctrl-names = "wlan_en_active", "wlan_en_sleep";
        pinctrl-0 = <&cnss_wlan_en_active>;
        pinctrl-1 = <&cnss_wlan_en_sleep>;
        qcom,wlan-rc-num = <0>;

        chip_cfg@1 {
                supported-ids = <0x003e>;
                wlan_vregs = "vdd-wlan";
                qcom,vdd-wlan-info = <0 0 0 10>;
        };
    };
```
