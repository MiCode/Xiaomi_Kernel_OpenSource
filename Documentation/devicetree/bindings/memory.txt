## Documentation/devicetree/bindings/mhi/msm_mhi.txt
```
MSM MHI

MSM MHI enables communication with a device over a PCIe link using the
Modem Host Interface protocol. The bindings referred to below, enable
the correct configuration of the interface and required sideband
signals.

==============
Node Structure
==============

Main node properties:

- compatible
  Usage: required
  Value type: <string>
  Definition: "qcom,mhi"

- qcom,pci-dev_id
  Usage: required
  Value type: <u32>
  Definition: Device id reported by modem

- qcom,pci-domain
  Usage: required
  Value type: <u32>
  Definition: PCIE root complex device connected to

- qcom,pci-bus
  Usage: required
  Value type: <u32>
  Definition: PCIE bus device connected to

- qcom,pci-slot
  Usage: required
  Value type: <u32>
  Definition: PCIE slot (dev_id/function) device connected to

- esoc-names
  Usage: optional
  Value type: <string>
  Definition: esoc name for the device

- esoc-0
  Usage: required if "esoc-names" is defined
  Value type: phandle
  Definition: A phandle pointing to the esoc node.

- qcom,msm-bus,name
  Usage: required if MHI is bus master
  Value type: string
  Definition: string representing the client name

- qcom,msm-bus,num-cases
  Usage: required if MHI is bus master
  Value type: <u32>
  Definition: Number of use cases MHI support.  Must be set to 2.

- qcom,msm-bus,num-paths
  Usage: required if MHI is bus master
  Value type: <u32>
  Definition: Total number of master-slave pairs.  Must be set to one.

- qcom,msm-bus,vectors-KBps
  Usage: required if MHI is bus master
  Value type: Array of <u32>
  Definition: Array of tuples which define the bus bandwidth requirements.
	Each tuple is of length 4, values are master-id, slave-id,
	arbitrated bandwidth in KBps, and instantaneous bandwidth in
	KBps.

- mhi-chan-cfg-#
  Usage: required
  Value type: Array of <u32>
  Definition: mhi channel configuration parameters for platform
	defined as below <A B C D>:
		A = chan number
		B = maximum descriptors
		C = event ring associated with channel
		D = flags defined by mhi_macros.h GET_CHAN_PROPS

- mhi-event-rings
  Usage: required
  Value type: <u32>
  Definition: Number of event rings device support

- mhi-event-cfg-#
  Usage: required
  Value type: Array of <u32>
  Definition: mhi event ring configuration parameters for platform
	defined as below <A B C D E F>:
		A = maximum event descriptors
		B = MSI associated with event
		C = interrupt moderation (see MHI specification)
		D = Associated channel
		E = priority of the event ring. 0 being the highest.
		F = flags defined by mhi_macros.h GET_EV_PROPS

- qcom,mhi-address-window
  Usage: required
  Value type: Array of <u64>
  Definition: start DDR address and ending DDR address device can access.

- qcom,mhi-manage-boot
  Usage: optional
  Value type: bool
  Definition: Determine whether MHI host manages firmware download to device.

- qcom,mhi-fw-image
  Usage: required if MHI host managing firmware download process
  Value type: string
  Definition: firmware image name

- qcom,mhi-max-sbl
  Usage: required if MHI host managing firmware download process
  Value type: <u32>
  Definition: Maximum size in bytes SBL image device support.

- qcom,mhi-sg-size
  Usage: required if MHI host managing firmware download process
  Value type: <u32>
  Definition: Segment size in bytes for each segment in bytes.

- qcom,mhi-bb-required
  Usage: optional
  Value type: bool
  Definition: Determine whether MHI device require bounce buffer
	during active transfer.  If true, during channel open host
	will pre-allocate transfer buffers.

========
Example:
========
mhi: qcom,mhi {
	compatible = "qcom,mhi";
	qcom,pci-dev_id = <0x0301>;
	qcom,pci-domain = <2>;
	qcom,pci-bus = <4>;
	qcom,pci-slot = <0>;
	qcom,mhi-address-window = <0x0 0x80000000 0x0 0xbfffffff>;
	esoc-names = "mdm";
	esoc-0 = <&mdm1>;
	qcom,msm-bus,name = "mhi";
	qcom,msm-bus,num-cases = <2>;
	qcom,msm-bus,num-paths = <1>;
	qcom,msm-bus,vectors-KBps =
			<100 512 0 0>,
			<100 512 1200000000 1200000000>;
	mhi-event-rings = <1>;
	mhi-chan-cfg-102 = <0x66 0x80 0x5 0x62>;
	mhi-event-cfg-0 = <0x80 0x0 0x0 0x0 0 1 0x11>;
};
```

## Documentation/devicetree/bindings/mhi/msm_mhi_dev.txt
```
MSM MHI DEV

MSM MHI DEV enables communication with the host over a PCIe link using the
Modem Host Interface protocol. The driver interfaces with the IPA for
enabling the HW acceleration channel path and provides interface for
software channels to communicate between Host and device.

Required properties:
  - compatible: should be "qcom,msm-mhi-dev" for MHI device driver.
  - reg: MHI MMIO physical register space.
  - reg-names: resource names used for the MHI MMIO physical address region,
	       IPA uC command and event ring doorbell mail box address.
	       Should be "mhi_mmio_base" for MHI MMIO physical address,
	       "ipa_uc_mbox_crdb" for IPA uC Command Ring doorbell,
	       "ipa_uc_mbox_erdb" for IPA uC Event Ring doorbell passed to
	       the IPA driver.
  - qcom,mhi-ifc-id: ID of HW interface via which MHI on device side
		communicates with host side.
  - qcom,mhi-ep-msi: End point MSI number.
  - qcom,mhi-version: MHI specification version supported by the device.

Example:

	mhi: qcom,msm-mhi-dev {
		compatible = "qcom,msm-mhi-dev";
		reg = <0xfc527000 0x1000>,
		     <0xfd4fa000 0x1>,
		     <0xfd4fa080 0x1>;
		reg-names = "mhi_mmio_base", "ipa_uc_mbox_crdb",
			    "ipa_uc_mbox_erdb";
		qcom,mhi-ifc-id = <0x030017cb>;
		qcom,mhi-ep-msi = <1>;
		qcom,mhi-version = <0x1000000>;
	};
```

## Documentation/devicetree/bindings/microtrust/microtrust,tz-log.txt
```
Microtrust TEEI Feature

Required properties
        - compatible: Should be "microtrust,tz-log.txt"
        - interrupts: teei interrupt number and property

Example:
        utos {
                compatible = "microtrust,tz-log";
                interrupts = <GIC_SPI 242 IRQ_TYPE_EDGE_RISING>,
                        <GIC_SPI 243 IRQ_TYPE_EDGE_RISING>;
        };
```

## Documentation/devicetree/bindings/microtrust/microtrust,utos.txt
```
Microtrust TEEI Feature

Required properties
        - compatible: Should be "microtrust,utos.txt"
        - interrupts: teei interrupt number and property

Example:
        utos {
                compatible = "microtrust,utos";
                interrupts = <GIC_SPI 242 IRQ_TYPE_EDGE_RISING>,
                        <GIC_SPI 243 IRQ_TYPE_EDGE_RISING>;
        };
```

## Documentation/devicetree/bindings/misc/access_ramoops.txt
```
access_ramoops driver
=====================

The access_ramoops driver allows userspace access to the persistent RAM storage
used for oops and panics as well as the metadata required to decrypt that data.

Required properties:

- compatible: must be "access_ramoops"

- memory-region: phandle to a region of memory that is preserved between reboots

- label: name of the region, will be used to create the device node /dev/<label>
```

## Documentation/devicetree/bindings/misc/adsp-shmem-device.txt
```
ADSP shared memory device driver for ADSP fast boot camera

Required properties:
-  memory-region : start address and size of the shared memory region

Example:
	qcom,adsp {
		status = "ok";
		compatible = "adsp-shmem-device";
		memory-region = <&adsp_shmem_device_mem>;
		};
```

## Documentation/devicetree/bindings/misc/apq8084_dock.txt
```
QTI APQ8084 Docking Station

This device describes the interface used when connecting to the
Docking Station's USB hub and Ethernet ports. The interface
consists of GPIOs used for controlling the main power supply
and reset lines.

Required properties:
 - compatible: Should be "qcom,apq8084-dock"
 - qcom,dock-detect-gpio: phandle to a GPIO node corresponding to the input
                         signal indicating when the dock is connected
 - qcom,dock-enable-gpio: phandle to a GPIO node corresponding to the output
                         signal that turns on/off power to the ports
 - qcom,dock-hub-reset-gpio: phandle to a GPIO node corresponding to the output
                            signal that resets the USB ports
 - qcom,dock-eth-reset-gpio: phandle to a GPIO node corresponding to the output
                            signal that resets the Ethernet ports
 - qcom,usb-host: phandle to the USB host controller connected to the dock port
```

## Documentation/devicetree/bindings/misc/at24.txt
```
EEPROMs (IIC) compatible with Atmel at24.

Required properties:
- compatible : "atmel,24c32".
- reg: Should contain registers location

Additional compatible properties are also allowed.

Example:
	at24@51 {
		compatible = "atmel,24c32";
		reg = <0x51>;
	};
```

## Documentation/devicetree/bindings/misc/ci_bridge_spi.txt
```
CI (CAM) Bridge Over SPI

Required properties:

- compatible: "smartv,cimax"
- reg: SPI chip-select
- spi-max-frequency: Max allowed frequency of SPI interface
- smartv,cimax-int-gpio: CIMax interrupt gpio pin
- smartv,cimax-rst-gpio: CIMax reset gpio pin

Example:

	spi@f9923000 {
	   ci-bridge-spi@0 {
			compatible = "smartv,cimax";
			reg = <0>;
			spi-max-frequency = <15000000>;
			smartv,cimax-int-gpio = <&msmgpio 133 0>;
			smartv,cimax-rst-gpio = <&ioexp_gpios 5 0>;
	   };
	};
```

## Documentation/devicetree/bindings/misc/fpc,fpc1028.txt
```
Fingerprint Cards AB. Fpc1028 driver

The fpc1028 fingerprint sensor is connected to the host processor via SPI.
The sensor will generates interrupts when the user touches the sensor.
The host controller is expected to read data over SPI and pass the data to
the rest of the system.

This binding document describes the properties for this module.

Properties:

- compatible
  Usage:      required
  Value type: <string>
  Definition: It must be "fpc,fpc1020"

- interrupts
  Usage:      required
  Value type: <prop-encoded-array>
  Definition: Peripheral interrupt specifier.

- interrupt-parent
  Usage:      required
  Value type: <phandle>
  Definition: phandle of the interrupt controller which services the
  summary interrupt.

- fpc,gpio_rst
  Usage:      required
  Value type: <prop-encoded-array>
  Definition: GPIO which connecting to the reset pin of fpc1028

- fpc,gpio_irq
  Usage:      required
  Value type: <prop-encoded-array>
  Definition: Specifies the GPIO which connecting to the irq pin of fpc1028.

- vcc_spi-supply
  Usage:      required
  Value type: <phandle>
  Definition: The phandle of the regulator which supplies fpc1028 spi bus core.

- vcc_io-supply
  Usage:      required
  Value type: <phandle>
  Definition: The phandle of the regulator which supplies fpc1028 io pins.

- vcc_ana-supply
  Usage:      required
  Value type: <phandle>
  Definition: The phandle of the regulator which supplies fpc1028 analog circuit.

- pinctrl-names:
  Usage:      required
  Value type: <string>
  Definition: Pinctrl state names for each pin group configuration.
  eg:"fpc1020_reset_reset", "fpc1020_reset_active", "fpc1020_irq_active".
  refer to "Documentation/devicetree/bindings/pinctrl/pinctrl-bindings.txt"

- pinctrl-n:
  Usage:      required
  Value type: <string>
  Definition: pinctrl state for each pin group
  refer to "Documentation/devicetree/bindings/pinctrl/pinctrl-bindings.txt"


Example:

	fpc1020 {
			compatible = "fpc,fpc1020";
			interrupt-parent = <&tlmm>;
			interrupts = <48 0>;
			fpc,gpio_rst = <&tlmm 124 0x0>;
			fpc,gpio_irq = <&tlmm 48 0>;
			vcc_spi-supply = <&pm8953_l5>;
			vdd_io-supply  = <&pm8953_l5>;
			vdd_ana-supply = <&pm8953_l5>;
			fpc,enable-on-boot;
			pinctrl-names = "fpc1020_reset_reset",
					"fpc1020_reset_active",
					"fpc1020_irq_active";
			pinctrl-0 = <&msm_gpio_124>;
			pinctrl-1 = <&msm_gpio_124_output_high>;
			pinctrl-2 = <&msm_gpio_48>;
		};
```

## Documentation/devicetree/bindings/misc/hisilicon-hikey-usb.txt
```
Support usb hub and usb data role switch of Hisilicon HiKey960 Board.

-----------------------------

Required properties:
- compatible: "hisilicon,gpio_hubv1"
- typec-vbus-gpios: gpio to control the vbus of typeC port
- otg-switch-gpios: gpio to switch DP & DM between the hub and typeC port
- hub-vdd33-en-gpios: gpio to enable the power of hub
- pinctrl-names: pin configuration state name ("default")
- pinctrl-0: pinctrl config
- usb-role-switch: flags the driver as a role switch provider
- ports: two endpoints to connect the usb core role switch provider
	 to the usb-c tcpm driver.

Example
-----
	hisi_hikey_usb: hisi_hikey_usb {
		compatible = "hisilicon,gpio_hubv1";
		typec-vbus-gpios = <&gpio25 2 GPIO_ACTIVE_HIGH>;
		otg-switch-gpios = <&gpio25 6 GPIO_ACTIVE_HIGH>;
		hub-vdd33-en-gpios = <&gpio5 6 GPIO_ACTIVE_HIGH>;
		pinctrl-names = "default";
		pinctrl-0 = <&usbhub5734_pmx_func>;
		usb-role-switch;

		port {
			#address-cells = <1>;
			#size-cells = <0>;

			hikey_usb_ep0: endpoint@0 {
				reg = <0>;
				remote-endpoint = <&dwc3_role_switch>;
			};
			hikey_usb_ep1: endpoint@1 {
				reg = <1>;
				remote-endpoint = <&rt1711h_ep>;
			};
		};
	};
```

## Documentation/devicetree/bindings/misc/isa1200.txt
```
Imagis ISA1200 Haptics Vibrator

Required properties:
 - reg:	slave address of bus
 - compatible: should be "imagis,isa1200"
 - label: name for vibrator directory
 - imagis,hap-en-gpio: haptic enable gpio
 - imagis,mode-ctrl: mode of the controller, 0 = POWER_DOWN_MODE,
	1 = PWM_INPUT_MODE, 2 = PWM_GEN_MODE, 3 = WAVE_GEN_MODE
 - imagis,max-timeout: maximum timeout for vibration
 - imagis,chip-en: chip enable
 - vcc_i2c-supply: regulator supplying i2c bus

Regulator described as a child of the main device:
 - regulator-name: A string used as a descriptive name for regulator outputs,
	should match vcc_i2c above
 - regulator-min-microvolt: smallest voltage consumers may set
 - regulator-max-microvolt: largest voltage consumers may set
 - regulator-max-microamp: largest current consumers may set

Optional properties:
 - imagis,smart-en: automatically control haptic power based on pwm/clk signal
 - imagis,is-erm: controlled by dc motor, use ERM driving method
 - imagis,overdrive-high: overdrive high
 - imagis,overdrive-en: enable overdrive
 - imagis,pwm-freq: pwm frequency (hZ)
 - imagis,pwm-ch-id: pwm channel id
 - imagis,pwm-div: pwm division to be used for vibration
 - imagis,need-pwm-clk: use "pwm_clk"
 - imagis,hap-len-gpio: haptic ldo enable gpio
 - imagis,etc-clk-en: use external clock
 - xyz-supply: to be used if additional regulators are require beyond
		"imagis,regulator" above

Any additional regulators are described as child nodes of main device:
 - regulator-name: A string used as a descriptive name for regulator outputs,
	should match supply "xyz"
 - regulator-min-microvolt: smallest voltage consumers may set
 - regulator-max-microvolt: largest voltage consumers may set
 - regulator-max-microamp: largest current consumers may set

Example:
	i2c@f9967000 {
		isa1200@48 {
			status = "okay";
			reg = <0x48>;
			vcc_i2c-supply = <&pm8941_s3>;
			compatible = "imagis,isa1200";
			label = "vibrator";
			imagis,chip-en;
			imagis,smart-en;
			imagis,need-pwm-clk;
			imagis,ext-clk-en;
			imagis,hap-en-gpio = <&msmgpio 86 0x00>;
			imagis,max-timeout = <15000>;
			imagis,pwm-div = <256>;
			imagis,mode-ctrl = <2>;
			imagis,regulator {
				regulator-name = "vcc_i2c";
				regulator-min-microvolt = <1800000>;
				regulator-max-microvolt = <1800000>;
				regulator-max-microamp = <9360>;
			};
		};
	};
```

## Documentation/devicetree/bindings/misc/maxim-xrfancontroller.txt
```
MAXIM-FANCONTROLLER provides a way to configure maxim-fanconroller driver.

Required properties:
- compatible : should be "maxim,xrfancontroller"

Optional properties:
Example:
	xrfancontroller {
		compatible = "maxim,xrfancontroller";
	};
```
