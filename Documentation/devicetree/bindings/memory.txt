## Documentation/devicetree/bindings/misc/mcu_time_sync.txt
```
MCU time sync driver is used for communicating with customer board, it using GPIO to trigger customer board. At the same time, to record currenct cpu time.


Required properties:
 - compatible        : Should be "qcom,mcu-time-sync".
 - qcom,mcu-link-gpio : the conenct gpio.

Example:
	qcom,mcu_time_sync {
		compatible = "qcom,mcu-time-sync";
		qcom,mcu-link-gpio = <&msm_gpio 90 1>;
	};
```

## Documentation/devicetree/bindings/misc/mediatek,dramc.txt
```
Mediatek SoC system dramc

Required properties:
- compatible : Should be "mediatek,dramc"
- reg: Should contain dramc registers location and length

Examples:

		dramc_conf@10004000 {
			compatible = "mediatek,dramc";
			reg = <0x10004000 0x1000>;
		};
```

## Documentation/devicetree/bindings/misc/mediatek,dvfsp.txt
```
MediaTek CPU DVFS Processor (DVFSP)


Required properties:

	- compatible: "mediatek,<soc>-dvfsp"
	- reg: (1) DVFSP register base and size
	       (2) Debug SRAM base and size
	- interrupts: DVFSP interrupt number and property
	- clocks, clock-names: I2C clock for external buck


Example:

	dvfsp@10227000 {
		compatible = "mediatek,mt6755-dvfsp";
		reg = <0x10227000 0x1000>,
		      <0x0011c000 0xf80>;
		interrupts = <GIC_SPI 152 IRQ_TYPE_LEVEL_LOW>;
		clocks = <&infrasys INFRA_I2C3>;
		clock-names = "i2c";
	};
```

## Documentation/devicetree/bindings/misc/mediatek,pmic_clock_buffer.txt
```
Mediatek PMIC Clock Buffer

Required properties:
- compatible: must be set to "mediatek,pmic_clock_buffer"
- mediatek,clkbuf-quantity: specify the quantity of clkbuf
- mediatek,clkbuf-config: the config of clkbuf type
	- 0: disable
	- 1: software control mode
	- 2: hardware control mode
- mediatek,clkbuf-driving-current: the driving current of clkbuf
	- 0: 0.4mA (loading: <10pF)
	- 1: 0.9mA (loading: 10~20pF, if PCB meet constraint)
	- 2: 1.4mA (loading: 20~30pF, default)
	- 3: 1.9mA (loading: >30pF)

Example:
	pmic_clock_buffer {
		compatible = "mediatek,pmic_clock_buffer";
		mediatek,clkbuf-quantity = <4>;
		mediatek,clkbuf-config = <2 1 1 2>;
		mediatek,clkbuf-driving-current = <2 2 2 2>;
	};
```

## Documentation/devicetree/bindings/misc/mediatek-md32.txt
```
* Mediatek MD32

MD32 is a tiny processor sub-system. MD32 integrated with peripherals is
designed to handle specific tasks for base-band SoC, such as Sensor HUB.

Required properties:
  - compatible: "mediatek,mt8163-md32"
  - reg: physical base address of the md32 sram, md32 register and md32 clock control,
    length of memory mapped region, 0x38000, 0x400 and 0x400 respectively.
  - interrupts: interrupt number to the cpu.
  - clocks : clock name from clock manager
  - clock-names: the clock of MD32 system

Example:
	md32@10020000 {
		compatible = "mediatek,mt8163-md32";
		reg = <0 0x10020000 0 0x38000>,
		      <0 0x10058000 0 0x400>,
		      <0 0x10059000 0 0x400>;
		interrupts = <GIC_SPI 174 IRQ_TYPE_LEVEL_HIGH>;
		clocks = <&infracfg CLK_INFRA_SCPSYS>;
		clock-names = "sys";
	};
```

## Documentation/devicetree/bindings/misc/qcom-liquid-dock.txt
```
QTI LiQUID Docking Station

This device describes the interface used when connecting a Qualcomm
Technology LiQUID Mobile Development Platform to its docking station.
This particular device describe's the dock's USB hub and Ethernet ports.
The interface consists of GPIOs used for controlling the main power
supply and reset lines.

Required properties:
 - compatible: Should be "qcom,liquid-dock". "qcom,apq8084-dock" is
	       also supported but deprecated.
 - qcom,dock-detect-gpio: phandle to a GPIO node corresponding to the input
                         signal indicating when the dock is connected
 - qcom,dock-enable-gpio: phandle to a GPIO node corresponding to the output
                         signal that turns on/off power to the ports
 - qcom,dock-hub-reset-gpio: phandle to a GPIO node corresponding to the output
                            signal that resets the USB ports
 - qcom,dock-eth-reset-gpio: phandle to a GPIO node corresponding to the output
                            signal that resets the Ethernet ports
 - qcom,usb-host: phandle to the USB host controller connected to the dock port
```

## Documentation/devicetree/bindings/misc/qfp-fuse.txt
```
* QFP-FUSE

The qfp-fuse entry specifies the memory mapped addresses for the QFPROM fuse
registers. The qfpfuse driver uses these to provide api(s) that can be used
to read and write the fuse values. The write operation can be done one time
only.

Required Properties:
compatible: component name used for driver matching, should be "qcom,qfp-fuse"
reg: physical base address and length of the register set

Optional Properties:
- qcom,blow-status-offset: offset of the blow status registers.
  The default offset is 0x204C. Include this only if the blow status register
  is at the different offset.
- qcom,blow-timer: blow timer value.
  The value specifies the blow time in number of blow timer clock cycles.
  The default setting is 0xF0. It meets the requirement for 28nm HPm fuse
  technology with blow timer clock at 19.2Mhz (12us blow time).
  Specify this only if the fuse blow time is different. The following are the
  recommended settings:
  - 0x280 (10us) for 45nm LP technology with 64Mhz blow timer clock
  - 0x100 (4us)  for 28nm LP technology with 64Mhz blow timer clock
  - 0x1E  (12us) for 28nm LP technology with 2.5Mhz blow timer clock

Example:
	qcom,qfpfuse@fc4b8000 {
		compatible = "qcom,qfp-fuse";
		reg = <0xfc4b8000 0x7000>;
		qcom,blow-status-offset = 0x204c;
	};
```

## Documentation/devicetree/bindings/misc/qpnp-misc.txt
```
QPNP-MISC

QPNP-MISC provides a way to read the PMIC part number and revision.

Required properties:
- compatible : should be "qcom,qpnp-misc"
- reg : offset and length of the PMIC peripheral register map.

Optional properties:
- qcom,pwm-sel:			Select PWM source. Possible values:
				0: LOW
				1: PWM1_in
				2: PWM2_in
				3: PWM1_in & PWM2_in
- qcom,enable-gp-driver:	Enable the GP driver. Should only be specified
				if a non-zero PWM source is specified under
				"qcom,pwm-sel" property.

- qcom,support-twm-config	Enable configuration for TWM mode.

- qcom,twm-mode			The TWM mode which PMIC enters post power-off.
				Valid only if 'qcom,support-twm-config' is
				defined. If not specified, the default mode
				is 3.
Example:
	qcom,misc@900 {
		compatible = "qcom,qpnp-misc";
		reg = <0x900 0x100>;
		qcom,pwm-sel = <2>;
		qcom,enable-gp-driver;
	};
```

## Documentation/devicetree/bindings/misc/therm_est.txt
```
Thermal estimator driver.

Properties :
 - compatible : Should contain "nvidia,therm-est".
 - toffset : Temperature offset for thermal estimation, in milli-celsius.
 - polling-period : Polling wait times for thermal estimation, in milliseconds.
 - passive-delay : Polling wait times for passive cooling, in milliseconds.
 - tc1 : Coefficient 1 for thermal trend calculation.
 - tc2 : Coefficient 2 for thermal trend calculation.
 - node for trip : Node for trip point information. Required.
     This node can be numerous.
 - node for subdev : Node for subdevice information. Required.
     This node can be numerous.
 - node for tzp : Node for thermal zone platform parameters. Optional.
 - node for timer trip : Node for timer trip point information. Optional.
     This node can be numerous.

Properties in trips node : Required. Can be numerous.
 - compatible : Should contain "nvidia,therm-est-trip".
 - cdev-type : Thermal cooling device type for binding with the thermal
     estimator thermal zone.
 - trip-type : Type of this trip point.
     This should be one of types in active, passive, hot, and critical.
 - trip-temp : Temperature to fire this trip point, in milli-celsius.
 - hysteresis : Hysteresis temperature for this trip point, in milli-celsius.
 - upper : Upper limit of the cooling state for this trip point. Optional.
     "-1" = THERMAL_NO_LIMIT: no upper limit.
         If no upper property, THERMAL_NO_LIMIT will be used.
 - lower : Lower limit of the cooling state for this trip point. Optional.
     "-1" = THERMAL_NO_LIMIT: no lower limit.
         If no lower property, THERMAL_NO_LIMIT will be used.

Properties in subdevice node : Required. Can be numerous.
 - compatible : Should contain "nvidia,therm-est-subdev".
 - dev_data : Thermal zone device type for thermal estimation.
 - coeffs : An array of coefficients, the number of entries should be twenty.

Properties in tzp node : Optional
 - compatible : Should contain "nvidia,therm-est-tzp".
 - governor : Thermal throttling governor name.
     The available governors could be different by Kernel build options.

Properties in timer trip : Optional. Can be numerous.
 - compatible : Should contain "nvidia,therm-est-timer-trip".
 - trip : Trip point to apply timer trip in the thermal estimator thermal zone.
 - node for timer : Nodes for timer trip point information. Required.
     This node can be numerous.

Properties in timer : Required if the timer trip is exist. Can be numerous.
 - compatible : Should contain "nvidia,therm-est-timer-trip".
 - time-after : Expiration time of the timer, in milliseconds.
 - trip-temp : Trip temperature will be used for this trip point after timer
     expires, in milli-celsius.
 - hysteresis : Hysteresis temperature will be used for this trip point after
     timer expires, in milli-celsius.

Example:

	therm_est {
		compatible = "nvidia,therm-est";
		toffset = <0>;
		polling-period = <1100>;
		passive-delay = <15000>;
		tc1 = <10>;
		tc2 = <1>;
		trips@0 {
			compatible = "nvidia,therm-est-trip";
			cdev-type = "skin-balanced";
			trip-type = "active";
			trip-temp = <40000>;
			hysteresis = <0>;
			upper = "1"; // fix cooling state to 1
			lower = "1";
		};
		trips@1 {
			compatible = "nvidia,therm-est-trip";
			cdev-type = "skin-balanced";
			trip-type = "passive";
			trip-temp = <45000>;
			hysteresis = <5000>;
			upper = "-1"; // THERMAL_NO_LIMIT
			lower = "-1"; // THERMAL_NO_LIMIT
		};
		subdevs@0 {
			compatible = "nvidia,therm-est-subdev";
			dev-data = "nct_ext";
			coeffs = "0 0 0 0 0 0 0 0 0 0 0 0 0 0 0 0 0 0 0 0";
		};
		subdevs@1 {
			compatible = "nvidia,therm-est-subdev";
			dev-data = "nct_int";
			coeffs = "0 0 0 0 0 0 0 0 0 0 0 0 0 0 0 0 0 0 0 0";
		};
		tzp {
			compatible = "nvidia,therm-est-tzp";
			governor = "pid_thermal_gov";
		};
		timer-trips@0 {
			compatible = "nvidia,therm-est-timer-trip";
			trip = <1>; // this timer trip will be applied to trip1
			timers@0 {
				compatible = "nvidia,therm-est-timer";
				time-after = <600000>;
				trip-temp = <43000>;
				hysteresis = <5000>;
			};
		};
	};
```
