## Documentation/devicetree/bindings/memory.txt
```
* Memory binding

The /memory node provides basic information about the address and size
of the physical memory. This node is usually filled or updated by the
bootloader, depending on the actual memory configuration of the given
hardware.

The memory layout is described by the folllowing node:

memory {
	reg =  <(baseaddr1) (size1)
		(baseaddr2) (size2)
		...
		(baseaddrN) (sizeN)>;
};

baseaddrX:	the base address of the defined memory bank
sizeX:		the size of the defined memory bank

More than one memory bank can be defined.


* Memory regions

In /memory node one can create additional nodes describing particular
memory regions, usually for the special usage by various device drivers.
A good example are contiguous memory allocations or memory sharing with
other operating system on the same hardware board. Those special memory
regions might depend on the board configuration and devices used on the
target system.

Parameters for each memory region can be encoded into the device tree
wit the following convention:

(name): region@(base-address) {
	reg = <(baseaddr) (size)>;
	(linux,reserve-contiguous-region);
	(linux,default-contiguous-region);
	(linux,reserve-region);
	(linux,memory-limit);
	(linux,remove-completely);
        label = (unique_name);
};

name:		an name given to the defined region.
base-address:	the base address of the defined region.
size:		the size of the memory region.
linux,reserve-contiguous-region: property indicating that the defined memory
		region is used for contiguous memory allocations,
		Linux specific (optional)
linux,default-contiguous-region: property indicating that the region
		is the default region for all contiguous memory
		allocations, Linux specific (optional)
linux,reserve-region: property indicating that the contiguous memory will
		not be given back to the system allocator. The memory be
		always be available for contiguous use.
linux,memory-limit: property specifying an upper bound on the physical address
		of the region if the region is placed dynamically. If no limit
		is specificed, the region may be placed anywhere in the physical
		address space. 0 may be used to specify lowmem (i.e. the region
		will be placed in the direct mapped lowmem region)
linux,remove-completely: property indicating the memory will be removed from the
		linux page allocator completely. This means that page structures
		associated with the memory will not be valid. This binding is
		expected to be used in conjunction with linux,reserve-region.
label:		an internal name used for automatically associating the
		cma region with a given device. The label is optional;
		if the label is not given the client is responsible for
		calling the appropriate functions to associate the region
		with a device.

* Device nodes

Once the regions in the /memory node are defined, they can be assigned
to device some device nodes for their special use. The following
properties are defined:

linux,contiguous-region = <&phandle>;
	This property indicates that the device driver should use the
	memory region pointed by the given phandle.


* Example:

This example defines a memory consisting of 4 memory banks. 2 contiguous
regions are defined for Linux kernel, one default of all device drivers
(named contig_mem, placed at 0x72000000, 64MiB) and one dedicated to the
framebuffer device (named display_mem, placed at 0x78000000, 16MiB). The
display_mem region is then assigned to fb@12300000 device for contiguous
memory allocation with Linux kernel drivers.

The reason for creating a separate region for framebuffer device is to
match the framebuffer address of from configuration done by bootloader,
so once Linux kernel drivers starts, no glitches on the displayed boot
logo appears.

/ {
	/* ... */
	memory {
		reg =  <0x40000000 0x10000000
			0x50000000 0x10000000
			0x60000000 0x10000000
			0x70000000 0x10000000>;

		contig_mem: region@72000000 {
			linux,reserve-contiguous-region;
			linux,default-contiguous-region;
			reg = <0x72000000 0x4000000>;
		};

		display_mem: region@78000000 {
			linux,reserve-contiguous-region;
			reg = <0x78000000 0x1000000>;
		};
	};

	fb@12300000 {
		linux,contiguous-region = <&display_mem>;
		status = "okay";
	};
};
```

## Documentation/devicetree/bindings/mfd/arizona.txt
```
Wolfson Arizona class audio SoCs

These devices are audio SoCs with extensive digital capabilites and a range
of analogue I/O.

Required properties:

  - compatible : One of the following chip-specific strings:
        "wlf,wm5102"
        "wlf,wm5110"
        "wlf,wm8280"
        "wlf,wm8281"
        "wlf,wm8997"
  - reg : I2C slave address when connected using I2C, chip select number when
    using SPI.

  - interrupts : The interrupt line the /IRQ signal for the device is
    connected to.
  - interrupt-controller : Arizona class devices contain interrupt controllers
    and may provide interrupt services to other devices.
  - interrupt-parent : The parent interrupt controller.
  - #interrupt-cells: the number of cells to describe an IRQ, this should be 2.
    The first cell is the IRQ number.
    The second cell is the flags, encoded as the trigger masks from
    Documentation/devicetree/bindings/interrupts.txt

  - gpio-controller : Indicates this device is a GPIO controller.
  - #gpio-cells : Must be 2. The first cell is the pin number and the
    second cell is used to specify optional parameters (currently unused).

  - AVDD-supply, DBVDD1-supply, DBVDD2-supply, DBVDD3-supply (wm5102, wm5110),
    CPVDD-supply, SPKVDDL-supply (wm5102, wm5110), SPKVDDR-supply (wm5102,
    wm5110), SPKVDD-supply (wm8997) : Power supplies for the device, as covered
    in Documentation/devicetree/bindings/regulator/regulator.txt

Optional properties:

  - wlf,reset : GPIO specifier for the GPIO controlling /RESET
  - wlf,ldoena : GPIO specifier for the GPIO controlling LDOENA

  - wlf,micd-software-compare : Use a software comparison to determine mic
    presence
  - wlf,micd-detect-debounce : Additional software microphone detection
    debounce specified in milliseconds
  - wlf,micd-pol-gpio : GPIO specifier for the GPIO controlling the headset
    polarity if one exists
  - wlf,micd-bias-start-time : Time allowed for MICBIAS to startup prior to
    performing microphone detection, specified as per the MICD_BIAS_STARTTIME
    bits in the register MIC_DETECT_1
  - wlf,micd-rate : Delay between successive microphone detection measurements,
    specified as per the MICD_RATE bits in the register MIC_DETECT_1
  - wlf,micd-dbtime : Microphone detection hardware debounce level, specified
    as per the MICD_DBTIME bits in the register MIC_DETECT_1
  - wlf,micd-timeout : Timeout for microphone detection, specified in
    milliseconds
  - wlf,micd-force-micbias : Force MICBIAS continuously on during microphone
    detection
  - wlf,micd-ranges : Microphone detection level and key configuration, this
    field can be of variable length but should always be a multiple of 2 cells
    long, each two cell group represents one button configuration
    The first cell is the maximum impedance for this button in ohms
    The second cell the key that should be reported to the input layer
  - wlf,micd-configs : Headset polarity configurations, the field can be of
    variable length but should always be a multiple of 3 cells long, each two
    cell group represents one polarity configration
    The first cell is the accessory detection source as per the ACCDET_SRC bits
    in the ACCESSORY_DETECT_MODE_1 register
    The second cell represents the MICBIAS to be used as per the MICD_BIAS_SRC
    bits in the MIC_DETECT_1 register
    The third cell represents the value of the micd-pol-gpio pin, a non-zero
    value indicates this should be on
  - wlf,init-mic-delay : Adds a delay in milliseconds between jack detection
    and beginning ramp of MICBIAS.

  - wlf,micbias1 : Configuration for the micbias regulator, should include 5
    cells.
    The first cell is the output voltage in millivolts
    The second cell a non-zero value indicates an external capacitor is fitted
    The third cell a non-zero value indicates the micbias should be actively
    discharged
    The four cell a non-zero value indicates that the micbias should be
    brought up slowly to reduce pops
    The fifth cell a non-zero value indicates the micbias should be bypassed
    and simply output MICVDD
  - wlf,micbias2 : See wlf,micbias1
  - wlf,micbias3 : See wlf,micbias1

  - wlf,gpio-defaults : A list of GPIO configuration register values. If
    absent, no configuration of these registers is performed. If any
    entry has a value that is out of range for a 16 bit register then
    the chip default will be used.  If present exactly five values must
    be specified.

  - wlf,max-channels-clocked : The maximum number of channels to be clocked on
    each AIF, useful for I2S systems with multiple data lines being mastered.
    If specified three cells must supplied one for each AIF, specify zero for
    AIFs that should be handled normally.

  - wlf,dmic-ref : DMIC reference for each input, must contain four cells if
    specified. 0 indicates MICVDD and is the default, 1,2,3 indicate the
    respective MICBIAS.

  - wlf,inmode : Input mode for each input, must contain four cells if
    specified. 0 indicates Differential, 1 indicates Single Ended and 2
    indicates a digital microphone.

  - wlf,use-jd-gpio : Use GPIO input for jack detection.
  - wlf,usr-jd-gpio-nopull : Internal pull on GPIO is disabled when used for
    jack detection.

  - wlf,gpsw : Settings for the general purpose switch, set as per the
    SW1_MODE bits in the GP Switch 1 register

    wlf,wm5102t-output-pwr : Output power setting (WM5102T only)

  - wlf,fixed-hpdet-imp : Do not perform any headphone detection, just use
    the fixed value specified here as the headphone impedance.

  - DCVDD-supply, MICVDD-supply : Power supplies, only need to be specified if
    they are being externally supplied. As covered in
    Documentation/devicetree/bindings/regulator/regulator.txt

Optional subnodes:
  - ldo1 : Initial data for the LDO1 regulator, as covered in
    Documentation/devicetree/bindings/regulator/regulator.txt
  - micvdd : Initial data for the MICVDD regulator, as covered in
    Documentation/devicetree/bindings/regulator/regulator.txt

Example:

codec: wm5102@1a {
	compatible = "wlf,wm5102";
	reg = <0x1a>;
	interrupts = <347>;
	interrupt-controller;
	#interrupt-cells = <2>;
        interrupt-parent = <&gic>;

	gpio-controller;
	#gpio-cells = <2>;

	wlf,micd-detect-debounce = <10>;
	wlf,micd-bias-start-time = <0x1>;
	wlf,micd-rate = <0x1>;
	wlf,micd-dbtime = <0x1>;
	wlf,micd-timeout = <10>;
	wlf,micd-force-micbias;
	wlf,micd-ranges = <
		11 0x100
		28 0x101
		54 0x102
		100 0x103
		186 0x104
		430 0x105
	>;
	wlf,micd-configs = <
		0x1 1 0
		0x0 2 1
	>;
	wlf,fixed-hpdet-imp = <8>;

	wlf,micbias2 = <2600 0 1 1 0>;
	wlf,init-mic-delay = <10>;

	wlf,dmic-ref = <0 0 1 0>;
	wlf,inmode = <0 0 2 0>;

	wlf,gpsw = <0x3>;

	wlf,gpio-defaults = <
		0x00000000 /* AIF1TXLRCLK */
		0xffffffff
		0xffffffff
		0xffffffff
		0xffffffff
	>;

	wlf,max-channels-clocked = <2 0 0>;
};
```

## Documentation/devicetree/bindings/mfd/qcom-i2c-pmic.txt
```
Qualcomm Technologies, Inc. I2C PMIC Interrupt Controller
Platform Independent Bindings

The I2C PMIC Controller is used by multi-function PMIC devices which communicate
over the I2C bus. An I2C PMIC controller node typically contains one or more
child nodes representing the device's peripherals. Each of the peripherals
typically has its own driver on the platform bus and will be enumerated by this
controller. The controller exposes a regmap to the peripherals to communicate
over the I2C bus.

The controller also controls interrupts for all of the peripherals on the bus.
The controller takes a summary interrupt, deciphers which peripheral triggered
the interrupt, and which of the peripheral's interrupts were triggered. Finally,
it calls the handlers for each of the virtual interrupts that were registered.

This document describes the common platform independent bindings that apply
to all I2C PMIC interrupt controllers.

========================================
First Level Nodes - I2C PMIC Controllers
========================================

Platform independent properties:
- compatible
	Usage:      required
	Value type: <string>
	Definition: Must be "qcom,i2c-pmic".

- reg
	Usage:      required
	Value type: <u32>
	Definition: 7-bit I2C address of the device.

- interrupt-parent
	Usage:      optional
	Value type: <phandle>
	Definition: phandle of the interrupt controller which services the
		    summary interrupt.

- interrupts
	Usage:      optional
	Value type: <prop-encoded-array>
	Definition: Summary interrupt specifier.

- interrupt-controller
	Usage:      optional
	Value type: <empty>
	Definition: Boolean flag which indicates this device node is an
		    interrupt controller.

- #interrupt-cells
	Usage:      optional
	Value type: <u32>
	Definition: Number of cells to encode an interrupt source.

- qcom,periph-map
	Usage:      optional
	Value type: <prop-encoded-array>
	Definition: A list of u32 arrays. This provides a mapping between the
		    summary status register bits and peripheral addresses.

		    The number of arrays should match the number of summary
		    registers with up to 8 elements each. One element per bit
		    of the summary status register in order from the least
		    sigificant bit to the most significant bit.

- pinctrl-names
	Usage:      optional
	Value type: <string-list>
	Definition: Should be "default".
		    Please refer to pinctrl-bindings.txt

- pinctrl-0
	Usage:      optional
	Value type: <phandle-list>
	Definition: phandle of the pin configuration.
		    Please refer to pinctrl-bindings.txt

=======
Example
=======

&i2c_3 {
	status = "ok";
	qcom,smb138x@8 {
		compatible = "qcom,i2c-pmic";
		reg = <0x8>;
		interrupt-parent = <&tlmm_pinmux>;
		interrupts = <83 0>;
		interrupt-controller;
		#interrupt-cells = <3>;
		pinctrl-names = "default";
		pinctrl-0 = <&smb_stat_active>;
		#address-cells = <1>;
		#size-cells = <0>;
		qcom,periph-map = <0x10 0x11 0x12 0x13 0x14 0x16 0x36>;
	};
};
```
