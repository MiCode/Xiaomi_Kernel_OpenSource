## Documentation/devicetree/bindings/usb/qcom,usb-ssphy.txt
```
Qualcomm Technologies, Inc. MSM PHY Transceivers

Required properties:
- compatible: Should be "qcom,usb-ssphy"
- reg: Address and length of the register set for the device
- clocks: a list of handles to the PHY clocks. Use as per
  Documentation/devicetree/bindings/clock/clock-bindings.txt
- clock-names: Names of the clocks in 1-1 correspondence with the "clocks"
  property. "ref_clk", "cfg_ahb_clk" and "pipe_clk" are mandatory.
- <supply-name>-supply: phandle to the regulator device tree node
Required "supply-name" examples are:
"vdd" : vdd supply for SSPHY digital circuit operation
"vdda18" : 1.8v high-voltage analog supply for SSPHY
- qcom,vdd-voltage-level: This property must be a list of three integer
values (no, min, max) where each value represents either a voltage in
microvolts or a value corresponding to voltage corner

Optional properties:
- qcom,vbus-valid-override: If present, indicates VBUS pin is not connected to
the USB PHY and the controller must rely on external VBUS notification in
order to manually relay the notification to the SSPHY.
-qcom,keep-powerdown: If present, power down the SSPHY to avoid leakage current.

Example:
ssphy@f9200000 {
	compatible = "qcom,usb-ssphy";
	reg = <0xf9200000 0xfc000>;
	vdd-supply = <&pm8841_s2_corner>;
	vdda18-supply = <&pm8941_l6>;
	qcom,vdd-voltage-level = <1 5 7>;
	clocks = <&clock_gcc USB_PHY_REF_CLK>,
		 <&clock_gcc USB_PHY_CFG_AHB_CLK>,
		 <&clock_gcc USB_PHY_PIPE_CLK>;
	clock-names = "ref_clk", "cfg_ahb_clk", "pipe_clk";
};
```

## Documentation/devicetree/bindings/usb/qpnp-pdphy.txt
```
Qualcomm Technologies, Inc. QPNP PD PHY - USB Power Delivery Physical layer

Required properties:
- compatible:		Must be "qcom,qpnp-pdphy"
- reg:			The base address for this peripheral
- vdd-pdphy-supply:	phandle to the VDD supply regulator node
- interrupts:		Specifies the interrupt associated with the peripheral.
- interrupt-names:	Specifies the interrupt names for the peripheral. Every
			available interrupt needs to have an associated name
			with it to indentify its purpose.

			The following interrupts are required:

			0: sig-tx
				Triggers when a signal (HardReset or CableReset)
				has been sent.
			1: sig-rx
				Triggers when a signal has been received.
			2: msg-tx
				Triggers when a message has been sent and the
				related GoodCRC has been received.
			3: msg-rx
				Triggers when a message has been received and
				the related GoodCRC was sent successfully.
			4: msg-tx-failed
				Triggers when a message failed all its
				transmission attempts, either due to a non-idle
				bus or missing GoodCRC reply.
			5: msg-tx-discarded
				Triggers when a message is received while a
				transmission request was in place. The request
				itself is discarded.
			6: msg-rx-discarded
				Triggers when a message was received but had to
				be discarded due to the RX buffer still in use
				by SW.

Optional properties:
- vbus-supply:		Regulator that enables VBUS source output
- vconn-supply:		Regulator that enables VCONN source output. This will
			be supplied on the USB CC line that is not used for
			communication when Ra resistance is detected.
- qcom,vconn-uses-external-source: Indicates whether VCONN supply is sourced
			from an external regulator. If omitted, then it is
			assumed it is connected to VBUS.
- qcom,default-sink-caps: List of 32-bit values representing the nominal sink
			capabilities in voltage (millivolts) and current
			(milliamps) pairs.

Example:
	qcom,qpnp-pdphy@1700 {
		compatible = "qcom,qpnp-pdphy";
		reg = <0x1700 0x100>;
		vdd-pdphy-supply = <&pm8998_l24>;
		interrupts = <0x2 0x17 0x0 IRQ_TYPE_EDGE_RISING>,
			     <0x2 0x17 0x1 IRQ_TYPE_EDGE_RISING>,
			     <0x2 0x17 0x2 IRQ_TYPE_EDGE_RISING>,
			     <0x2 0x17 0x3 IRQ_TYPE_EDGE_RISING>,
			     <0x2 0x17 0x4 IRQ_TYPE_EDGE_RISING>,
			     <0x2 0x17 0x5 IRQ_TYPE_EDGE_RISING>,
			     <0x2 0x17 0x6 IRQ_TYPE_EDGE_RISING>;

		interrupt-names = "sig-tx",
				  "sig-rx",
				  "msg-tx",
				  "msg-rx",
				  "msg-tx-failed",
				  "msg-tx-discarded",
				  "msg-rx-discarded";

		qcom,default-sink-caps = <5000 3000>, /* 5V @ 3A */
					 <9000 3000>, /* 9V @ 3A */
					 <12000 2250>; /* 12V @ 2.25A */
	};
```

## Documentation/devicetree/bindings/usb/usb2533-flex-hub.txt
```
USB2533 flex Hub

usb2533 HUB supports flex mode which allows swapping of upstream port with
one of the downstream port using I2C commands. This driver enables/disables
flex mode based on the USB mode (host/device).

Required properties :
- compatible : Must be "qcom,usb2533-flex-hub"
- reg: 7bit I2C slave address
- <supply-name>-supply: handle to the regulator device tree node.
        "supply-name" is "vbus" regulator to drive peripheral Vbus
	line in host mode.

Optional properties:
- qcom,hub-reset-gpio : This corresponds to GPIO that is used to drive USB HUB
  reset pin.
- qcom,usbeth-reset-gpio : This corresponds to GPIO that is used to drive
  reset of any other downstream device connected to HUB.
  GPIO flag represents whether ENB pin is active-high(0) or active-low(1).

Example :
	usb2533@2d {
		compatible = "qcom,usb2533-flex-hub";
		reg = <0x2d>;
		vbus-supply = <&usbeth_vbus_vreg>;
		pinctrl-names = "default";
		pinctrl-0 = <&usb2533_hub_reset>;
		qcom,hub-reset-gpio = <&tlmm 100 0>;
		qcom,usbeth-reset-gpio = <&ioexp_gpios 5 0>;
	};
```

## Documentation/devicetree/bindings/video/nvidia,ad5816.txt
```
NVIDIA Camera sensor ad5816 driver interface.

Required properties:
- compatible : The driver is compatible with
	"nvidia,ad5816".

- reg: Should contain I2C slave address of the driver.

All other properties are based on nvc (nvidia camera interface) standard
structures definitions, which are generic across the devices. Few of them are
explained below:

- nvidia,num: Indicates the instance of particular camera device, in this case
it is for camera focuser device. Currently for rear camera focuser "0" is used.

- nvidia,sync: Used for stereo synchronization. "0" for non-stereo usecase.

- nvidia,dev_name: Camera device driver name.

For more details refer nvc headers at : $TOP/kernel/include/media/
nvc.h
nvc_focus.h
nvc_image.h
nvc_torch.h

Example:

	ad5816@0E {
		compatible = "nvidia,ad5816";
		reg = <0x0E>;
		nvidia,cfg = <0>;
		nvidia,num = <0>;
		nvidia,sync = <0>;
		nvidia,dev_name = "focuser";
		status = "okay";
	};
```

## Documentation/devicetree/bindings/video/nvidia,ad5823.txt
```
NVIDIA Camera focuser ad5823 driver interface.

Required properties:
- compatible : The driver is compatible with
	"nvidia,ad5823".

- reg : Should contain I2C slave address of the driver.

- af-pwdn-gpios : ad5823 power down GPIO

Example:

	ad5823@0c {
		compatible = "nvidia,ad5823";
		reg = <0x0c>;
		af-pwdn-gpios = <&gpio 223 0>; /* gpo PBB7 */
		status = "okay";
	};
```

## Documentation/devicetree/bindings/video/nvidia,imx091.txt
```
NVIDIA Camera sensor imx091 driver interface.

Properties:
- compatible : The driver is compatible with
	"nvidia,imx091".

- reg: Should contain I2C slave address of the driver.

- nvidia,vcm_vdd : For few platforms this driver needs extra power regulator
"vcm_vdd" to be enabled. This bool property indicates the same. It must be
programmed only when imx091 driver needs it for a particular platform.

- nvidia,i2c_vdd : For few platforms this driver needs extra power regulator
"i2c_vdd" to be enabled. This bool property indicates the same. It must be
programmed only when imx091 driver needs it for a particular platform.

- nvidia,num: Indicates the instance of particular camera device, in this case
it is for camera focuser device. Currently for rear camera focuser "0" is used.

- nvidia,sync: Used for stereo synchronization. "0" for non-stereo usecase.

- nvidia,dev_name: Camera device driver name.

- imx091 caps: These properties are based on nvc (nvidia camera interface)
standard structure definition: nvc_imager_cap , which is generic across
the devices. For details refer nvc headers at :
$TOP/kernel/include/media/nvc_image.h

- edpc configs: standard edp paramters.
    - states: EDP state array holding the IMAX for each state. This must be
        sorted in descending order.
    - num_states: length of the above array.
    - e0_index: index of the E0 state in the above array.
    - priority: client priority - should be between EDP_MIN_PRIO & EDP_MAX_PRIO.

- flash caps: Please see below example for properties related to imx091
flash capabilities.

Example:

	imx091@10 {
		compatible = "nvidia,imx091";
		reg = <0x10>;
		nvidia,ext_reg; /* Extra power-regulators needed */

		nvidia,num = <0>;
		nvidia,sync = <0>;
		nvidia,dev_name = "camera";

		/* edpc config */
		nvidia,imx091_estates = <876 656 220 0>;
		nvidia,num_states = <4>;
		nvidia,e0_index = <0>;
		nvidia,priority = <1>;

		/* imx091 gpios */
		reset-gpios = <&gpio 219 0>; /* gpio PBB3 */
		power-gpios = <&gpio 221 0>; /* gpio PBB6 */
		gp1-gpios = <&gpio 225 0>; /* gpio PCC1 */

		/* imx091 caps */
		nvidia,identifier = "IMX091";
		nvidia,sensor_nvc_interface = <3>;
		nvidia,pixel_types = <0x100>;
		nvidia,orientation = <0>;
		nvidia,direction = <0>;
		nvidia,initial_clock_rate_khz = <6000>;
		nvidia,h_sync_edge = <0>;
		nvidia,v_sync_edge = <0>;
		nvidia,mclk_on_vgp0 = <0>;
		nvidia,csi_port = <0>;
		nvidia,data_lanes = <4>;
		nvidia,virtual_channel_id = <0>;
		nvidia,discontinuous_clk_mode = <1>;
		nvidia,cil_threshold_settle = <0x0>;
		nvidia,min_blank_time_width = <16>;
		nvidia,min_blank_time_height = <16>;
		nvidia,preferred_mode_index = <0>;
		nvidia,external_clock_khz_0 = <24000>;
		nvidia,clock_multiplier_0 = <850000>;
		nvidia,external_clock_khz_1 = <0>;
		nvidia,clock_multiplier_1 = <0>;

		/* flash caps */
		nvidia,sdo_trigger_enabled;
		nvidia,adjustable_flash_timing;

		status = "okay";

	};
```

## Documentation/devicetree/bindings/video/nvidia,imx132.txt
```
NVIDIA Camera sensor imx132 driver interface.

Required properties:
- compatible : The driver is compatible with
	"nvidia,imx132".

- cam2_gpios : Camera GPIO.

- reg: Should contain I2C slave address of the driver.

- nvidia,ext_reg : For few platforms this driver needs extra power regulators
to be enabled. This bool property indicates the same. It must be programmed
only when imx132 driver needs extra power rails for particular platform.

Example:

	imx132@36 {
		compatible = "nvidia,imx132";
		cam2_gpios = <&gpio 222 0>; /* gpio PBB6 */
		reg = <0x36>;
		nvidia,ext_reg; /* Extra power-regulators needed */
		status = "okay";
	};
```

## Documentation/devicetree/bindings/video/nvidia,ov5693.txt
```
NVIDIA Camera sensor ov5693 driver interface.

Properties:
- compatible : The driver is compatible with
	"nvidia,ov5693".

- reg : Should contain I2C slave address of the driver.

- nvidia,num : Indicates the instance of particular camera device, in this
case it is for camera sensor device. Currently for rear camera sensor "0"
is used.

- nvidia,dev-name : Camera device driver name.

- nvidia,use-vcm-vdd : For few platforms this driver needs extra power
regulator "ext_vcm_vdd" to be enabled. This bool property indicates the
same. It must be programmed only when ov5693 driver needs it for a
particular platform.

- reset-gpios : ov5693 reset GPIO

Example:

	ov5693@10 {
		compatible = "nvidia,ov5693";
		reg = <0x10>;
		nvidia,num = <0>;
		nvidia,dev-name = "camera";
		nvidia,use-vcm-vdd;
		reset-gpios = <&gpio 219 0>; /* gpio PBB3 */
		status = "okay";
	};
```

## Documentation/devicetree/bindings/video/nvidia,ov9772.txt
```
NVIDIA Camera sensor ov9772 driver interface.

Required properties:
- compatible : The driver is compatible with
	"nvidia,ov9772".

- reg: Should contain I2C slave address of the driver.

- nvidia,dev_name: Indicates device name.

- nvidia,num: Indicates device number.

- nvidia,vcm_vdd : For few platforms this driver needs extra power
regulator (vcm_vdd) to be enabled. This bool property indicates the
same. It must be programmed only when ov9772 driver needs extra power
rail for a platform in context.

Example:

	ov9772@10 {
		compatible = "nvidia,ov9772";
		reg = <0x10>;
		nvidia,num = <1>;

		nvidia,vcm_vdd; /* extra regulator needed */

		/* ov9772 gpios */
		reset-gpios = <&gpio 219 0>; /* gpio PBB3 */
		power-gpios = <&gpio 222 0>; /* gpio PBB6 */

		nvidia,dev_name = "camera";
		status = "okay";
	};
```
