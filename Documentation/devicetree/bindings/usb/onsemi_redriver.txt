## Documentation/devicetree/bindings/video/nvidia,tegra124-hdmi.txt
```
NVIDIA TEGRA124 High Definition Multimedia Interface
====================================================

1) The hdmi node:
 hdmi node must be contained in host1x parent node. This node represents NVIDIA TEGRA124
 High Definition Multimedia Interface.

 Required properties
 - name: hdmi
 - compatible: Should contain "nvidia,tegra124-hdmi".
 - reg: Physical base address and length of the controller's registers.
 - interrupts: The interrupt outputs from the controller.

 Optional properties:
 - nvidia,ddc-i2c-bus: phandle of an I2C controller used for DDC EDID probing
 - nvidia,hpd-gpio: specifies a GPIO used for hotplug detection
 - nvidia,edid: supplies a binary EDID blob
 - nvidia,hotplug-report: With 1, it will have optional hotplug report callback
   which does only set DDC_SDA and DDC_SCL pull downs to be active when hotplug
   is detected, otherwise keep them disabled.

 1.B) NVIDIA HDMI TMDS configurations
 This must be contained in hdmi parent node. This includes tmds configurations.

 Required properties:
 - name: Should be "nvidia,out-tmds-cfg"

 - Child nodes represent tmds configurations. Several configurations can be prepared.

 1.B.i) NVIDIA HDMI TMDS configuration
 This must be contained in nvidia,out-tmds-cfg parent node. This includes tmds configuration.

 Required properties:
 - name: Can be arbitrary, but each sibling node should have unique name.
 - pclk: pixel clk required in tmds table for each mode.
 - pll0: See HDMI_NV_PDISP_SOR_PLL0_0 in Tegra TRM.
 - pll1: See HDMI_NV_PDISP_SOR_PLL1_0 in Tegra TRM.
 - pe-current: Individual lane pre-emphasis current control (4bits per lane)
   See HDMI_NV_PDISP_PE_CURRENT_0 in Tegra TRM.
 - drive-current: TMDS per-lane I/O current control.
   See HDMI_NV_PDISP_SOR_LANE_DRIVE_CURRENT_0 in Tegra TRM.
 - peak-current: New pad controls for 28nm macro TMDS_X4_HP 8 bits per lane.
   See HDMI_NV_PDISP_SOR_IO_PEAK_CURRENT_0 in Tegra TRM.

Example
	host1x {
		hdmi {
			compatible = "nvidia,tegra124-hdmi";
			reg = <0x54280000 0x00040000>;
			interrupts = <0 75 0x04>;
			status = "okay";
			nvidia,ddc-i2c-bus = <&hdmi_ddc>;
			nvidia,hpd-gpio = <&gpio 111 1>;
		};
	};
```

## Documentation/devicetree/bindings/watchdog/qcom-vm-wdt.txt
```
* Qualcomm Technologies, Inc. VM  Watchdog

Watchdog timer is configured with bark and bite time interval.
If Virtual Machine fails to reset the counter during bark interval,
a bark interrupt (SPI) is send to the VM. Failing to respond to the
bark interrupt causes a bite, when counter reaches programmed
bite interval. The bite interrupt is routed to secure world, and
causes a system reset.

The device tree parameters are:

Required properties:

- compatible : "qcom,vm-wdt"
- reg : base offset and length of the register set.
- reg-names : names corresponding to each reg property value.
        "wdt-base" - physical base address of watchdog timer registers
- interrupts : should contain bark and bite irq numbers
- qcom,pet-time : Non zero time interval at which watchdog should be pet in ms.
- qcom,bark-time : Non zero timeout value for a watchdog bark in ms.


Example:

	qcom,vm-wdt@f9017000 {
		compatible = "qcom,vm-wdt";
		reg = <0x17980000 0x1000>;
		reg-names = "wdt-base";
		interrupts = <0 3 0>, <0 4 0>;
		qcom,bark-time = <11000>;
		qcom,pet-time = <10000>;
	};
```

## Documentation/devicetree/bindings/watchdog/sprd-fiq-wdt.txt
```
Spreadtrum SoCs Watchdog timer with fiq isr

Required properties:
- compatible: should be one of following:
	"sprd,wdt-r2p0-fiq".
	"sprd,wdt-r2p0-fiq-sharkl3".
- reg : Specifies base physical address and size of the registers.
- interrupts : Exactly one interrupt specifier.
- timeout-sec : Contain the default watchdog timeout in seconds.
- clock-names : Contain the input clock names.
- clocks : Phandles to input clocks.

Example:
	watchdog: watchdog@40310000 {
		compatible = "sprd,wdt-r2p0-fiq";
		reg = <0 0x40310000 0 0x1000>;
		interrupts = <GIC_SPI 61 IRQ_TYPE_LEVEL_HIGH>;
		timeout-sec = <12>;
		clock-names = "enable", "rtc_enable";
		clocks = <&clk_aon_apb_gates1 8>, <&clk_aon_apb_rtc_gates 9>;
	};
```

## Documentation/devicetree/bindings/watchdog/sprd-pmic-wdt.txt
```
Spreadtrum pmic Watchdog timer

Required properties:
- compatible: should be one of following:
	"sprd,sc2723t-wdt",
	"sprd,sc2731-wdt",
	"sprd,sc2730-wdt",
	"sprd,sc2721-wdt",
	"sprd,sc2720-wdt",
	"sprd,ump9620-wdt",
- reg : Specifies base physical address and size of the registers.

Example:
	pmic_wdt: watchdog@40 {
			  compatible = "sprd,sc27xx-wdt", "sprd,sc2721-wdt";
			  reg = <0x40>;
	};
```

## Documentation/devicetree/bindings/wcnss/wcnss-wlan.txt
```
* Qualcomm WCNSS Platform Driver

WCNSS driver is the platform driver. It is used for performing the cold
boot-up of the wireless device. It is responsible for adjusting
the necessary I/O rails and enabling appropriate gpios for wireless
connectivity subsystem.

Required properties:
- compatible: "wcnss_wlan"
- reg: physical address and length of the register set for the device.
- reg-names: "wcnss_mmio", "wcnss_fiq", "pronto_phy_base", "riva_phy_base",
             "riva_ccu_base", "pronto_a2xb_base", "pronto_ccpu_base",
             "pronto_saw2_base", "wlan_tx_phy_aborts","wlan_brdg_err_source",
             "wlan_tx_status", "alarms_txctl", "alarms_tactl",
             "pronto_mcu_base".
- interupts: Pronto to Apps interrupts for tx done and rx pending.
- qcom,pronto-vddmx-supply: regulator to supply pronto pll.
- qcom,pronto-vddcx-supply: voltage corner regulator to supply WLAN/BT/FM
                            digital module.
- qcom,pronto-vddpx-supply: regulator to supply WLAN DAC.
- qcom,iris-vddxo-supply  : regulator to supply RF XO.
- qcom,iris-vddrfa-supply : regulator to supply RFA digital.
- qcom,iris-vddpa-supply  : regulator to supply RF PA.
- qcom,iris-vdddig-supply : regulator to supply RF digital(BT/FM).
- gpios: gpio numbers to configure 5-wire interface of WLAN connectivity
- qcom,has-48mhz-xo: boolean flag to determine the usage of 24MHz XO from RF
- qcom,has-pronto-hw: boolean flag to determine the revId of the WLAN subsystem
- qcom,wcnss-adc_tm: ADC handle for vbatt notification APIs.
- qcom,wcnss-vadc: VADC handle for battery voltage notification APIs.
- pinctrl-<n> : Pinctrl states as described in bindings/pinctrl/pinctrl-bindings.txt
- pinctrl-names : Names corresponding to the numbered pinctrl states
- clocks: from common clock binding: handle to xo and rf_clk clocks.
- clock-names: Names of all the clocks that are accessed by the subsystem

Optional properties:
- qcom,has-autodetect-xo: boolean flag to determine whether Iris XO auto detect
should be performed during boot up.
- qcom,wlan-rx-buff-count: WLAN RX buffer count is a configurable value,
using a smaller count for this buffer will reduce the memory usage.
- qcom,is-pronto-vt: boolean flag to determine the pronto hardware version
in use. subsequently Pronto and IRIS voltage regulator range is configured
according to the ponto HW version
- qcom,is-pronto-v3: boolean flag to determine the pronto hardware version
in use. subsequently correct workqueue will be used by DXE engine to push frames
in TX data path and correct voting to RPM will be decided for booting.
- qcom,wcnss-pm : <Core rail LDO#, PA rail LDO#, XO settling time,
		   RPM power collapse enabled, standalone power collapse enabled>
	Power manager related parameter for LDO configuration.
	11     -  WCN CORE rail LDO number
	21     -  WCN PA rail LDO number
	1200   -  WCN XO settling time (usec)
	1      -  WCN RPM power collapse enabled
	1      -  WCN standalone power collapse enabled


Example:

    qcom,wcnss-wlan@fb000000 {
        compatible = "qcom,wcnss_wlan";
        reg = <0xfb000000 0x280000>,
              <0xf9011008 0x04>;
        reg-names = "wcnss_mmio", "wcnss_fiq";
        interrupts = <0 145 0 0 146 0>;
        interrupt-names = "wcnss_wlantx_irq", "wcnss_wlanrx_irq";

        qcom,pronto-vddmx-supply = <&pm8841_s1>;
        qcom,pronto-vddcx-supply = <&pm8841_s2_corner>;
        qcom,pronto-vddpx-supply = <&pm8941_s3>;
        qcom,iris-vddxo-supply = <&pm8941_l6>;
        qcom,iris-vddrfa-supply = <&pm8941_l11>;
        qcom,iris-vddpa-supply = <&pm8941_l19>;
        qcom,iris-vdddig-supply = <&pm8941_l3>;

        gpios = <&msmgpio 36 0>, <&msmgpio 37 0>, <&msmgpio 38 0>,
                <&msmgpio 39 0>, <&msmgpio 40 0>;
        qcom,has-48mhz-xo;
        qcom,is-pronto-vt;
        qcom,wlan-rx-buff-count = <512>;
        qcom,has-pronto-hw;
        qcom,wcnss-adc_tm = <&pm8226_adc_tm>;

        pinctrl-names = "wcnss_default", "wcnss_sleep";
        pinctrl-0 = <&wcnss_default>;
        pinctrl-1 = <&wcnss_sleep>;
        pinctrl-2 = <&wcnss_gpio_default>;

        clocks = <&clock_rpm clk_xo_wlan_clk>,
                   <&clock_rpm clk_rf_clk2>,
                   <&clock_debug clk_gcc_debug_mux>,
                   <&clock_gcc clk_wcnss_m_clk>;
        clock-names = "xo", "rf_clk", "measure", "wcnss_debug";
	qcom,wcnss-pm = <11 21 1200 1 1>;
    };
```

## arch/arm/configs/apq8064_defconfig
```kconfig
CONFIG_EXPERIMENTAL=y
# CONFIG_LOCALVERSION_AUTO is not set
CONFIG_SYSVIPC=y
CONFIG_IKCONFIG=y
CONFIG_IKCONFIG_PROC=y
CONFIG_CGROUPS=y
CONFIG_CGROUP_DEBUG=y
CONFIG_CGROUP_FREEZER=y
CONFIG_CGROUP_CPUACCT=y
CONFIG_RESOURCE_COUNTERS=y
CONFIG_CGROUP_SCHED=y
# CONFIG_FAIR_GROUP_SCHED is not set
CONFIG_RT_GROUP_SCHED=y
CONFIG_NAMESPACES=y
# CONFIG_UTS_NS is not set
# CONFIG_IPC_NS is not set
# CONFIG_USER_NS is not set
# CONFIG_PID_NS is not set
CONFIG_RELAY=y
CONFIG_BLK_DEV_INITRD=y
CONFIG_RD_BZIP2=y
CONFIG_RD_LZMA=y
CONFIG_EMBEDDED=y
CONFIG_KALLSYMS_ALL=y
CONFIG_ASHMEM=y
CONFIG_PROFILING=y
CONFIG_OPROFILE=m
CONFIG_MODULES=y
CONFIG_MODULE_UNLOAD=y
CONFIG_MODULE_FORCE_UNLOAD=y
CONFIG_ARCH_MSM=y
CONFIG_ARCH_APQ8064=y
# CONFIG_MSM_STACKED_MEMORY is not set
CONFIG_CPU_HAS_L2_PMU=y
# CONFIG_MSM_JTAG_V7 is not set
# CONFIG_MSM_FIQ_SUPPORT is not set
# CONFIG_MSM_PROC_COMM is not set
# CONFIG_MSM_DALRPC is not set
# CONFIG_MSM_HW3D is not set
CONFIG_MSM_DIRECT_SCLK_ACCESS=y
CONFIG_NO_HZ=y
CONFIG_HIGH_RES_TIMERS=y
CONFIG_SMP=y
# CONFIG_SMP_ON_UP is not set
CONFIG_PREEMPT=y
CONFIG_AEABI=y
CONFIG_HIGHMEM=y
CONFIG_VMALLOC_RESERVE=0x19000000
CONFIG_VFP=y
CONFIG_NEON=y
# CONFIG_CORE_DUMP_DEFAULT_ELF_HEADERS is not set
CONFIG_NET=y
CONFIG_UNIX=y
CONFIG_INET=y
CONFIG_BLK_DEV_LOOP=y
CONFIG_BLK_DEV_RAM=y
CONFIG_MISC_DEVICES=y
CONFIG_SCSI=y
CONFIG_SCSI_TGT=y
CONFIG_BLK_DEV_SD=y
CONFIG_CHR_DEV_SG=y
CONFIG_CHR_DEV_SCH=y
CONFIG_SCSI_MULTI_LUN=y
CONFIG_SCSI_CONSTANTS=y
CONFIG_SCSI_LOGGING=y
CONFIG_SCSI_SCAN_ASYNC=y
CONFIG_INPUT_EVDEV=y
CONFIG_INPUT_EVBUG=m
CONFIG_INPUT_JOYSTICK=y
CONFIG_INPUT_TOUCHSCREEN=y
CONFIG_INPUT_MISC=y
CONFIG_INPUT_UINPUT=y
CONFIG_SERIAL_MSM=y
# CONFIG_SERIAL_MSM_CLOCK_CONTROL is not set
CONFIG_SERIAL_MSM_HSL=y
CONFIG_SERIAL_MSM_HSL_CONSOLE=y
CONFIG_SERIAL_MSM_HS=y
CONFIG_HW_RANDOM=y
CONFIG_DCC_TTY=y
CONFIG_GPIOLIB=y
# CONFIG_HWMON is not set
# CONFIG_MFD_SUPPORT is not set
# CONFIG_HID_SUPPORT is not set
# CONFIG_USB_SUPPORT is not set
CONFIG_NEW_LEDS=y
CONFIG_LEDS_CLASS=y
# CONFIG_LEDS_MSM_PMIC is not set
CONFIG_STAGING=y
# CONFIG_STAGING_EXCLUDE_BUILD is not set
CONFIG_ANDROID=y
CONFIG_ANDROID_BINDER_IPC=y
CONFIG_ANDROID_LOGGER=y
CONFIG_ANDROID_RAM_CONSOLE=y
CONFIG_ANDROID_RAM_CONSOLE_ERROR_CORRECTION=y
CONFIG_ANDROID_TIMED_GPIO=y
CONFIG_ANDROID_LOW_MEMORY_KILLER=y
CONFIG_MSM_SSBI=y
CONFIG_EXT2_FS=y
CONFIG_EXT2_FS_XATTR=y
CONFIG_EXT3_FS=y
# CONFIG_EXT3_DEFAULTS_TO_ORDERED is not set
CONFIG_EXT4_FS=y
CONFIG_VFAT_FS=y
CONFIG_TMPFS=y
CONFIG_PARTITION_ADVANCED=y
CONFIG_NLS_CODEPAGE_437=y
CONFIG_NLS_ASCII=y
CONFIG_NLS_ISO8859_1=y
CONFIG_PRINTK_TIME=y
CONFIG_MAGIC_SYSRQ=y
CONFIG_DEBUG_FS=y
CONFIG_DEBUG_KERNEL=y
# CONFIG_SCHED_DEBUG is not set
CONFIG_TIMER_STATS=y
# CONFIG_DEBUG_PREEMPT is not set
CONFIG_DEBUG_INFO=y
CONFIG_DEBUG_MEMORY_INIT=y
# CONFIG_RCU_CPU_STALL_DETECTOR is not set
CONFIG_DYNAMIC_DEBUG=y
CONFIG_DEBUG_USER=y
CONFIG_DEBUG_ERRORS=y
CONFIG_KEYS=y
CONFIG_CRYPTO_AUTHENC=y
CONFIG_CRYPTO_CBC=y
CONFIG_CRYPTO_HMAC=y
CONFIG_CRYPTO_MD4=y
CONFIG_CRYPTO_MD5=y
CONFIG_CRYPTO_SHA1=y
CONFIG_CRYPTO_SHA256=y
CONFIG_CRYPTO_AES=y
CONFIG_CRYPTO_ARC4=y
CONFIG_CRYPTO_DES=y
CONFIG_CRYPTO_TWOFISH=y
CONFIG_CRYPTO_DEFLATE=y
# CONFIG_CRYPTO_HW is not set
CONFIG_CRC_CCITT=y
CONFIG_LIBCRC32C=y
```
