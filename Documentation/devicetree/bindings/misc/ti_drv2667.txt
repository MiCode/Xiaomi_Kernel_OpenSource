## Documentation/devicetree/bindings/misc/ti_drv2667.txt
```
TI DRV2667 is a haptic controller chip. It can drive piezo haptics
and can operate in two modes - analog and digital.

Required properties:

-compatible	: should be "ti,drv2667".
-reg		: i2c address to be used.
-vdd-supply	: regulator to power the chip.
-vdd-i2c-supply	: regulator to power i2c bus.

Optional properties:

-ti,label		: Name to be registered with timedoutput class.
-ti,mode		: Mode to be supported, 0 to 3 - FIFO, RAM, WAVE and ANALOG.
-ti,wav-seq		: Wave Sequence composed of 11 bytes - wave form id,
				Header size, start upper byte, start lower byte,
				stop upper byte, stop lower byte, repeat count,
				amplitude, frequency, duration and envelope
-ti,gain		: Gain to be programmed for the chip.
-ti,idle-timeout-ms	: Idle timeout in ms to be programmed for the chip to go into
				low power mode after finishing its operation.
-ti,max-runtime-ms	: Maximum time in ms for which chip can drive haptics.

Example:
	i2c@f9967000 {
		ti-drv2667@59 {
			compatible = "ti,drv2667";
			reg = <0x59>;
			vdd-supply = <&drv2667_vreg>;
			vdd-i2c-supply = <&pm8941_s3>;
			ti,label = "vibrator";
			ti,gain = <3>;
			ti,idle-timeout-ms = <20>;
			ti,max-runtime-ms = <15000>;
			ti,mode = <2>;
			ti,wav-seq = [
				/* wave form id */
				01
				/* header size, start and stop bytes */
				05 80 06 00 09
				/* repeat, amp, freq, duration, envelope */
				01 ff 19 02 00];
		};
	};
```

## Documentation/devicetree/bindings/misc/ti_tps65132.txt
```
TI (PANEL) Power Management
This device is designed to support positive / negative voltage for driving TFT-LCD panels.

Required properties:
- compatible: should be "ti,tps65132".
- reg: i2c address to be used.
- pinctrl-names : This should be defined if a target uses gpio and pinctrl framework.
  See "pinctrl" in Documentation/devicetree/bindings/pinctrl/msm-pinctrl.txt.
  It should specify the names of the configs that pinctrl can install in driver
	Following are the pinctrl config that can be installed
	"pmx_tps_active" : Active configuration of pins, this should specify active
	config of enn & enp gpio (if used) defined in their pin groups.
	"pmx_tps_sleep" : Disabled configuration of pins, this should specify sleep
	config of enn & enp gpio (if used) defined in their pin groups.
- pinctrl-0 : This exoplains the active state of the enn & enp gpio lines.
- pinctrl-1 : This exoplains the suspend state of the enn & enp gpio lines.
- tps,enn-gpio: Enable pin for negative supply rail.
- tps,enp-gpio: Enable pin for positive supply rail.

Example:
	tps@3e {
		compatible = "ti,tps65132";
		reg = <0x3e>;
		pinctrl-names = "pmx_tps_active","pmx_tps_suspend";
		pinctrl-0 = <&tps_active>;
		pinctrl-1 = <&tps_suspend>;
		ti,enn-gpio = <&msm_gpio 32 0x00>;
		ti,enp-gpio = <&msm_gpio 97 0x00>;
	};
```

## Documentation/devicetree/bindings/misc/usb-type-c.txt
```
USB Type-C Detection Chip

Required properties :
- compatible : Must be "pericom,usb-type-c" or "ti,usb-type-c"
- reg: 7bit I2C slave address
- interrupt-parent: Should be phandle for the interrupt controller
                    that services interrupts for this device.
- interrupt: IRQ line
- <supply-name>-supply: handle to the regulator device tree node.
        "supply-name" is "vdd_io" regulator to drive I2C SCL and SDA lines.

Optional properties:
- pinctrl-names : This should be defined if a target uses pinctrl framework
  for INT_N and ENB pin. See "pinctrl" in
  Documentation/devicetree/bindings/pinctrl/pinctrl-bindings.txt.
  It should specify the names of the configs that pinctrl can install in driver.
  Following are the pinctrl config that can be installed:
      "usbc_int_default" : Default configuration of pins.
- <vendor-name>,enb-gpio : This corresponds to GPIO that is used to drive ENB
  pin. <vendor-name> can be 'pericom' or 'ti'.
  GPIO flag represents whether ENB pin is active-high(0) or active-low(1).
- <vendor-name>,disable-on-suspend : If present then disable chip on suspend if
  state is not attached. <vendor-name> can be 'pericom' or 'ti'.

Example :
	pericom-type-c@3d {
		compatible = "pericom,usb-type-c";
		reg = <0x3d>;
		vdd_io-supply = <&pm8950_l5>;
		interrupt-parent = <&msm_gpio>;
		interrupts = <102 2>;    /* MSM GPIO 102, TRIGGER_FALLING */
		pericom,enb-gpio = <&msm_gpio 101 0x1>;	/* active low ENB */
		pinctrl-names = "default";
		pinctrl-0 = <&usbc_int_default>;
	};
```

## Documentation/devicetree/bindings/misc/xr-stdalonevwr-misc.txt
```
XR-STDALONEVWR-MISC provides a way to configure xrstdalonevwr-misc driver.

Required properties:
- compatible : should be "qcom,xr-stdalonevwr-misc"

Optional properties:
Example:
	qcom,xr-stdalonevwr-misc {
		compatible = "qcom,xr-stdalonevwr-misc";
	};
```

## Documentation/devicetree/bindings/mmc/msm_sdcc.txt
```
Qualcomm Secure Digital Card Controller (SDCC)

Secure Digital Card Controller provides host interface to
SD/MMC/SDIO cards.

Required properties:
  - compatible: should be "qcom,msm-sdcc"
  - reg: should contain SDCC (mandatory), SDCC-DML (optional) and BAM
    (optional) register maps.
  - reg-names: indicates various resources passed to driver (via reg
    property) by name. "reg-names" examples are "core_mem", "dml_mem"
    and "bam_mem". "dml_mem" and "bam_mem" are optional, and the SDCC
    driver will default to PIO mode when neither are present.
  - interrupts: should contain SDCC core interrupt.
  - interrupt-names: indicates interrupts passed to driver (via interrupts
    property) by name. "core_irq" is mandatory, "bam_irq" is mandatory only
    when BAM DMA engine is used. "status_irq" and "sdiowakeup_irq" are
    optional.
  - qcom,clk-rates: specifies supported SDCC clock frequencies, Units - Hz.
  - qcom,sup-voltages: specifies supported voltage ranges for card. Should
    always be specified in pairs (min, max), Units - mV.
  - <supply-name>-supply: phandle to the regulator device tree node.
    "supply-name" examples are "vdd", "vdd-io".

Optional Properties:
  - cell-index: defines slot ID.
  - qcom,bus-width: defines the bus I/O width that controller supports.
  - wp-gpios: specify GPIO for write protect switch detection.
  - cd-gpios: specify GPIO for card detection.
  - qcom,nonremovable: specifies whether the card in slot is hot pluggable
    or hard wired.
  - qcom,disable-cmd23: disable sending CMD23 to card when controller
    can't support it.
  - qcom,bus-speed-mode: specifies supported bus speed modes by host.
  - qcom,current-limit: specifies max. current the host can drive.
  - qcom,xpc: specifies if the host can supply more than 150mA for SDXC
    cards.
  - qcom,dat1-mpm-int: specifies MPM interrupt number corresponding to
    DAT1 line of SDCC (used only if slot has dedicated DAT1 MSM pin
    (not GPIO))

In the following, <supply> can be vdd (flash core voltage) or vdd-io
(I/O voltage).
  - qcom,<supply>-always-on: specifies whether supply should be kept "on"
    always.
  - qcom,<supply>-lpm-sup: specifies whether supply can be kept in low
    power mode (lpm).
  - qcom,<supply>-voltage-level: specifies voltage levels for supply.
    Should be specified in pairs (min, max), units uV.
  - qcom,<supply>-current-level: specifies load levels for supply in
    lpm or high power mode (hpm). Should be specified in pairs (lpm, hpm),
    units uA.

  - gpios: specifies gpios assigned for sdcc slot.
  - qcom,gpio-names:  a list of strings that map in order to the list
    of gpios. A slot has either gpios or dedicated tlmm pins as represented
    below.
  - qcom,pad-pull-on: Active pull configuration for sdc tlmm pins
  - qcom,pad-pull-off: Suspend pull configuration for sdc tlmm pins.
  - qcom,pad-drv-on: Active drive strength configuration for sdc tlmm pins.
  - qcom,pad-drv-off: Suspend drive strength configuration for sdc tlmm pins.
    Tlmm pins are specified as <clk cmd data>

  - qcom,bus-bw-vectors-bps: specifies array of throughput values in
    Bytes/sec. The values in the array are determined according to
    supported bus speed modes. For example, if host supports SDR12 mode,
    value is 13631488 Bytes/sec.
  - Refer to "Documentation/devicetree/bindings/arm/msm/msm_bus.txt" for
    below optional properties:
	- qcom,msm-bus,name
	- qcom,msm-bus,num-cases
	- qcom,msm-bus,active-only
	- qcom,msm-bus,num-paths
	- qcom,msm-bus,vectors-KBps

Example:

	qcom,sdcc@f9600000 {
	/* SDC1 used as eMMC slot */
	cell-index = <1>;
	compatible = "qcom,msm-sdcc";
	reg = <0xf9600000 0x800   // SDCC register interface
	/* To use PIO instead of BAM, skip DML and BAM regs */
		0xf9600800 0x1800  // DML register interface
		0xf9602000 0x2000> // BAM register interface

	interrupts = <123>;
	qcom,clk-rates = <400000 24000000 48000000>;
	qcom,sup-voltages = <2700 3300>;
	qcom,bus-width = <8>; //8-bit wide
	qcom,nonremovable;

	qcom,msm-bus,name = "sdcc2";
	qcom,msm-bus,num-cases = <7>;
	qcom,msm-bus,num-paths = <1>;
	qcom,msm-bus,vectors-KBps = <81 512 0 0>, /* No vote */
			<81 512 6656 13312>, /* 13 MB/s*/
			<81 512 13312 26624>, /* 26 MB/s */
			<81 512 26624 53248>, /* 52 MB/s */
			<81 512 53248 106496>, /* 104 MB/s */
			<81 512 106496 212992>, /* 208 MB/s */
			<81 512 2147483647 4294967295>; /* Max. bandwidth */
	qcom,bus-bw-vectors-bps = <0 13631488 27262976 54525952 109051904 218103808 4294967295>;
};
```

## Documentation/devicetree/bindings/mmc/nvidia,tegra20-sdhci.txt
```
* NVIDIA Tegra Secure Digital Host Controller

This controller on Tegra family SoCs provides an interface for MMC, SD,
and SDIO types of memory cards.

This file documents differences between the core properties described
by mmc.txt and the properties used by the sdhci-tegra driver.

Required properties:
- compatible : Should be "nvidia,<chip>-sdhci"
- base-clk : Integer.

Optional properties:
- power-gpios : Specify GPIOs for power control
- tap-delay : Integer. Valid range 0...31.
- trim-delay : Integer. Valid range 0...255.
- ddr-clk-limit : Integer.
- built-in : Boolean, indicates whether it is built-in card or not.
- mmc-ocr-mask : 0: 1V8, 1: 2V8.

Example:

sdhci@c8000200 {
	compatible = "nvidia,tegra20-sdhci";
	reg = <0xc8000200 0x200>;
	interrupts = <47>;
	cd-gpios = <&gpio 69 0>; /* gpio PI5 */
	wp-gpios = <&gpio 57 0>; /* gpio PH1 */
	power-gpios = <&gpio 155 0>; /* gpio PT3 */
	bus-width = <8>;
	base-clk = <104000000>;
};
```
