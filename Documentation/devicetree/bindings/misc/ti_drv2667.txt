## Documentation/devicetree/bindings/net/msm-qfec.txt
```
Qualcomm FSM Ethernet Controller (QFEC)

Required properties:
- cell-index : QFEC controller instance number.
- compatible : Should be "qcom,qfec" or "qcom,qfec-nss".
- reg : Offset and length of the register regions for the device
- reg-names : Register region names referenced in 'reg' above.
	Required register resource entries are:
	"qfec_mac"           : QFEC controller register block.

	Optional register resource entries are:
	"qfec_csr"           : QFEC wrapper register block.
	                       Required if 'qcom,qfec-nss' compatibility is
			       specified.
	"qfec_qsgmii"        : QFEC SGMII serdes register block.
	                       Required if 'phy-mode' is "sgmii" and
			       'qcom,qfec-nss' compatibility is specified.
	"qfec_rgmii_csr"     : QFEC RGMII CDC CSR register block.
	                       Required if 'phy-mode' is "rgmii" and
			       'qcom,qfec-nss' compatibility is specified.

- interrupts : Interrupt numbers used by this controller
- phy-addr : Specifies phy address on MDIO bus.
- phy-mode : Specifies PHY type being used (eg., "sgmii", "rgmii", "gmii" etc).

Optional properties:
- local-mac-address : The 6-byte MAC address.
		      This field is optional. If present, it is only a
		      placeholder for the MAC address. The correct MAC
		      address is populated in device tree during platform
		      initialization.
- qcom,qsgmii-pcs-chan : Specifies to use which QSGMII PCS channel
		      This field is required if 'qcom,qfec-nss' compatibility is
		      specified.
- pinctrl-names : Specifies the pinctrl binding of GPIO pins for MDIO.
		      The "active" pinctrl-name specifies the binding when the
		      GPIO pins serves as MDIO pins.
		      The "deactive" pinctrl-name specifies the binding when the
		      GPIO pins does not serve as MDIO pins.

Example:
	qfec0: qcom,qfec@0xe7000000 {
		compatible = "qcom,qfec-nss";
		cell-index = <0>;
		reg = <0xe7000000 0x10000>,
			<0xfc800000 0x4000>,
			<0xfc900000 0x100000>,
			<0xfcb00000 0x100000>;
		reg-names = "qfec_mac",
			"qfec_csr",
			"qfec_qsgmii",
			"qfec_rgmii_csr";
		interrupts = <0 242 0>;
		phy-addr = <6>;
		phy-mode = "rgmii";
		qcom,qsgmii-pcs-chan = <1>;
		pinctrl-names = "active", "deactive";
		pinctrl-0 = <&qfec0_mdio_default>;
		pinctrl-1 = <&gp_mdio_default>;
		status = "ok";
	};
```

## Documentation/devicetree/bindings/net/msm_nss_crypto.txt
```
* Qualcomm Technologies Inc. Crypto Platform Driver.

This driver configures the crypto engine for IPSec traffic in UBI32.

Required properties:
- compatible: Should be qcom,nss-crypto
- reg: Physical address and length of the register set for the device.
- qcom,ee: Number of interrupt lines(Execution Environments) supported by BAM.

Example:

crypto0: crypto@e8000000 {
	 compatible = "qcom,nss-crypto";
	 reg-names = "crypto_pbase", "bam_base";
	 reg = <0xe8000000 0x20000>,
	     <0xe8004000 0x22000>;
	 qcom,ee = <0>;
};
```

## Documentation/devicetree/bindings/net/msm_nss_drv.txt
```
* Qualcomm Technologies Inc. NSS HLOS Platform Driver.

This driver communicates with the NSS Firmware, and provides empty buffers for packet-processing to the UBI32 processor.
It also keeps track of sync packets from NSS Firmware.
This driver has 2 sections listed below, one common to all the UBI32 cores and other specific to each UBI32 core.

1. Driver access details common to UBI32 cores

Required properties:
- compatible: "qcom,nss-common"
- reg-names: Indicates various resources passed to driver by name.
		"nss_fpb_base","clk_ctl_base".
		These correspond to different register bases UBI32.
- reg: physical address and length of the register set for the device.

example:
nss-common@fc800000 {
	compatible = "qcom,nss-common";
	reg-names = "nss_fpb_base", "clk_ctl_base";
	reg = <0xfc800000 0x00001000>,
	    <0xfc400000 0x00004000>;
};

2. Driver access details specific to each UBI32 core.

Required properties:
- compatible: "qcom,nss"
- interrupts: UBI32 to Apps interrupts for Sync/Data Packets and Empty Buffers.
- reg-names: Indicates various resources passed to driver by name.
		"nphys","vphys"
		Refers to TCM and CSM Base Addresses of UBI32 Memory map.
- reg: physical address and length of the register set for the device.
- qcom,id: Unique Identifier for the HLOS block.This field is unique identifier for the core, which is also used as an index for global nss context.
Optional properties:
- qcom,ipv4-enabled: Enables registeration of N2H/PPPoE/ETH handlers, to receive stat sync
	             IPV4 packets from UBI32.
- qcom,ipv6-enabled: Enables registeration of IPV6 packet handlers, to receive stat sync
                     IPV6 packets from UBI32.
- qcom,crypto-enabled: Enables the cryptography feature for the platform.
- qcom,gmac0-enabled: Enables GMAC0 port.
- qcom,gmac1-enabled: Enables GMAC1 port.

example:
nss: nss@e6000000 {
	compatible = "qcom,nss";
	interrupts = <0 229 0x4>,
		<0 230 0x4>;
	reg-names = "nphys", "vphys";
	reg = <0xe6000000 0x1000>,
		<0xe4000000 0x20000>;
	qcom,id = <0>;
	qcom,num-irq = <2>;
	qcom,ipv4-enabled;
	qcom,ipv6-enabled;
	qcom,crypto-enabled;
	qcom,gmac0-enabled;
	qcom,gmac1-enabled;
};
```

## Documentation/devicetree/bindings/net/msm_nss_gmac.txt
```
* Qualcomm Technologies Inc. NSS GMAC Platform Driver.

This driver configures GMAC interfaces on the board, along with MII/MDIO interfaces and PHY devices.This forms the base interface for HLOS/Crypto Drivers.
This driver has 2 sections listed below, one common to all the GMACs and other specific to each GMAC interface.

1. Driver access details common to all GMACs

Required properties:
- compatible: "qcom,nss-gmac-common"
- reg-names: Indicates various resources passed to driver by name.
		"nss_reg_base", "qsgmii_reg_base", "clk_ctl_base".
		These correspond to different register bases of GMAC.
- reg: physical address and length of the register set for the device.

Example:
nss-gmac-common@fc800000 {
	compatible = "qcom,nss-gmac-common";
	reg-names = "nss_reg_base" , "qsgmii_reg_base", "clk_ctl_base";
	reg = <0xfc800000 0x0000ffff>,
	    <0xfc900000 0x0000ffff>,
	    <0xfc400000 0x00004000>;
};

Required properties:
- device_type: = "network";
- compatible: = should be "qcom,nss-gmac";
- reg:  physical address and length of the register set for the device.
- interrupts: GMAC interrupts to this processor.
- phy-mode:  Specifies PHY type being used (eg., "sgmii", "rgmii", "gmii" etc).
- qcom,id: Unique Identifier for the GMAC block.This field is unique identifier for the core,
	                which is also used as an index for global nss context.
- qcom,pcs-chanid: Specifies the channel ID used by PHY to communicate with MAC Chip.
- qcom,phy-mdio-addr: MDIO port number, used for communication with PHY chips
- qcom,poll-required: Enables disables auto-negotiation , thus polling the PHY chip to
			determine the configuration attributes of relavant chips.
- qcom,rgmii-delay: Enables delay during RGMI clock configuration
- qcom,forced-speed: The speed setting forced onto the GMAC, rather then probed.
- qcom,forced-duplex: The Duplex setting forced onto the GMAC,rather then probed.
- local-mac-address: Dummy MAC Address to be used at the time of GMAC initialization

Optional properties:

gmac0: ethernet@e7000000 {
	device_type = "network";
	compatible = "qcom,nss-gmac";
	reg = <0xe7000000 0x200000>;
	interrupts = <0 242 0>;
	phy-mode = "sgmii";
	qcom,id = <0>;
	qcom,pcs-chanid = <1>;
	qcom,phy-mdio-addr = <0>;
	qcom,poll-required = <1>;
	qcom,rgmii-delay = <0>;
	qcom,forced-speed = <0>;
	qcom,forced-duplex = <10>;
	local-mac-address = [000000000000];
	mdiobus = <&mdio0>;
};
```

## Documentation/devicetree/bindings/net/neutrino_avb.txt
```
* Neutrino Ethernet *
This driver implements Ethernet driver for Neutrino ethernet controller
Required properties:
  - compatible: Should be "qcom,ntn_avb"
  - ntn-rst-delay-msec: delay (msec) required after PCIe reset for stabilization
  - ntn-rc-num: PCIe root complex number on which Neutrino is connected

Optional properties:
  - ntn-bus-num: PCIe bus number on which Neutrino is connected
  - ntn-rst-gpio: Neutrino reset GPIO
  - vdd-ntn-hsic-supply: neutrino HSIC power supply
  - vdd-ntn-pci-supply: PCIe core power supply
  - vdd-ntn-io-supply:  Neutrino IO power supply
  - vdd-ntn-phy-supply: Ethernet Phy power supply
  - vdd-ntn-core-supply:  Neutrino core power supply
  - pinctrl-names: should contain GPIO details
  - pinctrl-0: Neutrino reset GPIO [this is from MSM]
  - ntn-rst-delay-msec: dealy (msec) required after PCIe reset for stabilization
  - ntn-rc-num: PCIe root complex number on which Neutrino is connected
  - qcom,txc-skew-ps: Skew control of TXC pad
  - qcom,rxc-skew-ps: Skew control of RXC pad

Example:
	qcom,ntn_avb {
		compatible = "qcom,ntn_avb";
		ntn-rst-gpio = <&pm8994_gpios 13 0>;
		vdd-ntn-hsic-supply = <&pm8994_l25>;
		vdd-ntn-pci-supply = <&pm8994_s4>;
		vdd-ntn-io-supply = <&pm8994_s4>;
		vdd-ntn-phy-supply = <&pm8994_l9>;
		vdd-ntn-core-supply = <&pm8994_l19>;
		pinctrl-names = "default";
		pinctrl-0 = <&ntn_default>;
		qcom,ntn-rst-delay-msec = <100>;
		qcom,ntn-rc-num = <1>;
		qcom,ntn-bus-num = <1>;
		qcom,txc-skew-ps = <1860>;
		qcom,rxc-skew-ps = <1860>;
	};
```

## Documentation/devicetree/bindings/net/neutrino_hsic.txt
```
* HSIC Neutrino Ethernet *

This driver implements HSIC based Ethernet driver for Neutrino ethernet controller

Required properties:
  - compatible: Should be "qcom,ntn-hsic"
  - vdd-ntn-hsic-supply: Neutrino HSIC power supply
  - ntn-rst-gpio: Neutrino reset GPIO
  - ntn-phy-id: Neutrino PHY ID
Optional properties:
  - ntn-timestamp-valid-window: Timestamp valid window in ms.
				Each unit represents 16.75ms.
  - ntn-timestamp-valid-window-disable: Disable Timestamp valid window feature.
				if this property not set, then feature disabled
				in driver.

Example:
	qcom,ntn_hsic {
		compatible = "qcom,ntn-hsic";
		vdd-ntn-hsic-supply = <&mdm9607_l11>;
		pinctrl-names = "default";
		pinctrl-0 = <&ntn_rst_gpio_default>;
		ntn-rst-gpio = <&tlmm_pinmux 30 1>;
		ntn-phy-id = <7>;
		ntn-timestamp-valid-window = <4>;
		ntn-timestamp-valid-window-disable = <0>;
	};
```

## Documentation/devicetree/bindings/net/qcom,emac-dwc-eqos.txt
```
Qualcomm Technologies Inc. EMAC Gigabit Ethernet controller

This network controller consists of the MAC and
RGMII IO Macro for interfacing with PHY.

Required properties:

emac_hw node:
- compatible: Should be "qcom,emac-dwc-eqos"
- reg: Offset and length of the register regions for the mac and io-macro
- interrupts: Interrupt number used by this controller
- io-macro-info: Internal io-macro-info
- emac_emb_smmu: Internal emac smmu node

Optional:
- qcom,msm-bus,name: String representing the client-name
- qcom,msm-bus,num-cases: Total number of usecases
- qcom,msm-bus,num-paths: Total number of master-slave pairs
- qcom,msm-bus,vectors-KBps: Arrays of unsigned integers representing:
                             master-id, slave-id, arbitrated bandwidth
                             in KBps, instantaneous bandwidth in KBps
qcom,bus-vector-names: specifies string IDs for the corresponding bus vectors
                       in the same order as qcom,msm-bus,vectors-KBps property.
- qcom,arm-smmu: Boolean, if present enables EMAC SMMU support in sdxpoorwills.

Internal io-macro-info:
- io-macro-bypass-mode: <0 or 1> internal or external delay configuration
- io-interface: <rgmii/mii/rmii> PHY interface used

Internal emac_emb_smmu:
- compatible: Should be "qcom,emac-smmu-embedded".
- qcom,smmu-s1-bypass: Boolean, if present S1 bypass is enabled.
- iommus: Includes the <&smmu_phandle stream_id size> pair for each context
			bank.
- qcom,iova-mapping: <starting_address size> of the smmu context bank.

Example:

soc {
	emac_hw: qcom,emac@00020000 {
			compatible = "qcom,emac-dwc-eqos";
			qcom,arm-smmu;
			reg = <0x20000 0x10000>,
				  <0x36000 0x100>;
				  <0x3D00000 0x300000>;
			reg-names = "emac-base", "rgmii-base";
			interrupts = <0 62 4>, <0 60 4>,
					<0 49 4>, <0 50 4>,
					<0 51 4>, <0 52 4>,
					<0 53 4>, <0 54 4>,
					<0 55 4>, <0 56 4>,
					<0 57 4>;
			interrupt-names = "sbd-intr", "lpi-intr",
				 "phy-intr", "tx-ch0-intr",
				 "tx-ch1-intr", "tx-ch2-intr",
				 "tx-ch3-intr", "tx-ch4-intr",
				 "rx-ch0-intr", "rx-ch1-intr",
				 "rx-ch2-intr", "rx-ch3-intr";
			qcom,msm-bus,name = "emac";
			qcom,msm-bus,num-cases = <4>;
			qcom,msm-bus,num-paths = <2>;
			qcom,msm-bus,vectors-KBps =
				<98 512 0 0>, <1 781 0 0>, /* No vote */
				<98 512 1250 0>, <1 781 0 40000>,  /* 10Mbps vote */
				<98 512 12500 0>, <1 781 0 40000>,  /* 100Mbps vote */
				<98 512 125000 0>, <1 781 0 40000>; /* 1000Mbps vote */
			qcom,bus-vector-names = "10", "100", "1000";
			clock-names = "emac_axi_clk", "emac_ptp_clk",
				"emac_rgmii_clk", "emac_slv_ahb_clk";
			qcom,phy-reset = <&tlmm 79 GPIO_ACTIVE_HIGH>;
			qcom,phy-intr-redirect = <&tlmm 124 GPIO_ACTIVE_LOW>;
			gdsc_emac-supply = <&emac_gdsc>;

			io-macro-info {
				io-macro-bypass-mode = <0>;
				io-interface = "rgmii";
			};

			emac_emb_smmu: emac_emb_smmu {
				compatible = "qcom,emac-smmu-embedded";
				qcom,smmu-s1-bypass;
				iommus = <&apps_smmu 0x3C0 0x0>;
				qcom,iova-mapping = <0x80000000 0x40000000>;
			};
		};
}
```

## Documentation/devicetree/bindings/net/qcom,sja1105p-eth-switch.txt
```
* NXP SJA1105P 10/100/1000 Ethernet Switch Driver

Required properties:
### Properties of top level
- compatible: Should be "qcom,nxp,sja1105p-switch".
- reg: Should contain SPI chip select.
- spi-max-frequency: Should contain maximum spi clock frequency
  for slave device.
- spi-cpha: SPI configuration to enable shift clock phase (CPHA) mode.
- switch-speed: Should contain switch ports speed 10/100/1000 Mbps.
- pinctrl-names : Names corresponding to the numbered pinctrl states
- pinctrl-<n> : Pinctrl states as described in bindings/pinctrl/pinctrl-bindings.txt
- qcom,reset-gpio: Reference to the GPIO connected to the reset input.

### Properties of the port-X child node
- `null-phy`: Determines if the port has a PHY connected to it or not
- `phy-ref`: _phandle_ to the connected ethernet PHY
   **NOTE**: Must be `0x00` in case there is no PHY connected to port-X
   (for example if port-X is a host port or a cascaded port)
- `logical-port-num`: logical port number, used for the port mapping
   **NOTE**: Must be `0xff` in case port-X is a cascaded port.

Example:

	sja1105: ethernet-switch@0{
		compatible = "qcom,nxp,sja1105p-switch";
		reg = <0>;
		spi-max-frequency = <12000000>;
		spi-cpha;
		switch-speed = <1000>;
		pinctrl-names = "default";
		pinctrl-0 = <&sja1105_default>;
		qcom,reset-gpio = <&tlmm 91 0x1>;

		port-0 {
			null-phy = <0x1>;
			phy-ref = < 0 >;
			logical-port-num = < 0 >;
		};

		port-1 {
			null-phy = <0x1>;
			phy-ref = < 0 >;
			logical-port-num = < 1 >;
		};

		port-2 {
			null-phy = <0x1>;
			phy-ref = < 0 >;
			logical-port-num = < 2 >;
		};

		port-3 {
			null-phy = <0x1>;
			phy-ref = < 0 >;
			logical-port-num = < 3 >;
		};

		port-4 {
			null-phy = <0x1>;
			phy-ref = < 0 >;
			logical-port-num = < 4 >;
		};
	};
```
