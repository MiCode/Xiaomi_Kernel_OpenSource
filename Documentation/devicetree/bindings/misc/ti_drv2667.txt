## Documentation/devicetree/bindings/net/can/k61-can.txt
```
* Kinetis K61 CAN *

This driver implements SPI slave protocol for Freescale K61 CAN controller.

Required properties:
  - compatible: Should be "fsl,k61".
  - reg: Should contain SPI chip select.
  - interrupt-parent: Should specify interrupt controller for the interrupt.
  - interrupts: Should contain IRQ line for the CAN controller.
  - reset-gpio: Reference to the GPIO connected to the reset input.
  - pinctrl-names : Names corresponding to the numbered pinctrl states.
  - pinctrl-0 : This explains the active state of the GPIO line.
  - pinctrl-1 : This explains the suspend state of the GPIO line.


Example:

	can-controller@0 {
		compatible = "fsl,k61";
		reg = <0>;
		interrupt-parent = <&tlmm_pinmux>;
		interrupts = <25 0>;
		reset-gpio = <&tlmm_pinmux 11 0x1>;
		pinctrl-names = "active", "sleep";
		pinctrl-0 = <&can_rst_on>;
		pinctrl-1 = <&can_rst_off>;
	};
```

## Documentation/devicetree/bindings/net/can/microchip,mcp25xxfd.txt
```
* Microchip MCP2517 stand-alone CAN controller device tree bindings

Required properties:
 - compatible: Should be one of the following:
   - "microchip,mcp2517fd" for MCP2517fd.
 - reg: SPI chip select.
 - clocks: The clock feeding the CAN controller.
 - interrupt-parent: The parent interrupt controller.
 - interrupts: Should contain IRQ line for the CAN controller.
 - gpio-controller: Marks the device node as a GPIO controller

Optional properties:
 - vdd-supply: Regulator that powers the CAN controller.
 - xceiver-supply: Regulator that powers the CAN transceiver.
 - microchip,clock_out_div = <0|1|2|4|10>: Clock output pin divider
					   0 = Start of Frame output
					   default: 10
 - microchip,clock_div2: bool: divide the internal clock by 2
 - gpio_opendrain: bool: enable open-drain for all pins (except cantx)

Example:
	can0: can@1 {
		compatible = "microchip,mcp2517fd";
		reg = <1>;
		clocks = <&clk24m>;
		interrupt-parent = <&gpio4>;
		interrupts = <13 0x8>;
		vdd-supply = <&reg5v0>;
		xceiver-supply = <&reg5v0>;
		gpio-controller;
	};
```

## Documentation/devicetree/bindings/net/can/rh850-can.txt
```
* Renesas RH850 CAN *

This driver implements spi slave protocol for rh850 can controller

Required properties:
  - compatible: Should be "renesas,rh850"
  - reg: Should contain spi chip select
  - interrupt-parent: Should specify interrupt controller for the interrupt
  - interrupts: Should contain IRQ line for the CAN controller
  - spi-max-frequency: Should contain maximum spi clock frequency for
                       slave device

Example:

	can-controller@0 {
		compatible = "renesas,rh850";
		reg = <0>;
		interrupt-parent = <&tlmm>;
		interrupts = <127 0>;
		spi-max-frequency = <5000000>;
	};
```

## Documentation/devicetree/bindings/net/danipc.txt
```
Qualcomm Technologies Inc. DANIPC driver

This is a kernel driver which makes use of DAN IPC hardware module.
DAN IPC is an inter-processor communication network which provides facilities
for fast and reliable data passing between processors.

Required properties:
- compatible:	should be "qcom,danipc"
- reg-names:	"ipc_bufs" - APPS IPC buffers region
		"agent_table" - IPC global agent table region
		"apps_ipc_intr_en" - APPS IPC interrupt enable MUX region
		"phycpu0_ipc" - PHY CPU0 IPC region
		"phycpu1_ipc" - PHY CPU1 IPC region
		"phycpu2_ipc" - PHY CPU2 IPC region
		"phycpu3_ipc" - PHY CPU3 IPC region
		"phydsp0_ipc" - PHY DSP0 IPC region
		"phydsp1_ipc" - PHY DSP1 IPC region
		"phydsp2_ipc" - PHY DSP2 IPC region
		"apps_ipc" - APPS IPC region
		"qdsp6_0_ipc" - QDSP6 0 IPC region
		"qdsp6_1_ipc" - QDSP6 1 IPC region
		"qdsp6_2_ipc" - QDSP6 2 IPC region
		"qdsp6_3_ipc" - QDSP6 3 IPC region
- reg:		location and size of APPS IPC buffers
		location and size of IPC global agent table
		location and size of APPS IPC interrupt enable MUX
		location and size of PHY CPU0 IPC region
		location and size of PHY CPU1 IPC region
		location and size of PHY CPU2 IPC region
		location and size of PHY CPU3 IPC region
		location and size of PHY DSP0 IPC region
		location and size of PHY DSP1 IPC region
		location and size of PHY DSP2 IPC region
		location and size of APPS IPC region
		location and size of QDSP6 0 IPC region
		location and size of QDSP6 1 IPC region
		location and size of QDSP6 2 IPC region
		location and size of QDSP6 3 IPC region
- interrupts:	IPC interrupt line

Optional properties:
-qcom,phycpu0-shm-size: size of shared memory region for PHY CPU0
-qcom,phycpu1-shm-size: size of shared memory region for PHY CPU1
-qcom,phycpu2-shm-size: size of shared memory region for PHY CPU2
-qcom,phycpu3-shm-size: size of shared memory region for PHY CPU3
-qcom,phydsp0-shm-size: size of shared memory region for PHY DSP0
-qcom,phydsp1-shm-size: size of shared memory region for PHY DSP1
-qcom,phydsp2-shm-size: size of shared memory region for PHY DSP2
-qcom,apps-shm-size: size of shared memory region for APPS
-qcom,qdsp6-0-shm-size: size of shared memory region for QDSP6 0
-qcom,qdsp6-1-shm-size: size of shared memory region for QDSP6 1
-qcom,qdsp6-2-shm-size: size of shared memory region for QDSP6 2
-qcom,qdsp6-3-shm-size: size of shared memory region for QDSP6 3

Examples:
	qcom,danipc@24200000 {
		compatible = "qcom,danipc";
		reg-names = "ipc_bufs", "agent_table", "apps_ipc_intr_en",
				"phycpu0_ipc", "phycpu1_ipc", "phycpu2_ipc", "phycpu3_ipc",
				"phydsp0_ipc", "phydsp1_ipc", "phydsp2_ipc", "apps_ipc",
				"qdsp6_0_ipc", "qdsp6_1_ipc", "qdsp6_2_ipc",
				"qdsp6_3_ipc";
		reg = <0x24200000 0x80000>, /* ipc_bufs */
			<0x1cf60000 0x2000>, /* agent_table */
			<0xfd4a3500 0x100>, /* apps_ipc_intr_en */
			<0xf683a000 0x100>, /* phycpu0_ipc */
			<0xf683a000 0x100>, /* phycpu1_ipc */
			<0xf683c000 0x100>, /* phycpu2_ipc */
			<0xf683c000 0x100>, /* phycpu3_ipc */
			<0xf6862000 0x100>, /* phydsp0_ipc */
			<0xf6862000 0x100>, /* phydsp1_ipc */
			<0xf6878000 0x100>, /* phydsp2_ipc */
			<0xfd490000 0x100>, /* apps_ipc */
			<0xfd491000 0x100>, /* qdsp6_0_ipc */
			<0xfd492000 0x100>, /* qdsp6_1_ipc */
			<0xfd496000 0x100>, /* qdsp6_2_ipc */
			<0xfd494000 0x100>; /* qdsp6_3_ipc */
		qcom,qdsp6-2-shm-size = <0x4000000>;
		interrupts = <0 202 0>;
	};
```

## Documentation/devicetree/bindings/net/msm-emac.txt
```
Qualcomm Technologies EMAC Gigabit Ethernet Controller

This network controller consists of two devices: a MAC and an
internal PHY (SGMII/RGMII). Each device is represented by a device tree node.
A phandle connects the MAC node to its corresponding internal phy node.
Another phandle points to the external PHY node.

Required properties:

MAC node:
- compatible : Should be "qcom,mdm9607-emac" for mdm9607 based EMAC driver
	       Should be "qcom,emac" for other targets based EMAC driver
- reg : Offset and length of the register regions for the device
- reg-names : Register region names referenced in 'reg' above.
	Required register resource entries are:
	"emac"       : EMAC controller register block.
	"emac_csr"   : EMAC wrapper register block.
	Optional register resource entries are:
	"emac_1588"      : EMAC 1588 (PTP) register block.
			   Required if 'qcom,emac-tstamp-en' is present.
- interrupts : Interrupt number used by this controller
- interrupt-names : Interrupt resource names referenced in 'interrupts' above.
	Required interrupt resource entries are:
	"emac_core0_irq" : EMAC core0 interrupt.
	"emac_core1_irq" : EMAC core1 interrupt.
	"emac_core2_irq" : EMAC core2 interrupt.
	"emac_core3_irq" : EMAC core3 interrupt.
	Optional interrupt resource entries are:
	"emac_wol_irq"   : EMAC Wake-On-LAN (WOL) interrupt.
			   Required if WOL is supported.
- phy-mode: String, operation mode of the PHY interface. See ethernet.txt in the
	same directory.
- internal-phy : phandle to the internal PHY node
- phy-handle : phandle the the external PHY node

Internal PHY node:
- compatible : Should be "qcom,mdm9607-emac-sgmii" for mdm9607.
	       Should be "qcom,qdf2432-emac-sgmii" for QDF2432
	       Should be "qcom,fsm9900-emac-sgmii" for FSM9900
- reg : Offset and length of the register region(s) for the device
- reg-names : Register region names referenced in 'reg' above.
	"emac_sgmii" : EMAC SGMII PHY register block.
		       Required if 'phy-mode' is "sgmii".
- interrupts : Interrupt number used by this controller
- interrupt-names : Interrupt resource names referenced in 'interrupts' above.
	"emac_sgmii_irq" : EMAC SGMII interrupt.
			   Required if 'phy-mode' is "sgmii".

The external phy child node:
- reg : The phy address

Optional properties:

MAC node:
- qcom,emac-tstamp-en : Enables the PTP (1588) timestamping feature.
		        Include this only if PTP (1588) timestamping
			feature is needed. If included, "emac_1588" register
			base should be specified.
- mac-address : The 6-byte MAC address. If present, it is the default
	MAC address.
- qcom,no-external-phy : Indicates there is no external PHY connected to EMAC.
			 Include this only if the EMAC is directly connected to
			 the peer end without EPHY.
- qcom,emac-ptp-grandmaster : Enable the PTP (1588) grandmaster mode.
			      Include this only if PTP (1588) is configured as
			      grandmaster.
- qcom,emac-ptp-frac-ns-adj : The vector table to adjust the fractional ns per
			      RTC clock cycle.
			     Include this only if there is accuracy loss of
			     fractional ns per RTC clock cycle. For individual
			     table entry, the first field indicates the RTC
			     reference clock rate. The second field indicates
			     the number of adjustment in 2 ^ -26 ns.
- tstamp-eble : Enables the PTP (1588) timestamping feature in ACPI mode.
- <supply-name>-supply: phandle to the regulator device tree node
			Required "supply-name" are "emac_vreg*"
- qcom,vdd-voltage-level: This property must be a list of five integer
        values (max voltage value for supply 1/2/3/4/5) where each value
	represents a voltage in microvolts.


Example:

FSM9900:

soc {
	#address-cells = <1>;
	#size-cells = <1>;

	emac0: ethernet@feb20000 {
		compatible = "qcom,fsm9900-emac";
		reg-names = "emac", "emac_csr", "emac_1588";
		reg = <0xfeb20000 0x10000>,
		      <0xfeb36000 0x1000>,
		      <0xfeb3c000 0x4000>,
		interrupts = <0 76 0>, <0 77 0>, <0 78 0>, <0 79 0>;
		interrupt-names = "emac_core0_irq", "emac_core1_irq",
				  "emac_core2_irq", "emac_core3_irq";

		clocks = <&gcc 0>, <&gcc 1>, <&gcc 3>, <&gcc 4>, <&gcc 5>,
			<&gcc 6>, <&gcc 7>;
		clock-names = "axi_clk", "cfg_ahb_clk", "high_speed_clk",
			"mdio_clk", "tx_clk", "rx_clk", "sys_clk";

		internal-phy = <&emac_sgmii>;

		phy-handle = <&phy0>;

		#address-cells = <1>;
		#size-cells = <0>;
		phy0: ethernet-phy@0 {
			reg = <0>;
		};

		pinctrl-names = "default";
		pinctrl-0 = <&mdio_pins_a>;
	};

	emac_sgmii: ethernet@feb38000 {
		compatible = "qcom,fsm9900-emac-sgmii";
		reg-names = "emac_sgmii";
		reg = <0xfeb38000 0x1000>;
		interrupts = <80>;
	};

	tlmm: pinctrl@fd510000 {
		compatible = "qcom,fsm9900-pinctrl";

		mdio_pins_a: mdio {
			state {
				pins = "gpio123", "gpio124";
				function = "mdio";
			};
		};
	};


MDM9607:

        emac0: qcom,emac@7c40000 {
                compatible = "qcom,mdm9607-emac";
                reg-names = "emac", "emac_csr", "emac_1588";
                reg = <0x7c40000 0x10000>,
                        <0x7c56000 0x1000>,
                        <0x7c5c000 0x4000>;

                #address-cells = <0>;
                interrupt-parent = <&emac0>;
                #interrupt-cells = <1>;
                interrupts = <0 1>;
                interrupt-map-mask = <0xffffffff>;
                interrupt-map = <0 &intc 0 76 0
                                1 &tlmm_pinmux 30 0x8>;
                interrupt-names = "emac_core0_irq", "emac_wol_irq";

                emac_vreg1-supply = <&mdm9607_l1>;
                emac_vreg2-supply = <&mdm9607_l3>;
                emac_vreg3-supply = <&mdm9607_l5>;
                emac_vreg4-supply = <&mdm9607_l11>;
                emac_vreg5-supply = <&emac_lan_vreg>;
                qcom,vdd-voltage-level = <1250000 1800000 2850000 1800000 0>;
                clocks = <&clock_gcc clk_gcc_emac_0_axi_clk>,
                         <&clock_gcc clk_gcc_emac_0_ahb_clk>,
                         <&clock_gcc clk_gcc_emac_0_125m_clk>,
                         <&clock_gcc clk_gcc_emac_0_sys_25m_clk>,
                         <&clock_gcc clk_gcc_emac_0_tx_clk>,
                         <&clock_gcc clk_gcc_emac_0_rx_clk>,
                         <&clock_gcc clk_gcc_emac_0_sys_clk>;
                clock-names = "axi_clk", "cfg_ahb_clk", "high_speed_clk",
                        "mdio_clk", "tx_clk", "rx_clk", "sys_clk";

                internal-phy = <&emac_sgmii>;
                phy-handle = <&phy0>;
                phy-mode = "sgmii";

                pinctrl-names = "emac_mdio_active", "emac_mdio_sleep",
                        "emac_ephy_active", "emac_ephy_sleep";
                pinctrl-0 = <&emac0_mdio_active>;
                pinctrl-1 = <&emac0_mdio_sleep>;
                pinctrl-2 = <&emac0_ephy_active>;
                pinctrl-3 = <&emac0_ephy_sleep>;
                qcom,emac-tstamp-en;
                qcom,emac-ptp-frac-ns-adj = <125000000 1>;

		qcom,msm-bus,name = "emac0";
		qcom,msm-bus,num-cases = <2>;
		qcom,msm-bus,num-paths = <1>;
		qcom,msm-bus,vectors-KBps =
				<114 512 0 0>,
				<114 512 125000 800000>;
                status = "disable";

                phy0: ethernet-phy@0 {
                        reg = <0>;
                };
        };

        emac_sgmii: ethernet@7c58000 {
                compatible = "qcom,mdm9607-emac-sgmii";
                reg-names = "emac_sgmii";
                reg = <0x7c58000 0x400>;
                interrupt-names = "emac_sgmii_irq";
                interrupts = <0 80 0>;
        };
```
