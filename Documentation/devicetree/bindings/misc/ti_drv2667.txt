## Documentation/devicetree/bindings/mmc/sdhci-msm.txt
```
Qualcomm Technologies, Inc. Standard Secure Digital Host Controller (SDHC)

Secure Digital Host Controller provides standard host interface to SD/MMC/SDIO cards.

Required properties:
  - compatible : should be "qcom,sdhci-msm"
		For SDCC version 5.0.0, MCI registers are removed from SDCC interface
		and some registers are moved to HC. New compatible string is added to
		support this change - "qcom,sdhci-msm-v5".
  - reg : should contain SDHC, SD Core register map.
  - reg-names : indicates various resources passed to driver (via reg proptery) by name.
		Required "reg-names" are "hc_mem" and "core_mem"
		optional ones are "tlmm_mem"
  - interrupts : should contain SDHC interrupts.
  - interrupt-names : indicates interrupts passed to driver (via interrupts property) by name.
		      Required "interrupt-names" are "hc_irq" and "pwr_irq".
  - <supply-name>-supply: phandle to the regulator device tree node
			  Required "supply-name" are "vdd" and "vdd-io".
  - qcom,ice-clk-rates: this is an array that specifies supported Inline
		    Crypto Engine (ICE) clock frequencies, Units - Hz.
  - sdhc-msm-crypto: phandle to SDHC ICE node

Required alias:
- The slot number is specified via an alias with the following format
	'sdhc{n}' where n is the slot number.

Optional Properties:
	- interrupt-names - "status_irq". This status_irq will be used for card
			     detection.
	- qcom,bus-width - defines the bus I/O width that controller supports.
			   Units - number of bits. The valid bus-width values are
			   1, 4 and 8.
	- qcom,nonremovable - specifies whether the card in slot is
			      hot pluggable or hard wired.
	- qcom,nonhotplug - specifies the card in slot is not hot pluggable.
			    if card lost or removed manually at runtime, don't retry
			    to redetect it until next reboot probe.
	- qcom,bus-speed-mode - specifies supported bus speed modes by host.
				The supported bus speed modes are :
				"HS200_1p8v" - indicates that host can support HS200 at 1.8v.
				"HS200_1p2v" - indicates that host can support HS200 at 1.2v.
				"DDR_1p8v" - indicates that host can support DDR mode at 1.8v.
				"DDR_1p2v" - indicates that host can support DDR mode at 1.2v.
	- qcom,devfreq,freq-table - specifies supported frequencies for clock scaling.
				    Clock scaling logic shall toggle between these frequencies based
				    on card load. In case the defined frequencies are over or below
				    the supported card frequencies, they will be overridden
				    during card init. In case this entry is not supplied,
				    the driver will construct one based on the card
				    supported max and min frequencies.
				    The frequencies must be ordered from lowest to highest.
	- qcom,pm-qos-irq-type - the PM QoS request type to be used for IRQ voting.
	  Can be either "affine_cores" or "affine_irq". If not specified, will default
	  to "affine_cores". Use "affine_irq" setting in case an IRQ balancer is active,
	  and IRQ affinity changes during runtime.
	- qcom,pm-qos-irq-cpu - specifies the CPU for which IRQ voting shall be done.
	  If "affine_cores" was specified for property 'qcom,pm-qos-irq-type'
	  then this property must be defined, and is not relevant otherwise.
	- qcom,pm-qos-irq-latency - a tuple defining two latency values with which
	  PM QoS IRQ voting shall be done. The first value is the latecy to be used
	  when load is high (performance mode) and the second is for low loads
	  (power saving mode).
	- qcom,pm-qos-cpu-groups - defines cpu groups mapping.
	  Each cell represnets a group, which is a cpu bitmask defining which cpus belong
	  to that group.
	- qcom,pm-qos-<mode>-latency-us - where <mode> is either "cmdq" or "legacy".
	  An array of latency value tuples, each tuple corresponding to a cpu group in the order
	  defined in property 'qcom,pm-qos-cpu-groups'. The first value is the latecy to be used
	  when load is high (performance mode) and the second is for low loads
	  (power saving mode). These values will be used for cpu group voting for
	  command-queueing mode or legacy respectively.
	- qcom,core_3_0v_support: an optional property that is used to fake
	  3.0V support for SDIO devices.
	- qcom,scaling-lower-bus-speed-mode:	specifies the lower bus speed mode to be used
						during clock scaling. If this property is not
						defined, then it falls back to the default HS
						bus speed mode to maintain backward compatibility.
	- qcom,sdr104-wa: On Certain chipsets, SDR104 mode might be unstable causing CRC errors
			  on the interface. So there is a workaround implemented to skip printing
			  register dumps on CRC errors and also downgrade bus speed mode to
			  SDR50/DDR50 in case of continuous CRC errors. Set this flag to enable
			  this workaround.
	- qcom,restore-after-cx-collapse - specifies whether the SDCC registers contents need
	  to be saved and restored by software when the CX Power Collapse feature is enabled.
	  On certain chipsets, coming out of the CX Power Collapse event, the SDCC registers
	  contents will not be retained. It is software responsibility to restore the
	  SDCC registers before resuming to normal operation.
	- qcom,force-sdhc1-probe: Force probing sdhc1 even if it is not the boot device.
	- qcom,ddr-config: Certain chipsets and platforms require particular settings for
			   the RCLK delay DLL configuration register for HS400 mode to work.
			   This value can vary between platforms and msms. If a msm/platform
			   require a different DLL setting than the default/POR setting for
			   HS400 mode, it can be specified using this field.
In the following, <supply> can be vdd (flash core voltage) or vdd-io (I/O voltage).
	- qcom,<supply>-always-on - specifies whether supply should be kept "on" always.
	- qcom,<supply>-lpm_sup - specifies whether supply can be kept in low power mode (lpm).
	- qcom,<supply>-voltage_level - specifies voltage levels for supply. Should be
					specified in pairs (min, max), units uV.
	- qcom,<supply>-current_level - specifies load levels for supply in lpm or
					high power mode (hpm). Should be specified in
					pairs (lpm, hpm), units uA.

	- gpios - specifies gpios assigned for sdhc slot.
	- qcom,gpio-names -  a list of strings that map in order to the list of gpios

	Tlmm pins are specified as <clk cmd data> and starting with eMMC5.0 as
	<clk cmd data rclk>

	- Refer to "Documentation/devicetree/bindings/pinctrl/pinctrl-bindings.txt"
	  for following optional properties:
		- pinctrl-names
		- pinctrl-0, pinctrl-1,.. pinctrl-n

	- qcom,large-address-bus - specifies whether the soc is capable of
				 supporting larger than 32 bit address bus width.

	- qcom,wakeup-on-idle: if configured, the mmcqd thread will call
	  set_wake_up_idle(), thereby voting for it to be called on idle CPUs.

Example:

	aliases {
		sdhc1 = &sdhc_1;
	};

	sdhc_1: qcom,sdhc@f9824900 {
		compatible = "qcom,sdhci-msm";
                reg = <0xf9824900 0x11c>, <0xf9824000 0x800>;
                reg-names = "hc_mem", "core_mem";
                interrupts = <0 123 0>, <0 138 0>;
                interrupt-names = "hc_irq", "pwr_irq";
		sdhc-msm-crypto = <&sdcc1_ice>;

		vdd-supply = <&pm8941_l21>;
		vdd-io-supply = <&pm8941_l13>;
		qcom,vdd-voltage-level = <2950000 2950000>;
		qcom,vdd-current-level = <9000 800000>;

		qcom,vdd-io-always-on;
		qcom,vdd-io-lpm-sup;
		qcom,vdd-io-voltage-level = <1800000 2950000>;
		qcom,vdd-io-current-level = <6 22000>;

		qcom,devfreq,freq-table = <52000000 200000000>;

		pinctrl-names = "active", "sleep";
		pinctrl-0 = <&sdc1_clk_on &sdc1_cmd_on &sdc1_data_on>;
		pinctrl-1 = <&sdc1_clk_off &sdc1_cmd_on &sdc1_data_on>;


                qcom,bus-width = <4>;
		qcom,nonremovable;
		qcom,large-address-bus;
		qcom,bus-speed-mode = "HS200_1p8v", "DDR_1p8v";
		qcom,ice-clk-rates = <300000000 150000000>;

		qcom,scaling-lower-bus-speed-mode = "DDR52";

		gpios = <&msmgpio 40 0>, /* CLK */
			<&msmgpio 39 0>, /* CMD */
			<&msmgpio 38 0>, /* DATA0 */
			<&msmgpio 37 0>, /* DATA1 */
			<&msmgpio 36 0>, /* DATA2 */
			<&msmgpio 35 0>; /* DATA3 */
		qcom,gpio-names = "CLK", "CMD", "DAT0", "DAT1", "DAT2", "DAT3";

		qcom,pm-qos-irq-type = "affine_cores";
		qcom,pm-qos-irq-cpu = <0>;
		qcom,pm-qos-irq-latency = <500 100>;
		qcom,pm-qos-cpu-groups = <0x03 0x0c>;
		qcom,pm-qos-cmdq-latency-us = <50 100>, <50 100>;
		qcom,pm-qos-legacy-latency-us = <50 100>, <50 100>;
	};

	sdhc_2: qcom,sdhc@f98a4900 {
		qcom,pm-qos-irq-type = "affine_irq";
		qcom,pm-qos-irq-latency = <120 200>;
	};
```

## Documentation/devicetree/bindings/msm_hdcp/msm_hdcp.txt
```
MSM HDCP driver

Standalone driver managing HDCP related communications
between TZ and HLOS for MSM chipset.

Required properties:

compatible = "qcom,msm-hdcp";

Example:

qcom_msmhdcp: qcom,msm_hdcp {
       compatible = "qcom,msm-hdcp";
};
```

## Documentation/devicetree/bindings/msm_mhi_dev.txt
```
MSM MHI DEV

MSM MHI DEV enables communication with the host over a PCIe link using the
Modem Host Interface protocol. The driver interfaces with the IPA for
enabling the HW acceleration channel path and provides interface for
software channels to communicate between Host and device.

Required properties:
  - compatible: should be "qcom,msm-mhi-dev" for MHI device driver.
  - reg: MHI MMIO physical register space.
  - reg-names: resource names used for the MHI MMIO physical address region,
	       IPA uC command and event ring doorbell mail box address.
	       Should be "mhi_mmio_base" for MHI MMIO physical address,
	       "ipa_uc_mbox_crdb" for IPA uC Command Ring doorbell,
	       "ipa_uc_mbox_erdb" for IPA uC Event Ring doorbell passed to
	       the IPA driver.
  - qcom,mhi-ifc-id: ID of HW interface via which MHI on device side
		communicates with host side.
  - qcom,mhi-ep-msi: End point MSI number.
  - qcom,mhi-version: MHI specification version supported by the device.

Optional property:
  - qcom,use-ipa-software-channel: If property is present use IPA hardware
		accelerated path for MHI software channel data transfers
		between host and device.
  - qcom,mhi-config-iatu: If property is present map the control and data region
		between host and device using iatu.
  - qcom,mhi-interrupt: If property is present register for mhi interrupt.
  - qcom,mhi-local-pa-base: The physical base address on the device used by the
		MHI device driver to map the control and data region with the
		MHI driver on the host. This property is required if iatu
		property qcom,mhi-config-iatu is present.
  - qcom,enable-m2: If property is present M2 autonomous is enabled.

MSM MHI DEV NET

MSM MHI DEV enables communication with the host over a PCIe link using the
Network Interface.

Required properties:
  - compatible: should be "qcom,msm-mhi-dev-net" for MHI net device driver.

Optional property:
  - qcom,mhi-ethernet-interface;: If property is present use ethernet packet
	parsing support.

Example:
	mhi: qcom,msm-mhi-dev {
		compatible = "qcom,msm-mhi-dev";
		reg = <0xfc527000 0x1000>,
		     <0xfd4fa000 0x1>,
		     <0xfd4fa080 0x1>;
		reg-names = "mhi_mmio_base", "ipa_uc_mbox_crdb",
			    "ipa_uc_mbox_erdb";
		qcom,mhi-ifc-id = <0x030017cb>;
		qcom,mhi-ep-msi = <1>;
		qcom,mhi-version = <0x1000000>;
	};

	qcom,mhi_net_dev {
		compatible = "qcom,msm-mhi-dev-net";
		qcom,mhi-ethernet-interface;
	};
```

## Documentation/devicetree/bindings/mtd/msm_qpic_nand.txt
```
Qualcomm Technologies, Inc. Parallel Interface controller (QPIC) for NAND devices

Required properties:
- compatible : "qcom,msm-nand".
- reg : should specify QPIC NANDc and BAM physical address range.
- reg-names : should specify relevant names to each reg property defined.
- interrupts : should specify QPIC/BAM interrupt numbers.
- interrupt-names : should specify relevant names to each interrupts property
  defined.
- qcom,reg-adjustment-offset : Specify the base adjustment offset value for the
  version registers

MTD flash partition layout for NAND devices -

Each partition is represented as a sub-node of the qcom,mtd-partitions device.
Each node's name represents the name of the corresponding partition.

This is now completely optional as the partition information is avaialble from
bootloader.

Optional properties:
- reg : boot_cfg. This is needed only on the targets where both NAND and eMMC
  devices are supported. On eMMC based builds, NAND cannot be enabled by
  default due to the absence of some of its required resources.
- reg : The partition offset and size
- label : The label / name for this partition.
- read-only: This parameter, if present, indicates that this partition
  should only be mounted read-only.
- Refer to "Documentation/devicetree/bindings/arm/msm/msm_bus.txt" for
below optional properties:
	- qcom,msm-bus,name
	- qcom,msm-bus,num-cases
	- qcom,msm-bus,active-only
	- qcom,msm-bus,num-paths
	- qcom,msm-bus,vectors-KBps

Examples:

	qcom,nand@f9af0000 {
		compatible = "qcom,msm-nand";
		reg = <0xf9af0000 0x1000>,
		      <0xf9ac4000 0x8000>,
		      <0x5e02c 0x4>;
		reg-names = "nand_phys",
			    "bam_phys",
			    "boot_cfg";
		qcom,reg-adjustment-offset = <0x4000>;

		interrupts = <0 279 0>;
		interrupt-names = "bam_irq";

		qcom,msm-bus,name = "qpic_nand";
		qcom,msm-bus,num-cases = <1>;
		qcom,msm-bus,num-paths = <1>;
		qcom,msm-bus,vectors-KBps = <91 512 0 0>,
	};

       qcom,mtd-partitions {
	       #address-cells = <1>;
	       #size-cells = <1>;
               partition@0 {
                       label = "boot";
                       reg = <0x0 0x1000>;
		       read-only;
               };
               partition@20000 {
                       label = "userdata";
                       reg = <0x20000 0x1000>;
               };
               partition@40000 {
                       label = "system";
                       reg = <0x40000 0x1000>;
               };
       };
```

## Documentation/devicetree/bindings/mtee/mtee.txt
```
MTK in-house tee interface

MTEE is a secure OS implementation developed by Mediatek.

Required properties:
- compatible: "mediatek,mtee"
```

## Documentation/devicetree/bindings/net/aquantia.txt
```
Aquantia Corporation AQC/AQN 107/108/109 Ethernet Controller


Required properties:

- compatible : should be one of "aquantia,aqc-107", "aquantia,aqc-108",
  "aquantia,aqc-109"

If SMMU is present, also use:

- qcom,smmu : if present, SMMU attach is performed
- qcom,smmu-iova-base : SMMU IOVA start address the device can access
- qcom,smmu-iova-size : SMMU IOVA size the device can access

Optional Properties:

- qcom,smmu-attr-s1-bypass : Bypasses SMMU S1 translation
- qcom,smmu-attr-fastmap : Enables SMMU fastmap
- qcom,smmu-attr-atomic : Enables DMA alloc using GFP_ATOMIC
- qcom,smmu-attr-pt-coherent : Use if DMA coherency is available for SMMU page tables


Example:

&pcie_rc0 {

	aqc_x1: qcom,aqc@0 {
		compatible = "aquantia,aqc-107";

		qcom,smmu;
		qcom,smmu-iova-base = /bits/ 64 <0x0>;
		qcom,smmu-iova-size = /bits/ 64 <0x100000000>;

		qcom,smmu-attr-s1-bypass;
	};
};

&pcie_rc1 {

	aqc_x4: qcom,aqc@1 {
		compatible = "aquantia,aqc-107";

		qcom,smmu;
		qcom,smmu-iova-base = /bits/ 64 <0x0>;
		qcom,smmu-iova-size = /bits/ 64 <0x100000000>;

		qcom,smmu-attr-atomic;
		qcom,smmu-attr-fastmap;
		qcom,smmu-attr-pt-coherent;
	};
};
```
