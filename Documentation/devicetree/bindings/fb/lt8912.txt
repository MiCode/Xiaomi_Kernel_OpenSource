## Documentation/devicetree/bindings/firmware/qcom/tz-log.txt
```
* TZLOG (Trust Zone Log)

The tz_log driver is a platform device driver that exposes a debugfs
interface for accessing and displaying diagnostic information
related to secure code (Trustzone/QSEE).

Required properties:
- compatible : Should be "qcom,tz-log"
- reg        : Offset and size of the register set for the device

Optional properties:
- qcom,hyplog-enabled   : (boolean) indicates if driver supports HYP logger service.
- hyplog-address-offset : Register offset to get the HYP log base address.
- hyplog-size-offset    : Register offset to get the HYP log size parameter.

Example:

	qcom,tz-log@146bf720 {
		compatible = "qcom,tz-log";
                reg = <0x146bf720, 0x3000>;
		qcom,hyplog-enabled;
		hyplog-address-offset = 0x410;
		hyplog-size-offset = 0x414;
	};
```

## Documentation/devicetree/bindings/gnsssirf/gnss_sirf.txt
```
Binding for SIRF GNSS receiver control driver
GPIO pins are toggled to control GNSS receiver power states either to
wake it from sleep or put receiver into sleep mode

Required properties:
- compatible: must be "gnss_sirf"
- #gpio-pins:
      0: GPIO 18
      1: GPIO 87

Example:
	ss5_pwr_ctrl0 {
		compatible = "gnss_sirf";
		pinctrl-0 = <&ss5_pwr_ctrl_rst_on>;
		ssVreset-gpio = <&tlmm 87 1>;
		ssVonoff-gpio = <&tlmm 18 1>;
	};

	ss5_pwr_ctrl_pins: ss5_pwr_ctrl_pins {
		ss5_pwr_ctrl_rst_on: ss5_pwr_ctrl_rst_on {
			mux {
				pins = "gpio87", "gpio18";
				function = "gpio";
			};

			config {
				pins = "gpio87", "gpio18";
				drive-strength = <16>; /* 16 mA */
				bias-pull-up;
				output-high;
			};
		};

		ss5_pwr_ctrl_rst_off: ss5_pwr_ctrl_off {
			mux {
				pins = "gpio87", "gpio18";
				function = "gpio";
			};

			config {
				pins = "gpio87", "gpio18";
				drive-strength = <16>; /* 16 mA */
				bias-pull-up;
				output-high;
			};
		};
	};
```

## Documentation/devicetree/bindings/gpio/gpio-msm.txt
```
MSM GPIO controller bindings

Required properties:
- compatible:
  - "qcom,msm-gpio" for MSM controllers
- #gpio-cells : Should be two.
  - first cell is the pin number
  - second cell is used to specify optional parameters (unused)
- gpio-controller : Marks the device node as a GPIO controller.
- #interrupt-cells : Should be 2.
- interrupt-controller: Mark the device node as an interrupt controller
- interrupts : Specify the TLMM summary interrupt number
- ngpio : Specify the number of MSM GPIOs
- qcom,direct-connect-irqs : Specifies the number of GPIOs that can be used as
  direct connect interrupts

Example:

	msmgpio: gpio@fd510000 {
		compatible = "qcom,msm-gpio";
		gpio-controller;
		#gpio-cells = <2>;
		interrupt-controller;
		#interrupt-cells = <2>;
		reg = <0xfd510000 0x4000>;
		interrupts = <0 208 0>;
		ngpio = <150>;
		qcom,direct-connect-irqs = <8>;
	};

To specify gpios for a device:

	device1@f991f000 {
		compatible = "qcom,msm-device-v1";
		reg = <0xf991f000 0x1000>;
		gpios = <&msmgpio 45 0>;
		cs-gpios = <&msmgpio 46 0>;
	};

45, 46 - gpio numbers.
The driver for device1 can call of_get_gpio() to extract the
gpio45. In order to extract gpio46, the driver needs to call
of_get_named_gpio with "cs-gpios" as the name parameter.
Please refer to the file: include/linux/of_gpio.h for the
complete list of APIs the driver can use to extract gpio
information from the device tree.
```

## Documentation/devicetree/bindings/gpio/gpio-smp2p.txt
```
Qualcomm SMSM Point-to-Point (SMP2P) GPIO Driver

Used to map an SMP2P entry and remote processor ID to a virtual GPIO controller
and virtual interrupt controller.

Required properties:
-compatible : should be "qcom,smp2pgpio";
-qcom,entry-name : name of the SMP2P entry
-qcom,remote-pid : the SMP2P remote processor ID (see smp2p_private_api.h)
-gpio-controller : specifies that this is a GPIO controller
-#gpio-cells : number of GPIO cells (should always be <2>)
-interrupt-controller : specifies that this is an interrupt controller
-#interrupt-cells : number of interrupt cells (should always be <2>)

Optional properties:
-qcom,is-inbound : specifies that this is an inbound entry (default is outbound)

Comments:
All device tree entries must be unique.  Therefore to prevent naming collisions
between clients, it is recommended that the DT nodes should be named using the
format:
	smp2pgpio_<ENTRY_NAME>_<REMOTE PID>_<in|out>

Unit test devices ("smp2p" entries):
-compatible : should be one of
		"qcom,smp2pgpio_test_smp2p_1_out"
		"qcom,smp2pgpio_test_smp2p_1_in"
		"qcom,smp2pgpio_test_smp2p_2_out"
		"qcom,smp2pgpio_test_smp2p_2_in"
		"qcom,smp2pgpio_test_smp2p_3_out"
		"qcom,smp2pgpio_test_smp2p_3_in"
		"qcom,smp2pgpio_test_smp2p_4_out"
		"qcom,smp2pgpio_test_smp2p_4_in"
		"qcom,smp2pgpio_test_smp2p_7_out"
		"qcom,smp2pgpio_test_smp2p_7_in"
		"qcom,smp2pgpio_test_smp2p_15_out"
		"qcom,smp2pgpio_test_smp2p_15_in"
-gpios : the relevant gpio pins of the entry

Example:
	/* Maps inbound "smp2p" entry on remote PID 7 to GPIO controller. */
	smp2pgpio_smp2p_7_in: qcom,smp2pgpio-smp2p-7-in {
		compatible = "qcom,smp2pgpio";
		qcom,entry-name = "smp2p";
		qcom,remote-pid = <7>;
		qcom,is-inbound;
		gpio-controller;
		#gpio-cells = <2>;
		interrupt-controller;
		#interrupt-cells = <2>;
	};

	/*
	 * Maps inbound "smp2p" entry on remote PID 7 to client driver
	 * "qcom,smp2pgpio_test_smp2p_7_in".
	 *
	 * Note:  If all 32-pins are used by this client, then you
	 *        can just list pin 0 here as a shortcut.
	 */
	qcom,smp2pgpio_test_smp2p_7_in {
		compatible = "qcom,smp2pgpio_test_smp2p_7_in";
		gpios = <&smp2pgpio_smp2p_7_in 0 0>, /* pin 0 */
			<&smp2pgpio_smp2p_7_in 1 0>,
			. . .
			<&smp2pgpio_smp2p_7_in 31 0>;    /* pin 31 */
	};


	/* Maps outbound "smp2p" entry on remote PID 7 to GPIO controller. */
	smp2pgpio_smp2p_7_out: qcom,smp2pgpio-smp2p-7-out {
		compatible = "qcom,smp2pgpio";
		qcom,entry-name = "smp2p";
		qcom,remote-pid = <7>;
		gpio-controller;
		#gpio-cells = <2>;
		interrupt-controller;
		#interrupt-cells = <2>;
	};

	/*
	 * Maps outbound "smp2p" entry on remote PID 7 to client driver
	 * "qcom,smp2pgpio_test_smp2p_7_out".
	 *
	 * Note:  If all 32-pins are used by this client, then you
	 *        can just list pin 0 here as a shortcut.
	 */
	qcom,smp2pgpio_test_smp2p_7_out {
		compatible = "qcom,smp2pgpio_test_smp2p_7_out";
		gpios = <&smp2pgpio_smp2p_7_out 0 0>, /* pin 0 */
			<&smp2pgpio_smp2p_7_out 1 0>,
			. . .
			<&smp2pgpio_smp2p_7_out 31 0>;    /* pin 31 */
	};
```

## Documentation/devicetree/bindings/gpio/gpio-sx150x.txt
```
Semtech sx150x GPIO controller bindings

Required properties:
- compatible:
  - "sx1508q" for sx1508 GPIO controller
  - "sx1509q" for sx1509 GPIO controller
- #gpio-cells : Should be two.
  - first cell is the pin number
  - second cell is used to specify optional parameters (unused)
- gpio-controller : Marks the device node as a GPIO controller.
- reg: 7-bit I2C address.
- sx150x,reset_onprobe: If set to true, the driver will trigger
  a full reset of the chip at the beginning of the probe in order
  to place it in a known state.
- sx150x,oscio_is_gpo: If set to true, the driver will configure
  OSCIO as a GPO instead of as an oscillator, increasing the size
  of the GP(I)O pool created by this expander by one. The
  output-only GPO pin will be added at the end of the block.
- sx150x,pullup_ena: A bit-mask which enables or disables the pull-up
  resistor for each IO line in the expander. Setting the bit at
  position n will enable the pull-up for the IO at the corresponding
  offset. For chips with fewer than 16 IO pins, high-end bits are ignored.
- sx150x,pulldn_ena: A bit-mask which enables-or disables the pull-down
  resistor for each IO line in the expander. Setting the bit at position
  n will enable the pull-down for the IO at the corresponding offset.
  For chips with fewer than 16 IO pins, high-end bits are ignored.
- sx150x,float_ena: A bit-mask which enables-or disables open-drain
  operation for each IO line in the expander. Setting the bit at
  position n enables open-drain operation for the IO at the corresponding
  offset. Clearing the bit enables regular push-pull operation for that IO.
  For chips with fewer than 16 IO pins, high-end bits are ignored.
- sx150x,polarity: A bit-mask which enables polarity inversion for each IO line
  in the expander. Setting the bit at position n inverts the polarity of
  that IO line, while clearing it results in normal polarity. For chips with
  fewer than 16 IO pins, high-end bits are ignored.
- sx150x,reset_gpio: System GPIO number connected to NRESET of SX150x devices.
  If "sx150x,reset_onprobe" is true, then the reset_gpio is pulled from low
  to high to reset the SX150x device. (optional)
 - <supply-name>-supply: phandle to the regulator device
   Required "supply-name" examples are:
	"vdd" : 1.8v supply for sx150x (io-expander).

Example:

i2c@f9925000 {
   ioexp_gpios: io_exp@3e {
      #gpio-cells = <2>;
      gpio-controller;
      compatible = "sx1509q";
      reg = <0x3e>;
      sx150x,pullup_ena = <0x00>;
      sx150x,pulldn_ena = <0x00>;
      sx150x,float_ena  = <0x00>;
      sx150x,polarity = <0x00>;
      sx150x,reset_onprobe;
      sx150x,reset_gpio = <&msmgpio 138 0x00>;
      label = "ioexp-gpio";
      vdd-supply = <&pm8917_l6>;
   };
};

Usage:
gpio_test {
   compatible = "testcode";
   test_gpio = <&ioexp_gpios 5 0x00>;
};
```

## Documentation/devicetree/bindings/gpio/gpio_keys.txt
```
Device-Tree bindings for input/gpio_keys.c keyboard driver

Required properties:
	- compatible = "gpio-keys";

Optional properties:
	- input-name: input name of the device
	- autorepeat: Boolean, Enable auto repeat feature of Linux input
	  subsystem.
	- pinctrl-names : This should be defined if a target uses pinctrl framework.
			See "pinctrl" in Documentation/devicetree/bindings/pinctrl/msm-pinctrl.txt.
			It should specify the names of the configs that pinctrl can install in drive

			Following are the pinctrl configs that can be installed:
			"gpio_ts_active" : Active configuration of pins, this should specify active
			config defined in pin groups of interrupt and reset gpio.
			"gpio_ts_suspend" : Disabled configuration of pins, this should specify sleep
			config defined in pin groups of interrupt and reset gpio.

Each button (key) is represented as a sub-node of "gpio-keys":
Subnode properties:

	- gpios: OF device-tree gpio specification.
	- label: Descriptive name of the key.
	- linux,code: Keycode to emit.

Optional subnode-properties:
	- linux,input-type: Specify event type this button/key generates.
	  If not specified defaults to <1> == EV_KEY.
	- debounce-interval: Debouncing interval time in milliseconds.
	  If not specified defaults to 5.
	- gpio-key,wakeup: Boolean, button can wake-up the system.

Example nodes:

	gpio_keys {
			compatible = "gpio-keys";
			#address-cells = <1>;
			#size-cells = <0>;
			autorepeat;
			input-name = "gpio-keys";
			pinctrl-names = "tlmm_gpio_key_active","tlmm_gpio_key_suspend";
			pinctrl-0 = <&gpio_key_active>;
			pinctrl-1 = <&gpio_key_suspend>;
			button@21 {
				label = "GPIO Key UP";
				linux,code = <103>;
				gpios = <&gpio1 0 1>;
			};
			...
```

## Documentation/devicetree/bindings/gpio/qpnp-gpio.txt
```
* msm-qpnp-gpio

msm-qpnp-gpio is a GPIO chip driver for the MSM SPMI implementation.
It creates a spmi_device for every spmi-dev-container block of device_nodes.
These device_nodes contained within specify the PMIC GPIO number associated
with each GPIO chip. The driver will map these to Linux GPIO numbers.

[PMIC GPIO Device Declarations]

-Root Node-

Required properties :
 - spmi-dev-container : Used to specify the following child nodes as part of the
   same SPMI device.
 - gpio-controller : Specify as gpio-contoller. All child nodes will belong to this
   gpio_chip.
 - #gpio-cells: We encode a PMIC GPIO number and a 32-bit flag field to
   specify the gpio configuration. This must be set to '2'.
 - #address-cells: Specify one address field. This must be set to '1'.
 - #size-cells: Specify one size-cell. This must be set to '1'.
 - compatible = "qcom,qpnp-gpio" : Specify driver matching for this driver.

-Child Nodes-

Required properties :
 - reg : Specify the spmi offset and size for this gpio device.
 - qcom,gpio-num : Specify the PMIC GPIO number for this gpio device.

Optional configuration properties :
 -  qcom,direction:	indicates whether the gpio should be input, output, or
			both.
			QPNP_GPIO_DIR_IN   = 0,
			QPNP_GPIO_DIR_OUT  = 1,
			QPNP_GPIO_DIR_BOTH = 2

 - qcom,output-type:	indicates gpio should be configured as CMOS or open
			drain.
			QPNP_GPIO_OUT_BUF_CMOS = 0
			QPNP_GPIO_OUT_BUF_OPEN_DRAIN_NMOS = 1,
			QPNP_GPIO_OUT_BUF_OPEN_DRAIN_PMOS = 2,

 - qcom,invert:		Invert the signal of the gpio line -
			QPNP_GPIO_INVERT_DISABLE = 0
			QPNP_GPIO_INVERT_ENABLE = 1

 - qcom,pull:		Indicates whether a pull up or pull down should be
			applied. If a pullup is required the current strength
			needs to be specified. Current values of 30uA, 1.5uA,
			31.5uA, 1.5uA with 30uA boost are supported.
			QPNP_GPIO_PULL_UP_30	 = 0,
			QPNP_GPIO_PULL_UP_1P5	 = 1,
			QPNP_GPIO_PULL_UP_31P5	 = 2,
			QPNP_GPIO_PULL_UP_1P5_30 = 3,
			QPNP_GPIO_PULL_DN	 = 4,
			QPNP_GPIO_PULL_NO	 = 5

  - qcom,vin-sel:	specifies the voltage level when the output is set to 1.
			For an input gpio specifies the voltage level at which
			the input is interpreted as a logical 1.
			QPNP_GPIO_VIN0 = 0,
			QPNP_GPIO_VIN1 = 1,
			QPNP_GPIO_VIN2 = 2,
			QPNP_GPIO_VIN3 = 3,
			QPNP_GPIO_VIN4 = 4,
			QPNP_GPIO_VIN5 = 5,
			QPNP_GPIO_VIN6 = 6,
			QPNP_GPIO_VIN7 = 7

  - qcom,out-strength:	the amount of current supplied for an output gpio.
			QPNP_GPIO_OUT_STRENGTH_LOW  = 1
			QPNP_GPIO_OUT_STRENGTH_MED  = 2,
			QPNP_GPIO_OUT_STRENGTH_HIGH = 3,

  - qcom,source-sel:	choose alternate function for the gpio. Certain gpios
			can be paired (shorted) with each other. Some gpio pin
			can act as alternate functions.
			QPNP_GPIO_FUNC_NORMAL   = 0,
			QPNP_GPIO_FUNC_PAIRED   = 1
			QPNP_GPIO_FUNC_1	= 2,
			QPNP_GPIO_FUNC_2	= 3,
			QPNP_GPIO_DTEST1	= 4,
			QPNP_GPIO_DTEST2	= 5,
			QPNP_GPIO_DTEST3	= 6,
			QPNP_GPIO_DTEST4	= 7

 - qcom,master-en:	1 = Enable features within the
			GPIO block based on configurations.
			0 = Completely disable the GPIO
			block and let the pin float with high impedance
			regardless of other settings.

*Note: If any of the configuration properties are not specified, then the
       qpnp-gpio driver will not modify that respective configuration in
       hardware.

[PMIC GPIO clients]

Required properties :
 - gpios : Contains 3 fields of the form <&gpio_controller pmic_gpio_num flags>

[Example]

qpnp: qcom,spmi@fc4c0000 {
		#address-cells = <1>;
		#size-cells = <0>;
		interrupt-controller;
		#interrupt-cells = <3>;

		qcom,pm8941@0 {
			spmi-slave-container;
			reg = <0x0>;
			#address-cells = <1>;
			#size-cells = <1>;

			pm8941_gpios: gpios {
				spmi-dev-container;
				compatible = "qcom,qpnp-gpio";
				gpio-controller;
				#gpio-cells = <2>;
				#address-cells = <1>;
				#size-cells = <1>;

				gpio@c000 {
					reg = <0xc000 0x100>;
					qcom,gpio-num = <62>;
				};

				gpio@c100 {
					reg = <0xc100 0x100>;
					qcom,gpio-num = <20>;
					qcom,source_sel = <2>;
					qcom,pull = <5>;
				};
			};

			qcom,testgpio@1000 {
				compatible = "qcom,qpnp-testgpio";
				reg = <0x1000 0x1000>;
				gpios = <&pm8941_gpios 62 0x0 &pm8941_gpios 20 0x1>;
			};
		};
	};
};
```
