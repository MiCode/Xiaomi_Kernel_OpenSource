## Documentation/devicetree/bindings/fb/mdss-pll.txt
```
Qualcomm MDSS pll for DSI/EDP/HDMI

mdss-pll is a pll controller device which supports pll devices that
are compatable with MIPI display serial interface specification,
HDMI and edp.

Required properties:
- compatible:		Compatible name used in the driver. Should be one of:
			"qcom,mdss_dsi_pll_8916", "qcom,mdss_dsi_pll_8939",
			"qcom,mdss_dsi_pll_8974", "qcom,mdss_dsi_pll_8994",
			"qcom,mdss_dsi_pll_8994", "qcom,mdss_dsi_pll_8909",
			"qcom,mdss_hdmi_pll", "qcom,mdss_hdmi_pll_8994",
			"qcom,mdss_dsi_pll_8992", "qcom,mdss_hdmi_pll_8992",
			"qcom,mdss_dsi_pll_8952", "qcom,mdss_dsi_pll_8976".
- cell-index:		Specifies the controller used
- reg:			offset and length of the register set for the device.
- reg-names :		names to refer to register sets related to this device
- gdsc-supply:		Phandle for gdsc regulator device node.
- vddio-supply:		Phandle for vddio regulator device node.
- clocks:		List of Phandles for clock device nodes
			needed by the device.
- clock-names:		List of clock names needed by the device.
- clock-rate:		List of clock rates in Hz.

Optional properties:
- label:	       	A string used to describe the driver used.
- vcca-supply:		Phandle for vcca regulator device node.

- qcom,mdss-en-pll-90-phase: 	Boolean property to indicate if the DSI PLL
				needs to be configured to have 90 phase difference
				between the BIT clock and BYTE clock frequencies.
- qcom,platform-supply-entries:	A node that lists the elements of the supply. There
				can be more than one instance of this binding,
				in which case the entry would be appended with
				the supply entry index.
				e.g. qcom,platform-supply-entry@0
				- reg: offset and length of the register set for the device.
				-- qcom,supply-name: name of the supply (vdd/vdda/vddio)
				-- qcom,supply-min-voltage: minimum voltage level (uV)
				-- qcom,supply-max-voltage: maximum voltage level (uV)
				-- qcom,supply-enable-load: load drawn (uA) from enabled supply
				-- qcom,supply-disable-load: load drawn (uA) from disabled supply
				-- qcom,supply-pre-on-sleep: time to sleep (ms) before turning on
				-- qcom,supply-post-on-sleep: time to sleep (ms) after turning on
				-- qcom,supply-pre-off-sleep: time to sleep (ms) before turning off
				-- qcom,supply-post-off-sleep: time to sleep (ms) after turning off

- linux,contiguous-region: Phandle to the continuous memory region reserved for
		   dynamic refresh rate data.

Example:
	mdss_dsi0_pll: qcom,mdss_dsi_pll@fd922A00 {
		compatible = "qcom,mdss_dsi_pll_8974";
		label = "MDSS DSI 0 PLL";
		cell-index = <0>;

		reg = <0xfd922A00 0xD4>,
		      <0xfd922900 0x64>,
		      <0xfd8c2300 0x8>;
		reg-names = "pll_base", "dynamic_pll_base", "gdsc_base";
		gdsc-supply = <&gdsc_mdss>;
		vddio-supply = <&pm8941_l12>;
		vcca-supply = <&pm8941_l28>;
		qcom,mdss-en-pll-90-phase;

		clocks = <&clock_gcc clk_gcc_mdss_mdp_clk>,
			 <&clock_gcc clk_gcc_mdss_ahb_clk>,
			 <&clock_gcc clk_gcc_mdss_axi_clk>;
		clock-names = "mdp_core_clk", "iface_clk", "bus_clk";
		clock-rate = <0>, <0>, <0>;

		qcom,platform-supply-entries {
			#address-cells = <1>;
			#size-cells = <0>;

			qcom,platform-supply-entry@0 {
				reg = <0>;
				qcom,supply-name = "vddio";
				qcom,supply-min-voltage = <1800000>;
				qcom,supply-max-voltage = <1800000>;
				qcom,supply-enable-load = <100000>;
				qcom,supply-disable-load = <100>;
				qcom,supply-pre-on-sleep = <0>;
				qcom,supply-post-on-sleep = <20>;
				qcom,supply-pre-off-sleep = <0>;
				qcom,supply-post-off-sleep = <0>;
			};
		};

		linux,contiguous-region = <&dfps_data_mem>;
	};
```

## Documentation/devicetree/bindings/fb/mdss-qpic-panel.txt
```
Qualcomm Technologies, Inc. mdss-qpic-panel

mdss-qpic-panel is a panel device which can be driven by qpic.

Required properties:
- compatible:				Must be "qcom,mdss-qpic-panel"
- qcom,mdss-pan-res:		A two dimensional array that specifies the panel
							resolution.
- qcom,mdss-pan-bpp:		Specifies the panel bits per pixel.
- qcom,refresh_rate:		Panel refresh rate

Optional properties:
- label:					A string used as a descriptive name of the panel


Example:
/ {
	qcom,mdss_lcdc_ili9341_qvga {
		compatible = "qcom,mdss-qpic-panel";
		label = "ili qvga lcdc panel";
		qcom,mdss-pan-res = <240 320>;
		qcom,mdss-pan-bpp = <18>;
		qcom,refresh_rate = <60>;
	};
};
```

## Documentation/devicetree/bindings/fb/mdss-qpic.txt
```
Qualcomm Technolgies, Inc.  mdss-qpic

mdss-qpic is a qpic controller device which supports dma transmission to MIPI
and LCDC panel.

Required properties:
- compatible:			must be "qcom,mdss_qpic"
- reg:					offset and length of the register set for the device.
- reg-names :			names to refer to register sets related to this device
- interrupts:			IRQ line
- vdd-supply:			Phandle for vdd regulator device node.
- avdd-supply:			Phandle for avdd regulator device node.
- qcom,cs-gpio:			Phandle for cs gpio device node.
- qcom,te-gpio:			Phandle for te gpio device node.
- qcom,rst-gpio:		Phandle for rst gpio device node.
- qcom,ad8-gpio:		Phandle for ad8 gpio device node.
- qcom,bl-gpio:			Phandle for backlight gpio device node.

Optional properties:
- Refer to "Documentation/devicetree/bindings/arm/msm/msm_bus.txt" for
below Bus Scaling properties:
	- qcom,msm-bus,name
	- qcom,msm-bus,num-cases
	- qcom,msm-bus,num-paths
	- qcom,msm-bus,vectors-KBps

Example:
	qcom,msm_qpic@f9ac0000 {
		compatible = "qcom,mdss_qpic";
		reg = <0xf9ac0000 0x24000>;
		reg-names = "qpic_base";
		interrupts = <0 251 0>;

		qcom,msm-bus,name = "mdss_qpic";
		qcom,msm-bus,num-cases = <2>;
		qcom,msm-bus,num-paths = <1>;

		qcom,msm-bus,vectors-KBps =
			<91 512 0 0>,
			<91 512 400000 800000>;

		vdd-supply = <&pm8019_l11>;
		avdd-supply = <&pm8019_l14>;
		qcom,cs-gpio = <&msmgpio 21 0>;
		qcom,te-gpio = <&msmgpio 22 0>;
		qcom,rst-gpio = <&msmgpio 23 0>;
		qcom,ad8-gpio = <&msmgpio 20 0>;
		qcom,bl-gpio = <&msmgpio 84 0>;
	};
```

## Documentation/devicetree/bindings/fb/mdss-rgb.txt
```
Qualcomm Technologies, Inc. mdss-rgb

mdss-rgb is the master RGB device which supports software RGB interface.

Required properties:
- compatible:				Must be "qcom,mdss-rgb"
- ranges:				The standard property which specifies the child address
- reg: 					Base address and length of the different register
					regions(s) required for RGB functionality.
- reg-names: 				A list of strings that map in order to the list of regs.
					"dsi_phy" - MDSS DSI PHY register region
					"dsi_phy_regulator" - MDSS DSI PHY REGULATOR region
					"mmss_misc_phys" - Register region for MMSS DSI clamps
- vdda-supply:				Phandle for vdda regulator device node.
- vddio-supply:				Phandle for vddio regulator device node.
- qcom,mdss-mdp:			pHandle that specifies the mdss-mdp device.
- qcom,mdss-fb-map:			pHandle that specifies the framebuffer to which the

- qcom,platform-reset-gpio:		Specifies the panel reset gpio.
- pinctrl-names:			List of names to assign mdss pin states defined in pinctrl device node
					Refer to pinctrl-bindings.txt
- pinctrl-<0..n>:			Lists phandles each pointing to the pin configuration node within a pin
					controller. These pin configurations are installed in the pinctrl
					device node. Refer to pinctrl-bindings.txt

- qcom,<type>-supply-entries:		A node that lists the elements of the supply used by the
					a particular "type" of RGB modulee. The module "types"
					can be "core", "ctrl", and "phy". Within the same type,
					there can be more than one instance of this binding,
					in which case the entry would be appended with the
					supply entry index.
					e.g. qcom,ctrl-supply-entry@0
					-- qcom,supply-name: name of the supply (vdd/vdda/vddio)
					-- qcom,supply-min-voltage: minimum voltage level (uV)
					-- qcom,supply-max-voltage: maximum voltage level (uV)
					-- qcom,supply-enable-load: load drawn (uA) from enabled supply
					-- qcom,supply-disable-load: load drawn (uA) from disabled supply
					-- qcom,supply-ulp-load: load drawn (uA) from supply in ultra-low power mode
					-- qcom,supply-pre-on-sleep: time to sleep (ms) before turning on
					-- qcom,supply-post-on-sleep: time to sleep (ms) after turning on
					-- qcom,supply-pre-off-sleep: time to sleep (ms) before turning off
					-- qcom,supply-post-off-sleep: time to sleep (ms) after turning off


Example:
	mdss_rgb: qcom,mdss_rgb {
		compatible = "qcom,mdss-rgb";
		#address-cells = <1>;
		#size-cells = <1>;

		ranges = <0x1a94400 0x1a94400 0x280
			0x1a94b80 0x1a94b80 0x30
			0x193e000 0x193e000 0x30>;

		reg = <0x1a94400 0x280>,
			<0x1a94b80 0x30>,
			<0x193e000 0x30>;
		reg-names = "dsi_phy",
			"dsi_phy_regulator", "mmss_misc_phys";

		gdsc-supply = <&gdsc_mdss>;
		vdda-1p2-supply = <&pms405_l4>;
		vdda-1p8-supply = <&pms405_l5>;
		vddio-supply = <&pms405_l6>;

		qcom,mdss-fb-map = <&mdss_fb0>;
		qcom,mdss-mdp = <&mdss_mdp>;

		pinctrl-names = "mdss_default", "mdss_sleep";
		pinctrl-0 = <&mdss_rgb_active &mdss_rgb_data0_active
				&mdss_rgb_data1_active &mdss_rgb_data2_active
				&mdss_rgb_data3_active &mdss_rgb_data4_active
				&mdss_rgb_data5_active &mdss_rgb_data_b0_active
				&mdss_rgb_data_b1_active &mdss_rgb_data_b2_active
				&mdss_rgb_data_b3_active &mdss_rgb_data_b4_active
				&mdss_rgb_data_b5_active &mdss_rgb_hsync_active
				&mdss_rgb_vsync_active &mdss_rgb_de_active
				&mdss_rgb_clk_active>;
		pinctrl-1 = <&mdss_rgb_suspend &mdss_rgb_data0_suspend
				&mdss_rgb_data1_suspend &mdss_rgb_data2_suspend
				&mdss_rgb_data3_suspend &mdss_rgb_data4_suspend
				&mdss_rgb_data5_suspend &mdss_rgb_data_b0_suspend
				&mdss_rgb_data_b1_suspend &mdss_rgb_data_b2_suspend
				&mdss_rgb_data_b3_suspend &mdss_rgb_data_b4_suspend
				&mdss_rgb_data_b5_suspend &mdss_rgb_hsync_suspend
				&mdss_rgb_vsync_suspend &mdss_rgb_de_suspend
				&mdss_rgb_clk_suspend>;
		qcom,platform-reset-gpio = <&tlmm 58 0>;

		qcom,core-supply-entries {
			#address-cells = <1>;
			#size-cells = <0>;

			qcom,core-supply-entry@0 {
				reg = <0>;
				qcom,supply-name = "gdsc";
				qcom,supply-min-voltage = <0>;
				qcom,supply-max-voltage = <0>;
				qcom,supply-enable-load = <0>;
				qcom,supply-disable-load = <0>;
			  };
		};

		qcom,ctrl-supply-entries {
			#address-cells = <1>;
			#size-cells = <0>;

			qcom,ctrl-supply-entry@0 {
				reg = <0>;
				qcom,supply-name = "vdda-1p2";
				qcom,supply-min-voltage = <1200000>;
				qcom,supply-max-voltage = <1200000>;
				qcom,supply-enable-load = <100000>;
				qcom,supply-disable-load = <100>;
				qcom,supply-post-on-sleep = <20>;
			};
		};

		qcom,phy-supply-entries {
			#address-cells = <1>;
			#size-cells = <0>;

			qcom,phy-supply-entry@0 {
				reg = <0>;
				qcom,supply-name = "vdda-1p8";
				qcom,supply-min-voltage = <1800000>;
				qcom,supply-max-voltage = <1800000>;
				qcom,supply-enable-load = <100000>;
				qcom,supply-disable-load = <100>;
			};
		};
	};

mdss-rgb-spi is the SPI controller for RGB device which supports control
commands communication with RGB panel.

Required properties:
- compatible:				Must be "qcom,mdss-rgb-spi"
- spi-max-frequency : Maximum SPI clocking speed of device in Hz

Optional properties:
- label: A string used to describe the controller used.
- spi-cpol : Empty property indicating device requires inverse
  clock polarity (CPOL) mode
- spi-cpha :  Empty property indicating device requires shifted
  clock phase (CPHA) mode

Example:
	mdss_rgb_spi: qcom,mdss_rgb_spi {
		compatible = "qcom,mdss-rgb-spi";
		label = "MDSS SPI QUP1 CLIENT";
		spi-max-frequency = <5000000>;
	}
```

## Documentation/devicetree/bindings/fb/mdss-rotator.txt
```
QTI MDSS Rotator

MDSS rotator is a rotator driver, which manages the rotator hw
block inside the Mobile Display Subsystem.

Required properties
- compatible :			Must be "qcom,mdss-rotator".
- qcom,mdss-wb-count:		The number of writeback block
				in the hardware
- <name>-supply:		Phandle for <name> regulator device node.

Bus Scaling Data:
- qcom,msm-bus,name:		String property describing MDSS client.
- qcom,msm-bus,num-cases:	This is the the number of Bus Scaling use cases
				defined in the vectors property. This must be
				set to <3> for MDSS driver where use-case 0 is
				used to take off MDSS BW votes from the system.
				And use-case 1 & 2 are used in ping-pong fashion
				to generate run-time BW requests.
- qcom,msm-bus,num-paths:	This represents the number of paths in each
				Bus Scaling Usecase. This value depends on
				how many number of AXI master ports are
				dedicated to MDSS for particular chipset.
- qcom,msm-bus,vectors-KBps:	* A series of 4 cell properties, with a format
				of (src, dst, ab, ib) which is defined at
				Documentation/devicetree/bindings/arm/msm/msm_bus.txt
				* Current values of src & dst are defined at
				include/linux/msm-bus-board.h
				src values allowed for MDSS are:
					22 = MSM_BUS_MASTER_MDP_PORT0
					23 = MSM_BUS_MASTER_MDP_PORT1
					25 = MSM_BUS_MASTER_ROTATOR
				dst values allowed for MDSS are:
					512 = MSM_BUS_SLAVE_EBI_CH0
				ab: Represents aggregated bandwidth.
				ib: Represents instantaneous bandwidth.
				* Total number of 4 cell properties will be
				(number of use-cases * number of paths).
				* These values will be overridden by the driver
				based on the run-time requirements. So initial
				ab and ib values defined here are random and
				bare no logic except for the use-case 0 where ab
				and ib values needs to be 0.
				* Define realtime vector properties followed by
				non-realtime vector properties.

Optional properties
- qcom,mdss-has-reg-bus:	Boolean property to indicate
				if rotator needs to vote for register bus. This
				property is needed starting 8996
- qcom,mdss-has-ubwc:		Boolean property to indicate
				if the hw supports universal
				bandwidth compression (ubwc)
- qcom,mdss-has-downscale	Boolean property to indicate
				if the hw supports downscale
- qcom,sde-reg-bus:		Subnode to provide Bus scaling for register access for
				rotator

Example:
	mdss_rotator: qcom,mdss_rotator {
		compatible = "qcom,mdss_rotator";
		qcom,mdss-has-downscale;
		qcom,mdss-has-ubwc;
		qcom,mdss-wb-count = <2>;

		qcom,mdss-has-reg-bus;
		/* Bus Scale Settings */
		qcom,msm-bus,name = "mdss_rotator";
		qcom,msm-bus,num-cases = <3>;
		qcom,msm-bus,num-paths = <1>;
		qcom,mdss-num-nrt-paths = <1>;
		qcom,msm-bus,vectors-KBps =
			<25 512 0 0>,
			<25 512 0 6400000>,
			<25 512 0 6400000>;

		vdd-supply = <&gdsc_mdss>;
		gdsc-mmagic-mdss-supply = <&gdsc_mmagic_mdss>;
		qcom,supply-names = "vdd", "gdsc-mmagic-mdss";
		qcom,sde-reg-bus {
		    /* Reg Bus Scale Settings */
		    qcom,msm-bus,name = "mdss_rot_reg";
		    qcom,msm-bus,num-cases = <4>;
		    qcom,msm-bus,num-paths = <1>;
		    qcom,msm-bus,active-only;
		    qcom,msm-bus,vectors-KBps =
			    <1 590 0 0>,
			    <1 590 0 76800>,
			    <1 590 0 160000>,
			    <1 590 0 320000>;
		};
	};
```

## Documentation/devicetree/bindings/fb/mdss-spi-client.txt
```
Qualcomm Technologies, Inc. mdss-spi-client

mdss-spi-client is for SPI display to send the FB data to SPI master.

Required properties:
- compatible : should be "qcom,mdss-spi-client"
- spi-max-frequency : Maximum SPI clocking speed of device in Hz

Optional properties:
- label: A string used to describe the controller used.
- spi-cpol : Boolean property indicating device requires inverse
  clock polarity (CPOL) mode
- spi-cpha :  Empty property indicating device requires shifted
  clock phase (CPHA) mode
- spi-cs-high :  Empty property indicating device requires
  chip select active high

Example:
spi@78b9000 { /* BLSP1 QUP5 */
	qcom,mdss_spi_client {
		reg = <0>;
		compatible = "qcom,mdss-spi-client";
		label = "MDSS SPI QUP5 CLIENT";
		spi-max-frequency = <50000000>;
	};
};
```
