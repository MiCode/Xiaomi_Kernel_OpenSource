## Documentation/devicetree/bindings/hwmon/qpnp-adc-voltage.txt
```
Qualcomm's QPNP PMIC Voltage ADC Arbiter

QPNP PMIC Voltage ADC (VADC) provides interface to clients to read
Voltage. A 15 bit ADC is used for Voltage measurements. There are multiple
peripherals to the VADC and the scope of the driver is to provide interface
for the USR peripheral of the VADC.

VADC node

Required properties:
- compatible : should be "qcom,qpnp-vadc" for Voltage ADC driver.
- reg : offset and length of the PMIC Aribter register map.
- address-cells : Must be one.
- size-cells : Must be zero.
- interrupts : The USR bank peripheral VADC interrupt.
- interrupt-names : Should contain "eoc-int-en-set".
- qcom,adc-bit-resolution : Bit resolution of the ADC.
- qcom,adc-vdd-reference : Voltage reference used by the ADC.

Channel nodes
NOTE: Atleast one Channel node is required.

Optional properties:
- qcom,vadc-poll-eoc: Use polling instead of interrupts for End of Conversion completion.
- qcom,pmic-revid : Phandle pointing to the revision peripheral node. Use it to query the
		    PMIC type and revision for applying the appropriate temperature
		    compensation parameters.

Client required property:
- qcom,<consumer name>-vadc : The phandle to the corresponding vadc device.
			The consumer name passed to the driver when calling
			qpnp_get_vadc() is used to associate the client
			with the corresponding device.

Required properties:
- label : Channel name used for sysfs entry.
- reg : AMUX channel number.
- qcom,decimation : Sampling rate to use for the individual channel measurement.
		    Select from following unsigned int.
		    0 : 512
		    1 : 1K
		    2 : 2K
		    3 : 4K
- qcom,pre-div-channel-scaling : Pre-div used for the channel before the signal
				 is being measured. Some of the AMUX channels
				 support dividing the signal from a predetermined
				 ratio. The configuration for this node is to know
				 the pre-determined ratio and use it for post scaling.
				 Select from the following unsinged int.
				 0 : {1, 1}
				 1 : {1, 3}
				 2 : {1, 4}
				 3 : {1, 6}
				 4 : {1, 20}
- qcom,calibration-type : Reference voltage to use for channel calibration.
			  Channel calibration is dependendent on the channel.
			  Certain channels like XO_THERM, BATT_THERM use ratiometric
			  calibration. Most other channels fall under absolute calibration.
			  Select from the following strings.
			  "absolute" : Uses the 625mv and 1.25V reference channels.
			  "ratiometric" : Uses the reference Voltage/GND for calibration.
- qcom,scale-function : Scaling function used to convert raw ADC code to units specific to
			a given channel.
			Select from the following unsigned int.
			0 : Default scaling to convert raw adc code to voltage.
			1 : Conversion to temperature based on btm parameters.
			2 : Returns result in degC for 100k pull-up.
			3 : Returns current across 0.1 ohm resistor.
			4 : Returns XO thermistor voltage in degree's Centigrade.
			5 : Returns result in degC for 150k pull-up.
			9 : Conversion to temperature based on -15~55 allowable
			    battery charging tempeature setting for btm parameters.
- qcom,hw-settle-time : Settling period for the channel before ADC read.
			Select from the following unsigned int.
			0 : 0us
			1 : 100us
			2 : 200us
			3 : 300us
			4 : 400us
			5 : 500us
			6 : 600us
			7 : 700us
			8 : 800us
			9 : 900us
			0xa : 1ms
			0xb : 2ms
			0xc : 4ms
			0xd : 6ms
			0xe : 8ms
			0xf : 10ms
- qcom,fast-avg-setup : Average number of samples to be used for measurement. Fast averaging
			provides the option to obtain a single measurement from the ADC that
			is an average of multiple samples. The value selected is 2^(value)
			Select from the following unsigned int.
			0 : 1
			1 : 2
			2 : 4
			3 : 8
			4 : 16
			5 : 32
			6 : 64
			7 : 128
			8 : 256

Example:
	/* Main Node */
	qcom,vadc@3100 {
                        compatible = "qcom,qpnp-vadc";
                        reg = <0x3100 0x100>;
			#address-cells = <1>;
			#size-cells = <0>;
                        interrupts = <0x0 0x31 0x0>;
			interrupt-names = "eoc-int-en-set";
                        qcom,adc-bit-resolution = <15>;
                        qcom,adc-vdd-reference = <1800>;

			/* Channel Node */
                        chan@0 {
                                label = "usb_in";
                                reg = <0>;
                                qcom,decimation = <0>;
                                qcom,pre-div-channel-scaling = <4>;
                                qcom,calibration-type = "absolute";
                                qcom,scale-function = <0>;
                                qcom,hw-settle-time = <0>;
                                qcom,fast-avg-setup = <0>;
                        };
	};

Client device example:
/* Add to the clients node that needs the VADC channel A/D */
client_node {
	qcom,client-vadc = <&pm8941_vadc>;
};

/* Clients have an option of measuring an analog signal through an MPP.
   MPP block is not part of the VADC block but is an individual PMIC
   block that has an option to support clients to configure an MPP as
   an analog input which can be routed through one of the VADC pre-mux
   inputs. Here is an example of how to configure an MPP as an analog
   input */

/* Configure MPP4 as an Analog input to AMUX8 and read from channel 0x23 */
/* MPP DT configuration in the platform DT file*/
	mpp@a300 { /* MPP 4 */
		qcom,mode = <4>; /* AIN input */
		qcom,invert = <1>; /* Enable MPP */
		qcom,ain-route = <3>; /* AMUX 8 */
		qcom,master-en = <1>;
		qcom,src-sel = <0>; /* Function constant */
	};

/* VADC Channel configuration */
	chan@23 {
		label = "mpp4_div3";
		reg = <0x23>;
		qcom,decimation = <0>;
		qcom,pre-div-channel-scaling = <1>;
		qcom,calibration-type = "absolute";
		qcom,scale-function = <0>;
		qcom,hw-settle-time = <0>;
		qcom,fast-avg-setup = <0>;
	};
```

## Documentation/devicetree/bindings/hwmon/qpnp-buck-current-monitor.txt
```
QPNP PMIC BUCK current monitoring

QPNP PMIC BUCK provides two current limiting interrupts INT1(icritical) and
INT2(iwarn), which gets trigger whenever buck load current crosses the
programmed threshold (INT1/INT2 interrupt triggers whenever load current
crosses INT1_CURRENT/INT2_CURRENT threshold respectively).
These interrupts are used for MSM current throttling.

[PMIC BUCK current monitor Device Declarations]

Required properties:
- compatible : should be "qcom,qpnp-buck-current-monitor".
- reg : offset and length of the PMIC Aribter register map.
- interrupts : Specifies critical and warning interrupt.
- interrupt-names : Should contain "iwarn", "icritical".

Optional properties:
- qcom,icrit-init-threshold-pc :   Initial critical current threshold in
				percentage of maximum rated current (3 Amps).
				If this	value is not specified default is 90%
				of rated current.
- qcom,iwarn-init-threshold-pc :   Initial warning current threshold in
				percentage of maximum rated current (3 Amps).
				If this value is not specified default is 70%
				of rated current.
- qcom,icrit-polling-delay-msec : Delay for polling RT status register for
				  ICRIT interrupt.
- qcom,iwarn-polling-delay-msec : Delay for polling RT status register for
				  IWARN interrupt.
- qcom,enable-current-monitor : Enable current monitor. If this property is
				not specified buck will not generate current
				limiting interrupts unless explictly enabled
				from user-space.

Example:
	qpnp-buck-current-monitor@1800 {
			compatible = "qcom,qpnp-buck-current-monitor";
			reg = <0x1800 0x100>;
			interrupts = <1 0x18 0>, <1 0x18 1>;
			interrupt-names = "iwarning", "icritical";
			qcom,icrit-init-threshold-pc = <90>;
			qcom,iwarn-init-threshold-pc = <70>;
			qcom,icrit-polling-delay-msec = <1000>;
			qcom,iwarn-polling-delay-msec = <2000>;
			qcom,enable-current-monitor;
	};
```

## Documentation/devicetree/bindings/i2c/i2c-msm-v2.txt
```
Qualcomm I2C controller

Required properties:
 - reg : Offset and length of the register region for the device named in
	reg-names and has the same index.
 - reg-names : Register region name(s) referenced in reg above
	"qup_phys_addr" : Physical address of QUP register space.
 - compatible : should be "qcom,i2c-msm-v2"
 - interrupts : Interrupt number which correspond to the entry with the same
	index in interrupt-names.
 - interrupt-names: QUP core interrupt name(s) referenced in interrupts above
	"qup_irq" : QUP interrupt used by the controller.
 - dmas : DMA engine API's parameters for blsp.
	<[phandle of the dma controller] [pipe index] [number of descriptors]
				[sps_connect flags] [sps_register_event flags]>;
 - dma-names :  dma channel names.
 - qcom,clk-freq-out : Desired I2C bus clock frequency in Hz
 - qcom,clk-freq-in  : Supplied core clock frequency in Hz.
 - qcom,i2c-dat : specifies GPIO which corresponds to the I2C data line.
 - qcom,i2c-clk : specifies GPIO which corresponds to the I2C clock line.

Required alias:
 - The desired bus-number is specified by an alias with the following format:
	'i2c{n}' where n is the bus number.

Optional property:
 - qcom,noise-rjct-scl : number of low samples on clock line to consider it low.
	When missing default to 0.
 - qcom,noise-rjct-sda : number of low samples on data  line to consider it low.
	When missing default to 0.
 - qcom,disable-dma : disables DMA transfer mode.
 - qcom,master-id : Master-port value used on voting for the clock path.
 - qcom,high-time-clk-div : high time divider value to configure clk-ctl
	register. When missing, default to the value given in driver.
 - qcom,fs-clk-div: fs divider value to configure clk-ctl register. When
	missing, default to the value given in driver.

Example:
	aliases {
		i2c10 = &i2c_10;
	};

	i2c_10: i2c@f9966000 {
		compatible = "qcom,i2c-msm-v2";
		reg-names = "qup_phys_addr", "dma_phys_addr";
		reg = <0xf9966000 0x1000>;
		interrupt-names = "qup_irq";
		interrupts = <0 104 0>;
		dmas = <&dma_blsp1 14 32 0x20000020 0x20>,
			<&dma_blsp1 15 64 0x20000020 0x20>;
		dma-names = "tx", "rx";
		qcom,clk-freq-out = <100000>;
		qcom,clk-freq-in  = <24000000>;
		qcom,noise-rjct-scl = <0>;
		qcom,noise-rjct-sda = <0>;
		qcom,i2c-dat = <&tlmm 67 0x00>;
		qcom,i2c-clk = <&tlmm 68 0x00>;

	};
```

## Documentation/devicetree/bindings/i2c/i2c-qup.txt
```
Qualcomm I2C controller

Required properties:

 - reg : Offset and length of the register region(s) for the device
	 For GSBI based controller, GSBI and QUP regions are expected
	 For BLSP based controller, QUP region offset is expected
 - reg-names : Register region name(s) referenced in reg above
	 BLSP based controller expects QUP region name ("qup_phys_addr")
	 GSBI controller expects QUP region name and GSBI region name
	 ("gsbi_qup_i2c_addr")
 - compatible : should be "qcom,i2c-qup"
 - cell-index : I2C bus number used for this controller
 - interrupts : QUP core interrupt(s). Core may have 1 error interrupt and flags
	 for input/output service, or 3 separate interrupts for the 3 services
 - interrupt-names: QUP core interrupt name(s) referenced in interrupts above
	 Expected interrupt resource name(s) are: "qup_err_irq", "qup_in_irq",
	 and "qup_out_irq"
 - qcom,i2c-bus-freq : desired I2C bus clock frequency is Hz

Optional property:
 - qcom,i2c-src-freq : Frequency of the source clocking this bus in Hz.
		      Divider value is set based on soruce-frequency and
		      desired I2C bus frequency. If this value is not
		      provided, the source clock is assumed to be running
		      at 19.2 MHz.
 - qcom,scl-gpio     : I2C clock GPIO number. Required for execution of bus
		      recovery procedure.
 - qcom,sda-gpio     : I2C data  GPIO number. Required for execution of bus
		      recovery procedure.
 - qcom,active-only  : Vote for core clock when the application processor goes
		      to active state and remove that vote when it goes to idle
		      state. This flag may improve service time of first i2c
		      request at the expense of power consumption. When this
		      entry is not present, voting is done by the runtime-pm
		      callbacks.
 - qcom,master-id    : Master endpoint number used for voting on clocks using
		      bus-scaling driver.
 - qcom,clk-ctl-xfer : When present, the clocks's state (prepare_enable/
		      unprepare_disable) is controlled by i2c-transaction's
		      begining and ending. When missing, the clock's state
		      is controlled by runtime-pm events.

Example:
	i2c_3: i2c@f9966000 {
		cell-index = <3>;
		compatible = "qcom,i2c-qup";
		reg = <0xf9966000 0x1000>;
		reg-names = "qup_phys_addr";
		interrupts = <0 104 0>;
		interrupt-names = "qup_err_intr";
		qcom,i2c-bus-freq = <100000>;
		qcom,i2c-src-freq = <24000000>;
		qcom,clk-ctl-xfer;
		qcom,scl-gpio = <&msmgpio 7 0>;
		qcom,sda-gpio = <&msmgpio 6 0>;
	};
```

## Documentation/devicetree/bindings/i2c/nvidia,tegra-i2c.txt
```
NVIDIA I2C controller driver interface.

Required properties:
- compatible : The driver is compatible with
	"nvidia,tegra114-i2c".
	"nvidia,tegra30-i2c".
	"nvidia,tegra20-i2c",
	"nvidia,tegra20-i2c-dvc".
- reg: Should contain I2C registers location and length.
- interrupts: Should contain I2C interrupts.
- nvidia,dma-request-selector : The Tegra DMA controller's phandle and
  request selector for this SLINK controller.

Recommended properties:
- clock-frequency: desired I2C bus clock frequency in Hz.

Optional properties:
- nvidia,clock-always-on: If clock should be always ON and dynamic clock management
	need to be disable.
- nvidia,hs-master-code: Hisgh speed master code if highspeed mode need to be enable.

Example:

	i2c@7000c000 {
		compatible =  "nvidia,tegra30-i2c", "nvidia,tegra20-i2c";
		reg = <0x7000c000 0x100>;
		interrupts = <0 38 0x04>;
		clock-frequency = <100000>;
		nvidia,clock-always-on;
		nvidia,hs-master-code = <0x1234>;
		#address-cells = <1>;
		#size-cells = <0>;
		status = "disabled";
	}; 
```
