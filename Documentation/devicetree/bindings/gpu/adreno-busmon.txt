## Documentation/devicetree/bindings/gpu/adreno-busmon.txt
```
Adreno bus monitor device

kgsl-busmon is a psedo device that represents a devfreq bus bandwidth
governor. If this device is present then two different governors are used
for  GPU DCVS and bus DCVS.

Required properties:
- compatible:	Must be "qcom,kgsl-busmon"
- label:	Device name used for sysfs entry.

Example:

	qcom,kgsl-busmon {
		compatible = "qcom,kgsl-busmon";
		label = "kgsl-busmon";
	};
```

## Documentation/devicetree/bindings/gpu/adreno-iommu.txt
```
Qualcomm Technologies, Inc. GPU IOMMU

Required properties:

Required properties:
- compatible : one of:
	- "qcom,kgsl-smmu-v1"
	- "qcom,kgsl-smmu-v2"

- reg		: Base address and size of the SMMU.

- clocks	: List of clocks to be used during SMMU register access. See
		  Documentation/devicetree/bindings/clock/clock-bindings.txt
		  for information about the format. For each clock specified
		  here, there must be a corresponding entry in clock-names
		  (see below).

- clock-names	: List of clock names corresponding to the clocks specified in
		  the "clocks" property (above). See
		  Documentation/devicetree/bindings/clock/clock-bindings.txt
		  for more info.
- qcom,protect  : The GPU register region which must be protected by a CP
		  protected mode. On some targets this region must cover
		  the entire SMMU register space, on others there
		  is a separate aperture for CP to program context banks.

Optional properties:
- qcom,micro-mmu-control : Some targets provide an implementation defined
		  register for blocking translation requests during GPU side
		  programming.  This property specifies the offset of this
		  register within the iommu register space.
- qcom,retention :  A boolean specifying if retention is supported on this target
- qcom,global_pt :  A boolean specifying if global pagetable should be used.
		  When not set we use per process pagetables
- qcom,hyp_secure_alloc : A bool specifying if the hypervisor is used on this target
		  for secure buffer allocation
- qcom,secure_align_mask: A mask for determining how secure buffers need to
		  be aligned
- qcom,coherent-htw: A boolean specifying if coherent hardware table walks should
		  be enabled.

- List of sub nodes, one for each of the translation context banks supported.
  The driver uses the names of these nodes to determine how they are used,
  currently supported names are:
  - gfx3d_user : Used for the 'normal' GPU address space.
  - gfx3d_secure : Used for the content protection address space.
  Each sub node has the following required properties:

	- compatible : "qcom,smmu-kgsl-cb"
	- iommus : Specifies the SID's used by this context bank, this needs to be
		   <kgsl_smmu SID> pair, kgsl_smmu is the string parsed by iommu
		   driver to match this context bank with the kgsl_smmu device
		   defined in iommu device tree. On targets where the msm iommu
		   driver is used rather than the arm smmu driver, this property
		   may be absent.
	- qcom,gpu-offset :  Offset into the GPU register space for accessing
		   this context bank. On some targets the iommu registers are not
		   part of the GPU's register space, and a separate register aperture
		   is used. Otherwise the same register offsets may be used for CPU
		   or GPU side programming.

Example:

	msm_iommu: qcom,kgsl-iommu {
		compatible = "qcom,kgsl-smmu-v2";
		reg = <0xb40000 0x20000>;
		qcom,protect = <0x40000 0x20000>;
		clocks = <&clock_mmss clk_gpu_ahb_clk>,
			<&clock_gcc clk_gcc_mmss_bimc_gfx_clk>,
			<&clock_mmss clk_mmss_mmagic_ahb_clk>,
			<&clock_mmss clk_mmss_mmagic_cfg_ahb_clk>;
		clock-names = "gpu_ahb_clk", "bimc_gfx_clk", "mmagic_ahb_clk", "mmagic_cfg_ahb_clk";
		qcom,secure_align_mask = <0xfff>;
		qcom,retention;
		qcom,global_pt;

		gfx3d_user: gfx3d_user {
			compatible = "qcom,smmu-kgsl-cb";
			iommus = <&kgsl_smmu 0>,
				 <&kgsl_smmu 1>;
			qcom,gpu-offset = <0x48000>;
		};

		gfx3d_secure: gfx3d_secure {
			compatible = "qcom,smmu-kgsl-cb";
			iommus = <&kgsl_smmu 2>;
		};
	};
```

## Documentation/devicetree/bindings/gpu/adreno-pwrlevels.txt
```
Qualcomm Technologies, Inc. GPU powerlevels

Powerlevels are defined in sets by qcom,gpu-pwrlevels. Multiple sets (bins)
can be defined within qcom,gpu-pwrelvel-bins. Each powerlevel defines a
voltage, bus, bandwidth level, and a DVM value.

- qcom,gpu-pwrlevel-bins:	Contains one or more qcom,gpu-pwrlevels sets

Properties:
- compatible:			Must be qcom,gpu-pwrlevel-bins
- qcom,gpu-pwrlevels:		Defines a set of powerlevels

Properties:
- qcom,speed-bin:		Speed bin identifier for the set - must match
				the value read from the hardware
- qcom,initial-pwrlevel:	GPU wakeup powerlevel

- qcom,gpu-pwrlevel:		A single powerlevel

- qcom,ca-target-pwrlevel:
				This value indicates which qcom,gpu-pwrlevel
				to jump on in case of context aware power level
				jump.
Required Properties:
- reg:				Index of the powerlevel (0 = highest perf)
- qcom,gpu-freq			GPU frequency for the powerlevel (in Hz)
- qcom,bus-freq			Index to a bus level (defined by the bus
				settings).

- qcom,bus-freq-ddrX		If specified, define the DDR specific bus
				frequency for the power level.  X will be the
				return value from of_fdt_get_ddrtype().

Optional Properties:
- qcom,bus-min			Minimum bus level to set for the power level

- qcom,bus-min-ddrX		If specified, define the DDR specific minimum
				bus level for the power level.  X will be the
				return value from of_fdt_get_ddrtype().

- qcom,bus-max			maximum bus level to set for the power level

- qcom,bus-max-ddrX		If specified, define the DDR specific maximum
				bus level for the power level.  X will be the
				return value from of_fdt_get_ddrtype().

- qcom,dvm-val:			Value that is used as a register setting for
				the ACD power feature. It helps determine the
				threshold for when ACD activates. 0xFFFFFFFF
				is the default value, and the setting where
				ACD will never activate.
Example:

qcom,gpu-pwrlevel@6 {
	reg = <6>;
	qcom,gpu-freq = <0>;
	qcom,bus-freq = <0>;
	qcom,bus-min = <0>;
	qcom,bus-max = <0>;
	qcom,dvm-val = <0xffffffff>;
};

Example for DDR4/DDR5 specific part:

qcom,gpu-pwrlevel@6 {
	reg = <6>;
	qcom,gpu-freq = <480000000>;

	/* DDR5 */
	qcom,bus-freq-ddr8 = <10>;
	qcom,bus-min-ddr8 = <9>;
	qcom,bus-max-ddr8 = <11>;

	/* DDR 4 */
	qcom,bus-freq-ddr7 = <9>;
	qcom,bus-min-ddr7 = <7>;
	qcom,bus-max-ddr7 = <9>;

	qcom,dvm-val = <0xffffffff>;
};
```
