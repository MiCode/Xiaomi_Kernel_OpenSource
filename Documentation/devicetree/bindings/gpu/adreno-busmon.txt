## Documentation/devicetree/bindings/iio/adc/qcom,spmi-adc5.txt
```
Qualcomm Technologies Inc. SPMI PMIC5 voltage and current ADC

SPMI PMIC5 voltage ADC (ADC) provides interface to clients to read
voltage. The ADC is a 15-bit sigma-delta ADC.

ADC node:

- compatible:
    Usage: required
    Value type: <string>
    Definition: Should contain "qcom,spmi-adc5" for PMIC5 ADC driver.
		Should contain "qcom,spmi-adc-rev2" for PMIC refresh ADC driver.

- reg:
    Usage: required for VADC base address
    Value type: <prop-encoded-array>
    Definition: VADC base address and length in the SPMI PMIC register map.
                ADC_CAL base address and length in SPMI PMIC register map.
                ADC_CAL base is optional and is dependent on USB_IN_V channel
                read sequence for the PMIC.

- reg-names
    Usage: required
    Value type: <string>
    Definition: Names associated with base addresses. should be
                "adc5-usr-base", "adc5-cal-base".

- #address-cells:
    Usage: required
    Value type: <u32>
    Definition: Must be one. Child node 'reg' property should define ADC
            channel number.

- #size-cells:
    Usage: required
    Value type: <u32>
    Definition: Must be zero.

- #io-channel-cells:
    Usage: required
    Value type: <u32>
    Definition: Must be one. For details about IIO bindings see:
            Documentation/devicetree/bindings/iio/iio-bindings.txt

- interrupts:
    Usage: optional
    Value type: <prop-encoded-array>
    Definition: End of conversion interrupt.

- qcom,pmic-revid:
    Usage: optional
    Value type:<u32>
    Definition: phandle pointing to the revision peripheral node. Use it to query the
                PMIC type and revision.

Channel node properties:

- reg:
    Usage: required
    Value type: <u32>
    Definition: ADC channel number.
            See include/dt-bindings/iio/qcom,spmi-vadc.h

- label:
    Usage: required
    Value type: <empty>
    Definition: ADC datasheet channel name.
            For thermistor inputs connected to generic AMUX or GPIO inputs
            these can vary across platform for the same pins. Hence select
            the datasheet name for this channel.

- qcom,pre-scaling:
    Usage: required
    Value type: <u32 array>
    Definition: Used for scaling the channel input signal before the signal is
            fed to VADC. The configuration for this node is to know the
            pre-determined ratio and use it for post scaling. Select one from
            the following options.
            <1 1>, <1 3>, <1 4>, <1 6>, <1 20>, <1 8>, <10 81>, <1 10>
            If property is not found default value depending on chip will be used.

- qcom,decimation:
    Usage: optional
    Value type: <u32>
    Definition: This parameter is used to decrease ADC sampling rate.
            Quicker measurements can be made by reducing decimation ratio.
            For PMIC5 ADC, combined two step decimation values are 250, 420 and 840.
            If property is not found, default value of 840 will be used.
	    For PMIC refresh ADC, supported decimation values are 256, 512, 1024.
	    If property is not found, default value of 1024 will be used.

- qcom,ratiometric:
    Usage: optional
    Value type: <empty>
    Definition: Channel calibration type. If this property is specified
            VADC will use the VDD reference (1.875V) and GND for channel
            calibration. If property is not found, channel will be
            calibrated with 0V and 1.25V reference channels, also
            known as absolute calibration.

- qcom,hw-settle-time:
    Usage: optional
    Value type: <u32>
    Definition: Time between AMUX getting configured and the ADC starting
            conversion.
	    For PMIC5, delay = 15us for value 0,
			100us * (value) for values 0 < value < 11, and
            		2ms * (value - 10) otherwise.
            Valid values are: 15, 100, 200, 300, 400, 500, 600, 700, 800,
            900 us and 1, 2, 4, 6, 8, 10 ms
            If property is not found, channel will use 15us.
	    For PMIC rev2, delay = 100us * (value) for values 0 < value < 11, and
			2ms * (value - 10) otherwise.
            Valid values are: 0, 100, 200, 300, 400, 500, 600, 700, 800,
            900 us and 1, 2, 4, 6, 8, 10 ms
            If property is not found, channel will use 0 us.

- qcom,avg-samples:
    Usage: optional
    Value type: <u32>
    Definition: Number of samples to be used for measurement.
            Averaging provides the option to obtain a single measurement
            from the ADC that is an average of multiple samples. The value
            selected is 2^(value).
            Valid values are: 1, 2, 4, 8, 16
            If property is not found, 1 sample will be used.

- qcom,lut-index:
    Usage: optional
    Value type: <u32>
    Definition: Lookup table index (only for bat_therm channels).
            A bat_therm channel (for 30k, 100k or 400k pull-up resistance)
            requires a voltage-temperature look-up table which depends on the target.
            The LUT to be used for a channel is selected from a table of LUTs
            for that particular channel.
            If property is not found, a default LUT is used for that channel,
            corresponding to index 0.

Example:

        /* VADC node */
        pmic_vadc: vadc@3100 {
                compatible = "qcom,spmi-adc5";
                reg = <0x3100 0x100>;
                interrupts = <0x0 0x31 0x0 IRQ_TYPE_EDGE_RISING>;
                #address-cells = <1>;
                #size-cells = <0>;
                #io-channel-cells = <1>;
                io-channel-ranges;

                /* Channel node */
                vph_pwr {
                        reg = <ADC_VPH_PWR>;
                        label = "vph_pwr";
                        qcom,decimation = <840>;
                        qcom,hw-settle-time = <0>;
                        qcom,avg-samples = <1>;
                        qcom,pre-scaling = <1 3>;
                };
        };

        /* IIO client node */
        usb {
                io-channels = <&pmic_vadc ADC_VPH_PWR>;
                io-channel-names = "vadc";
        };
```

## Documentation/devicetree/bindings/iio/adc/qcom-rradc.txt
```
Qualcomm Technologies Inc., PMIC Round Robin ADC (RRADC)

PMIC RRADC provides an interface to the clients to read
the voltage, current and temperature for supported channels
such as battery ID, battery thermistor, die temperature,
charger temperature, USB_IN and DC_IN voltage and current.

Main node properties:

- compatible:
    Usage: required
    Value type: <string>
    Definition: Should contain "qcom,rradc".

- reg:
    Usage: required
    Value type: <prop-encoded-array>
    Definition: RRADC base address and length in the PMIC register map.

- #address-cells:
    Usage: required
    Value type: <u32>
    Definition: Must be one. Child node 'channel' property should define ADC
            channel number. For details about IIO bindings see:
            Documentation/devicetree/bindings/iio/iio-bindings.txt

- #size-cells:
    Usage: required
    Value type: <u32>
    Definition: Must be zero. For details about IIO bindings see:
            Documentation/devicetree/bindings/iio/iio-bindings.txt

- #io-channel-cells:
    Usage: required
    Value type: <u32>
    Definition: Must be one. For details about IIO bindings see:
            Documentation/devicetree/bindings/iio/iio-bindings.txt

IIO client nodes need to specify the RRADC channel number while requesting ADC reads.
The channel list supported by the RRADC driver is available in the enum rradc_channel_id
located at at drivers/iio/adc/qcom-rradc.c. Clients can use this index from the enum
as the channel number while requesting ADC reads.

Optional property:
- qcom,pmic-revid : Phandle pointing to the revision peripheral node. Use it to query the
		    PMIC fabrication ID for applying the appropriate temperature
		    compensation parameters.
- qcom,batt-id-delay-ms :
    Value type: <u32>
    Definition: Used to specify HW settling time in MS for measuring BATT_ID.
            Possible values are: 0, 1, 4, 12, 20, 40, 60, 80.
Example:

	/* RRADC node */
	pmic_rradc: rradc@4500 {
		compatible = "qcom,rradc";
		reg = <0x4500 0x100>;
		#address-cells = <1>;
		#size-cells = <0>;
		#io-channel-cells = <1>;
	};

	/* IIO client node */
	charger {
		io-channels = <&pmic_rradc 0>;
		io-channel-names = "rradc_batt_id";
	};
```

## Documentation/devicetree/bindings/iio/adc/qcom-tadc.txt
```
Qualcomm Technologies, Inc. TADC Specific Bindings

TADC (Telemetry ADC) is a 10 bit resolution ADC which has 8 channels: battery
temperature, skin temperature, die temperature, battery current, battery
voltage, input current, input voltage, and OTG current.

=======================
Required Node Structure
=======================

A TADC must be described in two levels of devices nodes.

=======================
First Level Node - TADC
=======================

- reg
  Usage:      required
  Value type: <prop-encoded-array>
  Definition: Address and size of the TADC register block.

TADC specific properties:
- compatible
  Usage:      required
  Value type: <string>
  Definition: Must be "qcom,tadc".

- interrupts
  Usage:      required
  Value type: <prop-encoded-array>
  Definition: Peripheral interrupt specifier.

- interrupt-names
  Usage:      required
  Value type: <stringlist>
  Definition: Interrupt names.  This list must match up 1-to-1 with the
	      interrupts specified in the 'interrupts' property.

=============================================
Second Level Nodes - TADC Thermistor Channels
=============================================

- reg
  Usage:      required
  Value type: <u32>
  Definition: The 0 based channel number.

TADC thermistor channel specific properties:
- qcom,rbias
  Usage:      required
  Value type: <u32>
  Definition: The bias resistor value.

- qcom,therm-at-25degc
  Usage:      required
  Value type: <u32>
  Definition: The thermistor resistance at 25 DegC.

- qcom,beta-coefficient
  Usage:      required
  Value type: <u32>
  Definition: The beta coefficeent or B-parameter of the thermistor.

===============================================
Second Level Nodes - TADC Scale/Offset Channels
===============================================

- reg
  Usage:      required
  Value type: <u32>
  Definition: The 0 based channel number.

TADC scale/offset channel specific properties:
- qcom,scale
  Usage:      required
  Value type: <s32>
  Definition: The RAW scaling factor.

- qcom,offset
  Usage:      optional
  Value type: <s32>
  Definition: The offset after scaling.

=======
Example
=======

smb138x_tadc: qcom,tadc@3600 {
	compatible = "qcom,tadc";
	#address-cells = <1>;
	#size-cells = <0>;
	#io-channel-cells = <1>;
	interrupts = <0x36 0x0 IRQ_TYPE_EDGE_BOTH>;
	interrupt-names = "eoc";

	batt_temp@0 {
		reg = <0>;
		qcom,rbias = <68100>;
		qcom,rtherm-at-25degc = <68000>;
		qcom,beta-coefficient = <3450>;
	};

	skin_temp@1 {
		reg = <1>;
		qcom,rbias = <33000>;
		qcom,rtherm-at-25degc = <68000>;
		qcom,beta-coefficient = <3450>;
	};

	die_temp@2 {
		reg = <2>;
		qcom,scale = <(-1032)>;
		qcom,offset = <344125>;
	};

	batt_i@3 {
		reg = <3>;
		qcom,channel = <3>;
		qcom,scale = <20000000>;
	};

	batt_v@4 {
		reg = <4>;
		qcom,scale = <5000000>;
	};

	input_i@5 {
		reg = <5>;
		qcom,scale = <14285714>;
	};

	input_v@6 {
		reg = <6>;
		qcom,scale = <25000000>;
	};

	otg_i@7 {
		reg = <7>;
		qcom,scale = <5714286>;
	};
};
```

## Documentation/devicetree/bindings/iio/imu/inv_mpu9250.txt
```
The mpu9250 sensor is 9-axis gyroscope+accelerometer+magnetometer combo
device which is made by InvenSense Inc. It can be accessed
via SPI bus with max frequency up to 20MHz. The recommended
SPI mode is the mode 3(CPOL=1, CPHA=1).

Required properties:
 - compatible        : Should be "invn,mpu9250".
 - reg               : the Chip select ID.
 - spi-max-frequency : the SPI bus max frequency.
 - invn,mu9250-irq   : the irq gpio.

Optional properties:
 - spi-cpol       : SPI MODE(CPOL).
 - spi-cpha       : SPI MODE(CPHA).

spi-cpol,spi-cpha,spi-max-frequency information is described in
Documentation/devicetree/bindings/spi/spi_qsd.txt.

Example:
	spi@7575000 {
		mpu9250-spi@0 {
			compatible = "invn,mpu9250";
			reg = <0>;
			spi-max-frequency = <8000000>;
			invn,mpu9250-irq = <&tlmm 79 0>;
			spi-cpol;
			spi-cpha;
		};
	};
```
