## Documentation/devicetree/bindings/i2c/qcom,i2c-qcom-geni.txt
```
GENI based Qualcomm Technologies Inc Universal Peripheral version 3 (QUPv3)
								I2C controller

Required properties:
 - compatible: Should be:
   * "qcom,i2c-geni.
 - reg: Should contain QUP register address and length.
 - interrupts: Should contain I2C interrupt.
 - clocks: Serial engine core clock, and AHB clocks needed by the device.
 - pinctrl-names/pinctrl-0/1: The GPIOs assigned to this core. The names
   should be "active" and "sleep" for the pin confuguration when core is active
   or when entering sleep state.
 - #address-cells: Should be <1> Address cells for i2c device address
 - #size-cells: Should be <0> as i2c addresses have no size component
 - qcom,wrapper-core: Wrapper QUPv3 core containing this I2C controller.

Optional property:
 - qcom,clk-freq-out: Desired I2C bus clock frequency in Hz.
   When missing default to 400000Hz.
 - qcom,clk-cfg: Array of <u32>, clk cfg array should have 2nd to 5th parameter as
   suggested by hardware expert. Standard frequency parameters taken cared by the
   driver itself. This field is needed only if client freq is not from the i2c standard
   supported frequencies or to fine tune the existing clock parameters.
   1st parameter: clk-freq-out, desired I2C bus clock frequency in Hz.
   2nd parameter: clk_div, desired I2C bus divider value.
   3rd parameter: t_high, desired HIGH period of SCL clock.
   4th parameter: t_low, desired LOW period of SCL clock.
   5th parameter: t_cycle, desired clock cycle.

   Note: Both qcom,clk-freq-out and qcom,clk-cfg should not be specified at the same time.

Child nodes should conform to i2c bus binding.

Example:

i2c@a94000 {
	compatible = "qcom,i2c-geni";
	reg = <0xa94000 0x4000>;
	interrupts = <GIC_SPI 358 0>;
	clock-names = "se-clk", "m-ahb", "s-ahb";
	clocks = <&clock_gcc GCC_QUPV3_WRAP0_S5_CLK>,
		<&clock_gcc GCC_QUPV3_WRAP_0_M_AHB_CLK>,
		<&clock_gcc GCC_QUPV3_WRAP_0_S_AHB_CLK>;
	pinctrl-names = "default", "sleep";
	pinctrl-0 = <&qup_1_i2c_5_active>;
	pinctrl-1 = <&qup_1_i2c_5_sleep>;
	#address-cells = <1>;
	#size-cells = <0>;
	qcom,wrapper-core = <&qupv3_0>;
	qcom,clk-freq-out = <400000>;
	qcom,clk-cfg = <400000 2 5 12 24>; //optional to qcom,clk-freq-out
};
```

## Documentation/devicetree/bindings/i2c/sii8334-i2c.txt
```
* Silicon Image-8334 MHL Tx

Required properties:
- compatible: must be "qcom,mhl-sii8334"
- reg: i2c slave address
- mhl-intr-gpio: MHL interrupt gpio coming out of sii8334
- mhl-pwr-gpio: MHL power gpio required for power rails
- mhl-rst-gpio: MHL reset gpio going into sii8334 for toggling reset pin
- <supply-name>-supply: phandle to the regulator device tree node.
- qcom,hdmi-tx-map: phandle to the hdmi tx device tree node.

Example:
	i2c@f9967000 {
		sii8334@72 {
			compatible = "qcom,mhl-sii8334";
			reg = <0x72>;
			interrupt-parent = <&msmgpio>;
			interrupts = <82 0x8>;
			mhl-intr-gpio = <&msmgpio 82 0>;
			mhl-pwr-gpio = <&msmgpio 12 0>;
			mhl-rst-gpio = <&pm8941_mpps 8 0>;
			avcc_18-supply = <&pm8941_l24>;
			avcc_12-supply = <&pm8941_l2>;
			smps3a-supply = <&pm8941_s3>;
			vdda-supply = <&pm8941_l12>;
			qcom,hdmi-tx-map = <&mdss_hdmi_tx>;
		};
	};
```

## Documentation/devicetree/bindings/i2c/sii8620-i2c.txt
```
* Silicon Image-8620 MHL Tx

Required properties:
- compatible: must be "sil,sii-8620"
- reg: i2c slave address
- sil,pwr-gpio: MHL power gpio required to power sii8620
- sil,fw-wake: MHL fw wake gpio going into sii8620
- sil,reset-gpio: MHL reset gpio going into sii8620 for toggling reset pin
- sil,irq-gpio: MHL interrupt gpio coming out of sii8620
- sil,i2c_port#: Port number of i2c device
- pinctrl-0: Pin control group to be used for this controller.
- pinctrl-names: Should contain only one value - "mhl_active".

Example:
	i2c@f9923000 {
		sil,sii-8620@72 {
			compatible = "sil,sii-8620";
			reg = <0x72>;
			sil,pwr-gpio = <&pm8994_gpios 2 0>;
			sil,fw-wake = <&msm_gpio 38 0>;
			sil,reset-gpio = <&msm_gpio 58 0>;
			sil,irq-gpio = <&msm_gpio 57 0>;
			sil,i2c_port# = <1>;
			pinctrl-names = "mhl_active";
			pinctrl-0 = <&mhl_intr_active &mhl_reset_active>;
		};
	};
```

## Documentation/devicetree/bindings/i3c/qcom,geni-i3c.txt
```
Qualcomm Technologies, Inc. GENI I3C master block

Generic bindings document for GENI I3C master controller driver.

Required properties:
- compatible: shall be "qcom,geni-i3c".
- clocks: shall reference the se clock.
- clock-names: shall contain clock name corresponding to the serial engine.
- interrupts: the interrupt line connected to this I3C master.
- reg: I3C master registers.
- qcom,wrapper-core: Wrapper QUPv3 core containing this I3C controller.
- qcom,ibi-ctrl-id: IBI controller instance number.

Optional properties:
- se-clock-frequency: Source serial clock frequency to use.
- dfs-index: Dynamic frequency scaling table index to use.

Mandatory properties defined by the generic binding (see
Documentation/devicetree/bindings/i3c/i3c.txt for more details):

- #address-cells: shall be set to 3.
- #size-cells: shall be set to 0.

Optional properties defined by the generic binding (see
Documentation/devicetree/bindings/i3c/i3c.txt for more details):

- i2c-scl-hz: frequency for i2c transfers.
- i3c-scl-hz: frequency for i3c transfers.

I3C device connected on the bus follow the generic description (see
Documentation/devicetree/bindings/i3c/i3c.txt for more details).

Example:
        i3c0: i3c-master@980000 {
		compatible = "qcom,geni-i3c";
		reg = <0x980000 0x4000>,
			<0xec30000 0x10000>;
		clock-names = "se-clk", "m-ahb", "s-ahb";
		clocks = <&clock_gcc GCC_QUPV3_WRAP0_S0_CLK>,
			<&clock_gcc GCC_QUPV3_WRAP_0_M_AHB_CLK>,
			<&clock_gcc GCC_QUPV3_WRAP_0_S_AHB_CLK>;
		pinctrl-names = "default", "sleep";
		pinctrl-0 = <&qupv3_se0_i3c_active>;
		pinctrl-1 = <&qupv3_se0_i3c_sleep>;
		interrupts = <GIC_SPI 601 IRQ_TYPE_LEVEL_HIGH>;
		#address-cells = <3>;
		#size-cells = <0>;
		qcom,wrapper-core = <&qupv3_0>;
		qcom,ibi-ctrl-id = <0>;
	};
```

## Documentation/devicetree/bindings/iio/adc/mt635x-auxadc.txt
```
* Mediatek PMIC AUXADC(Auxiliary Analog/Digital Converter)
===============

The PMIC AUXADC is a voltage ADC found in some Mediatek PMICs.
It provides an IIO interface to clients to read voltage.

Required properties:
  - compatible: Should be one of:
    - "mediatek,mt6357-auxadc": For PMIC MT6357 AUXADC
    - "mediatek,mt6358-auxadc": For PMIC MT6358 AUXADC
    - "mediatek,mt6359-auxadc": For PMIC MT6359 AUXADC
  - #io-channel-cells: Should be 1, see ../iio-bindings.txt

Required properties for supported channel in subnodes:
  - channel: PMIC AUXADC channel number.
            See include/dt-bindings/iio/mt635x-auxadc.h

Optional properties for supported channel in subnodes:
  - resistance-ratio: The mapping ratio from 1.8V domain to real voltage.
            It's represented by a 2-elements array like <7 2> which means
            (1.8V domain) * 7 / 2 = (Real voltage domain).
            If this property is not found, the default ratio is 1.

  - avg-num: Selects AUXADC average sample numbers for this channel.
            The valid values are 1, 4, 8, 16, 32, 64, 128, 256.
            If this property is not found, the default number is 8.

Example:
#include <dt-bindings/iio/mt635x-auxadc.h>

	/* AUXADC node */
	pmic_auxadc: pmic_auxadc {
		compatible = "mediatek,mt6359-auxadc";
		#io-channel-cells = <1>;

		batadc {
			channel = <AUXADC_BATADC>;
			resistance-ratio = <7 2>;
			avg-num = <128>;
		};
		bat_temp {
			channel = <AUXADC_BAT_TEMP>;
			resistance-ratio = <5 2>;
		};
		chip_temp {
			channel = <AUXADC_CHIP_TEMP>;
		};
	};

	/* IIO client node */
	thermal {
		io-channels = <&pmic_auxadc AUXADC_CHIP_TEMP>;
		io-channel-names = "pmic_chip_temp";
	};
```

## Documentation/devicetree/bindings/iio/adc/mt6577_auxadc.txt
```
* Mediatek AUXADC - Analog to Digital Converter on Mediatek mobile soc (mt65xx/mt81xx/mt27xx)
===============

The Auxiliary Analog/Digital Converter (AUXADC) is an ADC found
in some Mediatek SoCs which among other things measures the temperatures
in the SoC. It can be used directly with register accesses, but it is also
used by thermal controller which reads the temperatures from the AUXADC
directly via its own bus interface. See
Documentation/devicetree/bindings/thermal/mediatek-thermal.txt
for the Thermal Controller which holds a phandle to the AUXADC.

Required properties:
  - compatible: Should be one of:
    - "mediatek,mt2701-auxadc": For MT2701 family of SoCs
    - "mediatek,mt2712-auxadc": For MT2712 family of SoCs
    - "mediatek,mt7622-auxadc": For MT7622 family of SoCs
    - "mediatek,mt6765-auxadc": For MT6765 family of SoCs
    - "mediatek,mt8173-auxadc": For MT8173 family of SoCs
  - reg: Address range of the AUXADC unit.
  - clocks: Should contain a clock specifier for each entry in clock-names
  - clock-names: Should contain "main".
  - #io-channel-cells: Should be 1, see ../iio-bindings.txt

Optional properties:
  - mediatek,cali-en-bit: auxadc cali on/off bit shift
  - mediatek,cali-ge-bit: auxadc cali ge bits shift
  - mediatek,cali-oe-bit: auxadc cali oe bits shift
  - mediatek,cali-efuse-reg-offset: auxadc cali efuse register offset
  - nvmem: Phandle of nvmem provider which contains efuse address
  - nvmem-names: Should be "mtk_efuse"

Example:

auxadc: adc@11001000 {
	compatible = "mediatek,mt6765-auxadc";
	reg = <0 0x11001000 0 0x1000>;
	clocks = <&pericfg CLK_PERI_AUXADC>;
	clock-names = "main";
	#io-channel-cells = <1>;
	mediatek,cali-en-bit = <20>;
	mediatek,cali-ge-bit = <10>;
	mediatek,cali-oe-bit = <0>;
	mediatek,cali-efuse-reg-offset = <0x1B4>;
	nvmem = <&efuse>;
	nvmem-names = "mtk_efuse";
};
```

## Documentation/devicetree/bindings/iio/adc/palmas-gpadc.txt
```
* Palmas general purpose ADC IP block devicetree bindings

Required properties:
- compatible : Must be "ti,palmas-gpadc".

Optional sub-nodes:
ti,channel0-current-microamp: Channel 0 current in uA.
	Valid values 0uA, 5uA, 15uA, 20uA.
ti,channel3-current-microamp: Channel 3 current in uA.
	Valid value 0uA, 10uA, 400uA, 800uA.
ti,enable-channel3-dual-current: Enable dual current on channel 3.
ti,enable-extended-delay: Enable extended delay.

Optional sub-node:
The Palmas ADC node has optional subnode to define the iio mapping.
It is the name with "iio_map". This node has again subnode to define
the property of the channel. The sub subnode has following properties:
- ti,adc-channel-number: ADC channel numbber.
- ti,adc-consumer-device: Consumer device name.
- ti,adc-consumer-channel: ADC consumer channel name.

Example:

pmic {
	compatible = "ti,twl6035-pmic", "ti,palmas-pmic";
	...
	gpadc {
		compatible = "ti,palmas-gpadc";
		interrupts = <18 0
			      16 0
			      17 0>;
		ti,channel0-current-microamp = <5>;
		ti,channel3-current-microamp = <10>;
		iio_map {
			ch1 {
				ti,adc-channel-number = <1>;
				ti,adc-consumer-device = "generic-adc-thermal.0";
				ti,adc-consumer-channel ="battery-temp-channel";
			};

			ch6 {
				ti,adc-channel-number = <6>;
				ti,adc-consumer-device = "palmas-battery";
				ti,adc-consumer-channel ="vbat_channel";
			};
		};
	};
	...
};
```
