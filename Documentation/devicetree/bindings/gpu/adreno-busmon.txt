## Documentation/devicetree/bindings/gpu/nvidia,tegra-host1x.txt
```
NVIDIA Tegra host1x

Required properties:
- compatible: "nvidia,tegra<chip>-host1x"
- reg: Physical base address and length of the controller's registers.
- interrupts: The interrupt outputs from the controller.
- #address-cells: The number of cells used to represent physical base addresses
  in the host1x address space. Should be 1.
- #size-cells: The number of cells used to represent the size of an address
  range in the host1x address space. Should be 1.
- ranges: The mapping of the host1x address space to the CPU address space.
- nvidia,memory-clients: memory client ID of the controller.

The host1x top-level node defines a number of children, each representing one
of the following host1x client modules:

- mpe: video encoder

  Required properties:
  - compatible: "nvidia,tegra<chip>-mpe"
  - reg: Physical base address and length of the controller's registers.
  - interrupts: The interrupt outputs from the controller.

- vi: video input

  Required properties:
  - compatible: "nvidia,tegra<chip>-vi"
  - reg: Physical base address and length of the controller's registers.
  - interrupts: The interrupt outputs from the controller.
  - nvidia,memory-clients: memory client ID of the controller.

- epp: encoder pre-processor

  Required properties:
  - compatible: "nvidia,tegra<chip>-epp"
  - reg: Physical base address and length of the controller's registers.
  - interrupts: The interrupt outputs from the controller.

- isp: image signal processor

  Required properties:
  - compatible: "nvidia,tegra<chip>-isp"
  - reg: Physical base address and length of the controller's registers.
  - interrupts: The interrupt outputs from the controller.
  - nvidia,memory-clients: memory client ID of the controller.

- gr2d: 2D graphics engine

  Required properties:
  - compatible: "nvidia,tegra<chip>-gr2d"
  - reg: Physical base address and length of the controller's registers.
  - interrupts: The interrupt outputs from the controller.

- gr3d: 3D graphics engine

  Required properties:
  - compatible: "nvidia,tegra<chip>-gr3d"
  - reg: Physical base address and length of the controller's registers.

- dc: display controller

  Required properties:
  - compatible: "nvidia,tegra<chip>-dc"
  - reg: Physical base address and length of the controller's registers.
  - interrupts: The interrupt outputs from the controller.
  - nvidia,memory-clients: memory client ID of the controller.

  Each display controller node has a child node, named "rgb", that represents
  the RGB output associated with the controller. It can take the following
  optional properties:
  - nvidia,ddc-i2c-bus: phandle of an I2C controller used for DDC EDID probing
  - nvidia,hpd-gpio: specifies a GPIO used for hotplug detection
  - nvidia,edid: supplies a binary EDID blob

- hdmi: High Definition Multimedia Interface

  Required properties:
  - compatible: "nvidia,tegra<chip>-hdmi"
  - reg: Physical base address and length of the controller's registers.
  - interrupts: The interrupt outputs from the controller.
  - vdd-supply: regulator for supply voltage
  - pll-supply: regulator for PLL

  Optional properties:
  - nvidia,ddc-i2c-bus: phandle of an I2C controller used for DDC EDID probing
  - nvidia,hpd-gpio: specifies a GPIO used for hotplug detection
  - nvidia,edid: supplies a binary EDID blob

- tvo: TV encoder output

  Required properties:
  - compatible: "nvidia,tegra<chip>-tvo"
  - reg: Physical base address and length of the controller's registers.
  - interrupts: The interrupt outputs from the controller.

- dsi: display serial interface

  Required properties:
  - compatible: "nvidia,tegra<chip>-dsi"
  - reg: Physical base address and length of the controller's registers.

- msenc: Multi-Stream Encoder

  Required properties:
  - compatible: "nvidia,tegra<chip>-msenc"
  - reg: Physical base address and length of the controller's registers.
  - nvidia,memory-clients: memory client ID of the controller.

- tsec: Tegra Security Engine Controller

  Required properties:
  - compatible: "nvidia,tegra<chip>-tsec"
  - reg: Physical base address and length of the controller's registers.
  - nvidia,memory-clients: memory client ID of the controller.

- vic: Video Image Compositor

  Required properties:
  - compatible: "nvidia,tegra<chip>-vic"
  - reg: Physical base address and length of the controller's registers.
  - nvidia,memory-clients: memory client ID of the controller.

- gk20a: Kepler GPU

  Required properties:
  - compatible: "nvidia,tegra<chip>-gk20a"
  - reg: Physical base address and length of the controller's registers.
  - interrupts: The interrupt outputs from the controller.
  - nvidia,memory-clients: memory client ID of the controller.

Example:

/ {
	...

	host1x {
		compatible = "nvidia,tegra20-host1x", "simple-bus";
		reg = <0x50000000 0x00024000>;
		interrupts = <0 65 0x04   /* mpcore syncpt */
			      0 67 0x04>; /* mpcore general */
		nvidia,memory-clients = <6>;

		#address-cells = <1>;
		#size-cells = <1>;

		ranges = <0x54000000 0x54000000 0x04000000>;

		mpe {
			compatible = "nvidia,tegra20-mpe";
			reg = <0x54040000 0x00040000>;
			interrupts = <0 68 0x04>;
		};

		vi {
			compatible = "nvidia,tegra20-vi";
			reg = <0x54080000 0x00040000>;
			interrupts = <0 69 0x04>;
			nvidia,memory-clients = <18>;
		};

		epp {
			compatible = "nvidia,tegra20-epp";
			reg = <0x540c0000 0x00040000>;
			interrupts = <0 70 0x04>;
		};

		isp {
			compatible = "nvidia,tegra20-isp";
			reg = <0x54100000 0x00040000>;
			interrupts = <0 71 0x04>;
			nvidia,memory-clients = <8>;
		};

		gr2d {
			compatible = "nvidia,tegra20-gr2d";
			reg = <0x54140000 0x00040000>;
			interrupts = <0 72 0x04>;
		};

		gr3d {
			compatible = "nvidia,tegra20-gr3d";
			reg = <0x54180000 0x00040000>;
		};

		dc@54200000 {
			compatible = "nvidia,tegra20-dc";
			reg = <0x54200000 0x00040000>;
			interrupts = <0 73 0x04>;
			nvidia,memory-clients = <2>;

			rgb {
				status = "disabled";
			};
		};

		dc@54240000 {
			compatible = "nvidia,tegra20-dc";
			reg = <0x54240000 0x00040000>;
			interrupts = <0 74 0x04>;
			nvidia,memory-clients = <3>;

			rgb {
				status = "disabled";
			};
		};

		hdmi {
			compatible = "nvidia,tegra20-hdmi";
			reg = <0x54280000 0x00040000>;
			interrupts = <0 75 0x04>;
			status = "disabled";
		};

		tvo {
			compatible = "nvidia,tegra20-tvo";
			reg = <0x542c0000 0x00040000>;
			interrupts = <0 76 0x04>;
			status = "disabled";
		};

		dsi {
			compatible = "nvidia,tegra20-dsi";
			reg = <0x54300000 0x00040000>;
			status = "disabled";
		};

                vic {
                        compatible = "nvidia,tegra124-vic";
                        reg = <0x54340000 0x00040000>;
                        nvidia,memory-clients = <19>;
                };

                msenc {
                        compatible = "nvidia,tegra124-msenc";
                        reg = <0x544c0000 0x00040000>;
                        nvidia,memory-clients = <11>;
                };

                tsec {
                        compatible = "nvidia,tegra124-tsec";
                        reg = <0x54500000 0x00040000>;
                        nvidia,memory-clients = <23>;
                };

                gk20a {
                        compatible = "nvidia,tegra124-gk20a";
                        reg = <0x538F0000 0x00001000>,
                              <0x57000000 0x01000000>,
                              <0x58000000 0x01000000>;
                        interrupts = <0 157 0x04
                                      0 158 0x04>;
                        nvidia,memory-clients = <56 57>;
                };

	};

	...
};
```

## Documentation/devicetree/bindings/hwmon/boost-dynamic-controller.txt
```
QTI's Boost Dynamic Controller Driver

Boost Dynamic Controller changes boost regulator mode to force bypass mode or
force boost mode according to VPH voltage level dynamically.

Required properties:
- compatible:			Must be "qcom,boost-dynamic-controller"
- qcom,vph-threshold-adc_tm:	The phandle to the corresponding VADC_TM device.
- qcom,vph-vadc:		The phandle to the corresponding VADC device.
- qcom,boost-dynamic-controller-vph-high-threshold-uv: The threshold in uV for Boost Dynamic Controller to enable force bypass mode when the VPH power is larger than it.
- qcom,boost-dynamic-controller-vph-low-threshold-uv: The threshold in uV for Boost Dynamic Controller to disable force bypass mode when the VPH power is less than it.
- qcom,boost-dynamic-controller-boost-resource-type: A string used to describe the type of the RPM resource who controls the boost regulator.
- qcom,boost-dynamic-controller-boost-resource-key: A string used to describe the key of the RPM resource who controls the boost regulator.
- qcom,boost-dynamic-controller-boost-resource-id: The id of the RPM resource who controls the boost regulator.

Example:
	qcom,boost-dynamic-controller {
		compatible = "qcom,boost-dynamic-controller";
		qcom,vph-threshold-adc_tm = <&pma8084_adc_tm>;
		qcom,vph-vadc = <&pma8084_vadc>;
		qcom,boost-dynamic-controller-vph-high-threshold-uv = <3700000>;
		qcom,boost-dynamic-controller-vph-low-threshold-uv = <3650000>;
		qcom,boost-dynamic-controller-boost-resource-type = "bbya";
		qcom,boost-dynamic-controller-boost-resource-key = "bypa";
		qcom,boost-dynamic-controller-boost-resource-id = <1>;
	};
```

## Documentation/devicetree/bindings/hwmon/epm_adc.txt
```
Embedded Power Measurement(EPM) using Cypress Progammable System on a chip (PSOC)

The EPM using the PSoC5 is used by clients to measure on target power
measurement on supported channels. The PSoC5 is a microcontroller
that is communicated over the SPI from the MSM. Primary configuration
supports upto 31 channels and the scope of the driver is to support
userspace clients.

EPM node

Required properties:
- compatible : should be "cy,epm-adc-cy8c5568lti-114" for EPM using PSoC5.
- reg : chip select for the device.
- interrupt-parent : should be phandle of the interrupt controller
		     servicing the interrupt for this device.
- spi-max-frequency : existing support is set for 960kHz.
- qcom,channels : The number of voltage and current channels that
		  are supported.
- qcom,gain : The gain for each of the supported channels.
- qcom,rsense : The rsense value for each channel. The current channels
		rsense values units are in milliohms. The voltage channels
		rsense value is 1.
- qcom,channel-type : Bitmak of channels to set as voltage and current.
		      These are platform dependent and the appropriate scaling
		      functions are used for returning voltage and current.
- qcom,<gpio-name>-gpio : Handle to the GPIO node, see "gpios property" in
		Documentation/devicetree/bindings/gpio/gpio.txt.
  "gpio-name" can be "epm-enable" which is the EPM global enable GPIO for powering up the PSoC.
```

## Documentation/devicetree/bindings/hwmon/qpnp-adc-current.txt
```
Qualcomm's QPNP PMIC current ADC driver

QPNP PMIC current ADC (IADC) provides interface to clients to read
current. A 16 bit ADC is used for current measurements. There are multiple
peripherals to the IADC and the scope of the driver is to provide interface
for the USR peripheral of the IADC.

IADC node

Required properties:
- compatible : should be "qcom,qpnp-iadc" for Current ADC driver.
- reg : offset and length of the PMIC Arbiter register map.
- reg-names : resource names used for the physical base address of the PMIC IADC
	      peripheral, the SMBB_BAT_IF_TRIM_CNST_RDS register.
	      Should be "iadc-base" for the PMIC IADC peripheral base register.
	      Should be "batt-id-trim-cnst-rds" for reading the
	      SMBB_BAT_IF_TRIM_CNST_RDS register.
- address-cells : Must be one.
- size-cells : Must be zero.
- interrupts : The USR bank peripheral IADC interrupt.
- interrupt-names : Should contain "eoc-int-en-set".
- qcom,adc-bit-resolution : Bit resolution of the ADC.
- qcom,adc-vdd-reference : Voltage reference used by the ADC.

Optional properties:
- qcom,rsense : Use this property when external rsense should be used
		for current calculation and specify the units in nano-ohms.
- qcom,iadc-poll-eoc: Use polling instead of interrupts for End of Conversion completion.
- qcom,pmic-revid : Phandle pointing to the revision peripheral node. Use it to query the
		    PMIC type and revision for applying the appropriate temperature
		    compensation parameters.
- qcom,use-default-rds-trim : Add this property to check if certain conditions are to be checked
			      reading the SMBB_BAT_IF_CNST_RDS, IADC_RDS trim register and
			      manufacturer type. Check the driver for conditions that each of the type.
			      0 : Select the TypeA to read the IADC and SMBB trim register and
				  apply the default RSENSE if conditions are met.
			      1 : Select the TypeB to read the IADC, SMBB trim register and
				  manufacturer type and apply the default RSENSE if conditions are met.
			      2 : Select the TypeC to read the IADC, SMBB trim register and
				  apply the default RSENSE if conditions are met.

Channel node
NOTE: Atleast one Channel node is required.

Client required property:
- qcom,<consumer name>-iadc : The phandle to the corresponding iadc device.
			The consumer name passed to the driver when calling
			qpnp_get_iadc() is used to associate the client
			with the corresponding device.

Required properties:
- label : Channel name used for sysfs entry.
- reg : AMUX channel number.
- qcom,channel-num : Channel number associated to the AMUX input.
- qcom,decimation : Sampling rate to use for the individual channel measurement.
		    Select from the following unsigned int.
		    0 : 512
		    1 : 1K
		    2 : 2K
		    3 : 4K
- qcom,fast-avg-setup : Average number of samples to be used for measurement. Fast averaging
			provides the option to obtain a single measurement from the ADC that
			is an average of multiple samples. The value selected is 2^(value)
			Select from the following unsigned int.
			0 : 1
			1 : 2
			2 : 4
			3 : 8
			4 : 16
			5 : 32
			6 : 64
			7 : 128
			8 : 256
- qcom,iadc-vadc : Corresponding phandle of the VADC device to read the die_temperature and set
		simultaneous voltage and current conversion requests.

Example:
	/* Main Node */
	qcom,iadc@3200 {
                        compatible = "qcom,qpnp-iadc";
                        reg = <0x3200 0x100>;
			#address-cells = <1>;
			#size-cells = <0>;
                        interrupts = <0 0x36 0>;
			interrupt-names = "eoc-int-en-set";
                        qcom,adc-bit-resolution = <16>;
                        qcom,adc-vdd-reference = <1800>;
			qcom,rsense = <1500>;
			qcom,iadc-vadc = <&pm8941_vadc>;

			/* Channel Node */
                        chan@0 = {
                                label = "rsense";
                                reg = <0>;
                                qcom,decimation = <0>;
                                qcom,fast-avg-setup = <0>;
                        };
	};

Client device example:
/* Add to the clients node that needs the IADC */
client_node {
	qcom,client-iadc = <&pm8941_iadc>;
};
```
