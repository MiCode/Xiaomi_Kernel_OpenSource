## Documentation/devicetree/bindings/cache/arm64_cache_erp.txt
```
* ARM Cortex A53 / A57 cache error reporting driver

Required properties:
- compatible: Should be "arm,arm64-cpu-erp"
- interrupts: List of hardware interrupts that may indicate an error condition
  in the CPU subsystem, or in the L1 / L2 caches. At least one interrupt entry
  is required.
- interrupt-names: Must contain one or more of the following IRQ types:
	"pri-dbe-irq" - double-bit error interrupt for primary cluster
	"sec-dbe-irq" - double-bit error interrupt for secondary cluster
	"pri-ext-irq" - external bus error interrupt for primary cluster
	"sec-ext-irq" - external bus error interrupt for secondary cluster
	"cci-irq"     - CCI error interrupt. If this property is present, having
			the 'cci' reg-base defined using the 'reg' property is
			recommended.
	"sbe-irq"     - Single-bit Error interrupt. Single-bit errors interrupts
			are generated by the pmu overflow interrupt, so this essentially
			is just the arm64 pmu interrupt. This is a percpu interrupt.
	At least one irq entry is required.

Optional properties:
- reg: Should contain physical address of the CCI register space
- reg-names: Should contain 'cci'. Must be present if 'reg' property is present
- qcom,apply-cti-pmu-wa: Indicates if the driver needs to apply the CTI PMU Workaround. Relevant for 8994V1.
- poll-delay-msec: Indicates how often the edac check callback should be called. Time in msec.

Example:
	cpu_cache_erp {
		compatible = "arm,arm64-cpu-erp";
		interrupt-names = "pri-dbe-irq",
				  "sec-dbe-irq",
				  "pri-ext-irq",
				  "sec-ext-irq";
		interrupts = <0 92 0>,
			     <0 91 0>,
			     <0 96 0>,
			     <0 95 0>;
	};
```

## Documentation/devicetree/bindings/cache/msm_cache_dump.txt
```
* Qualcomm Krait L1 / L2 cache dumping device
This is a virtual device that dumps the contents of L1 and L2 caches in the
event of a kernel panic or a watchdog trigger.

Required properties:
- compatible:			Should be "qcom,cache_dump"
- qcom,l1-dump-size:		Amount of memory needed for L1 dump(s), in bytes
- qcom,l2-dump-size:		Amount of memory needed for L2 dump, in bytes
- qcom,memory-reservation-size: Combined reserved memory for the dump buffers
- qcom,memory-reservation-type: Type of memory to be reserved

Optional properties:
- qcom,use-imem-dump-offset: If specified, store cache dump buffer addresses
  in IMEM rather than using the memory dump reservation table.

Example:
	qcom,cache_dump {
		compatible = "qcom,cache_dump";
		qcom,l1-dump-size = <0x100000>;
		qcom,l2-dump-size = <0x400000>;
		qcom,memory-reservation-type = "EBI1";
		qcom,memory-reservation-size = <0x500000>;
	};
```

## Documentation/devicetree/bindings/cache/msm_cache_erp.txt
```
* Qualcomm Krait L1 / L2 cache error reporting driver

Required properties:
- compatible: Should be "qcom,cache_erp"
- interrupts: Should contain the L1/CPU error interrupt number and
  the L2 cache interrupt number
- interrupt-names: Should contain the interrupt names "l1_irq" and
  "l2_irq"
- qcom,msm-imem-phandle: phandle reference to the imem cache erp node

Optional properties:
- reg: A set of I/O regions to be dumped in the event of a hardware fault being
  detected. If this property is present, the "reg-names" property is must be
  present as well.
- reg-names: Human-readable names assigned to the I/O regions defined by the
  "reg" property. The names can be completely arbitrary, since they are
  intended to be human-read during failure analysis, and because the set of I/O
  regions of interest may vary with the overall system design. This property
  shall only be present if the "reg" property is present, and must contain as
  many elements as the "reg" property.

Example:
	qcom,cache_erp {
		compatible = "qcom,cache_erp";
		interrupts = <1 9 0>, <0 2 0>;
		interrupt-names = "l1_irq", "l2_irq";
	};

Example with "reg" property defined:
	qcom,cache_erp@f9012000 {
		reg = <0xf9012000 0x80>,
		      <0xf9089000 0x80>,
		      <0xf9099000 0x80>;

		reg-names = "l2_saw",
			    "krait0_saw",
			    "krait1_saw";

		compatible = "qcom,cache_erp";
		interrupts = <1 9 0>, <0 2 0>;
		interrupt-names = "l1_irq", "l2_irq";

		qcom,msm-imem-phandle = <&imem_cache_erp>;
	};
```

## Documentation/devicetree/bindings/cache/msm_cache_erp64.txt
```
* MSM 64bit L0, L1, L2 and L3 cache error reporting driver

Required properties:
- compatible: Should be "qcom,kryo_cache_erp64"
- reg: I/O address L3 hardware block.
- interrupts: Should contain the L0/L1, L2 and L3 cache error interrupt number.
- interrupt-names: Should contain the interrupt names "l1_irq", "l2_irq_info_0",
		   "l2_irq_info_1", "l2_irq_err_0", "l2_irq_err_1", "l3_irq".

Example:
	qcom,cache_erp64@6500000 {
		compatible = "qcom,kryo_cache_erp64";
		reg = <0x6500000 0x4000>;
		/*
		 * PPI 0  for L0/L1
		 * SPI 1  for Cluster 1 L2 Info
		 * SPI 9  for Cluster 2 L2 Info
		 * SPI 2  for Cluster 1 L2 Error
		 * SPI 10 for Cluster 2 L2 Error
		 * SPI 17 for L3 error
		 */
		interrupts = <1 0 0>, <0 1 0>, <0 9 0>, <0 2 0>, <0 10 0>,
			     <0 17 0>;
		interrupt-names = "l1_irq", "l2_irq_info_0", "l2_irq_info_1",
				  "l2_irq_err_0", "l2_irq_err_1", "l3_irq";
	};
```

## Documentation/devicetree/bindings/cache/msm_gladiator_erp.txt
```
* MSM Gladiator error reporting driver

Required properties:
- compatible: Should be "qcom,msm-gladiator"
- reg: I/O address Gladiator H/W block
- reg-names: Should be "gladiator_base"
- interrupts: Should contain the gladiator error interrupt number.

Example:

qcom,msm-gladiator@b1c0000 {
	compatible = "qcom,msm-gladiator";
	reg = <0xB1C0000 0x4000>;
	reg-names = "gladiator_base";
	interrupts = <0 34 0>;
}
```

## Documentation/devicetree/bindings/cache/msm_m4m_erp.txt
```
* MSM M4M error reporting driver

Required properties:
- compatible: Should be "qcom,m4m_erp".
- reg: I/O address M4M hardware block.
- interrupts: Should contain the M4M error interrupt number.
- interrupt-names: Should contain the interrupt names "m4m_irq".

Example:
	qcom,m4m_erp64@9A40000 {
		compatible = "qcom,m4m_erp";
		reg = <0x9A40000 0x40000>;
		interrupts = <0 22 0>;
		interrupt-names = "m4m_irq";
	};
```

## Documentation/devicetree/bindings/ccci/ccci_off/mediatek,ccci_off.txt
```
Mediatek ccci_off device
============================

The Mediatek ccci_off controller will turn off all Modem related power in charing mode or ccci driver disable.

Required Properties:

	- compatible: Should be:
		"mediatek,ccci_off"
	- clocks: Clock driving the hardware.
	- clock-names:  Clock driving the hardware name.
Optional properties:

Example:
ccci_off@0 {
	compatible = "mediatek,ccci_off";
	clocks = <&scpsys SCP_SYS_MD1>;
	clock-names = "scp-sys-md1-main";
};
```

## Documentation/devicetree/bindings/ccci/dual_ccci/mediatek,ap_ccif0.txt
```
Mediatek ap_ccif0 device
============================

The Mediatek ap_ccif0 controller is an interface to communicate with MD1.

Required Properties:

	- compatible: Should be:
		"mediatek,ap_ccif0"
	- reg: physical base address of AP CCIF base, length of AP CCIF, and MD CCIF base & Length of MD CCIF
	- interrupts: interrupt number to the cpu.
	- mediatek,md_smem_size: AP and MD share memory size.

Optional properties:
	- mediatek,ccif_capability: config AP ccci driver feature, reserved in MT6580

Example:
ap_ccif0:ap_ccif0@1000C000 {
		compatible = "mediatek,ap_ccif0";
		reg =	<0x1000C000 0x1000>,	/*AP_CCIF_BASE*/
		<0x1000D000 0x1000>;	/*MD_CCIF_BASE*/
		interrupts =	<GIC_SPI 93 IRQ_TYPE_LEVEL_LOW>, /* CCIF0 IRQ */
				<GIC_SPI 152 IRQ_TYPE_EDGE_FALLING>;/* MD WDT IRQ */
		mediatek,ccif_capability = <2>;
		mediatek,md_smem_size = <0x200000>; /* md share memory size */
};
```

## Documentation/devicetree/bindings/ccci/eccci/mediatek,ap2c2k_ccif.txt
```
Mediatek ap2c2k device
============================

The Mediatek ap2c2k controller is an interface to communicate with C2K modem.

Required Properties:

	- compatible: Should be:
		"mediatek,ap2c2k_ccif"
	- reg: physical base address of AP CCIF base, length of AP CCIF, and MD CCIF base & Length of MD CCIF
	- interrupts: interrupt number to the cpu.
	- mediatek,md_id: configure MD id for modem_ccif driver.
	- mediatek,cldma_capability: config AP ccci driver feature.
	- mediatek,md_smem_size: AP and MD share memory size.
	- clocks: Clock driving the hardware.
	- clock-names:  Clock driving the hardware name.
Optional properties:

Example:
ap2c2k_ccif@1020b000 {
	compatible = "mediatek,ap2c2k_ccif";
	reg = <0x1020b000 0x1000>, //CCIF
		<0x10211000 0x300>, // MD1 PCCIF
		<0x10213000 0x300>; // MD3 PCCIF
	interrupts = <GIC_SPI 141 IRQ_TYPE_LEVEL_LOW>, // C2K_CCIF
			   <GIC_SPI 220 IRQ_TYPE_EDGE_FALLING>; // C2K_WDT
	cell-index = <2>;
	ccif,major = <169>;
	ccif,minor_base = <0>;
	ccif,capability = <0>;
	mediatek,md_smem_size = <0x400000>; //md share memory size
	clocks = <&scpsys SCP_SYS_MD2>;
	clock-names = "scp-sys-md2-main";
};
```

## Documentation/devicetree/bindings/ccci/eccci/mediatek,ap_ccif1.txt
```
Mediatek ap_ccif1 device
============================

The Mediatek ap_ccif1 controller is an interface to communicate with MD2.

Required Properties:

	- compatible: Should be:
		"mediatek,ap_ccif1"
	- reg: physical base address of AP CCIF base, length of AP CCIF, and MD CCIF base & Length of MD CCIF
	- interrupts: interrupt number to the cpu.
	- mediatek,md_id: configure MD id for modem_ccif driver.
	- mediatek,ccif_capability: config AP ccci driver feature.
	- mediatek,md_smem_size: AP and MD share memory size.

Optional properties:

Example:
ap_ccif1:ap_ccif1@1020B000 {
		compatible = "mediatek,ap_ccif1";
		reg = 	<0x1020B000 0x1000>, /*ap ccif1 base*/
						<0x1020C000 0x1000>; /*md ccif1 base*/
		interrupts = <0 141 0x8>, /* AP CCIF1 irq*/
		             <0 175 0x2>; /* MD2_WDT irq*/
		mediatek,md_id = <1>;
		mediatek,ccif_capability = <0>;
		mediatek,md_smem_size = <0x400000>; /* md share memory size */
};
```

## Documentation/devicetree/bindings/ccci/eccci/mediatek,mdcldma.txt
```
Mediatek mdcldma device
============================

The Mediatek mdcldma controller is an interface to communicate with MD1.

Required Properties:

	- compatible: Should be:
		"mediatek,mdcldma"
	- reg: physical base address of AP CCIF base, length of AP CCIF, and MD CCIF base & Length of MD CCIF
	- interrupts: interrupt number to the cpu.
	- mediatek,md_id: configure MD id for modem_ccif driver.
	- mediatek,cldma_capability: config AP ccci driver feature.
	- mediatek,md_smem_size: AP and MD share memory size.
	- clocks: Clock driving the hardware.
	- clock-names:  Clock driving the hardware name.
Optional properties:

Example:
mdcldma:mdcldma@1000A000 {
	compatible = "mediatek,mdcldma";
	reg = 	<0x1000A000 0x1000>, /*AP_CLDMA_AO*/
		<0x1000B000 0x1000>, /*MD_CLDMA_AO*/
		<0x1021A000 0x1000>, /*AP_CLDMA_PDN*/
		<0x1021B000 0x1000>, /*MD_CLDMA_PDN*/
		<0x1020A000 0x1000>, /*AP_CCIF_BASE*/
		<0x1020B000 0x1000>; /*MD_CCIF_BASE*/
	interrupts = <GIC_SPI 145 IRQ_TYPE_LEVEL_HIGH>, /*IRQ_CLDMA*/
		     <GIC_SPI 140 IRQ_TYPE_LEVEL_LOW>, /*IRQ_CCIF*/
		     <GIC_SPI 221 IRQ_TYPE_EDGE_FALLING>; /*IRQ_MDWDT*/
	mediatek,md_id = <0>;
	mediatek,cldma_capability = <6>;
	mediatek,md_smem_size = <0x10000>; /* md share memory size */
	clocks = <&scpsys SCP_SYS_MD1>;
	clock-names = "scp-sys-md1-main";
};
```

## Documentation/devicetree/bindings/ccci/ssw/mediatek,ssw.txt
```
Mediatek ssw device
============================

The Mediatek ssw controller is charge of switch sim mode.

Required Properties:

	- compatible: Should be:
		"mediatek,mediatek,sim_switch"

Optional properties:

Example:
ssw:simswitch@0 {
	compatible = "mediatek,sim_switch";
};

&ssw {
	pinctrl-names = "default", "hot_plug_mode1", "hot_plug_mode2", "two_sims_bound_to_md1", "sim1_md3_sim2_md1";
	pinctrl-0 = <&ssw_default>;
	pinctrl-1 = <&ssw_hot_plug_mode1>;
	pinctrl-2 = <&ssw_hot_plug_mode2>;
	pinctrl-3 = <&ssw_two_sims_bound_to_md1>;
	pinctrl-4 = <&ssw_sim1_md3_sim2_md1>;

	status = "okay";
};
```

## Documentation/devicetree/bindings/clock/clk-palmas.txt
```
* palmas clock IP block devicetree bindings

Required properties:
- compatible : Must be "ti,palmas-clk".

Optional sub-nodes:
 The Palmas clock node have the subnode to configure the Palmas'c clock.
 The subnode name should match with the name of the clocks.

 The valid clock names are: clk32k_kg and clk32k_kg_audio.

- ti,clock-boot-enable: Enable the clock on boot time.
- ti,external-sleep-control: Sleep control for the clock. The clock
	is enabled/disabled through external pins.
	The valid value for external pins are:
			ENABLE1 then 1,
			ENABLE2 then 2 or
			NSLEEP then 3.
Example:

pmic {
	compatible = "ti,twl6035-pmic", "ti,palmas-pmic";
	...
	clocks {
		compatible = "ti,palmas-clk";
		clk32k_kg {
			ti,clock-boot-enable;
			ti,external-sleep-control = <3>;
		}

		clk32k_kg_audio {
			ti,clock-boot-enable;
		};
	};
	...
};
```

## Documentation/devicetree/bindings/clock/clk-qpnp-div.txt
```
Qualcomm Technologies, Inc. QPNP clock divider (clkdiv)

clkdiv configures the clock frequency of a set of outputs on the PMIC.
These clocks are typically wired through alternate functions on
gpio pins.

=======================
Supported Properties
=======================

- compatible
	Usage:      required
	Value type: <string>
	Definition: should be "qcom,qpnp-clkdiv".

- reg
	Usage:      required
	Value type: <prop-encoded-array>
	Definition: Addresses and sizes for the memory of this CLKDIV
		    peripheral.

- qcom,cxo-freq
	Usage:      required
	Value type: <u32>
	Definition: The frequency of the crystal oscillator (CXO) clock in Hz.

- qcom,clkdiv-id
	Usage:      required
	Value type: <u32>
	Definition: Integer value specifies the hardware identifier of this
		    CLKDIV peripheral.

- qcom,clkdiv-init-freq
	Usage:      optional
	Value type: <u32>
	Definition: Initial output frequency in Hz to configure for the CLKDIV
		    peripheral. The initial frequency value should be less than
		    or equal to CXO clock frequency and greater than or equal to
		    CXO_freq/64.

=======
Example
=======

qcom,clkdiv@5b00 {
	compatible = "qcom,qpnp-clkdiv";
	reg = <0x5b00 0x100>;

	qcom,cxo-freq = <19200000>;
	qcom,clkdiv-id = <1>;
	qcom,clkdiv-init-freq = <9600000>;
};
```
