## Documentation/devicetree/bindings/clock/qcom,a7-cpucc.txt
```
Qualcomm Application A7 CPU clock driver
-------------------------------------

It is the clock controller driver which provides higher frequency
clocks and allows A7 CPU frequency scaling on sdxpoorwills based platforms.

Required properties:
- compatible : shall contain only one of the following:
		"qcom,cpu-sdxpoorwills",
- clocks : Phandle to the clock device.
- clock-names: Names of the used clocks.
- qcom,a7cc-init-rate = Initial rate which needs to be set from cpu driver.
- reg : shall contain base register offset and size.
- reg-names : Names of the bases for the above registers.
- vdd_dig_ao-supply : The regulator powering the APSS PLL.
- cpu-vdd-supply : The regulator powering the APSS RCG.
- qcom,rcg-reg-offset : Register offset for APSS RCG.
- qcom,speedX-bin-vZ :	A table of CPU frequency (Hz) to regulator voltage (uV) mapping.
			Format: <freq uV>
			This represents the max frequency possible for each possible
			power configuration for a CPU that's binned as speed bin X,
			speed bin revision Z. Speed bin values can be between [0-7]
			and the version can be between [0-3].
- #clock-cells : shall contain 1.

Optional properties :
- reg-names: "efuse",

Example:
	clock_cpu: qcom,clock-a7@17808100 {
		compatible = "qcom,cpu-sdxpoorwills";
		clocks = <&clock_rpmh RPMH_CXO_CLK_A>;
		clock-names = "xo_ao";
		qcom,a7cc-init-rate = <1497600000>;
		reg = <0x17808100 0x7F10>;
		reg-names = "apcs_pll";

		vdd_dig_ao-supply = <&pmxpoorwills_s5_level_ao>;
		cpu-vdd-supply = <&pmxpoorwills_s5_level_ao>;
		qcom,rcg-reg-offset = <0x7F08>;
		qcom,speed0-bin-v0 =
			<          0 RPMH_REGULATOR_LEVEL_OFF>,
			<  345600000 RPMH_REGULATOR_LEVEL_LOW_SVS>,
			<  576000000 RPMH_REGULATOR_LEVEL_SVS>,
			< 1094400000 RPMH_REGULATOR_LEVEL_NOM>,
			< 1497600000 RPMH_REGULATOR_LEVEL_TURBO>;
		#clock-cells = <1>;
	};
```

## Documentation/devicetree/bindings/clock/qcom,aop-qmp.txt
```
Qualcomm Technologies, Inc. Always On Processor Clock controller Binding
------------------------------------------------------------------------

Required properties :
- compatible : must be "qcom,aop-qmp-clk"
- #clock-cells : must contain 1
- mboxes : list of QMP mailbox phandle and channel identifier tuples.
- mbox-names: List of identifier strings for each mailbox channel.
		Must contain "qdss_clk".
- qcom,clk-stop-bimc-log: Presence indicates a BIMC logging request will
			  be sent to AOP during kernel panic.

Example :
	clock_qdss: qcom,aopclk {
		compatible = "qcom,aop-qmp-clk";
		#clock-cells = <1>;
		mboxes = <&qmp_aop 0>;
		mbox-names = "qdss_clk";
	};
```

## Documentation/devicetree/bindings/clock/qcom,camcc.txt
```
Qualcomm Technologies, Inc. Camera Clock & Reset Controller Binding
-------------------------------------------------------------------

Required properties :
- compatible : must contain one of the following:
		"qcom,camcc-sm8150",
		"qcom,camcc-sm8150-v2",
		"qcom,camcc-sa8155",
		"qcom,camcc-sa8155-v2",
		"qcom,camcc-sdmshrike",
		"qcom,camcc-sm6150",
		"qcom,camcc-sdmmagpie",
		"qcom,camcc-sa6155",
		"qcom,atoll-camcc".
- reg : shall contain base register location and length.
- reg-names: names of registers listed in the same order as in
	     the reg property.
- clock-names: Shall contain "cfg_ahb_clk"
- clocks: phandle + clock reference to the GCC AHB clock.
- vdd_<rail>-supply: The logic rail supply.
- #clock-cells : shall contain 1.

Example:
	clock_camcc: qcom,camcc {
		compatible = "qcom,camcc-sm8150";
		reg = <0xad00000 0x10000>;
		reg-names = "cc_base";
		vdd_mx-supply = <&pm8150l_s4_level>;
		vdd_mm-supply = <&pm8150l_s5_level>;
		clock-names = "cfg_ahb_clk";
		clocks = <&clock_gcc GCC_CAMERA_AHB_CLK>;
		#clock-cells = <1>;
	};
```

## Documentation/devicetree/bindings/clock/qcom,cmn-blk-pll.txt
```
Qualcomm Technologies, Inc. Common Block PLL Controller Binding
---------------------------------------------------------------

Required properties :
- compatible : shall contain only the following:
			"qcom,cmn_blk_pll"

- reg : shall contain base register location and size.
- reg-names : "cmn_blk".
- clock-names : Shall contain "misc_reset", "ahb_clk", "aon_clk".
- clocks : phandle + clock reference to misc_reset, ahb and aon clock.
- #clock-cells : shall contain 1.

Example :
	clock_cmn_blk_pll@2f780 {
		compatible = "qcom,cmn_blk_pll";
		reg = <0x2f780 0x4>;
		reg-names = "cmn_blk";
		clocks = <&clock_gcc GCC_BIAS_PLL_MISC_RESET_CLK>,
			<&clock_gcc GCC_BIAS_PLL_AHB_CLK>,
			<&clock_gcc GCC_BIAS_PLL_AON_CLK>;
		clock-names = "misc_reset_clk", "ahb_clk", "aon_clk";
		resets = <&clock_gcc GCC_BIAS_PLL_BCR>;
		reset-names = "cmn_blk_pll_reset";
		#clock-cells = <1>;
	};
```

## Documentation/devicetree/bindings/clock/qcom,debugcc.txt
```
Qualcomm Technologies, Inc. Debug Clock Controller Binding
----------------------------------------------------------

Required properties :
- compatible: Shall contain "qcom,kona-debugcc", "qcom,lito-debugcc",
		"qcom,bengal-debugcc", "qcom,lagoon-debugcc"
		or "qcom,sdm660-debugcc".
- qcom,gcc: phandle to the GCC device node.
- qcom,videocc: phandle to the Video CC device node.
- qcom,camcc: phandle to the Camera CC device node.
- qcom,dispcc: phandle to the Display CC device node.
- qcom,npucc: phandle to the NPU CC device node.
- clock-names: Shall contain "xo_clk_src"
- clocks: phandle + clock reference to the CXO clock.
- #clock-cells : Shall contain 1.

Example:
	clock_debug: qcom,cc-debug {
		compatible = "qcom,kona-debugcc";
		qcom,gcc = <&clock_gcc>;
		qcom,videocc = <&clock_videocc>;
		qcom,camcc = <&clock_camcc>;
		qcom,dispcc = <&clock_dispcc>;
		qcom,npucc = <&clock_npucc>;
		clock-names = "xo_clk_src";
		clocks = <&clock_rpmh RPMH_CXO_CLK>;
		#clock-cells = <1>;
	};
```

## Documentation/devicetree/bindings/clock/qcom,dispcc.txt
```
Qualcomm Technologies, Inc. Display Clock & Reset Controller Binding
--------------------------------------------------------------------

Required properties :
- compatible : Shall contain one of the following:
		"qcom,dispcc-sm8150",
		"qcom,dispcc-sm8150-v2",
		"qcom,dispcc-sm6150",
		"qcom,dispcc-sdmmagpie",
		"qcom,dispcc-trinket",
		"qcom,dispcc-sdmshrike-v2",
		"qcom,dispcc-sa6155",
		"qcom,atoll-dispcc".
- reg : Shall contain base register location and length.
- reg-names: Address name. Must be "cc_base".
- vdd_mm-supply: phandle to the MM_CX rail that needs to be voted on behalf
		 of the clocks.
- clock-names: Shall contain "cfg_ahb_clk"
- clocks: phandle + clock reference to the GCC AHB clock.
- #clock-cells : Shall contain 1.
- #reset-cells : Shall contain 1.

Example:
	clock_dispcc: qcom,dispcc {
		compatible = "qcom,dispcc-sm8150";
		reg = <0xaf00000 0x20000>;
		reg-names = "cc_base";
		vdd_mm-supply = <&pm8150l_s5_level>;
		clock-names = "cfg_ahb_clk";
		clocks = <&clock_gcc GCC_DISP_AHB_CLK>;
		#clock-cells = <1>;
		#reset-cells = <1>;
	};
```
