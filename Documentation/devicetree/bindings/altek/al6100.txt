## Documentation/devicetree/bindings/arm/mediatek/mediatek,dpe.txt
```
Mediatek imgsys controller
============================

The Mediatek imgsys controller provides various clocks to the system.

Required Properties:

- compatible: Should be one of:
	- "mediatek,mt2701-imgsys", "syscon"
	- "mediatek,mt6797-imgsys", "syscon"
	- "mediatek,mt8173-imgsys", "syscon"
- #clock-cells: Must be 1

The imgsys controller uses the common clk binding from
Documentation/devicetree/bindings/clock/clock-bindings.txt
The available clocks are defined in dt-bindings/clock/mt*-clk.h.

Example:

dpe@15028000 {
	compatible = "mediatek,dpe";
	reg = <0 0x15028000 0 0x1000>;
	interrupts = <GIC_SPI 271 IRQ_TYPE_LEVEL_LOW>;
	clocks = <&imgsys CLK_IMG_DPE>;
	clock-names = "DPE_CG_IMG_DPE";
};
```

## Documentation/devicetree/bindings/arm/mediatek/mediatek,gce.txt
```
MediaTek GCE
===============

The Global Command Engine (GCE) is used to help read/write registers with
critical time limitation, such as updating display configuration during the
vblank. The GCE can be used to implement the Command Queue (CMDQ) driver.

Required properties:
- compatible: Must be "mediatek,gce"
- reg: Address range of the GCE unit
- interrupts: The interrupt signal from the GCE block
- clock: Clocks according to the common clock binding
- clock-names: Must be "GCE" to stand for GCE clock

Example:

	gce: gce@10212000 {
		compatible = "mediatek,gce";
		reg = <0 0x10212000 0 0x1000>;
		interrupts = <GIC_SPI 135 IRQ_TYPE_LEVEL_LOW>;
		clocks = <&infracfg_ao INFRACFG_AO_GCE_CG>;
		clock-names = "GCE";
	};
```

## Documentation/devicetree/bindings/arm/mediatek/mediatek,idle-state.txt
```
MediaTek Idle States for cpuidle driver

ARM provides idle-state node to define the cpuidle states, as defined in [1].
cpuidle-mediatek is the cpuidle driver for MediaTek SoCs and uses these idle
states. Idle states have different enter/exit latency and residency values.

A cpu can power down and warmboot if there is a sufficient time between the
time it enters idle and the next known wake up. MediaTek idle-state is used
to indicate a core entering a power down state without consulting any other
cpu or the system resources. A core distinguishes itself in that the cpu
acknowledges and permits the SoC to enter deeper sleep modes. The MediaTek
Soc support suspend to idle state. This idle state will work efficiency when
platform will enter suspend. Supend to idle will have the same conservation
with system suspend in MediaTek SoC solution.


The idle-state for MediaTek SoCs are distinguished by the compatible property
of the idle-states device node.

The devicetree representation of the idle state should be -
Required properties:

- compatible: Must be one of -
	      "mediatek,idle-state",

Other required and optional properties are specified in [1].

Example:
	idle-states {
		entry-method = "arm,psci";

		cpuoff: cpuoff {
			compatible = "mediatek,idle-state";
			arm,psci-suspend-param = <0x00010001>;
			local-timer-stop;
			entry-latency-us = <50>;
			exit-latency-us = <100>;
			min-residency-us = <1400>;
		};

		clusteroff: clusteroff {
			compatible = "mediatek,idle-state";
			arm,psci-suspend-param = <0x01010001>;
			local-timer-stop;
			entry-latency-us = <50>;
			exit-latency-us = <100>;
			min-residency-us = <1400>;
		};

		mcusys: mcusys {
			compatible = "mediatek,idle-state";
			arm,psci-suspend-param = <0x01010002>;
			local-timer-stop;
			entry-latency-us = <150>;
			exit-latency-us = <200>;
			min-residency-us = <2000>;
		};

		s2idle: s2idle {
			compatible = "mediatek,idle-state";
			arm,psci-suspend-param = <0x01010100>;
			local-timer-stop;
			entry-latency-us = <0xffffffff>;
			exit-latency-us = <0xffffffff>;
			min-residency-us = <0xffffffff>;
		};
	};

[1]. Documentation/devicetree/bindings/arm/idle-states.txt
```

## Documentation/devicetree/bindings/arm/mediatek/mediatek,mailbox-gce-svp.txt
```
MediaTek GCE Secure Video Path Support Driver
===============

The Global Command Engine (GCE) is used to help read/write registers with
critical time limitation, such as updating display configuration during the
vblank. The GCE can be used to implement the Command Queue (CMDQ) driver.
Secure Video Path driver can protect premium video content leakage

Required properties:
- compatible: Must be "mediatek,mailbox-gce-svp"
- reg: Address range of the GCE unit
- interrupts: The interrupt signal from the GCE block
- clock: Clocks according to the common clock binding
- clock-names: Must be "gce" to stand for GCE clock

Example:

	gce_mbox_svp: gce_mbox_svp@10238000 {
		compatible = "mediatek,mailbox-gce-svp";
		reg = <0 0x10238000 0 0x1000>;
		interrupts = <GIC_SPI 154 IRQ_TYPE_LEVEL_LOW>;
		clocks = <&infracfg_ao INFRACFG_AO_GCE_CG>;
		clock-names = "gce";
	};
```

## Documentation/devicetree/bindings/arm/mediatek/mediatek,mailbox-gce.txt
```
MediaTek GCE
===============

The Global Command Engine (GCE) is used to help read/write registers with
critical time limitation, such as updating display configuration during the
vblank. The GCE can be used to implement the Command Queue (CMDQ) driver.

Required properties:
- compatible: Must be "mediatek,mailbox-gce"
- reg: Address range of the GCE unit
- interrupts: The interrupt signal from the GCE block
- clock: Clocks according to the common clock binding
- clock-names: Must be "gce" to stand for GCE clock

Example:

	gce_mbox: gce_mbox@10238000 {
		compatible = "mediatek,mailbox-gce";
		reg = <0 0x10238000 0 0x1000>;
		interrupts = <GIC_SPI 154 IRQ_TYPE_LEVEL_LOW>;
		clocks = <&infracfg_ao INFRACFG_AO_GCE_CG>;
		clock-names = "gce";
	};
```

## Documentation/devicetree/bindings/arm/msm/acc.txt
```
Application Processor Sub-system (APSS) Application Clock Controller (ACC)

The ACC provides clock, power domain, and reset control to a CPU. There is one ACC
register region per CPU within the APSS remapped region as well as an alias register
region that remaps accesses to the ACC associated with the CPU accessing the region.

Required properties:
- compatible:		Must be "qcom,arm-cortex-acc"
- reg:			The first element specifies the base address and size of
			the register region. An optional second element specifies
			the base address and size of the alias register region.

Example:

	clock-controller@b088000 {
		compatible = "qcom,arm-cortex-acc";
		reg = <0x0b088000 0x1000>,
		      <0x0b008000 0x1000>;
	}
```

## Documentation/devicetree/bindings/arm/msm/acpuclock/acpuclock-9625.txt
```
* Qualcomm Application CPU clock driver

acpuclock-9625 is the application cpu clock driver for MDM9625. It is used for
cpu frequency scaling, voltage scaling and bus bandwidth scaling.

Required properties:
- compatible: "qcom,acpuclk-9625"
- reg: offset and length of the register sets for the acpuclock controller
- reg-names: name of the bases for the above registers. "rcg_base", "pwr_base"
	     are expected.
- a5_cpu-supply: regulator to supply a5 cpu
- a5_mem-supply: regulator to supply a5 l2 cache

Example:
        qcom,acpuclk@f9010000 {
                compatible = "qcom,acpuclk-9625";
                reg = <0xf9010008 0x10>,
                      <0xf9008004 0x4>;
                reg-names = "rcg_base", "pwr_base";
                a5_cpu-supply = <&pm8019_l10_corner_ao>;
                a5_mem-supply = <&pm8019_l12_ao>;
        };
```

## Documentation/devicetree/bindings/arm/msm/acpuclock/acpuclock-a7.txt
```
* Qualcomm Application CPU clock device

acpuclock-a7 selects the clock source used by the cpus and l2 cache. It
can be configured to divide the clock source by any value in [1, 16] in
half-integer increments.

Required properties:
- compatible: "qcom,acpuclk-a7"
- reg: offset and length of the register sets for the acpuclock controller
- reg-names: name of the bases for the above registers. "rcg_base"
	     is expected.
- a7_cpu-supply: regulator to supply a7 cpu

Example:
	qcom,acpuclk@f9011050 {
		compatible = "qcom,acpuclk-a7";
		reg = <0xf9011050 0x8>;
		reg-names = "rcg_base";
		a7_cpu-supply = <&pm8026_s2>;
	};
```

## Documentation/devicetree/bindings/arm/msm/acpuclock/clock-a7.txt
```
* Qualcomm Application CPU clock driver

clock-a7 is the driver for the Root Clock Generator (rcg) hw which controls
the cpu rate. RCGs support selecting one of several clock inputs, as well as
a configurable divider. This hw is different than normal rcgs in that it may
optionally have a register which encodes the maximum rate supported by hw.

Required properties:
- compatible: "qcom,clock-a7-8226", "qcom,clock-a7-9630",
		"qcom,clock-a53-8916", "qcom,clock-a7-vpipa",
		"qcom,clock-a7-9640", "qcom,clock-a7-californium"
		"qcom,clock-a7-9640", "qcom,clock-a7-mdm9607"
- reg: pairs of physical address and region size
- reg-names: "rcg-base" is expected
- clock-names: list of names of clock inputs
- qcom,speedX-bin-vZ:
		A table of CPU frequency (Hz) to regulator voltage (uV) mapping.
		Format: <freq uV>
		This represents the max frequency possible for each possible
		power configuration for a CPU that's binned as speed bin X,
		speed bin revision Z. Speed bin values can be between [0-7]
		and the version can be between [0-3].

- cpu-vdd-supply: regulator phandle for cpu power domain.

Optional properties:
- reg-names: "efuse", "efuse1"
- qcom,safe-freq: Frequency in HZ
	     When switching rates from A to B, the mux div clock will
             instead switch from A -> safe_freq -> B.
- qcom,enable-opp: This will allow to register the cpu clock with OPP
	     framework.

Example:
	qcom,acpuclk@f9011050 {
                compatible = "qcom,clock-a7-8226";
                reg = <0xf9011050 0x8>;
                reg-names = "rcg_base";
                cpu-vdd-supply = <&apc_vreg_corner>;

                clock-names = "clk-4", "clk-5";
		qcom,speed0-bin-v0 =
			<384000000 1150000>,
			<600000000 1200000>;
        };
```

## Documentation/devicetree/bindings/arm/msm/adv7481.txt
```
ADV7481 chip driver (VIDEO_ADV7481)

VIDEO_ADV7481 is a kernel platform driver that is used for video decoder
and dual mode HDMI/MHL receiver.

The devicetree representation of the VIDEO_ADV7481 block should be:

Required properties

- compatible: "qcom,adv7481"
- reg: The i2c slave address of adv7481 device.
- qcom,cci-master: The i2c master id to be used for adv7481 driver.
- gpios: The GPIOs required to be configured for the driver. It should
	be in the order I2C data line, i2c clock line, reset line,
	interrupt 1, interrupt 2 and interrupt 3.
- cam_vdig-supply: Should contain regulator to be used for the digital
	vdd.
- cam_vio-supply: Should contain regulator to be used for the IO vdd.
- cam_vana-supply: Should contain regulator from which analog voltage
	is supplied.
- qcom,cam-vreg-name: Should specify array of regulator names required
	for the device.
- qcom,cam-vreg-min-voltage: Should specify array of minimum voltage
	level in uV for the regulators specified in the property
	"qcom,cam-vreg-name".
- qcom,cam-vreg-max-voltage: Should specify array of maximum voltage
	level in uV for the regulators specified in the property
	"qcom,cam-vreg-name".
- qcom,cam-vreg-op-mode: Should specify array of current level in uA
	for the regulators specified in the property "qcom,cam-vreg-name".

Example:

	qcom,adv7481@70 {
		compatible = "qcom,adv7481";
		reg = <0x70 0xff>;
		cam_vdig-supply = <&vph_pwr_vreg>;
		/* Cameras powered by PMIC: */
		cam_vio-supply = <&pm8994_lvs1>;
		cam_vana-supply = <&pm8994_l17>;
		/* Self-powered cameras: */
		qcom,cam-vreg-name = "cam_vdig", "cam_vio", "cam_vana";
		qcom,cam-vreg-min-voltage = <1300000 0 2500000>;
		qcom,cam-vreg-max-voltage = <1300000 0 2500000>;
		qcom,cam-vreg-op-mode = <105000 0 80000>;
		qcom,cci-master = <0>;
		qcom,slave-addr = <0x70>;
		gpios = <&tlmm 17 0>,          /* I2C SDA */
			<&tlmm 18 0>,          /* I2C SCL */
			<&pm8994_gpios 4 0>,   /* RST     */
			<&pm8994_gpios 5 0>,   /* INT1    */
			<&pm8994_gpios 6 0>,   /* INT2    */
			<&pm8994_gpios 7 0>;   /* INT3    */
	};
```

## Documentation/devicetree/bindings/arm/msm/android.txt
```
Android firmware

Node to specify early mount of vendor and system partition.

Required properties

-compatible: "android,firmware"

Child nodes:
------------

fstab:
------------------------------

fstab entry to specify mount attributes of vendor partition.

Required properties:

-compatible: "android,fstab"

Child nodes:
------------

vendor:
-----------------

vendor partition specification.

Required properties:

-compatible: "android, vendor"
-dev: block device corresponding to vendor partition
-type: file system type of vendor partition
-mnt_flags: mount flags
-fsmgr_flags: fsmgr flags

Example:

	firmware: firmware {
		android {
			compatible = "android,firmware";
			fstab {
				compatible = "android,fstab";
				vendor {
					compatible = "android,vendor";
					dev = "/dev/block/platform/soc/1da4000.ufshc/by-name/vendor";
					type = "ext4";
					mnt_flags = "ro,barrier=1,discard";
					fsmgr_flags = "wait,slotselect";
					status = "ok";
				};
			};
		};
	};

odm:
-----------------

odm partition specification.

Required properties:

-compatible: "android, odm"
-dev: block device corresponding to odm partition
-type: file system type of odm partition
-mnt_flags: mount flags
-fsmgr_flags: fsmgr flags

Example:

       firmware: firmware {
               android {
                       compatible = "android,firmware";
                       fstab {
                               compatible = "android,fstab";
                               odm {
                                       compatible = "android,odm";
                                       dev = "/dev/block/platform/soc/1da4000.ufshc/by-name/odm";
                                       type = "ext4";
                                       mnt_flags = "ro,barrier=1,discard";
                                       fsmgr_flags = "wait,slotselect";
                                       status = "ok";
                               };
                       };
               };
       };

system:
-----------------

system partition specification.

Required properties:

-compatible: "android,system"
-dev: block device corresponding to system partition
-type: file system type of system partition
-mnt_flags: mount flags
-fsmgr_flags: fsmgr flags

Example:

        firmware: firmware {
                android {
                        compatible = "android,firmware";
                        fstab {
                                compatible = "android,fstab";
                                system {
                                        compatible = "android,system";
                                        dev = "/dev/block/platform/soc/1da4000.ufshc/by-name/system";
                                        type = "ext4";
                                        mnt_flags = "ro,barrier=1,discard";
                                        fsmgr_flags = "wait,slotselect";
                                        status = "ok";
                                };
                        };
                };
        };
```
