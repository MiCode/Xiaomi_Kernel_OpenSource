## Documentation/devicetree/bindings/arm/msm/clock-controller.txt
```
Qualcomm Technologies, Inc. MSM Clock controller

Qualcomm Technologies, Inc. MSM Clock controller devices contain PLLs, root clock
generators and other clocking hardware blocks that provide stable, low power
clocking to hardware blocks on Qualcomm Technologies SOCs. The clock controller
device node lists the power supplies needed to be scaled using the vdd_*-supply
property.

Minor differences between hardware revisions are handled in code by re-using
the compatible string to indicate the revision.

Required properties:
- compatible:           Must be one of following,
			"qcom,gcc-8953"
			"qcom,gcc-8909"
			"qcom,gcc-sdm632"
			"qcom,cc-debug-8953"
			"qcom,cc-debug-8909"
			"qcom,cc-debug-sdm632"
			"qcom,gcc-mdss-8953"
			"qcom,gcc-mdss-sdm632"
                        "qcom,gcc-gfx-8953"
                        "qcom,gcc-gfx-sdm450"
                        "qcom,gcc-gfx-sdm632"
			"qcom,gcc-8992"
			"qcom,gcc-8952"
			"qcom,gcc-8937"
			"qcom,gcc-sdm439"
			"qcom,gcc-sdm429"
			"qcom,gcc-8917"
			"qcom,gcc-8940"
			"qcom,gcc-8920"
			"qcom,gcc-spm-8952"
			"qcom,gcc-spm-8937"
			"qcom,rpmcc-8909"
			"qcom,rpmcc-8909-pm660"
			"qcom,cc-debug-8952"
			"qcom,cc-debug-8953"
			"qcom,cc-debug-8937"
			"qcom,cc-debug-8917"
			"qcom,cc-debug-8940"
			"qcom,cc-debug-8920"
			"qcom,gcc-mdss-8953"
			"qcom,gcc-mdss-8952"
			"qcom,gcc-mdss-8909"
			"qcom,gcc-mdss-8937"
			"qcom,gcc-mdss-8917"
			"qcom,gcc-mdss-8940"
			"qcom,gcc-mdss-8920"
			"qcom,gcc-mdss-sdm429"
			"qcom,gcc-mdss-sdm439"
			"qcom,gcc-gfx-8953"
			"qcom,gcc-gfx-sdm450"
			"qcom,gcc-mdm9607"
			"qcom,cc-debug-mdm9607"
			"qcom,gcc-9650"
			"qcom,cc-debug-9650"
			"qcom,gcc-sdx20"

- reg:                  Pairs of physical base addresses and region sizes of
                        memory mapped registers.
- reg-names:            Names of the bases for the above registers. Currently,
                        there is one expected base: "cc_base". Optional
                        reg-names are "apcs_base", "meas", "mmss_base",
                        "lpass_base", "apcs_c0_base", "apcs_c1_base",
                        "apcs_cci_base", "efuse".

Optional properties:
- vdd_dig-supply:       The digital logic rail supply.
- <pll>_dig-supply:     Some PLLs might have separate digital supply on some
                        targets. These properties will be provided on those
                        targets for specific PLLs.
- <pll>_analog-supply:  Some PLLs might have separate analog supply on some
                        targets. These properties will be provided on those
                        targets for specific PLLs.
- vdd_gpu_mx-supply:    MX rail supply for the GPU core.
- #clock_cells:         If this device will also be providing controllable
                        clocks, the clock_cells property needs to be specified.
                        This will allow the common clock device tree framework
                        to recognize _this_ device node as a clock provider.
- qcom,<clk>-corner-<vers>: List of frequency voltage pairs that the clock can
                            operate at. Drivers can use the OPP library API to
                            operate on the list of OPPs registered using these
                            values.
- qcom,<clk>-speedbinX: A table of frequency (Hz) to voltage (corner) mapping
                        that represents the max frequency possible for each
                        supported voltage level for the clock.
                        'X' is the speed bin into which the device falls into -
                        a bin will have unique frequency-voltage relationships.
                        The value 'X' is read from efuse registers, and the right
                        table is picked from multiple possible tables.
- qcom,<clock-name>-opp-handle: phandle references to the devices for which OPP
                        table is filled with the clock frequency and voltage
                        values.
- qcom,<clock-name>-opp-store-vcorner: phandle references to the devices for
                        which OPP table is filled with the clock frequency
                         and voltage corner/level.

Example:
        clock_gcc: qcom,gcc@fc400000 {
                compatible = "qcom,gcc-8974";
                reg = <0xfc400000 0x4000>;
                reg-names = "cc_base";
                vdd_dig-supply = <&pm8841_s2_corner>;
                #clock-cells = <1>;
        };
```

## Documentation/devicetree/bindings/arm/msm/clock-cpu-8939.txt
```
Qualcomm Technology Inc MSM8939 CPU clock tree

clock-cpu-8939 is a device that represents the MSM8939 or MSM8952 CPU
subsystem clock tree. It lists the various power supplies that need to be
scaled when the clocks are scaled and also other HW specific parameters like
fmax tables, avs settings table, etc.

Required properties:
- compatible:		Must be one of "qcom,clock-cpu-8939" or
			"qcom,cpu-clock-8952", "qcom,cpu-clock-gold".
- reg:			Pairs of physical base addresses and region sizes of
			memory mapped registers.
- reg-names:		Names of the bases for the above registers. Expected
			bases are:
			"apcs-c0-rcg-base", "apcs-c1-rcg-base",
			"apcs-cci-rcg-base", "efuse", "efuse1", "efuse2"
- vdd-c0-supply:	The regulator powering the little cluster
- vdd-c1-supply:	The regulator powering the big cluster
- vdd-cci-supply:	The regulator powering the CCI cluster
- qcom,speedX-bin-vY-ZZZ:
			A table of CPU frequency (Hz) to voltage (corner)
			mapping that represents the max frequency possible
			for each supported voltage level for a CPU. 'X' is
			the speed bin into which the device falls into - a
			bin will have unique frequency-voltage relationships.
			'Y' is the characterization version, implying that
			characterization (deciding what speed bin a device
			falls into) methods and/or encoding may change. The
			values 'X' and 'Y' are read from efuse registers, and
			the right table is picked from multiple possible tables.
			'ZZZ' can be c1, c0 or cci depending on whether the table
			is for the big cluster, little cluster or cci.
Optional properties:
- qcom,cpu-pcnoc-vote:  Boolean to indicate cpu clocks would need to keep
			active pcnoc vote.
- qcom,num-cluster:     Boolean to indicate cpu clock code is used for single
			cluster.
Example:
	clock_cpu: qcom,cpu-clock-8939@f9015000 {
		compatible = "qcom,cpu-clock-8939";
		reg = <0xf9015000 0x1000>,
		      <0xf9016000 0x1000>,
		      <0xf9011000 0x1000>,
		      <0xf900d000 0x1000>,
		      <0xf900f000 0x1000>,
		      <0xf9112000 0x1000>;
		reg-names = "apcs-c0-rcg-base", "apcs-c1-rcg-base",
			     "apcs-cci-rcg-base", "efuse", "efuse1",
				"efuse2";
                vdd-c0-supply = <&apc_vreg_corner>;
		vdd-c1-supply = <&apc_vreg_corner>;
		vdd-cci-supply = <&apc_vreg_corner>;
		qcom,speed0-bin-v0-c0 =
			<         0 0>,
			< 384000000 1>,
			< 787200000 2>,
			<1286400000 3>;
		qcom,speed0-bin-v0-c1 =
			<         0 0>,
			< 384000000 1>,
			< 787200000 2>,
			<1785600000 3>;
		qcom,speed0-bin-v0-cci =
			<         0 0>,
			< 150000000 1>,
			< 300000000 2>,
			< 600000000 3>;
		clocks = <&clock_gcc clk_gpll0_ao>,
			<&clock_gcc clk_a53ss_c0_pll>,
			<&clock_gcc clk_gpll0_ao>,
			<&clock_gcc clk_a53ss_c1_pll>,
			<&clock_gcc clk_gpll0_ao>,
			<&clock_gcc clk_a53ss_cci_pll>;
			clock-names = "clk-c0-4", "clk-c0-5",
			"clk-c1-4", "clk-c1-5",
			"clk-cci-4", "clk-cci-5";
		#clock-cells = <1>;
};
```

## Documentation/devicetree/bindings/arm/msm/clock-cpu-8976.txt
```
Qualcomm MSM8976 CPU clock tree

clock-cpu-8976 is a device that represents the MSM8976 CPU subystem clock
tree. It lists the various power supplies that need to be scaled when the
clocks are scaled and also other HW specific parameters like fmax tables etc.

The root clock generator could have the ramp controller in built.
Ramp control will allow programming the sequence ID for pulse swallowing,
enable sequence and for linking sequence IDs.

Required properties:
- compatible:		Must be one of "qcom,clock-cpu-8976" and in case it
			support SPM event  "qcom,cpu-spm-8976" needs to be
			defined.

- reg:			Pairs of physical base addresses and region sizes of
			memory mapped registers.
- reg-names:		Names of the bases for the above registers. Expected
			bases are:
			"c0-pll", "c1-pll", "c0-mux", "c1-mux", "cci-mux",
			"efuse","rcgwr-c0-base(optional)",
			"rcgwr-c1-base(optional)".
- clocks:		The clocks sources used by the cluster/cci mux.
- clock-names:		Name of the clocks for the above clocks.
- vdd_mx-supply:	The regulator powering all the PLLs of cluster-0,
			cluster-1, cci.
- vdd_a72-supply:	The regulator powering the big cluster
- vdd_a53-supply:	The regulator powering the little cluster
- vdd_cci-supply:	The regulator powering the CCI cluster
- qcom,speedX-bin-vY-ZZZ:
			A table of CPU frequency (Hz) to voltage (corner)
			mapping that represents the max frequency possible
			for each supported voltage level for a CPU. 'X' is
			the speed bin into which the device falls into - a
			bin will have unique frequency-voltage relationships.
			'Y' is the characterization version, implying that
			characterization (deciding what speed bin a device
			falls into) methods and/or encoding may change. The
			values 'X' and 'Y' are read from efuse registers, and
			the right table is picked from multiple possible tables.
			'ZZZ' can be c1, c0 or cci depending on whether the table
			is for the big cluster, little cluster or cci.
Optional Properties:

- qcom,num-clusters:	Number of clusters which support RCGwR.
- qcom,lmh-sid-cX:	List of LMH SID offset and value to be programmed for
			each cluster (X: 0 or 1)
- qcom,link-sid-cX:	List of Link SID offset and value to be programmed for
			each cluster (X: 0 or 1)
- qcom,dfs-sid-cX:	List of DFS SID offset and value to be programmed for
			each cluster (X: 0 or 1)
- qcom,ramp-dis-cX:	Boolean property to disable ramp down for each cluster
			(X: 0 or 1)

Example:
        clock_cpu: qcom,cpu-clock-8976@b016000 {
                compatible = "qcom,cpu-clock-8976";
		qcom,num-clusters = <2>;
		qcom,lmh-sid-c0  = < 0x30 0x077706db>,
				   < 0x34 0x05550249>,
				   < 0x38 0x00000111>;
		qcom,lmh-sid-c1  = < 0x30 0x077706db>,
				   < 0x34 0x05550249>,
				   < 0x38 0x00000111>;
                reg = <0xb114000 0x68>,
		      <0xb014000 0x68>,
		      <0xb116000 0x40>,
                      <0xb016000 0x40>,
                      <0xb1d0000 0x40>,
                      <0xb111050 0x08>,
                      <0xb011050 0x08>,
                      <0Xb1d1050 0x08>;
                reg-names = "rcgwr-c0-base", "rcgwr-c1-base",
				"c0-pll", "c1-pll", "cci-pll",
                            "c0-mux", "c1-mux", "cci-mux";
                vdd_mx-supply = <phandle for MX>;*/
                vdd_a72-supply = <&apc_vreg_corner>;
                vdd_a53-supply = <&apc_vreg_corner>;
                vdd_cci-supply = <&apc_vreg_corner>;
                clocks = <&clock_gcc clk_xo_a_clk_src>,
                         <&clock_gcc clk_gpll4_clk_src>,
                         <&clock_gcc clk_gpll0_ao_clk_src>;
                clock-names = "xo_a", "aux_clk_2", "aux_clk_3";
                qcom,speed0-bin-v0-c0 =
                        <          0 0>,
                        < 1478400000 3>;
                qcom,speed0-bin-v0-c1 =
                        <          0 0>,
                        < 1843200000 3>;
                qcom,speed0-bin-v0-cci =
                        <          0 0>,
                        <  614400000 3>;
                #clock-cells = <1>;
};
```
