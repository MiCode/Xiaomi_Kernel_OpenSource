## Documentation/devicetree/bindings/altek/al6100.txt
```
Altek al6100 depth chip driver(spi/I2c)

Description:

The al6100 is a mini isp chip which is to process
the dual IR raw images from IR camera sensor to be
depth data. It has own firmware. It can connect to
two IR camera sensors via internal mipi port(Rx0/Rx1).
The input of this chip is the IR raw image from
the two IR camera sensors. The Tx0/Tx1 on chip can
connect to AP side and output depth data and IR images
to AP.

Required properties:
 - compatible: Should be "altek,isp"(with spi)/
   "altek,i2c_slave"(with i2c)/"altek,i2c_top"(with i2c)
   for al6100 depth chip driver
 - irq-gpios: a gpio for spi/I2c interrupt

Optional properties:
 - vcc1-gpios: If present, specifies a gpio for power on
   al6100 depth chip
 - wp-gpios: If present, specifies a gpio for control
   eeprom write protected pin
 - reset-gpios: If present, specifies a gpio for reset
   al6100 depth chip

Example:
	(spi)
	&spi_8 {
		mini_isp@0 {
			compatible = "altek,isp";
			reg = <0>;
			spi-max-frequency = <50000000>;
			spi-cpol;
			spi-cpha;
			vcc-supply = <&pm8953_s3>;
			reset-gpios = <&tlmm 33 0x00>;
			irq-gpios = <&tlmm 35 0x00>;
			vcc1-gpios = <&tlmm 38 0x00>;
			wp-gpios = <&tlmm 52 0x00>;
			vcc2-gpios = <&tlmm 63 0x00>;
			status = "ok";
		};
	};

	(I2c)
	i2c_slave@11 {
		compatible = "altek,i2c_slave";
		reg = <0x4b>;	/* for Pure Bypass */
		reg = <0x11>;
		status = "disabled";	/* use SPI instead */
	};

	i2c_top@77 {
		compatible = "altek,i2c_top";
		reg = <0x77>;
		vcc-supply = <&pm8953_s3>;
		reset-gpios = <&tlmm 33 0x00>;
		irq-gpios = <&tlmm 35 0x00>;
		vcc1-gpios = <&tlmm 38 0x00>;
		wp-gpios = <&tlmm 52 0x00>;
		vcc2-gpios = <&tlmm 63 0x00>;
		status = "disabled";	/* use SPI instead */
	};
```

## Documentation/devicetree/bindings/arm/arch_timer.txt
```
* ARM architected timer

ARM Cortex-A7 and Cortex-A15 have a per-core architected timer, which
provides a per-cpu local timer.

The timer is attached to a GIC to deliver its two per-processor
interrupts (one for the secure mode, one for the non-secure mode).

** Timer node properties:

- compatible : Should be "arm,armv7-timer"

- interrupts : Interrupt list for secure, non-secure, virtual and
  hypervisor timers, in that order.

- clock-frequency : The frequency of the main counter, in Hz. Optional.

Example:

	timer {
		compatible = "arm,cortex-a15-timer",
			     "arm,armv7-timer";
		interrupts = <1 13 0xf08>,
			     <1 14 0xf08>,
			     <1 11 0xf08>,
			     <1 10 0xf08>;
		clock-frequency = <100000000>;
	};
```

## Documentation/devicetree/bindings/arm/cache.txt
```
==========================================
ARM processors cache binding description
==========================================

Device tree bindings for ARM processor caches adhere to the cache bindings
described in [3], in section 3.8 for multi-level and shared caches.
On ARM based systems most of the cache properties related to cache
geometry are probeable in HW, hence, unless otherwise stated, the properties
defined in ePAPR for multi-level and shared caches are to be considered
optional by default.

On ARM, caches are either architected (directly controlled by the processor
through coprocessor instructions and tightly coupled with the processor
implementation) or unarchitected (controlled through a memory mapped
interface, implemented as a stand-alone IP external to the processor
implementation).

This document provides the device tree bindings for ARM architected caches.

- ARM architected cache node

	Description: must be a direct child of the cpu node. A system
		     can contain multiple architected cache nodes per cpu node,
		     linked through the next-level-cache phandle. The
		     next-level-cache property in the cpu node points to
		     the first level of architected cache for the CPU.
		     The next-level-cache property in architected cache nodes
		     points to the respective next level of caching in the
		     hierarchy. An architected cache node with an empty or
		     missing next-level-cache property represents the last
		     architected cache level for the CPU.
		     On ARM v7 and v8 architectures, the order in which cache
		     nodes are linked through the next-level-cache phandle must
		     follow the ordering specified in the processors CLIDR (v7)
		     and CLIDR_EL1 (v8) registers, as described in [1][2],
		     implying that a cache node pointed at by a
		     next-level-cache phandle must correspond to a level
		     defined in CLIDR (v7) and CLIDR_EL1 (v8) greater than the
		     one the cache node containing the next-level-cache
		     phandle corresponds to.

	Since on ARM most of the cache properties are probeable in HW the
	properties described in [3] - section 3.8 multi-level and shared
	caches - shall be considered optional, with the following properties
	updates, specific for the ARM architected cache node.

	- compatible
		Usage: Required
		Value type: <string>
		Definition: value shall be "arm,arch-cache".

	- interrupts
		Usage: Optional
		Value type: See definition
		Definition: standard device tree property [3] that defines
			    the interrupt line associated with the cache.
			    The property can be accompanied by an
			    interrupt-names property, as described in [4].

	- power-domain
		Usage: Optional
		Value type: phandle
		Definition: A phandle and power domain specifier as defined by
			    bindings of power controller specified by the
			    phandle [5].

Example(dual-cluster big.LITTLE system 32-bit)

	cpus {
		#size-cells = <0>;
		#address-cells = <1>;

		cpu@0 {
			device_type = "cpu";
			compatible = "arm,cortex-a15";
			reg = <0x0>;
			next-level-cache = <&L1_0>;

			L1_0: l1-cache {
				compatible = "arm,arch-cache";
				next-level-cache = <&L2_0>;
			};

			L2_0: l2-cache {
				compatible = "arm,arch-cache";
			};
		};

		cpu@1 {
			device_type = "cpu";
			compatible = "arm,cortex-a15";
			reg = <0x1>;
			next-level-cache = <&L1_1>;

			L1_1: l1-cache {
				compatible = "arm,arch-cache";
				next-level-cache = <&L2_0>;
			};
		};

		cpu@2 {
			device_type = "cpu";
			compatible = "arm,cortex-a15";
			reg = <0x2>;
			next-level-cache = <&L1_2>;

			L1_2: l1-cache {
				compatible = "arm,arch-cache";
				next-level-cache = <&L2_0>;
			};
		};

		cpu@3 {
			device_type = "cpu";
			compatible = "arm,cortex-a15";
			reg = <0x3>;
			next-level-cache = <&L1_3>;

			L1_3: l1-cache {
				compatible = "arm,arch-cache";
				next-level-cache = <&L2_0>;
			};
		};

		cpu@100 {
			device_type = "cpu";
			compatible = "arm,cortex-a7";
			reg = <0x100>;
			next-level-cache = <&L1_4>;

			L1_4: l1-cache {
				compatible = "arm,arch-cache";
				next-level-cache = <&L2_1>;
			};

			L2_1: l2-cache {
				compatible = "arm,arch-cache";
			};
		};

		cpu@101 {
			device_type = "cpu";
			compatible = "arm,cortex-a7";
			reg = <0x101>;
			next-level-cache = <&L1_5>;

			L1_5: l1-cache {
				compatible = "arm,arch-cache";
				next-level-cache = <&L2_1>;
			};
		};

		cpu@102 {
			device_type = "cpu";
			compatible = "arm,cortex-a7";
			reg = <0x102>;
			next-level-cache = <&L1_6>;

			L1_6: l1-cache {
				compatible = "arm,arch-cache";
				next-level-cache = <&L2_1>;
			};
		};

		cpu@103 {
			device_type = "cpu";
			compatible = "arm,cortex-a7";
			reg = <0x103>;
			next-level-cache = <&L1_7>;

			L1_7: l1-cache {
				compatible = "arm,arch-cache";
				next-level-cache = <&L2_1>;
			};
		};
	};

[1] ARMv7-AR Reference Manual
    http://infocenter.arm.com/help/index.jsp
[2] ARMv8-A Reference Manual
    http://infocenter.arm.com/help/index.jsp
[3] ePAPR standard
    https://www.power.org/documentation/epapr-version-1-1/
[4] Kernel documentation - resource property bindings
    Documentation/devicetree/bindings/resource-names.txt
[5] Kernel documentation - power domain bindings
    Documentation/devicetree/bindings/power/power_domain.txt
```
