## Documentation/devicetree/bindings/display/msm/cec.txt
```
Qualcomm Technologies, Inc. CEC device

CEC is a protocol that provides high-level control functions between all of the
various audiovisual products in a user environment.

Required properties:
- compatible: Must be "qcom,hdmi-cec".
- qcom,hdmi-dev: Phandle for the hdmi device node.
- interrupt-parent: Must be the hdmi interrupt controller.
- interrupts: Interrupt associated with cec.
- reg: Physical base address and length of the controller's registers.
- reg-names: "hdmi_cec".
- clocks: List of Phandles for clock device nodes needed by the device.
- clock-names: List of clock names needed by the device.
- pinctrl-names: Should contain only two values: "cec_active" and "cec_sleep" which stands for the
		active and sleep state of pinctrl used in this CEC driver.
- pinctrl-0: The active pinctrl state which is a list of phandles pointing to a pin configuration node.
- pinctrl-1: The sleep pinctrl state which is a list of phandles pointing to a pin configuration node.
- cec-gdsc-supply: Phandle for cec gdsc supply regulator device node.
- qcom,platform-supply-entries: A sub node that lists the elements of the supply. There can be more
				than one instance of this binding, in which case the entry would be
				appended with the supply entry index. e.g. qcom,platform-supply-entry@0.
				-- reg: offset and length of the register set for the device.
				-- qcom,supply-name: name of the supply (vdd/vdda/vddio).
				-- qcom,supply-min-voltage: minimum voltage level (uV).
				-- qcom,supply-max-voltage: maximum voltage level (uV).
				-- qcom,supply-enable-load: load drawn (uA) from enabled supply.
				-- qcom,supply-disable-load: load drawn (uA) from disabled supply.


Optional properties:
- qcom,platform-supply-entries: A sub node that lists the elements of the supply. There can be more
				than one instance of this binding, in which case the entry would be
				appended with the supply entry index. e.g. qcom,platform-supply-entry@0.
				-- qcom,supply-pre-on-sleep: time to sleep (ms) before turning on.
				-- qcom,supply-post-on-sleep: time to sleep (ms) after turning on.
				-- qcom,supply-pre-off-sleep: time to sleep (ms) before turning off.
				-- qcom,supply-post-off-sleep: time to sleep (ms) after turning off.

Example:

sde_hdmi_cec: qcom,hdmi-cec@c9a0000 {
	compatible = "qcom,hdmi-cec";
	label = "sde_hdmi_cec";
	qcom,hdmi-dev = <&sde_hdmi>;
	interrupt-parent = <&sde_hdmi_tx>;
	interrupts = <1 0>;

	reg = <0xc9a0000 0x50c>;
	reg-names = "hdmi_cec";

	clocks = <&clock_mmss clk_mmss_mnoc_ahb_clk>,
	       <&clock_mmss clk_mmss_mdss_ahb_clk>,
	       <&clock_mmss clk_mmss_mdss_hdmi_clk>;
	clock-names = "cec_mnoc_clk", "cec_iface_clk", "cec_core_clk";

	pinctrl-names = "cec_active", "cec_sleep";
	pinctrl-0 = <&mdss_hdmi_cec_active>;
	pinctrl-1 = <&mdss_hdmi_cec_suspend>;

	cec-gdsc-supply = <&gdsc_mdss>;
	qcom,platform-supply-entries {
		#address-cells = <1>;
		#size-cells = <0>;

		qcom,platform-supply-entry@0 {
			reg = <0>;
			qcom,supply-name = "cec-gdsc";
			qcom,supply-min-voltage = <0>;
			qcom,supply-max-voltage = <0>;
			qcom,supply-enable-load = <0>;
			qcom,supply-disable-load = <0>;
		};
	};
};
```

## Documentation/devicetree/bindings/display/msm/edrm.txt
```
Qualcomm Technologies, Inc. EDRM KMS

EDRM KMS implements Linux DRM/KMS APIs to drive early user interface to
different panel interfaces. EDRM driver provides early service to display
subsystem which manage a subset data paths to specific panel interfaces.
EDRM is expected to provide display service to fill in the gap between
bootloader and main application UI.  Only early application is expected to
use EDRM.  EDRM will be terminated when main application UI is ready.

Required properties
- compatible: Must be "qcom,msm-kms-edrm"

Assigned Display Subnodes:
- qcom,edrm-assigned-display:	List of display that eDRM can use.

Subnode properties:
- qcom,edrm-display-id@x:	a node that contains the display information

- qcom,label:	The string that indicate the label of the display.  The
			label should match with the label used in sde_display.
			For example, SDE display dtsi may defined:
				dsi_adv_7533_2: qcom,dsi-display@8 {...}

			If eDRM wants to use that display, it should set the
			label as:
				qcom,label = "dsi_adv_7533_1";

- qcom,intf-type:  a string that indicate the interface type.  Right now
				it can be "dsi" or "hdmi"

- qcom,assigned_plane :	List of plane that assigned for this display.
				There must be at least one plane in this field.
				The plane that is in this field must also be
				defined in qcom,sde-reserved-plane under sde_kms
				For example, SDE may contains the following
				reserved plane:
				&sde_kms {
					qcom,sde-reserved-plane {
					reserved_plane1: qcom,sde-reserved-plane@1 {
					reg = <0x1>;
					qcom,plane-name = "rgb3";
					lm-stage = <5>;
				}
				Then assigned_plane field can reference to the
				reserved plane like:
				qcom,assigned_plane = <&reserved_plane1>;

Example:
	msm_kms_edrm: qcom,msm_kms_edrm@900000 {
		qcom,edrm-assigned-display {
			qcom,edrm-display-id@0 {
				qcom,label = "dsi_adv_7533_1";
				qcom,intf-type = "dsi";
				qcom,assigned_plane = <&reserved_plane1>;
			}
		}
	}
```

## Documentation/devicetree/bindings/display/msm/msm-notifier.txt
```
Qualcomm Technologies, Inc. MSM NOTIFIER

Snapdragon Display Engine implements msm notifier to alert
listeners to changes in display mode.

Required properties
- compatible:			"qcom,msm-notifier"
- panel:			list of panels that support multiple refresh
				rate

Example:
	msm_notifier: qcom,msm_notifier@0{
		compatible = "qcom,msm-notifier";
		panel = <&dsi_sw43404_amoled_cmd &dsi_sharp_qsync_wqhd_cmd>;
	};
```

## Documentation/devicetree/bindings/display/msm/sde-hyp.txt
```
Qualcomm Technologies, Inc. SDE KMS HYP

Snapdragon Display Engine HYP registers with the Linux DRM/KMS framework to
facilitate DRM driver creation, publishing /dev/dri/card0, and sending
VBlank and Page Flip events to User Space listeners.

Required properties
- compatible: Must be "qcom,sde-kms-hyp"

Optional properties:
- qcom,client-id:	A four character string that is converted to a u32. It's
			understood as a hex value, if compatible (i.e. "7816").
			Otherwise, it is treated as a FourCC sequence code
			(i.e. "LV01").

Example:
	sde_kms_hyp: qcom,sde_kms_hyp@900000 {
		compatible = "qcom,sde-kms-hyp";
		qcom,client-id = "7816";
	};
```

## Documentation/devicetree/bindings/display/msm/sde-lease.txt
```
Qualcomm Technologies, Inc. SDE KMS LEASE

Snapdragon Display Engine Lease registers with the Linux DRM/KMS framework to
facilitate DRM driver creation, publishing /dev/dri/card<n>, n=1,2,... from
card0 with objects implicitly leased.

This device must be added to the connectors list of qcom,sde-kms device.

Required properties
- compatible: Must be "qcom,sde-kms-lease".

Optional properties
- qcom,lease-connectors: Connector names leased to the card.
- qcom,lease-planes: Plane names leased to the card.
- qcom,dev-name: Name of the lease device.

If there are cards with qcom,lease-connectors and/or qcom,lease-planes not
defined, the last one with empty connectors and/or planes in the connectors
list of qcom,sde-kms device will have all the remaining connectors and/or
planes that are not leased to other cards.

Example:
	card1: qcom,sde-kms-lease@0 {
		compatible = "qcom,sde-kms-lease";
		qcom,dev-name = "msm_drm1";
		qcom,lease-connectors = "DSI-1";
		qcom,lease-planes = "plane-0", "plane-8";
	};

	card2: qcom,sde-kms-lease@1 {
		compatible = "qcom,sde-kms-lease";
		qcom,dev-name = "msm_drm2";
		qcom,lease-connectors = "DSI-2";
		qcom,lease-planes = "plane-1", "plane-9";
	};
```

## Documentation/devicetree/bindings/display/msm/sde-rsc.txt
```
Qualcomm Technologies, Inc. SDE RSC

Snapdragon Display Engine implements display rsc to driver
display core to different modes for power saving

Required properties
- compatible:			Must be "qcom,sde-rsc"
- reg:				Offset and length of the register set for
				the device.
- reg-names:			Names to refer to register sets related
				to this device

Optional properties:
- clocks:			List of phandles for clock device nodes
				needed by the device.
- clock-names:			List of clock names needed by the device.
- vdd-supply:			phandle for vdd regulator device node.
- qcom,sde-rsc-version:		U32 property represents the rsc version. It helps to
				select correct sequence for sde rsc based on version.
- qcom,sde-dram-channels:	U32 property represents the number of channels in the
				Bus memory controller.
- qcom,sde-num-nrt-paths:	U32 property represents the number of non-realtime
				paths in each Bus Scaling Usecase. This value depends on
				number of AXI ports that are dedicated to non-realtime VBIF
				for particular chipset.
				These paths must be defined after rt-paths in
				"qcom,msm-bus,vectors-KBps" vector request.

Bus Scaling Subnodes:
- qcom,sde-data-bus:		Property to provide Bus scaling for data bus access for
				sde blocks.
- qcom,sde-llcc-bus:		Property to provide Bus scaling for data bus access for
				mnoc to llcc.
- qcom,sde-ebi-bus:		Property to provide Bus scaling for data bus access for
				llcc to ebi.

Bus Scaling Data:
- qcom,msm-bus,name:		String property describing client name.
- qcom,msm-bus,active-only:	Boolean context flag for requests in active or
				dual (active & sleep) contex
- qcom,msm-bus,num-cases:	This is the number of Bus Scaling use cases
				defined in the vectors property.
- qcom,msm-bus,num-paths:	This represents the number of paths in each
				Bus Scaling Usecase.
- qcom,msm-bus,vectors-KBps:	* A series of 4 cell properties, with a format
				of (src, dst, ab, ib) which is defined at
				Documentation/devicetree/bindings/arm/msm/msm_bus.txt
				* Current values of src & dst are defined at
				include/linux/msm-bus-board.h
Example:
	sde_rscc {
		cell-index = <0>;
		compatible = "qcom,sde-rsc";
		reg = <0xaf20000 0x1c44>,
			<0xaf30000 0x3fd4>;
		reg-names = "drv", "wrapper";
		clocks = <&clock_mmss clk_mdss_ahb_clk>,
			<&clock_mmss clk_mdss_axi_clk>;
		clock-names = "iface_clk", "bus_clk";
		vdd-supply = <&gdsc_mdss>;

		qcom,sde-rsc-version = <1>;
		qcom,sde-dram-channels = <2>;
		qcom,sde-num-nrt-paths = <1>;

		qcom,sde-data-bus {
		      qcom,msm-bus,name = "sde_rsc";
		      qcom,msm-bus,active-only;
		      qcom,msm-bus,num-cases = <3>;
		      qcom,msm-bus,num-paths = <2>;
		      qcom,msm-bus,vectors-KBps =
		          <22 512 0 0>, <23 512 0 0>,
		          <22 512 0 6400000>, <23 512 0 6400000>,
		          <22 512 0 6400000>, <23 512 0 6400000>;
		};
		qcom,sde-llcc-bus {
			qcom,msm-bus,name = "sde_rsc_llcc";
			qcom,msm-bus,active-only;
			qcom,msm-bus,num-cases = <3>;
			qcom,msm-bus,num-paths = <1>;
			qcom,msm-bus,vectors-KBps =
			    <20001 20513 0 0>,
			    <20001 20513 0 6400000>,
			    <20001 20513 0 6400000>;
		};
		qcom,sde-ebi-bus {
			qcom,msm-bus,name = "sde_rsc_ebi";
			qcom,msm-bus,active-only;
			qcom,msm-bus,num-cases = <3>;
			qcom,msm-bus,num-paths = <1>;
			qcom,msm-bus,vectors-KBps =
			    <20000 20512 0 0>,
			    <20000 20512 0 6400000>,
			    <20000 20512 0 6400000>;
		};
	};
```
