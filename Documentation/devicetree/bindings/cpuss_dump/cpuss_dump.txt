## Documentation/devicetree/bindings/crypto/msm/qcrypto.txt
```
* QCRYPTO (QTI Crypto)

Required properties:
  - compatible : should be "qcom,qcrypto"
  - reg : should contain crypto, BAM register map.
  - reg-names : should contain the crypto and bam base register names.
  - interrupts : should contain crypto BAM interrupt.
  - qcom,bam-pipe-pair : should contain crypto BAM pipe pair index.
  - qcom,ce-hw-instance : should contain crypto HW instance.
  - qcom,msm_bus,name: Should be "qcrypto-noc"
  - qcom,msm_bus,num_cases: Depends on the use cases for bus scaling
  - qcom,msm_bus,active-only: Boolean flag for context of request (actve/dual)
  - qcom,msm_bus,num_paths: The paths for source and destination ports
  - qcom,ce-device: Device number. Device number is encoded with the following:
		bit 3-0   device type:	0 for full disk encryption(fde)
					1 for per file encrption(pfe)
		bit 7-4   unit number within the device type.


Optional properties:
  - qcom,ce-hw-shared : optional, indicates if the hardware is shared between EE.
  - qcom,ce-hw-key : optional, indicates if the hardware supports use of HW KEY.
  - qcom,use-sw-aes-cbc-ecb-ctr-algo : optional, indicates if use SW aes-cbc/ecb/ctr algorithm.
  - qcom,use-sw-aes-xts-algo : optional, indicates if use SW aes-xts algorithm.
  - qcom,use-sw-aead-algo : optional, indicates if use SW aead algorithm.
  - qcom,use-sw-ahash-algo : optional, indicates if use SW hash algorithm.
  - qcom,use-sw-hmac-algo : optional, indicates if use SW hmac algorithm.
  - qcom,use-sw-aes-ccm-algo : optional, indicates if use SW aes-ccm algorithm.
  - qcom,clk-mgmt-sus-res : optional, indicate if the ce clocks need to be disabled/enabled in suspend/resume function.
  - qcom,support-core-clk-only : optional, indicates if the HW supports single crypto core clk.
  - qcom,request-bw-before-clk : optional, indicates if the HW supports bandwidth requests prior to clock controls.
  - qcom,bsm-ee : optional, indicate the BAM EE value, changes from target to target.Default value is 1 if not specified.

  - qcom,ce-opp-freq: optional, indicates the CE operating frequency in Hz,
	changes from target to target. If not specified, by default the
	frequency is set as 100MHZ.

  - qcom,msm_bus,vectors: optional, indicates vectors for bus topology.
        This attribute is required for msm targets where bus scaling is
	required. For other targets such as fsm, they do not perform
	bus scaling. It is not required for those targets.

  - qcom,smmu-s1-enable : Boolean flag to bypass SMMU stage 1 translation.
  - iommus : A list of phandle and IOMMU specifier pairs that describe the IOMMU master interfaces of the device.

Example:

        qcom,qcrypto@fd444000 {
		compatible = "qcom,qcrypto";
		reg = <0xfd440000 0x20000>,
		      <0xfd444000 0x8000>;
		reg-names = "crypto-base","crypto-bam-base";
		interrupts = <0 235 0>;
		qcom,bam-pipe-pair = <1>;
		qcom,ce-hw-instance = <1>;
		qcom,ce-device = <0>;
		qcom,ce-hw-shared;
                qcom,msm-bus,name = "qcrypto-noc";
		qcom,msm-bus,num-cases = <2>;
		qcom,msm-bus,num-paths = <1>;
		qcom,msm-bus,vectors-KBps =
				<56 512 0 0>,
				<56 512 3936000 393600>,
		qcom,ce-opp-freq = <100000000>;
	};
```

## Documentation/devicetree/bindings/devfreq/arm-memlat-mon.txt
```
ARM CPU memory latency monitor device

arm-memlat-mon is a device that represents the use of the PMU in ARM cores
to measure the parameters for latency driven memory access patterns.

Required structure:
An instance of arm-memlat-mon must be described in two levels of device nodes.
The first level describes the controller while the second level describes the
monitors that the controller manages. At least one monitor is required per
controller.

[First Level Nodes]
Required properties:
- compatible:			Must be "qcom,arm-memlat-cpugrp"
- qcom,cpulist:			List of CPU phandles to be monitored in a
				cluster. Must be a superset of cpulists
				described in second level nodes.

[Second Level Nodes]
Required properties:
- compatible:			Must be "qcom,arm-memlat-mon" or
				"qcom,arm-compute-mon"
- qcom,target-dev:		The DT device that corresponds to this master
				port
- qcom,core-dev-table:		A mapping table of core frequency to a required
				bandwidth vote at the given core frequency.
- qcom,cachemiss-ev:		The cache miss event that this monitor is
				supposed to measure. Optional for compute only.
Optional properties:
- qcom,cpulist:			List of CPU phandles to be monitored in a
				cluster. Must be a subset of the cpulist
				described in first level node. Defaults to
				cpulist in first level node if not specified.
- qcom,inst-ev:			The instruction count event that this monitor is
				supposed to measure. Defaults to 0x08 if not
				specified.
- qcom,stall-cycle-ev:		The stall cycle count that this monitor is
				supposed to measure. Assumes 100% stall if not
				specified.
- qcom,ddr-type:		Optional property indicates ddr type which can support
				different frequencies for a given target.

Example:

#define DDR_TYPE_LPDDR3	5
#define DDR_TYPE_LPDDR4X	7

	qcom,arm-memlat-cpugrp {
		compatible = "qcom,arm-memlat-cpugrp";
		qcom,cpulist = <&CPU0 &CPU1>;

		qcom,arm-memlat-mon {
			compatible = "qcom,arm-memlat-mon";
			qcom,target-dev = <&memlat0>;
			qcom,cachemiss-ev = <0x2A>;
			qcom,inst-ev = <0x08>;
			qcom,stall-cycle-ev = <0xE7>;
			ddr3-map {
				qcom,ddr-type = <DDR_TYPE_LPDDR3>;
				qcom,core-dev-table =
				<  300000 1525 >,
				<  499200 3143 >,
				< 1881600 5859 >;
			};
			ddr4-map {
				qcom,ddr-type = <DDR_TYPE_LPDDR4X>;
				qcom,core-dev-table =
					<  300000 1525 >,
					<  499200 3143 >,
					< 1881600 5859 >;
			};
		};
	};
```

## Documentation/devicetree/bindings/devfreq/armbw-pm.txt
```
ARM PMU based bandwidth monitor device

armbw-pm is a device that represents the use of the PMU present in ARM cores
to measure the bandwidth of bus access traffic from the cores.

Required properties:
- compatible:			Must be "qcom,armbw-pm"
- interrupts:			Lists the required interrupt settings
- qcom,bytes-per-beat:	The number of bytes present in each access

Example:
	qcom,armbw-pm {
		compatible = "qcom,armbw-pm";
		interrupts = <1 7 0xF1>;
		qcom,bytes-per-beat = <16>;
	};
```

## Documentation/devicetree/bindings/devfreq/bimc-bwmon.txt
```
MSM BIMC bandwidth monitor device

bimc-bwmon is a device that represents the MSM BIMC bandwidth monitors that
can be used to measure the bandwidth of read/write traffic from the BIMC
master ports. For example, the CPU subsystem sits on one BIMC master port.

Required properties:
- compatible:		Must be "qcom,bimc-bwmon", "qcom,bimc-bwmon2"
			"qcom,bimc-bwmon3" or "qcom,bimc-bwmon4" or
			"qcom,bimc-bwmon5"
- reg:			Pairs of physical base addresses and region sizes of
			memory mapped registers.
- reg-names:		Names of the bases for the above registers. Expected
			bases are: "base", "global_base"
- interrupts:		Lists the threshold IRQ.
- qcom,mport:		The hardware master port that this device can monitor
- qcom,target-dev:	The DT device that corresponds to this master port
- qcom,hw-timer-hz:	Hardware sampling rate in Hz. This field must be
			specified for "qcom,bimc-bwmon4"
Optional properties:
- qcom,byte-mid-match:  Byte count MID match value
- qcom,byte-mid-mask:   Byte count MID mask value

Example:
	qcom,cpu-bwmon {
		compatible = "qcom,bimc-bwmon";
		reg = <0xfc388000 0x300>, <0xfc381000 0x200>;
		reg-names = "base", "global_base";
		interrupts = <0 183 1>;
		qcom,mport = <0>;
		qcom,target-dev = <&cpubw>;
		qcom,hw-timer-hz = <19200000>;
		qcom,byte-mid-match = <0x1e00>;
		qcom,byte-mid-mask = <0x1e00>;

	};
```

## Documentation/devicetree/bindings/devfreq/devbw.txt
```
MSM device bandwidth device

devbw is a device that represents a MSM device's BW requirements from its
master port(s) to a different device's slave port(s) in a MSM SoC. This
device is typically used to vote for BW requirements from a device's (Eg:
CPU, GPU) master port(s) to the slave (Eg: DDR) port(s).

Required properties:
- compatible:		Must be "qcom,devbw" or "qcom,devbw-ddr" or "qcom,devbw-llcc"
- qcom,src-dst-ports:	A list of tuples where each tuple consists of a bus
			master port number and a bus slave port number.
- operating-points-v2:	A phandle to the OPP v2 table that holds meaningful
			instantaneous bandwidth values (in MB/s) that can be
			requested from the device master port to the slave port.
			The list of values depend on the supported bus/slave
			frequencies and the bus width.
Optional properties:
- qcom,active-only:	Indicates that the bandwidth votes need to be
			enforced only when the CPU subsystem is active.
- governor:		Initial governor to use for the device.
			Default: "performance"

- opp-supported-hw:	For the devices that are compatible with "qcom, devbw-ddr",
			the OPP node can have opp-supported-hw property. This is a
			single 32 bit bitmap value, representing compatible DDR-Type in HW.
Example:
		    Value:
			0x80:	Frequency Compatible for LPDDR4X only
			0x100:	Frequency Compatible for LPDDR5 only
			0x180:	Frequency Compatible for both LPDDR4X and LPDDR5


Example:

	bw_opp_table: bw-opp-table {
		compatible = "operating-points-v2";
		opp-75  {
			opp-hz = /bits/ 64 <  572 >; /*  75 MHz */
			opp-supported-hw = <0x80>;
		};
		opp-150 {
			opp-hz = /bits/ 64 < 1144 >; /* 150 MHz */
			opp-supported-hw = <0x80>;
		};
		opp-200 {
			opp-hz = /bits/ 64 < 1525 >; /* 200 MHz */
			opp-supported-hw = <0x180>;
		};
		opp-307 {
			opp-hz = /bits/ 64 < 2342 >; /* 307 MHz */
			opp-supported-hw = <0x80>;
		};
		opp-460 {
			opp-hz = /bits/ 64 < 3509 >; /* 460 MHz */
			opp-supported-hw = <0x80>;
		};
		opp-614 {
			opp-hz = /bits/ 64 < 4684 >; /* 614 MHz */
			opp-supported-hw = <0x80>;
		};
		opp-800 {
			opp-hz = /bits/ 64 < 6103 >; /* 800 MHz */
			opp-supported-hw = <0x80>;
		};
		opp-931 {
			opp-hz = /bits/ 64 < 7102 >; /* 931 MHz */
			opp-supported-hw = <0x80>;
		};
	};
	qcom,cpubw {
		compatible = "qcom,devbw-ddr";
		qcom,src-dst-ports = <1 512>, <2 512>;
		qcom,active-only;
		operating-points-v2 = <&bw_opp_table>;
	};
```

## Documentation/devicetree/bindings/devfreq/devfreq-cpufreq.txt
```
Devfreq CPUfreq governor

devfreq-cpufreq is a parent device that contains one or more child devices.
Each child device provides CPU frequency to device frequency mapping for a
specific device. Examples of devices that could use this are: DDR, cache and
CCI.

Parent device name shall be "devfreq-cpufreq".

Required child device properties:
- cpu-to-dev-map:	A list of tuples where each tuple consists of a
			CPU frequency (KHz) and the corresponding device
			frequency. CPU frequencies not listed in the table
			will use the device frequency that corresponds to the
			next rounded up CPU frequency.
- target-dev:		Phandle to device that this mapping applies to.

Example:
	devfreq-cpufreq {
		cpubw-cpufreq {
			target-dev = <&cpubw>;
			cpu-to-dev-map =
				<  300000  1144 >,
				<  422400  2288 >,
				<  652800  3051 >,
				<  883200  5996 >,
				< 1190400  8056 >,
				< 1497600 10101 >,
				< 1728000 12145 >,
				< 2649600 16250 >;
		};

		cache-cpufreq {
			target-dev = <&cache>;
			cpu-to-dev-map =
				<  300000  300000 >,
				<  422400  422400 >,
				<  652800  499200 >,
				<  883200  576000 >,
				<  960000  960000 >,
				< 1497600 1036800 >,
				< 1574400 1574400 >,
				< 1728000 1651200 >,
				< 2649600 1728000 >;
		};
	};
```

## Documentation/devicetree/bindings/devfreq/devfreq-qcom-fw.txt
```
QCOM Devfreq firmware device

Some Qualcomm Technologies, Inc. (QTI) chipsets have a firmware that
offloads the steps for frequency switching. It provides a table of
supported frequencies and a register to request one of the supported
freqencies.

The qcom,devfreq-fw represents this firmware as a device. Sometimes,
multiple entities want to vote on the frequency request that is sent to the
firmware. The qcom,devfreq-fw-voter represents these voters as child
devices of the corresponding qcom,devfreq-fw device.

Required properties:
- compatible:		Must be "qcom,devfreq-fw" or "qcom,devfreq-fw-voter"
Only for qcom,devfreq-fw:
- reg:			Pairs of physical base addresses and region sizes of
			memory mapped registers.
- reg-names:		Names of the bases for the above registers.
			Required register regions are:
			- "en-base": address of register to check if the
			  firmware is enabled.
			- "ftbl-base": address region for the frequency
			  table.
			- "perf-base": address of register to request a
			  frequency.
			Optional register region:
			- "pstate-base": address of register to request
			  for current performance state (Mandatory if
			  qcom,support-panic-notifier property is added).
Optional properties:
- qcom,ftbl-row-size:    Size of the LUT row size.
- qcom,support-panic-notifier:	Support for panic notifier for l3-domain.

Example:

	qcom,devfreq-l3 {
		compatible = "qcom,devfreq-fw";
		reg-names = "en-base", "ftbl-base", "perf-base";
		reg = <0x18321000 0x4>, <0x18321110 0x600>, <0x18321920 0x4>;

		qcom,cpu0-l3 {
			compatible = "qcom,devfreq-fw-voter";
		};

		qcom,cpu4-l3 {
			compatible = "qcom,devfreq-fw-voter";
		};
	};
```
