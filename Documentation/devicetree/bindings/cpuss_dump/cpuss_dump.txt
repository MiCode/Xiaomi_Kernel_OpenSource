## Documentation/devicetree/bindings/devfreq/devfreq-spdm.txt
```
MSM SPDM bandwidth monitor device

devfreq-spdm is a device that represents a device that is monitored by the SPDM
hardware to measure the traffic status of configured master ports on the bus.


Required properties:
-compatible:			Must be "qcom,devfreq_spdm"
-qcom,spdm-client:		Client id of the port being monitored
-qcom,bw-upstep:		Initial up vote size in MB/s
-qcom,bw-dwnstep:		Initial down vote size in MB/s
-qcom,max-vote:			Vote ceiling in MB/s
-qcom,ports:			SPDM ports used by this device
-qcom,alpha-up:			SPDM filter up alpha value
-qcom,alpha-down:		SPDM filter down alpha value
-qcom,bucket-size:		SPDM filter bucket size
-qcom,pl-freqs:			The driver supports different filter values at
				three different performance levels.  This value
				defines the cut-over frequenices
-qcom,reject-rate:		Desired rejection rate used to calculate
				SPDM threshold
-qcom,response-time-us:	Desired response time used to calculate
				SPDM threshold
-qcom,cci-response-time-us:	Desired response time used to calculate
				SPDM threshold when CCI is under heavy load
-qcom,max-cci-freq:		CCI frequency at which cci_response_time_us
				is used
-qcom,up-step-multp:		used to increase rate of growth on up votes
-qcom,spdm-interval:		down-vote polling interval

Optional properties:
-clock-names:			Clocks used to measure current bus frequency.
				Expected names are "cci_clk"
-clocks:			References to named clocks

Example:
devfreq_spdm_cpu {
	compatible = "qcom,devfreq_spdm";
	qcom,msm-bus,name = "devfreq_spdm";
	qcom,msm-bus,num-cases = <2>;
	qcom,msm-bus,num-paths = <1>;
	qcom,msm-bus,vectors-KBps =
			<1 512 0 0>,
			<1 512 0 0>;
	qcom,spdm-client = <0>;

	clock-names = "cci_clk";
	clocks = <&clock_cpu clk_cci_clk>;

	qcom,bw-upstep = <100>;
	qcom,bw-dwnstep = <100>;
	qcom,max-vote = <10000>;
	qcom,up-step-multp = <2>;
	qcom,spdm-interval = <100>;

	qcom,ports = <16>;
	qcom,alpha-up = <7>;
	qcom,alpha-down = <15>;
	qcom,bucket-size = <8>;

	/*max pl1 freq, max pl2 freq*/
	qcom,pl-freqs = <149999999 150000000>;

	/* pl1 low, pl1 high, pl2 low, pl2 high, pl3 low, pl3 high */
	qcom,reject-rate = <5000 5000 5000 5000 5000 5000>;
	/* pl1 low, pl1 high, pl2 low, pl2 high, pl3 low, pl3 high */
	qcom,response-time-us = <220 220 2000 2000 900 900>;
	/* pl1 low, pl1 high, pl2 low, pl2 high, pl3 low, pl3 high */
	qcom,cci-response-time-us = <50 50 30 30 20 20>;
	qcom,max-cci-freq = <600000000>;
};

This device is always used with the SPDM governor which requires a device tree
entry to know what IRQ to respond to.

Required properties:
-compatible			Must be "qcom,gov_spdm_hyp"
-interrupt-names		SPDM irq to handle.  Name should be "spdm-irq"
-interrupts			The interrupt number the SPDM hw is assigned

Example:
devfreq_spdm_gov {
	compatible = "qcom,gov_spdm_hyp";
	interrupt-names = "spdm-irq";
	interrupts = <0 192 0>;
};
```

## Documentation/devicetree/bindings/devfreq/devfreq_icc.txt
```
MSM devfreq icc device

devfreq icc is a device that represents a MSM device's BW requirements from its
master port(s) to a different device's slave port(s) in a MSM SoC. This
device is typically used to vote for BW requirements from a device's (Eg:
CPU, GPU) master port(s) to the slave (Eg: DDR) port(s).

Required properties:
- compatible:		Must be "qcom,devfreq-icc" or "qcom,devfreq-icc-ddr"
			or "qcom,devfreq-icc-llcc" or "qcom,devfreq-icc-l3"
			or "qcom,devfreq-icc-l3bw"
- interconnects:	Pairs of phandles and interconnect provider specificers
			to denote the edge source and destination ports of the
			desired interconnect path.
- operating-points-v2:	A phandle to the OPP v2 table that holds meaningful
			instantaneous bandwidth values (in MB/s) that can be
			requested from the device master port to the slave port.
			The list of values depend on the supported bus/slave
			frequencies and the bus width. Required for all devices
			except those compatible with "qcom,devfreq-icc-l3" or
			"qcom,devfreq-icc-l3bw".
- reg:			Physical base address and region size of the memory
			mapped registers containing the device's frequency
			table. Required for "qcom,devfreq-icc-l3" and
			"qcom,devfreq-icc-l3bw" devices.
- reg-names:		Name used for the above registers. Expected name is
			"ftbl-base". Required for "qcom,devfreq-icc-l3"
			and "qcom,devfreq-icc-l3bw" devices.
- qcom,bus-width:	Bus width of the interconnect path. Only required for
			"qcom,devfreq-icc-l3bw" devices.
Optional properties:
- qcom,active-only:	Indicates that the bandwidth votes need to be
			enforced only when the CPU subsystem is active.
- governor:		Initial governor to use for the device.
			Default: "performance"

- opp-supported-hw:	For the devices that are compatible with "qcom,devfreq-icc-ddr",
			the OPP node can have opp-supported-hw property. This is a
			single 32 bit bitmap value, representing compatible DDR-Type in HW.
Example:
		    Value:
			0x80:	Frequency Compatible for LPDDR4X only
			0x100:	Frequency Compatible for LPDDR5 only
			0x180:	Frequency Compatible for both LPDDR4X and LPDDR5


Example:

	bw_opp_table: bw-opp-table {
		compatible = "operating-points-v2";
		opp-75  {
			opp-hz = /bits/ 64 <  572 >; /*  75 MHz */
			opp-supported-hw = <0x80>;
		};
		opp-150 {
			opp-hz = /bits/ 64 < 1144 >; /* 150 MHz */
			opp-supported-hw = <0x80>;
		};
		opp-200 {
			opp-hz = /bits/ 64 < 1525 >; /* 200 MHz */
			opp-supported-hw = <0x180>;
		};
		opp-307 {
			opp-hz = /bits/ 64 < 2342 >; /* 307 MHz */
			opp-supported-hw = <0x80>;
		};
		opp-460 {
			opp-hz = /bits/ 64 < 3509 >; /* 460 MHz */
			opp-supported-hw = <0x80>;
		};
		opp-614 {
			opp-hz = /bits/ 64 < 4684 >; /* 614 MHz */
			opp-supported-hw = <0x80>;
		};
		opp-800 {
			opp-hz = /bits/ 64 < 6103 >; /* 800 MHz */
			opp-supported-hw = <0x80>;
		};
		opp-931 {
			opp-hz = /bits/ 64 < 7102 >; /* 931 MHz */
			opp-supported-hw = <0x80>;
		};
	};
	qcom,cpubw {
		compatible = "qcom,devfreq-icc-ddr";
		interconnects = <&mc_virt MASTER_LLCC &mc_virt SLAVE_EBI1>;
		qcom,active-only;
		operating-points-v2 = <&bw_opp_table>;
	};
```

## Documentation/devicetree/bindings/devfreq/m4m-hwmon.txt
```
MSM M4M hardware monitor device

m4m-hwmon is a device that represents the MSM M4M hardware monitors
that can be used to measure the various types of requests in the MSM M4M.

Required properties:
- compatible:		Must be "qcom,m4m-hwmon"
- reg:			Pairs of physical base addresses and region sizes of
			memory mapped registers.
- interrupts:		Lists the threshold IRQ.
- qcom,counter-event-sel: Array of counter and event selection values.
- qcom,target-dev:	The DT device that is monitored by this MSM M4M
			counter configuration.

Example:
	qcom,m4m-hwmon {
		compatible = "qcom,m4m-hwmon";
		reg = <0x6530000 0x160>;
		interrupts = <0 19 4>;
		qcom,counter-event-sel = <4 0x100>;
		qcom,target-dev = <&m4m_cache>;
	};
```

## Documentation/devicetree/bindings/devfreq/msmcci-hwmon.txt
```
MSM CCI hardware monitor device

msmcci-hwmon is a device that represents the MSM CCI hardware monitors
that can be used to measure the various types of requests in the MSM CCI.

Required properties:
- compatible:		Must be "qcom,msmcci-hwmon"
- reg:			Pairs of physical base addresses and region sizes of
			memory mapped registers.
- interrupts:		Lists the threshold IRQ.
- qcom,counter-event-sel:	Array of event selection values.
- qcom,target-dev:	The DT device that is monitored by this MSM CCI
			counter configuration.

Example:
	qcom,msmcci-hwmon {
		compatible = "qcom,msmcci-hwmon";
		reg = <0xf910f000 0xb0>,
		      <0xf910f004 0xb0>;
		interrupts = <0 345 4>,
			     <0 346 4>;
		qcom,counter-event-sel = <1 2>;
		qcom,target-dev = <&cci_cache>;
	};
```

## Documentation/devicetree/bindings/devfreq/sprd/sprd,ddr-dvfs.txt
```
Spreadtrum ddr dvfs bindings

This dirver give functions for ddr frequency control to userspace.

Required properties:
- compatible: Should be "sprd,ddr-dvfs"
- freq-num: Specifies the max frequency points supported by soc.
- sprd-scene: Application scenarios, optional.
- sprd-freq: Frequency of application scenarios, optional.
- overflow: Bandwidth overflow threshold, optional.
- underflow: Bandwidth underflow threshold, optional.

Example:
ddr_dfs: scene-frequency {
	compatible = "sprd,ddr-dvfs";
	freq-num = <8>;
	sprd-scene = "boost", "lcdon", "lcdoff", "camlow",
		"camhigh", "camveryhigh", "faceid", "top";
	sprd-freq = <1333 768 256 384 512 0xbacd 1333 0xbacd>;
	overflow = <716800 1075200 1433600 2150400 2867200 4294967295 4294967295 4294967295>;
	underflow = <0 616800 975200 1333600 2050400 2767200 0 0>;
};
```

## Documentation/devicetree/bindings/display/bridge/anx7625.txt
```
Analogix ANX7625 SlimPort (Full-HD Transmitter)
-----------------------------------------------

The ANX7625 is DSI to DisplayPort bridge.

Required properties:

 - compatible		: "analogix,anx7625"
 - reg			: I2C address of the device
 - interrupt-parent	: Should be the phandle of the interrupt controller
			  that services interrupts for this device
 - interrupts		: Should contain the INTP interrupt
 - cbl_det-gpios	: Which GPIO to use for cable detection
 - power_en-gpios	: Which GPIO to use for power enable
 - reset_n-gpios	: Which GPIO to use for reset
 - ports		: Port 0 for DSI input, should be a reference to a
			  valid mipi_dsi_host device

Example:

	anx7625: anx7625@ee {
		compatible = "analogix,anx7625";
		reg = <0xee>;
		interrupt-parent = <&qup15>;
		interrupts = <2 IRQ_TYPE_LEVEL_LOW>;   /* INTP */
		cbl_det-gpio = <&qup15 1 GPIO_ACTIVE_HIGH>;
		power_en-gpio = <&pio 27 GPIO_ACTIVE_HIGH>;
		reset_n-gpio = <&pio 49 GPIO_ACTIVE_HIGH>;
		ports {
			#address-cells = <1>;
			#size-cells = <0>;

			port@0 {
				reg = <0>;
				anx7625_in: endpoint {
					remote-endpoint = <&dsi_out>;
				};
			};
		};
	};
```

## Documentation/devicetree/bindings/display/bridge/lt9611.txt
```
LT9611 DSI to HDMI bridge


Required properties:
	- compatible:				Must be "lt,lt9611"
	- reg:					Main I2C slave ID (for I2C host driver)
	- lt,irq-gpio:				Main IRQ gpio mapping
	- lt,reset-gpio				Main reset gpio mapping


Optional properties:
	- lt,hdmi-ps-gpio:			gpio mapping for HDMI PS
	- lt,hdmi-en-gpio:			gpio mapping for HDMI EN

	- lt,supply-entries:			A node that lists the elements of the supply used to
						power the bridge. There can be more than one instance
						of this binding, in which case the entry would be
						appended with the supply entry index.
	e.g. lt,supply-entry@0
	-- lt,supply-name: name of the supply (vdd/vcc)
	-- lt,supply-min-voltage: minimum voltage level (uV)
	-- lt,supply-max-voltage: maximum voltage level (uV)
	-- lt,supply-enable-load: load drawn (uA) from enabled supply
	-- lt,supply-disable-load: load drawn (uA) from disabled supply
	-- lt,supply-ulp-load: load drawn (uA) from supply in ultra-low power mode
	-- lt,supply-pre-on-sleep: time to sleep (ms) before turning on
	-- lt,supply-post-on-sleep: time to sleep (ms) after turning on
	-- lt,supply-pre-off-sleep: time to sleep (ms) before turning off
	-- lt,supply-post-off-sleep: time to sleep (ms) after turning off

	- lt,non-pluggable: Boolean to indicate if display is non pluggable.
	- lt,preferred-mode: Preferred display mode.
	- lt,customize-modes: Customized modes when it's non-pluggable display.
	e.g. lt,customize-mode-id@0
	-- lt,mode-h-active: Horizontal active pixels for this mode.
	-- lt,mode-h-front-porch: Horizontal front porch in pixels for this mode.
	-- lt,mode-h-pulse-width: Horizontal sync width in pixels for this mode.
	-- lt,mode-h-back-porch: Horizontal back porch in pixels for this mode.
	-- lt,mode-h-active-high: Boolean to indicate if mode horizontal polarity is active high.
	-- lt,mode-v-active: Vertical active lines for this mode.
	-- lt,mode-v-front-porch: Vertical front porch in lines for this mode.
	-- lt,mode-v-pulse-width: Vertical sync width in lines for this mode.
	-- lt,mode-v-back-porch: Vertical back porch in lines for this mode.
	-- lt,mode-v-active-high: Boolean to indicate if mode vertical polarity is active high.
	-- lt,mode-refersh-rate: Mode refresh rate in hertz.
	-- lt,mode-clock-in-khz: Mode pclk in KHz.

Required nodes:

The LT9611 has one video port. Its connection is modelled using the OF
graph bindings specified in Documentation/devicetree/bindings/graph.txt.
Video port 0 is for the DSI input. The remote endpoint phandle should
be a reference to a valid mipi_dsi_host device node.


Example:

&qupv3_se9_i2c {
	status = "okay";
	lt9611@3b {
		compatible = "lt,lt9611";
		reg = <0x3b>;
		interrupt-parent = <&tlmm>;
		interrupts = <125 0>;
		interrupt-names = "lt_irq";
		lt,irq-gpio = <&tlmm 125 0x0>;
		lt,reset-gpio = <&tlmm 134 0x0>;
		lt,hdmi-ps-gpio = <&tlmm 136 0x0>;
		lt,hdmi-en-gpio = <&tlmm 137 0x0>;
		lt,non-pluggable;
		lt,preferred-mode = "1920x1080";

		vcc-supply = <&pm660l_l6>;
		vdd-supply = <&pm660_l11>;
		lt,supply-entries {
			#address-cells = <1>;
			#size-cells = <0>;

			lt,supply-entry@0 {
				reg = <0>;
				lt,supply-name = "vcc";
				lt,supply-min-voltage = <3300000>;
				lt,supply-max-voltage = <3300000>;
				lt,supply-enable-load = <200000>;
				lt,supply-post-on-sleep = <50>;
			};

			lt,supply-entry@1 {
				reg = <1>;
				lt,supply-name = "vdd";
				lt,supply-min-voltage = <1800000>;
				lt,supply-max-voltage = <1800000>;
				lt,supply-enable-load = <200000>;
				lt,supply-post-on-sleep = <50>;
			};
		};

		lt,customize-modes {
			lt,customize-mode-id@0 {
				lt,mode-h-active = <1920>;
				lt,mode-h-front-porch = <88>;
				lt,mode-h-pulse-width = <44>;
				lt,mode-h-back-porch = <148>;
				lt,mode-h-active-high;
				lt,mode-v-active = <1080>;
				lt,mode-v-front-porch = <4>;
				lt,mode-v-pulse-width = <5>;
				lt,mode-v-back-porch = <36>;
				lt,mode-v-active-high;
				lt,mode-refresh-rate = <60>;
				lt,mode-clock-in-khz = <148500>;
			};
		};

		ports {
			#address-cells = <1>;
			#size-cells = <0>;

			port@0 {
				reg = <0>;
				lt9611_in: endpoint {
				remote-endpoint = <&ext_dsi_out>;
				};
			};
		};
	};
};
```
