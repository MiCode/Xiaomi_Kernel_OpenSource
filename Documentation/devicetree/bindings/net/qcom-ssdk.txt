## Documentation/devicetree/bindings/phy/phy-msm-sata.txt
```
* MSM Serial Advanced Technology Attachment (SATA) PHY

SATA PHY nodes are defined to describe on-chip SATA PHY hardware macro.
To bind SATA PHY with SATA host controller, the controller node should
contain a phandle reference to SATA PHY node.
Refer to generic phy bindings @
Documentation/devicetree/bindings/phy/phy-bindings.txt

Required properties:
- compatible        : compatible list, contains "qcom,sataphy"
- reg               : <registers mapping>
- reg-names         : corresponding register space names
			"phy_mem" is mandatory
			"phy_sel" is optional and is required only for UFS-SATA combo phy
- #phy-cells        : shall be set to 0.
- vdda-phy-supply   : phandle to main PHY supply for analog domain
- vdda-pll-supply   : phandle to PHY PLL and Power-Gen block power supply

Optional properties:
- vdda-phy-max-microamp : specifies max. load that can be drawn from phy supply
- vdda-pll-max-microamp : specifies max. load that can be drawn from pll supply

Example:

	sataphy0: sataphy@0xfc597000 {
		compatible = "qcom,sataphy";
		reg = <0xfc581000 0x400>, <0xfd4ab20c 0x4>;
		reg-names = "phy_mem", "phy_sel";
		#phy-cells = <0>;
		vdda-phy-supply = <&pma8084_l4>;
		vdda-pll-supply = <&pma8084_l12>;
		vdda-phy-max-microamp = <50000>;
		vdda-pll-max-microamp = <1000>;
	};

	sata@0xfc598000 {
		...
		phys = <&sataphy0>;
		phy-names = "sata-6g";
	};
```

## Documentation/devicetree/bindings/phy/qcom,snps-28nm-hs-usb.txt
```
Qualcomm Synopsys 28nm Femto phy controller
===========================================

Synopsys 28nm femto phy controller supports LS/FS/HS usb connectivity on
Qualcomm chipsets.

Required properties:
- compatible:
    Value type: <string>
    Definition: Should contain "qcom,usb-snps-hsphy".

- reg:
    Value type: <prop-encoded-array>
    Definition: USB PHY base address and length of the register map

- reg-names:
    Value type: <string>
    Definition: Names of the reg bases in 1-1 correspondence with the
		"reg" property. "phy_csr" is a mandatory reg base.

- clocks:
    Value type: <prop-encoded-array>
    Definition: See clock-bindings.txt section "consumers". List of
                two clock specifiers for interface and core controller
                clocks.

- clock-names:
    Value type: <string>
    Definition: Names of the clocks in 1-1 correspondence with the "clocks"
		property. Must contain "phy_csr_clk" and "ref_clk" clocks.

- vdd-supply:
    Value type: <phandle>
    Definition: phandle to the regulator VDD supply node.

- vdda18-supply:
    Value type: <phandle>
    Definition: phandle to the regulator 1.8V supply node.

- vdda33-supply:
    Value type: <phandle>
    Definition: phandle to the regulator 3.3V supply node.

- qcom,vdd-voltage-level:
    Value type: <prop-array>
    Definition: This is a list of three integer values (no, min, max) where
		each value corresponding to voltage corner.

- resets:
    Value type: <prop-encoded-array>
    Definition: See reset.txt section "consumers". PHY reset specifier.

- reset-names:
    Value type: <string>
    Definition: Must contain "phy_por_reset" and "phy_reset" strings.

Example:
	usb_phy: phy@78d9000 {
		compatible = "qcom,usb-snps-hsphy";
		reg = <0x78d9000 0x400>;
		reg-names = "phy_csr";

		vdd-supply = <&pm8916_s1_corner>;
		vdda18-supply = <&pm8916_l7>;
		vdda33-supply = <&pm8916_l13>;

		clocks = <&gcc GCC_USB_HS_AHB_CLK>,
			     <&gcc GCC_USB_HS_SYSTEM_CLK>;
		clock-names = "phy_csr_clk", "ref_clk";

		resets = <&gcc GCC_QUSB2_PHY_BCR>,
			 <&gcc GCC_USB2_HS_PHY_ONLY_BCR>;
		reset-names = "phy_por_reset", "phy_reset";

	};
```

## Documentation/devicetree/bindings/pil/inrush-current-mitigation.txt
```
In Rush Current Mitigation driver:

On recent targets, APSS L2 memories are moved to APC domain which were
earlier on Mx domain. Analysis suggests that on current targets APSS L2
memories provide reverse capacitance on Mx and this used to provide buffer
while powering ON Q6 L2. Now due to L2s moving to APC, the cushion is not
available. So there is a chance of droop when Q6 L2 memories are being
powered up.

During Q6 low power modes L2 is kept in retention only and never collapsed. So
the cases where it needs to be taken care is during PIL(modem and adsp bringup
during boot). So in cold boot path before bringing up modem or adsp, turn on MM
memories. Hence providing a intermediate load.

Required properties:
- compatible:			Must be qcom,msm-inrush-current-mitigation
- qcom,dependent-subsystems:	List of subsystems which need the intermediate load
- vdd-supply:			gdsc handle to switch on memory.

Example:
	qcom,inrush-current {
		compatible = "qcom,msm-inrush-current-mitigation";
		qcom,dependent-subsystems = "modem", "adsp";
		vdd-supply = <&gdsc_mdss>;
	};
```

## Documentation/devicetree/bindings/pil/pil-bcss.txt
```
* Broadcast Subsystem Peripheral Image Loader

pil-bcss is a peripheral image loading (PIL) driver. It is used for loading
and authenticating broadcast demodulator firmware images.

Required properties:
- compatible: "pil-bcss"
- qcom,firmware-name: Base name of the firmware image. Ex. "bcss"

Optional properties:
- qcom,restart-group: List of subsystems that will need to restart together.

Example:

	qcom,pil-bcss {
		compatible = "qcom,pil-bcss";

		qcom,firmware-name = "bcss";
	};
```

## Documentation/devicetree/bindings/pil/pil-blackghost.txt
```
Qualcomm Technologies Inc Blackghost(BG) PIL driver:

Blackghost(BG) PIL driver provide interface to load and boot Blackghost(BG)
SOC. Blackghost(BG) SOC is an external SOC which communicate to MSM via
SPI. The PIL driver loads firmware into memory and invoke secure app via
qseecom to transfer and handshake the boot process. Once Blackghost(BG) SOC
is booted it raises ready interrupt which is handled by BG PIL driver, and
this event is informed to other MSM drivers, other remote subsystem via
notifier framework. The PIL driver also handles interrupt for the BG SOC
crash upon arrival of which it reset and initiates ramdump collection for BG
SOC.

Required properties:
- compatible:			Must be "qcom,PIL-blackghost"
- qcom,firmware-name:		Base name of the firmware image.
- qcom,bg2ap-status-gpio:	GPIO used by the blackghost to indicate status to the apps.
- qcom,bg2ap-errfatal-gpio:	GPIO used by the blackghost to indicate software error to the apps.
- qcom,ap2bg-status-gpio:	GPIO used by the apps to indicate its status to blackghost.
- qcom,ap2bg-errfatal-gpio:	GPIO used by the apps to indicate blackghost about apps reset.

Example:

	qcom,blackghost {
		compatible = "qcom,pil-blackghost";
		qcom,firmware-name = "bgelf";

		/* GPIO inputs from blackghost */
		qcom,bg2ap-status-gpio = <&msm_gpio 97 0>;
		qcom,bg2ap-errfatal-gpio = <&msm_gpio 95 0>;
		/* GPIO output to blackghost */
		qcom,ap2bg-status-gpio = <&msm_gpio 17 0>;
		qcom,ap2bg-errfatal-gpio = <&msm_gpio 23 0>;
	};
```
