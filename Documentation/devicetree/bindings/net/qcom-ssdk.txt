## Documentation/devicetree/bindings/net/qcom-ssdk.txt
```
* Qualcomm Technologies Inc. SSDK Driver.

Add missing DT bindings documentation for 8337 ethernet switch.

Required properties:
- compatible: Should be "qcom,ess-switch-qca83xx"
- qcom,switch-access-mode: Should be "mdio" or "local bus"
- qcom,link-intr-gpio: Link interrupt number used by switch
- qcom,switch-cpu-bmp: Switch cpu port bitmap
- qcom,switch-lan-bmp: Switch lan port bitmap
- qcom,switch-wan-bmp: Switch wan port bitmap
- qcom,ar8327-initvals: Initial qca83xx configuration

Optional:
- qcom,link-polling-required: Boolean- Present if using polling for link check

Example:

ess-switch@0 {
	compatible = "qcom,ess-switch-qca83xx";
	qcom,switch-access-mode = "mdio";
	qcom,ar8327-initvals = <
		0x00004 0x4200000   /* PAD0_MODE */
		0x00008 0x0         /* PAD5_MODE */
		0x000e4 0xaa545     /* MAC_POWER_SEL */
		0x000e0 0xc74164de  /* SGMII_CTRL */
		0x0007c 0x4e        /* PORT0_STATUS */
		0x00094 0x4e        /* PORT6_STATUS */
	>;
	qcom,link-intr-gpio = <84>;
	qcom,switch-cpu-bmp = <0x01>;    /* cpu port bitmap */
	qcom,switch-lan-bmp = <0x3e>;    /* lan port bitmap */
	qcom,switch-wan-bmp = <0x0>;     /* wan port bitmap */
};
```

## Documentation/devicetree/bindings/net/qrtr-ethernet-dev.txt
```
QTI QRTR Ethernet Device transport binding

- compatible:
	Usage: required
	Value type: <stringlist>
	Definition: must be "qcom,qrtr-ethernet-dev"

- qcom,net-id:
	Usage: optional
	Value type: <u32>
	Definition: indicates what subnet this transport belongs to. Should be
		    passed into the qrtr core logic to determine if forwarding
		    is needed on this endpoint.

- qcom,low-latency:
	Usage: optional
	Value type: <bool>
	Definition: indicates whether this transport receiving thread needs to
		    be set to realtime priority for enhanced performance.

= EXAMPLE
The following example represents the qrtr ethernet dev transport node on a
device configured as an ethernet endpoint and needs to forward data from the
host to a modem co-processor.

	qcom,eth_dev_qrtr {
		compatible = "qcom,qrtr-ethernet-dev";
		qcom,net-id = <4>;
		qcom,low-latency;
	};
```

## Documentation/devicetree/bindings/net/qrtr-mhi-dev.txt
```
QTI QRTR MHI Dev transport binding

- compatible:
	Usage: required
	Value type: <stringlist>
	Definition: must be "qcom,qrtr-mhi-dev"

- qcom,net-id:
	Usage: optional
	Value type: <u32>
	Definition: indicates what subnet this transport belongs to. Should be
		    passed into the qrtr core logic to determine if forwarding
		    is needed on this endpoint.

- qcom,low-latency:
	Usage: optional
	Value type: <bool>
	Definition: indicates whether this transport receiving thread needs to
		    be set to realtime priority for enhanced performance.

= EXAMPLE
The following example represents the qrtr mhi dev transport node on a device
configured as a pcie endpoint and needs to forward data from the host to a
modem co-processor.

	qcom,mhi_dev_qrtr {
		compatible = "qcom,qrtr-mhi-dev";
		qcom,net-id = <3>;
		qcom,low-latency;
	};
```

## Documentation/devicetree/bindings/net/wireless/ath/ath6kl.txt
```
* Qualcomm Atheros mobile chipsets

Required properties:
    - compatible: Can be "qca,ar6004-sdio" for SDIO device and
    "qca,ar6004-hsic" for HSIC device. For AR6003, "qca,ar6003-sdio" can be
    used.
    - qca,chip-pwd-l-gpios: specify GPIO for CHIP_PWD_L.

Optional Properties:
    - cell-index: WLAN Hardware index.
    - qca,pm-enable-gpios: Specify this GPIO if internal PMU needs to be used.
    - qca,vbatt-supply: Specify this if VBATT is provided through a regulator.
    - qca,vdd-io-supply: Specify this if VDD-IO is provided through a
    regulator.

Example:

	wlan0: qca,wlan {
		cell-index = <0>;
		compatible = "qca,ar6004-sdio";
		qca,chip-pwd-l-gpios = <&msmgpio 62 0>;
		qca,pm-enable-gpios = <&pm8019_gpios 3 0x0>;
		qca,vdd-io-supply = <&pm8019_l11>;
	};
```

## Documentation/devicetree/bindings/net/wireless/qcom,wcn3990-wifi.txt
```
* Qualcomm Technologies, Inc. WCN3990 chipset WLAN platform Driver

This driver adds support for the Integrated WCN3990 WLAN module, WCN3990
is integrated 802.11ac chipset with SNOC bus interface. It also add support
for SNOC bus registration, copy engine configuration for the WCN3990 chipset,
shadow register configuration, create host to target communication interface
to interact with WLAN firmware, WLAN module interface control and data
receive(RX)/transmit(TX) control.

Required properties:
 - compatible: "qcom,wcn3990-wifi";
 - reg: Memory regions defined as starting address and size
 - reg-names: Names of the memory regions defined in reg entry
 - clocks: List of clock phandles
 - clock-names: List of clock names corresponding to the "clocks" property
 - interrupts: Copy engine interrupt table
Optional properties:
  - <supply-name>-supply: phandle to the regulator device tree node
			   optional "supply-name" is "vdd-0.8-cx-mx".
  - qcom,<supply>-config: Specifies voltage levels for supply. Should be
			   specified in pairs (min, max), units uV.  There can
			   be optional load in uA and Regulator settle delay in
			   uS.

Example:
	msm_ath10k_wlan: qcom,msm_ath10k_wlan@18800000 {
		compatible = "qcom,wcn3990-wifi";
		reg = <0x18800000 0x800000>;
		reg-names = "membase";
		clocks = <&clock_gcc clk_aggre2_noc_clk>;
		clock-names = "smmu_aggre2_noc_clk";
		interrupts =
			   <0 130 0 /* CE0 */ >,
			   <0 131 0 /* CE1 */ >,
			   <0 132 0 /* CE2 */ >,
			   <0 133 0 /* CE3 */ >,
			   <0 134 0 /* CE4 */ >,
			   <0 135 0 /* CE5 */ >,
			   <0 136 0 /* CE6 */ >,
			   <0 137 0 /* CE7 */ >,
			   <0 138 0 /* CE8 */ >,
			   <0 139 0 /* CE9 */ >,
			   <0 140 0 /* CE10 */ >,
			   <0 141 0 /* CE11 */ >;
		vdd-0.8-cx-mx-supply = <&pm8998_l5>;
		vdd-1.8-xo-supply = <&pm8998_l7_pin_ctrl>;
		vdd-1.3-rfa-supply = <&pm8998_l17_pin_ctrl>;
		vdd-3.3-ch0-supply = <&pm8998_l25_pin_ctrl>;
		qcom,vdd-0.8-cx-mx-config = <800000 800000>;
		qcom,vdd-3.3-ch0-config = <3104000 3312000>;
	};
```

## Documentation/devicetree/bindings/nfc/nfc-nci.txt
```
Qualcomm QCA199x NFC NCI device

Near Field Communication (NFC) device is based on NFC Controller Interface (NCI)

Required properties:

- compatible: "qcom,nfc-nci"
- reg: NCI i2c slave address.
- qcom,dis-gpio: specific gpio for hardware reset.
- qcom,irq-gpio: specific gpio for read interrupt.
- qcom,clk-src: nfc clock source ("BBCLK2", "RFCLK3", "GPCLK", "GPCLK2", ...)
- interrupt-parent: Should be phandle for the interrupt controller
                    that services interrupts for this device.
- interrupts: Nfc read interrupt,gpio-clk-req interrupt


Recommended properties:

- interrupt-names: names of interupts, should include "nfc_irq", used for reference


Optional properties:

- qcom,pwr-req-gpio: pmic gpio to vote for power to be supplied to the uicc
- qcom,clk-src-gpio: msm gpio clock,used only if clock source is msm gpio
- qcom,clk-req-gpio: clk-req input gpio for MSM based clocks.
                     not used for pmic implementation
- qcom,clk-gpio: pmic or msm gpio on which bbclk2 signal is coming.
- pinctrl-names, pinctrl-0, pincntrl-1: references to our pincntrl settings
- clocks, clock-names: must contain the QCA1990's core clock.

note:
nfc with msm type clock sources (GPCLK and GPCLK 2) require qcom,clk-src-gpio and qcom,clk-req-gpio entries to work propperly.
nfc with pmic type clock sources (BBCLK2 RFCLK3) require the qcom,clk-gpio entry to function properly.
The nfcc needs a core clock supplied in order to respond to nci messages.
The driver currently votes for ref_clk if clock source is set to BBCLK2.  Please ensure the clock indicated by clk-src is defined.


Example:

	nfc-nci@e {
		compatible = "qcom,nfc-nci";
		reg = <0x0e>;
		qcom,irq-gpio = <&msm_gpio 21 0x00>;
		qcom,dis-gpio = <&msm_gpio 20 0x00>;
		qcom,clk-src = "BBCLK2";
		interrupt-parent = <&msm_gpio>;
		interrupts = <21 0>;
		interrupt-names = "nfc_irq";
		pinctrl-names = "nfc_active","nfc_suspend";
		pinctrl-0 = <&nfc_int_active &nfc_disable_active>;
		pinctrl-1 = <&nfc_int_suspend &nfc_disable_suspend>;
		qcom,clk-gpio = <&pm8916_gpios 2 0>;
		clocks = <&clock_rpm clk_bb_clk2_pin>;
		clock-names = "ref_clk";
	};
```

## Documentation/devicetree/bindings/nfc/nq-nci.txt
```
Qualcomm Technologies, Inc NQxxxx NFC NCI device

Near Field Communication (NFC) device is based on NFC Controller Interface (NCI)

Required properties:

- compatible: "qcom,nq-nci"
- reg: NCI i2c slave address.
- qcom,nq-ven: specific gpio for hardware reset.
- qcom,nq-irq: specific gpio for read interrupt.
- qcom,nq-firm: gpio for firmware download
- qcom,nq-clkreq: gpio for clock
- interrupt-parent: Should be phandle for the interrupt controller
                    that services interrupts for this device.
- interrupts: Nfc read interrupt,gpio-clk-req interrupt


Recommended properties:

- interrupt-names: names of interrupts, should include "nfc_irq", used for reference


Optional properties:

- pinctrl-names, pinctrl-0, pincntrl-1: references to our pincntrl settings
- clocks, clock-names: must contain the NQxxxx's core clock.
- qcom,nq-esepwr: gpio to control power of secure element
- qcom,nq-vdd-1p8-supply: name of LDO to which NFC is connected
- qcom,nq-vdd-1p8-voltage: min and max voltage(in uV) requirement for NFC
- qcom,nq-vdd-1p8-current: max current(in uA) expected by NFC
- qcom,clk-src: NFC clock for antenna

Example:

	nq-nci@2b {
		compatible = "qcom,nq-nci";
		reg = <0x2b>;
		qcom,nq-irq = <&tlmm 29 0x00>;
		qcom,nq-ven = <&tlmm 30 0x00>;
		qcom,nq-firm = <&tlmm 93 0x00>;
		qcom,nq-clkreq = <&pm8998_gpios 21 0x00>;
		qcom,nq-esepwr = <&tlmm 116 0x00>;
		qcom,nq-vdd-1p8-supply = <&L11A>;
		qcom,nq-vdd-1p8-voltage = <1800000 1800000>;
		qcom,nq-vdd-1p8-current = <157000>;
		qcom,clk-src = "BBCLK2";
		interrupt-parent = <&tlmm>;
		interrupts = <29 0>;
		interrupt-names = "nfc_irq";
		pinctrl-names = "nfc_active","nfc_suspend";
		pinctrl-0 = <&nfc_int_active &nfc_disable_active>;
		pinctrl-1 = <&nfc_int_suspend &nfc_disable_suspend>;
		clocks = <&clock_rpm clk_bb_clk2_pin>;
		clock-names = "ref_clk";
	};
```

## Documentation/devicetree/bindings/nfc/nq-ntag.txt
```
Qualcomm Technologies, Inc NTx NTAG device

Near Field Communication wireless tag integrated circuit device(NTAG) is compliant
with NFC Forum Type 2 Tag specification.

Required properties:

- compatible: "qcom,nq-ntag"
- reg: i2c slave address.
- pinctrl-names, pinctrl-0, pinctrl-1: references to our pinctrl settings
- qcom,nq-ntagfd : specific gpio for field detect interrupt.

Example:

	nq-ntag@55 {
		compatible = "qcom,nq-ntag";
		reg = <0x55>;
		qcom,nq-ntagfd = <&tlmm 22 0x00>;
		interrupt-parent = <&tlmm>;
		interrupts = <22 0>;
		interrupt-names = "ntag_fd";
		pinctrl-names = "ntag_active","ntag_suspend";
		pinctrl-0 = <&ntag_int_active>;
		pinctrl-1 = <&ntag_int_suspend>;
	};
```

## Documentation/devicetree/bindings/nfc/sn-nci.txt
```
Qualcomm Technologies, Inc SNxxx NFC NCI device

Near Field Communication (NFC) device is based on NFC Controller Interface (NCI)

Required properties:

- compatible: "qcom,sn-nci"
- reg: NCI I2C slave address.
- qcom,sn-ven: specific gpio for hardware reset.
- qcom,sn-irq: specific gpio for read interrupt.
- qcom,sn-firm: gpio for firmware download
- qcom,sn-clkreq: gpio for clock
- interrupt-parent: Should be phandle for the interrupt controller
                    that services interrupts for this device.
- interrupts: Nfc read interrupt,gpio-clk-req interrupt


Recommended properties:

- interrupt-names: names of interrupts, should include "nfc_irq", used for reference


Optional properties:

- pinctrl-names, pinctrl-0, pincntrl-1: references to our pincntrl settings
- clocks, clock-names: must contain the SNxxx's core clock.
- qcom,clk-src: NFC clock for antenna

Example:

	sn-nci@2b {
		compatible = "qcom,sn-nci";
		reg = <0x2b>;
		qcom,sn-irq = <&tlmm 87 0x00>;
		qcom,sn-ven = <&tlmm 62 0x00>;
		qcom,sn-firm = <&tlmm 86 0x00>;
		qcom,sn-clkreq = <&tlmm 63 0x00>;
		qcom,clk-src = "BBCLK2";
		interrupt-parent = <&tlmm>;
		interrupts = <29 0>;
		interrupt-names = "nfc_irq";
		pinctrl-names = "default","sleep";
		pinctrl-0 = <&nfc_enable_active &nfc_fwdl_active
				&nfc_clk_req_active &nfc_int_active>;
		pinctrl-1 = <&nfc_enable_suspend &nfc_fwdl_suspend
				&nfc_clk_req_suspend &nfc_int_suspend>;
		clocks = <&clock_rpm clk_bb_clk2_pin>;
		clock-names = "ref_clk";
		status = "ok";
	};
```

## Documentation/devicetree/bindings/nvidia,imx135.txt
```
NVIDIA Camera sensor imx135 driver interface.

Required properties:
- compatible : The driver is compatible with
	"nvidia,imx135".

- cam1_gpios : Camera GPIO.

- reset_gpios : Reset GPIO.

- af_gpios : AF1 GPIO.

- reg: Should contain I2C slave address of the driver.

- nvidia,ext_reg : For few platforms this driver needs extra power regulators
to be enabled. This bool property indicates the same. It must be programmed
only when imx135 driver needs extra power rails for particular platform.

Example:

	imx135@10 {
		compatible = "nvidia,imx135";
		cam1-gpios = <&gpio 221 0>; /* gpio PBB5 */
		reset-gpios = <&gpio 219 0>; /* gpio PBB3 */
		af-gpios = <&gpio 225 0>; /* gpio PCC1 */
		nvidia,ext_reg; /* Extra power-regulators needed */
		reg = <0x10>;
		status = "okay";
	};
```

## Documentation/devicetree/bindings/nvme/qcom,nvme.txt
```
= NVME(Non Volatile Memory Express) Device Tree Bindings =

Required properties:

- compatible : Must be "qcom,nvme"

If SMMU is present, also use:

- qcom,smmu : if present, SMMU attach is performed
- qcom,smmu-iova-base : SMMU IOVA start address the device can access
- qcom,smmu-iova-size : SMMU IOVA size the device can access

Optional Properties:

- qcom,smmu-attr-s1-bypass : Bypasses SMMU S1 translation
- qcom,smmu-attr-fastmap : Enables SMMU fastmap
- qcom,smmu-attr-atomic : Enables DMA alloc using GFP_ATOMIC
- qcom,smmu-attr-pt-coherent : Use if DMA coherency is available for SMMU page tables


Example:

&pcie_rc0 {

	nvme_x1: qcom,nvme@pcie_rc0 {
		compatible = "qcom,nvme";

		qcom,smmu;
		qcom,smmu-iova-base = /bits/ 64 <0x0>;
		qcom,smmu-iova-size = /bits/ 64 <0x100000000>;

		qcom,smmu-attr-s1-bypass;
	};
};

&pcie_rc1 {

	nvme_x4: qcom,nvme@pcie_rc1 {
		compatible = "qcom,nvme";

		qcom,smmu;
		qcom,smmu-iova-base = /bits/ 64 <0x0>;
		qcom,smmu-iova-size = /bits/ 64 <0x100000000>;

		qcom,smmu-attr-atomic;
		qcom,smmu-attr-fastmap;
		qcom,smmu-attr-pt-coherent;
	};
};
```

## Documentation/devicetree/bindings/nvmem/mt6359-efuse.txt
```
= Mediatek MT6359 PMIC eFuse device tree bindings =

Required properties:
- compatible: Should be
	"mediatek,mt6359-efuse": for MT6359 PMIC
- #address-cells: should be <1>
- #size-cells: should be <1>

= Data cells =
Are child nodes of PMIC eFuse, bindings of which as described in
bindings/nvmem/nvmem.txt

Example:

	pmic_efuse: efuse {
		compatible = "mt6359-efuse";
		#address-cells = <1>;
		#size-cells = <1>;

		/* Data cells */
		accdet_cali: accdet_cali@10 {
			reg = <0x66 0x2>;
		};
	};

= Data consumers =
Are device nodes which consume nvmem data cells or nvmem device directly.

Example:

	thermal {
		...
		nvmem = <&pmic_efuse>;
		nvmem-names = "pmic_efuse_device";
	};

	accdet {
		...
		nvmem-cells = <&accdet_cali>;
		nvmem-cell-names = "calibration";
	};
```
