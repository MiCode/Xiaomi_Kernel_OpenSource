## Documentation/devicetree/bindings/nvmem/sc27xx-efuse.txt
```
= Spreadtrum SC27XX PMIC eFuse device tree bindings =

Required properties:
- compatible: Should be one of the following.
	"sprd,sc2720-efuse"
	"sprd,sc2721-efuse"
	"sprd,sc2723-efuse"
	"sprd,sc2730-efuse"
	"sprd,sc2731-efuse"
	"sprd,ump9620-efuse"
	"sprd,ump9621-efuse"
- reg: Specify the address offset of efuse controller.
- hwlocks: Reference to a phandle of a hwlock provider node.

= Data cells =
Are child nodes of eFuse, bindings of which as described in
bindings/nvmem/nvmem.txt

Example:

	sc2731_pmic: pmic@0 {
		compatible = "sprd,sc2731";
		reg = <0>;
		spi-max-frequency = <26000000>;
		interrupts = <GIC_SPI 31 IRQ_TYPE_LEVEL_HIGH>;
		interrupt-controller;
		#interrupt-cells = <2>;
		#address-cells = <1>;
		#size-cells = <0>;

		efuse@380 {
			compatible = "sprd,sc2731-efuse";
			reg = <0x380>;
			#address-cells = <1>;
			#size-cells = <1>;
			hwlocks = <&hwlock 12>;

			/* Data cells */
			thermal_calib: calib@10 {
				reg = <0x10 0x2>;
			};
		};
	};

= Data consumers =
Are device nodes which consume nvmem data cells.

Example:

	thermal {
		...
		nvmem-cells = <&thermal_calib>;
		nvmem-cell-names = "calibration";
	};

Aliases:
For multi instance eFuses, each eFuse should have a number
similar to efusen (n = 0,1) in the alias node.
The eFuse driver should use "of_alias_get_id()" to retrieve the device ID.

Example:

	aliases {
		pmic_efuse0 = &ump9620_efuse;
		pmic_efuse1 = &ump9621_efuse;
	};

	ump9621_efuse: efuse@800 {
		compatible = "sprd,ump9621-efuse", "sprd,sc27xx-efuse";
		reg = <0x800>;
		#address-cells = <1>;
		#size-cells = <1>;
		hwlocks = <&hwlock 15>;
		/* Data cells */
	};
```

## Documentation/devicetree/bindings/ocmem/msm-ocmem.txt
```
Qualcomm MSM On-Chip Memory Driver

msm-ocmem is a driver for managing On-Chip Memory (OCMEM) in MSM SoCs.
It is responsible for allowing various clients to allocate memory from
OCMEM based on performance, latency and power requirements.

Required Properties:
- compatible:   Must be "qcom,msm-ocmem"
- reg:          Four pairs of physical base addresses and region sizes
                of memory mapped registers.
- reg-names : Register region name(s) referenced in reg above
                "ocmem_ctrl_physical" corresponds to OCMEM control registers.
                "dm_ctrl_physical" corresponds to DM control registers.
                "br_ctrl_physical" corresponds to BR control registers.
                "ocmem_physical" corresponds to address range of OCMEM memory.
- interrupts:   OCMEM core interrupt(s).
- interrupt-names: OCMEM core interrupt name(s) reference in interrupts above
		    "ocmem_irq" corresponds to OCMEM Error Interrupt.
		    "dm_irq" corresponds to DM Interrupt.
- qcom,ocmem-num-regions: The number of OCMEM hardware memory regions.
- qcom,resource-type: The hardware resource type of the OCMEM core.

In addition to the information on the OCMEM core, the
device tree contains additional information describing partitions
of the OCMEM address space. This is used to establish regions
of OCMEM that are used for each potential client. The partitions
can overlap and the OCMEM driver ensures that there is no possibility
of concurrent access from more than one client to the same address range.
This allows the OCMEM driver to maximize the usage of OCMEM at all times.

Each partition is represented as a sub-node of the OCMEM device.

OCMEM partitions

Required Properties:
 - reg : The partition's offset and size within OCMEM.
 - qcom,ocmem-part-name : The name for this partition.
 - qcom,ocmem-part-min: The minimum amount of memory reserved exclusively for
                        this client.
Optional Properties:
 - qcom,ocmem-part-tail : This parameter, if present, indicates that successive
                          allocations from this partition must be allocated at
                          lower offsetis.
Example:

	qcom,ocmem@fdd00000 {
		reg = <0xfdd00000 0x2000>,
		      <0xfdd02000 0x2000>,
		      <0xfe039000 0x400>,
		      <0xfec00000 0x180000>;
		reg-names = "ocmem_ctrl_physical", "dm_ctrl_physical", "br_ctrl_physical", "ocmem_physical";
		interrupts = <0 76 0 0 77 0>;
		interrupt-names = "ocmem_irq", "dm_irq";
		qcom,ocmem-num-regions = <0x3>;
		qcom,resource-type = <0x706d636f>
		#address-cells = <1>;
		#size-cells = <1>;
		ranges = <0x0 0xfec00000 0x180000>;

		partition@0 {
			reg = <0x0 0x100000>;
			qcom,ocmem-part-name = "graphics";
			qcom,ocmem-part-min = <0x80000>;
		};

		partition@100000 {
			reg = <0x100000 0x80000>;
			qcom,ocmem-part-name = "video";
			qcom,ocmem-part-min = <0x55000>;
		};

	};
```

## Documentation/devicetree/bindings/pci/mediatek-pci.txt
```
* Mediatek PCIe controller

Mandatory properties:
- compatible: Must be "mediatek,pcie"
- reg: specifies the physical base address and length of
  PCIe controller register
- interrupts: GIC interrupt lines connected to INTx or MSI
- bus-range: PCI bus numbers covered
- #address-cells: set to <3>
- #size-cells: set to <2>
- ranges: describes the translation of addresses for root ports
  and standard PCI regions

Moreover, the device tree node have sub-nodes to define each
PCIe interface. The properties of sub-node:
- device_type: Must be "pci"
- reg: used only for interrupt mapping, so only the first four bytes
  are used to refer to the correct bus number and device number
- #address-cells: set to <3>
- #size-cells: set to <2>
- ranges: sub-ranges distributed from the PCIe controller node
- interrupt-map-mask, interrupt-map: standard PCI properties
  to define the mapping of the PCIe interface to interrupt numbers
- pcie-port: the physical PCIe port number
- num-lanes: number of lanes to use
- phys: phandle of the PCIe PHY device
- phy-names: Must be "pcie-phy0", "pcie-phy1", "pcie-phyN".. based on the
  number of PHYs as specified in *phys* property
- status: either "ok" or "disabled"
- pcie_intc#: Interrupt controller device node

PCIe controller may needs to adjust PHY settings through PHY device node,
having the following mandatory properties:
- compatible: Must be "mediatek,pcie-phy"
- reg: specifies the physical base address and length of
  PCIe PHY register
- #phy-cells: set to <0>

Example:

	pcie@0x1a143000 {
		compatible = "mediatek,pcie";
		device_type = "pci";
		reg = <0 0x1a143000 0 0x2000
			0 0x1a145000 0 0x2000>;
		interrupts = <GIC_SPI 228 IRQ_TYPE_LEVEL_LOW
			      GIC_SPI 229 IRQ_TYPE_LEVEL_LOW>;
		bus-range = <0x00 0xff>;
		#address-cells = <3>;
		#size-cells = <2>;
		ranges = <0x82000000 0 0x20000000  0x0 0x20000000  0 0x02000000>;

		pcie0: pcie@1,0 {
			device_type = "pci";
			reg = <0x0800 0 0 0 0>;
			#address-cells = <3>;
			#size-cells = <2>;
			#interrupt-cells = <1>;
			ranges;
			interrupt-map-mask = <0 0 0 7>;
			interrupt-map = <0 0 0 1 &pcie_intc0 1>,
					<0 0 0 2 &pcie_intc0 2>,
					<0 0 0 3 &pcie_intc0 3>,
					<0 0 0 4 &pcie_intc0 4>;
			pcie-port = <0>;
			num-lanes = <1>;
			phys = <&pcie0_phy>;
			phy-names = "pcie-phy0";
			status = "okay";
			pcie_intc0: interrupt-controller {
				interrupt-controller;
				#address-cells = <0>;
				#interrupt-cells = <1>;
			};
		};

		pcie1: pcie@2,0 {
			device_type = "pci";
			reg = <0x1000 0 0 0 0>;
			#address-cells = <3>;
			#size-cells = <2>;
			#interrupt-cells = <1>;
			ranges;
			interrupt-map-mask = <0 0 0 7>;
			interrupt-map = <0 0 0 1 &pcie_intc1 1>,
					<0 0 0 2 &pcie_intc1 2>,
					<0 0 0 3 &pcie_intc1 3>,
					<0 0 0 4 &pcie_intc1 4>;
			pcie-port = <1>;
			num-lanes = <1>;
			phys = <&pcie1_phy>;
			phy-names = "pcie-phy1";
			status = "okay";
			pcie_intc1: interrupt-controller {
				interrupt-controller;
				#address-cells = <0>;
				#interrupt-cells = <1>;
			};
		};
	};

	pcie0_phy: pciephy@0x1a147000 {
		compatible = "mediatek,pcie-phy";
		reg = <0 0x1a147000 0 0x0800>;
		#phy-cells = <0>;
	};

	pcie1_phy: pciephy@0x1a147800 {
		compatible = "mediatek,pcie-phy";
		reg = <0 0x1a147800 0 0x0800>;
		#phy-cells = <0>;
	};
```

## Documentation/devicetree/bindings/pci/msm_ep_pcie.txt
```
MSM PCI express endpoint

Required properties:
  - compatible: should be "qcom,pcie-ep".
  - reg: should contain PCIe register maps.
  - reg-names: indicates various resources passed to driver by name.
		Should be "msi", "dm_core", "elbi", "parf", "phy", "mmio",
		"tcsr_pcie_perst_en".
		These correspond to different modules within the PCIe domain.
  - #address-cells: Should provide a value of 0.
  - interrupt-parent: Should be the PCIe device node itself here.
  - interrupts: Should be in the format <0 1 2> and it is an index to the
		interrupt-map that contains PCIe related interrupts.
  - #interrupt-cells: Should provide a value of 1.
  - #interrupt-map-mask: should provide a value of 0xffffffff.
  - interrupt-map:  Must create mapping for the number of interrupts
		    that are defined in above interrupts property.
		    For PCIe device node, it should define 6 mappings for
		    the corresponding PCIe interrupts supporting the
		    specification.
  - interrupt-names: indicates interrupts passed to driver by name.
		     Should be "int_pm_turnoff", "int_dstate_change",
				"int_l1sub_timeout", "int_link_up",
				"int_link_down", "int_bridge_flush_n".
  - perst-gpio: PERST GPIO specified by PCIe spec.
  - wake-gpio: WAKE GPIO specified by PCIe spec.
  - clkreq-gpio: CLKREQ GPIO specified by PCIe spec.
  - <supply-name>-supply: phandle to the regulator device tree node.
    Refer to the schematics for the corresponding voltage regulators.
    vreg-1.8-supply: phandle to the analog supply for the PCIe controller.
    vreg-0.9-supply: phandle to the analog supply for the PCIe controller.

Optional Properties:
  - qcom,<supply-name>-voltage-level: specifies voltage levels for supply.
    Should be specified in pairs (max, min, optimal), units uV.
  - clock-names: list of names of clock inputs.
		     Should be "pcie_pipe_clk",
				"pcie_aux_clk", "pcie_cfg_ahb_clk",
				"pcie_mstr_axi_clk", "pcie_slv_axi_clk",
				"pcie_ldo";
  - max-clock-frequency-hz: list of the maximum operating frequencies stored
				in the same order of clock names;
  - resets: reset specifier pair consists of phandle for the reset controller
    and reset lines used by this controller.
  - reset-names: reset signal names sorted in the same order as the property
    of resets.
  - qcom,pcie-phy-ver: version of PCIe PHY.
  - qcom,phy-init: The initialization sequence to bring up the PCIe PHY.
    Should be specified in groups (offset, value, delay, direction).
  - qcom,phy-status-reg: Register offset for PHY status.
  - qcom,phy-status-reg2: For sdxprairie and above use only
    qcom,phy-status-reg2 as register offset for PHY status.
  - qcom,dbi-base-reg: Register offset for DBI base address.
  - qcom,slv-space-reg: Register offset for slave address space size.
  - qcom,pcie-vendor-id: Vendor id to be written to the Vendor ID register.
  - qcom,pcie-device-id: Device id to be written to the Device ID register.
  - qcom,pcie-link-speed: generation of PCIe link speed. The value could be
    1, 2 or 3.
  - qcom,pcie-active-config: boolean type; active configuration of PCIe
    addressing.
  - qcom,pcie-edma: boolean type; edma usage for PCIe.
  - qcom,pcie-aggregated-irq: boolean type; interrupts are aggregated.
  - qcom,pcie-mhi-a7-irq: boolean type; MHI a7 has separate irq.
  - qcom,pcie-perst-enum: Link enumeration will be triggered by PERST
    deassertion.
  - qcom,tcsr-not-supported: TCSR pcie perst is not supported.
  - mdm2apstatus-gpio: GPIO used by PCIe endpoint side to notify the host side.
  - Refer to "Documentation/devicetree/bindings/arm/msm/msm_bus.txt" for
    below optional properties:
	- qcom,msm-bus,name
	- qcom,msm-bus,num-cases
	- qcom,msm-bus,num-paths
	- qcom,msm-bus,vectors-KBps
  - qcom,pcie-m2-autonomous: Enable L1ss sleep/exit to support M2 autonomous mode.
  - qcom,mhi-soc-reset-offset: AXI register offset to initiate a SOC reset.

Example:

	pcie_ep: qcom,pcie@bfffd000 {
		compatible = "qcom,pcie-ep";

		reg = <0xbfffd000 0x1000>,
			<0xbfffe000 0x1000>,
			<0xbffff000 0x1000>,
			<0xfc520000 0x2000>,
			<0xfc526000 0x1000>,
			<0xfc527000 0x1000>,
			<0x01fcb000 0x1000>;

		reg-names = "msi", "dm_core", "elbi", "parf", "phy", "mmio",
				"tcsr_pcie_perst";

		#address-cells = <0>;
		interrupt-parent = <&pcie_ep>;
		interrupts = <0 1 2 3 4 5>;
		#interrupt-cells = <1>;
		interrupt-map-mask = <0xffffffff>;
		interrupt-map = <0 &intc 0 44 0
				1 &intc 0 46 0
				2 &intc 0 47 0
				3 &intc 0 50 0
				4 &intc 0 51 0
				5 &intc 0 52 0>;
		interrupt-names = "int_pm_turnoff", "int_dstate_change",
				"int_l1sub_timeout", "int_link_up",
				"int_link_down", "int_bridge_flush_n";

		perst-gpio = <&msmgpio 65 0>;
		wake-gpio = <&msmgpio 61 0>;
		clkreq-gpio = <&msmgpio 64 0>;
		mdm2apstatus-gpio = <&tlmm_pinmux 16 0>;

		gdsc-vdd-supply = <&gdsc_pcie_0>;
		vreg-1.8-supply = <&pmd9635_l8>;
		vreg-0.9-supply = <&pmd9635_l4>;

		qcom,vreg-1.8-voltage-level = <1800000 1800000 1000>;
		qcom,vreg-0.9-voltage-level = <950000 950000 24000>;

		clock-names = "pcie_pipe_clk",
				"pcie_aux_clk", "pcie_cfg_ahb_clk",
				"pcie_mstr_axi_clk", "pcie_slv_axi_clk",
				"pcie_ldo";
		max-clock-frequency-hz = <62500000>, <1000000>,
						<0>, <0>, <0>, <0>;

		resets = <&clock_gcc GCC_PCIE_BCR>,
			<&clock_gcc GCC_PCIE_PHY_BCR>;

		reset-names = "pcie_core_reset", "pcie_phy_reset";

		qcom,msm-bus,name = "pcie-ep";
		qcom,msm-bus,num-cases = <2>;
		qcom,msm-bus,num-paths = <1>;
		qcom,msm-bus,vectors-KBps =
				<45 512 0 0>,
				<45 512 500 800>;

		qcom,pcie-link-speed = <1>;
		qcom,pcie-active-config;
		qcom,pcie-aggregated-irq;
		qcom,pcie-mhi-a7-irq;
		qcom,pcie-perst-enum;
		qcom,phy-status-reg = <0x728>;
		qcom,dbi-base-reg = <0x168>;
		qcom,slv-space-reg = <0x16c>;

		qcom,phy-init = <0x604 0x03 0x0 0x1
					0x048 0x08 0x0 0x1
					0x64c 0x4d 0x0 0x1
					0x600 0x00 0x0 0x1
					0x608 0x03 0x0 0x1>;
	};
```
