## Documentation/devicetree/bindings/iommu/google,s2mpu.yaml
```yaml
# SPDX-License-Identifier: (GPL-2.0-only OR BSD-2-Clause)
%YAML 1.2
---
$id: http://devicetree.org/schemas/iommu/google,s2mpu.yaml#
$schema: http://devicetree.org/meta-schemas/core.yaml#

title: S2MPU device tree bindings

maintainers:
  - David Brazdil <dbrazdil@google.com>

properties:
  reg:
    maxItems: 1

  compatible:
    contains:
      const: google,s2mpu

  power-domain-id:
    $ref: /schemas/types.yaml#/definitions/uint32
    description:
      ID of the power domain that the S2MPU belongs to. If not specified,
      the device is assumed to be always powered.

required:
  - compatible
  - reg

additionalProperties: true
```

## Documentation/devicetree/bindings/iommu/iommu-debug.txt
```
This document describes the device tree binding for IOMMU test devices.

The iommu-debug framework can optionally make use of some platform devices
for improved standalone testing and other features.

- compatible: iommu-debug-test


Required properties
===================

- iommus: The IOMMU for the test device (see iommu.txt)


Example
=======

	iommu_test_device {
		compatible = "iommu-debug-test";
		/*
		 * 42 shouldn't be used by anyone on the cpp_fd_smmu.  We just
		 * need _something_ here to get this node recognized by the
		 * SMMU driver. Our test uses ATOS, which doesn't use SIDs
		 * anyways, so using a dummy value is ok.
		 */
		iommus = <&cpp_fd_smmu 42>;
	};
```

## Documentation/devicetree/bindings/iommu/msm_iommu.txt
```
* Qualcomm MSM IOMMU

Required properties:
- compatible : one of:
	- "qcom,msm-smmu-v2"
- reg : offset and length of the register set for the device.

- List of sub nodes, one for each of the translation context banks supported.
  Each sub node has the following required properties:

  - reg : offset and length of the register set for the context bank.
  - interrupts : should contain the context bank interrupt.
  - qcom,iommu-ctx-sids : List of stream identifiers associated with this
    translation context.
  - label : Name of the context bank
  - qcom,iommu-smt-size : Number of SMR entries in the SMT of this HW block
  - vdd-supply : vdd-supply: phandle to GDSC regulator controlling this IOMMU.

Optional properties:
- qcom,needs-alt-core-clk : boolean to enable the secondary core clock for
  access to the IOMMU configuration registers

Example:

        qcom,iommu@fda64000 {
                compatible = "qcom,msm-smmu-v2";
                reg = <0xfda64000 0x10000>;
		vdd-supply = <&gdsc_iommu>;

                qcom,iommu-ctx@fda6c000 {
                        reg = <0xfda6c000 0x1000>;
                        interrupts = <0 70 0>;
                        qcom,iommu-ctx-sids = <0 2>;
			label = "ctx_0";
                };
                qcom,iommu-ctx@fda6d000 {
                        reg = <0xfda6d000 0x1000>;
                        interrupts = <0 71 0>;
                        qcom,iommu-ctx-sids = <1>;
			label = "ctx_1";
                };
        };
```

## Documentation/devicetree/bindings/iommu/msm_iommu_v0.txt
```
* Qualcomm MSM IOMMU v0

Required properties:
- compatible : one of:
	- "qcom,msm-smmu-v0"
- reg : offset and length of the register set for the device.
- qcom,glb-offset : Offset for the global register base.

Optional properties:
- interrupts : should contain the performance monitor overflow interrupt number.
- qcom,iommu-pmu-ngroups: Number of Performance Monitor Unit (PMU) groups.
- qcom,iommu-pmu-ncounters: Number of PMU counters per group.
- qcom,iommu-pmu-event-classes: List of event classes supported.
- qcom,needs-alt-core-clk : boolean to enable the secondary core clock for
  access to the IOMMU configuration registers
- Bus scaling properties: See msm_bus.txt
- qcom,msm-enable-remote-spinlock : boolean to enable use of remote spinlock

- List of sub nodes, one for each of the translation context banks supported.
    Required properties for each sub-node:

    - compatible : "qcom,msm-smmu-v0-ctx"
    - reg : offset and length of the register set for the context bank.
    - interrupts : should contain the context bank interrupt.
    - qcom,iommu-ctx-mids : List of machine identifiers associated with this
      translation context.
    - label : Name of the context bank

    Optional properties for each sub-node:
    - none

Example:

	qcom,iommu@fd000000 {
		compatible = "qcom,msm-smmu-v0";
		#address-cells = <1>;
		#size-cells = <1>;
		ranges;
		reg = <0xfd890000 0x10000>;
		qcom,glb-offset = <0xF000>;
		interrupts = <0 38 0>;
		qcom,iommu-pmu-ngroups = <1>;
		qcom,iommu-pmu-ncounters = <4>;
		qcom,iommu-pmu-event-classes = <0x08
						0x11>;

		qcom,iommu-ctx@fd000000 {
			compatible = "qcom,msm-smmu-v0-ctx";
			reg = <0xfd000000 0x1000>;
			interrupts = <0 250 0>;
			qcom,iommu-ctx-mids = <0 3>;
			label = "a_label";
		};
```

## Documentation/devicetree/bindings/iommu/msm_iommu_v1.txt
```
* Qualcomm MSM IOMMU v1

Required properties:
- compatible : one of:
	- "qcom,msm-smmu-v1"
	- "qcom,msm-smmu-v2"
	- "qcom,msm-mmu-500"
- reg : - offset and length of the register set for the device.
	- Optional offset and length for clock register for additional clock that
	needs to be turned on for access to this IOMMU.
	- Optional offset and length for enabling aggregated Context bank
	interrupts
- reg-names: "iommu_base", "clk_base" (optional), "smmu_local_base" (optional)
- label: name of this IOMMU instance.

Optional properties:
- qcom,iommu-secure-id : Secure identifier for the IOMMU block
- qcom,secure-context : boolean indicating that a context is secure and
  programmed by the secure environment.
- qcom,vdd-supply: Regulator needed to access IOMMU
- qcom,alt-vdd-supply : Alternative regulator needed to access IOMMU
  configuration registers.
- interrupts : Interrupt numbers for permormance and global fault interrupts
- interrupt-names: Refers to the interrupts number mentioned above.
	"pmon" : the performance monitor overflow interrupt number
	"global_cfg_NS_irq" : the global config non-secure interrupt number
	"global_client_NS_irq" : the global client non-secure interrupt number
	"global_cfg_S_irq" : the global config secure interrupt number
	"global_client_S_irq" : the global client secure interrupt number
- qcom,iommu-enable-halt : Enable halt of the IOMMU before programming certain	19
  registers
- qcom,iommu-pmu-ngroups: Number of Performance Monitor Unit (PMU) groups.
- qcom,iommu-pmu-ncounters: Number of PMU counters per group.
- qcom,iommu-pmu-event-classes: List of event classes supported.
- Bus scaling properties: See msm_bus.txt
- qcom,cb-base-offset: context bank 0's base address from global base address

- List of sub nodes, one for each of the translation context banks supported.
  Each sub node has the following required properties:

  - compatible : "qcom,msm-smmu-v1-ctx"
  - reg : offset and length of the register set for the context bank.
  - interrupts : should contain the context bank interrupt. If this is
    a secure context bank, this should be a list of 2 3-tuples where
    the first is the non-secure interrupt, and the second is the
    secure interrupt.
  - qcom,iommu-ctx-sids : List of stream identifiers associated with this
    translation context.
  - label : Name of the context bank
  - vdd-supply : vdd-supply: phandle to GDSC regulator controlling this IOMMU.

Optional properties:
- qcom,needs-alt-core-clk : boolean to enable the secondary core clock for
  access to the IOMMU configuration registers
- qcom,needs-alt-iface-clk : boolean to enable the secondary iface clock for
  access to the IOMMU configuration registers
- qcom,iommu-bfb-regs : An array of unsigned 32-bit integers corresponding to
  BFB register addresses that need to be configured for performance tuning
  purposes. If this property is present, the qcom,iommu-bfb-data must also be
  present. Register addresses are specified as an offset from the base of the
  IOMMU hardware block. This property may be omitted if no BFB register
  configuration needs to be done for a particular IOMMU hardware instance. The
  registers specified by this property shall fall within the IOMMU
  implementation-defined register region.
- qcom,iommu-bfb-data : An array of unsigned 32-bit integers representing the
  values to be programmed into the corresponding registers given by the
  qcom,iommu-bfb-regs property. If this property is present, the
  qcom,iommu-bfb-regs property shall also be present, and the lengths of both
  properties shall be the same.
- qcom,iommu-lpae-bfb-regs : See description for qcom,iommu-bfb-regs. This is
  the same property except this is for IOMMU with LPAE support.
- qcom,iommu-lpae-bfb-data : See description for qcom,iommu-bfb-data. This is
  the same property except this is for IOMMU with LPAE support.

Example:

	qcom,iommu@fda64000 {
		compatible = "qcom,msm-smmu-v1";
		reg = <0xfda64000 0x10000>;
		reg-names = "iommu_base";
		vdd-supply = <&gdsc_iommu>;
		qcom,iommu-bfb-regs = <0x204c 0x2050>;
		qcom,iommu-bfb-data = <0xffff 0xffce>;
		label = "iommu_0";
		qcom,iommu-pmu-ngroups = <1>;
		qcom,iommu-pmu-ncounters = <8>;
		qcom,iommu-pmu-event-classes = <0x00,
						0x01>;

		qcom,iommu-ctx@fda6c000 {
			compatible = "qcom,msm-smmu-v1-ctx";
			reg = <0xfda6c000 0x1000>;
			interrupts = <0 70 0>;
			qcom,iommu-ctx-sids = <0 2>;
			label = "ctx_0";
		};
		qcom,iommu-ctx@fda6d000 {
			compatible = "qcom,msm-smmu-v1-ctx";
			reg = <0xfda6d000 0x1000>;
			interrupts = <0 71 0>;
			qcom,iommu-ctx-sids = <1>;
			label = "ctx_1";
		};
	};
```

## Documentation/devicetree/bindings/leds/Nxp-ledseg.txt
```
NXP LED segment driver devicetree bindings

Required properties:

 - compatible               : "nxp,pca9956b" for PCA9956b
 - nxp,mode1                : MODE1 register
 - nxp,mode2                : MODE2 register
 - nxp,ledout0~5            : LED output state registers
 - nxp,defaultiref          : LED output gain control default value

LED sub-node properties:
 - reg: number of LED line, 0 to 24
 - label: (optional) name of LED
 - linux,default-trigger : (optional)

Example:
pca9956b {
	/* I2C version */
	reg = <0x7d>;

	/* nxp-ledseg properties */

	compatible    = "nxp,pca9956b";

	pinctrl-names = "default";
	pinctrl-0     = <&pca9956b_pins>;

	pca9956b,support_initialize = <1>;
	pca9956b,mode1 = <0x09>;
	pca9956b,mode2 = <0x05>;

	pca9956b,ledout0 = <0xaa>;
	pca9956b,ledout1 = <0xaa>;
	pca9956b,ledout2 = <0xaa>;
	pca9956b,ledout3 = <0xff>;
	pca9956b,ledout4 = <0xff>;
	pca9956b,ledout5 = <0xff>;
	pca9956b,defaultiref = <0x2f>;

	out0@0 {
		label = "ledsec1_b";
		reg = <0x0>;
	};

	out1@1 {
		label = "ledsec1_g";
		reg = <0x1>;
	};

	out5@5 {
		label = "ledsec1_g";
		reg = <0x5>;
		linux,default_trigger = "heartbeat";
	};
};
```
