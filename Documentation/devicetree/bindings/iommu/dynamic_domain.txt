## Documentation/devicetree/bindings/mailbox/mtk-gce.txt
```
MediaTek GCE
===============

The Global Command Engine (GCE) is used to help read/write registers with
critical time limitation, such as updating display configuration during the
vblank. The GCE can be used to implement the Command Queue (CMDQ) driver.

CMDQ driver uses mailbox framework for communication. Please refer to
mailbox.txt for generic information about mailbox device-tree bindings.

Required properties:
- compatible: Must be "mediatek,mt8173-gce"
- reg: Address range of the GCE unit
- interrupts: The interrupt signal from the GCE block
- clock: Clocks according to the common clock binding
- clock-names: Must be "gce" to stand for GCE clock
- #mbox-cells: Should be 2

Required properties for a client device:
- mboxes: client use mailbox to communicate with GCE, it should have this
  property and list of phandle, mailbox channel specifiers, and atomic
  execution flag.

Example:

	gce: gce@10212000 {
		compatible = "mediatek,mt8173-gce";
		reg = <0 0x10212000 0 0x1000>;
		interrupts = <GIC_SPI 135 IRQ_TYPE_LEVEL_LOW>;
		clocks = <&infracfg CLK_INFRA_GCE>;
		clock-names = "gce";

		#mbox-cells = <2>;
	};

Example for a client device:

	mmsys: clock-controller@14000000 {
		compatible = "mediatek,mt8173-mmsys";
		mboxes = <&gce 0 1 /* main display with atomic execution */
			  &gce 1 1>; /* sub display with atomic execution */
		...
	};
```

## Documentation/devicetree/bindings/mailbox/qcom-tcs.txt
```
TCS Mailbox:
------------

Trigger Command Set (TCS) is the mailbox mechanism for communicating with
the hardened resource accelerators. Requests to the resources can be written
to the mailbox registers and using a (addr, val) pair and triggered. Messages
in the mailbox are then sent in sequence over an internal bus.

The implementation of the TCS mailbox, follows the mailbox controller
architecture [1]. The logical block (DRV) is a part of the h/w entity
(Resource State Coordinator a.k.a RSC) that can handle a multiple sleep and
active/wake resource request related functionality including the mailbox.
Multiple such DRVs can exist in a SoC and can be written to from Linux. The
structure of each DRV follows the same template with a few variations that are
captured by the properties here.

Each DRV could have 'm' TCS instances. Each TCS could have 'n' slots. Each
slot has a header (u32), address (u32), data (u32), status (u32) and a
read-response (u32). A TCS when triggered will send all the enabled commands
of the 'n' commands in that slot in sequence.

A TCS may be triggered from Linux or triggered by the F/W after all the CPUs
have powered off to faciliate idle power saving. TCS could be classified as -

	SLEEP,  /* Triggered by F/W and not by Linux */
	WAKE,   /* Triggered by F/W, may be used by Linux */
	ACTIVE, /* Triggered by Linux */
	CONTROL /* Triggered by F/W */

Requests can be made for the state of a resource, when the subsystem is active
or idle. When all subsystems like Modem, GPU, CPU are idle, the resource state
will be an aggregeate of the sleep votes from each of those subsystem. Drivers
may request a sleep value for their shared resources in addition to the active
mode requests.

Control requests are instance specific requests that may or may not reach an
accelerator. Only one platform device in Linux can request a control channel
on a DRV.

CONTROLLER:
----------

PROPERTIES:

- compatible:
	Usage: required
	Value type: <string>
	Definition: Should be "qcom,tcs-drv".

- reg:
	Usage: required
	Value type: <prop-encoded-array>
	Definition: the first element specifies the base address of the DRV,
	            the second element specifies the size of the region.

- #mbox-cells:
	Usage: required
	Value type: <u32>
	Definition: the number of mail-box cells. Must be 1.

- interrupts:
	Usage: required
	Value type: <prop-encoded-interrupt>
	Definition: the interrupt that trips when a message complete/response
	           is received for this DRV from the accelertors.

- qcom,drv-id:
	Usage: required
	Value type: <u32>
	Definition: the id of the DRV in the RSC block.

- qcom, tcs-config:
	Usage: required
	Value type: <prop-encoded-array>
	Definition: the tuple definining the configuration of TCS.
	            Must have 2 cells which describe each TCS type.
	            <type number_of_tcs>
	- Cell #1 (TCS Type): Only the TCS types can be specified -
		SLEEP_TCS
		WAKE_TCS
		ACTIVE_TCS
		CONTROL_TCS
	- Cell #2 (Number of TCS): <u32>
- label:
	Usage: optional
	Value type: <string>
	Definition: Name for the mailbox. The name would be used in trace logs.

EXAMPLE 1:

For a TCS whose RSC base address is is 0x179C0000 and is at a DRV of 2, the
register offsets for DRV2 start at 0D00, the register calculations are like
this -
First tuple: 0x179C0000 + 0x10000 * 2 = 0x179E0000
Second tuple: 0x179E0000 + 0xD00  = 0x179E0D00

	apps_rsc: mailbox@179e000 {
		compatible = "qcom,tcs_drv";
		label = "apps_rsc";
		reg = <0x179E0000 0x10000>, <0x179E0D00 0x3000>;
		interrupts = <0 5 0>;
		#mbox-cells = <1>;
		qcom,drv-id = <2>;
		qcom,tcs-config = <SLEEP_TCS   3>,
				  <WAKE_TCS    3>,
				  <ACTIVE_TCS  2>,
				  <CONTROL_TCS 1>;
	};

EXAMPLE 2:

For a TCS whose RSC base address is 0xAF20000 and is at DRV of 0, the register
offsets for DRV0 start at 01C00, the register calculations are like this -
First tuple: 0xAF20000
Second tuple: 0xAF20000 + 0x1C00

	disp_rsc: mailbox@af20000 {
		status = "disabled";
		label = "disp_rsc";
		compatible = "qcom,tcs-drv";
		reg = <0xAF20000 0x10000>, <0xAF21C00 0x3000>;
		interrupts = <0 129 0>;
		#mbox-cells = <1>;
		qcom,drv-id = <0>;
		qcom,tcs-config = <SLEEP_TCS 1>,
				<WAKE_TCS    1>,
				<ACTIVE_TCS  0>,
				<CONTROL_TCS 1>;
	};


CLIENT:
-------

A device needing to communicate with the accelerators should specify the
common mailbox client properties described in [1]. mbox-names can be used to
provide a string name optionally for driver to lookup by name.

- mboxes:
	Usage: required, if the device wants to communicate with the mailbox
	Value type: <prop-encoded-array>
	Definition: The tuple has an handle to the mailbox instance the client
	            as the first argument, the second argument must be 0. This
		    is one per MBOX controller addressed.

EXAMPLE:

	leaky_device@0 {
		<...>;
		mbox-names = <"leaky-channel">;
		mboxes = <&tcs_box 0>;
	};

	leaky_device@1 {
		<...>;
		mbox-names = <"apps", "display">;
		mboxes = <&tcs_box 0>, <&dsp_box 0>;
	};

	power_ctrl@0 {
		<...>;
		mbox-names = <"rpmh">;
		mboxes = <&tcs_box 0>;
	};

[1]. Documentation/mailbox.txt
```

## Documentation/devicetree/bindings/mcd/mcd.txt
```
* MCD (MobiCore Driver)

t-base is an operating system running in the secure world (TrustZone).
The t-base implementation consists of several components in the
secure world and the non-secure world (kernel and user space). The
MobiCore driver communicates with the t-base operating system that
exists in TrustZone.

Required properties:
  - compatible: Should be "qcom,mcd"
  - qcom,ce-hw-instance: should contain crypto HW instance
  - qcom,ce-device: Device number
  - clocks: Array of <clock_controller_phandle clock_reference> listing
            all the clocks that are accesed by this subsystem.
  - qcom,ce-opp-freq: indicates the CE operating frequency in Hz, changes from target to target.

Example:
	mcd {
		compatible = "qcom,mcd";
		qcom,ce-hw-instance = <0>;
		qcom,ce-device = <0>;
		clocks = <&clock_gcc clk_crypto_clk_src>,
			 <&clock_gcc clk_gcc_crypto_clk>,
			 <&clock_gcc clk_gcc_crypto_ahb_clk>,
			 <&clock_gcc clk_gcc_crypto_axi_clk>;
		clock-names = "core_clk_src", "core_clk",
				"iface_clk", "bus_clk";
		qcom,ce-opp-freq = <100000000>;
	};
```

## Documentation/devicetree/bindings/media/camera/msm-cam-csiphy.txt
```
* Qualcomm Technologies, Inc. MSM CSI Phy

=======================
Required Node Structure
=======================
The camera CSIPHY node must be described in First level of device nodes. The
first level describe the overall CSIPHY node structure.

======================================
First Level Node - CSIPHY device
======================================

- compatible
  Usage: required
  Value type: <string>
  Definition: Should be "qcom,csiphy-v1.0",
	"qcom,csiphy-v1.1", "qcom,csiphy-v1.2", "qcom,csiphy-v1.2.1",
	"qcom,csiphy-v1.2.2", "qcom,csiphy-v2.0", "qcom,csiphy".

- cell-index: csiphy hardware core index
  Usage: required
  Value type: <u32>
  Definition: Should specify the Hardware index id.

- reg
  Usage: required
  Value type: <u32>
  Definition: offset and length of the register set
	for the device for the csiphy operating in
	compatible mode.

- reg-names
  Usage: required
  Value type: <string>
  Definition: Should specify relevant names to each
	reg property defined.

- reg-cam-base
  Usage: required
  Value type: <string>
  Definition: offset of CSIPHY in  camera hw block

- interrupts
  Usage: required
  Value type: <u32>
  Definition: Interrupt associated with CCI HW.

- interrupt-names
  Usage: required
  Value type: <string>
  Definition: Name of the interrupt.

- clock-names
  Usage: required
  Value type: <string>
  Definition: List of clock names required for CSIPHY HW.

- clock-rates
  Usage: required
  Value type: <u32>
  Definition: List of clock rates in Hz for CSIPHY HW.

- clock-cntl-level
  Usage: required
  Value type: <string>
  Definition: All different clock level node can support.

- clocks
  Usage: required
  Value type: <phandle>
  Definition: all clock phandle and source clocks.

- regulator-names
  Usage: required
  Value type: <string>
  Definition: name of the voltage regulators required for the device.

- gdscr-supply
  Usage: required
  Value type: <phandle>
  Definition: should contain gdsr regulator used for CSIPHY clocks.

- mipi-csi-vdd-supply
  Usage: required
  Value type: <phandle>
  Definition: should contain phandle for mipi-csi-vdd regulator used for
	CSIPHY device.

- csi-vdd-voltage
  Usage: required
  Value type: <u32>
  Definition: should contain required voltage for csi-vdd supply for CSIPHY.

Example:

qcom,csiphy@ac65000 {
     cell-index = <0>;
     compatible = "qcom,csiphy-v1.0", "qcom,csiphy";
     reg = <0xac65000 0x200>;
     reg-cam-base = <0x65000>;
     reg-names = "csiphy";
     interrupts = <0 477 0>;
     interrupt-names = "csiphy";
     regulator-names = "gdscr", "refgen";
     mipi-csi-vdd-supply = <&pm8998_l1>;
     csi-vdd-voltage = <1200000>;
     gdscr-supply = <&titan_top_gdsc>;
     clocks = <&clock_camcc CAM_CC_CPHY_RX_CLK_SRC>,
              <&clock_camcc CAM_CC_CSIPHY0_CLK>,
              <&clock_camcc CAM_CC_CSI0PHYTIMER_CLK_SRC>,
              <&clock_camcc CAM_CC_CSI0PHYTIMER_CLK>;
     clock-names = "cphy_rx_clk_src", "csiphy0_clk",
              "csi0phytimer_clk_src", "csi0phytimer_clk";
     clock-rates = <400000000 0 300000000 0>;
     clock-cntl-level = "turbo";
     status = "ok";
};
```

## Documentation/devicetree/bindings/media/camera/msm-cam-custom-hw.txt
```
* Qualcomm Technologies, Inc. MSM Camera Custom HW

Camera Custom device provides the definitions for enabling
the custom hardware. It also provides the functions for the client
to control the Custom hardware.

=======================
Required Node Structure
=======================
The Custom device is described in one level of the device node.

======================================
First Level Node - CAM Custom device
======================================
Required properties:
- compatible
  Usage: required
  Value type: <string>
  Definition: Should specify the compatibility string for matching the
	driver. e.g. "qcom,cam_custom_hw_sub_mod".

Example:

	qcom,cam-custom-hw {
		compatible = "qcom,cam_custom_hw_sub_mod";
		arch-compat = "custom";
		status = "ok";
	};
```

## Documentation/devicetree/bindings/media/camera/msm-camera-flash.txt
```
* Qualcomm Technologies, Inc. MSM FLASH

The MSM camera Flash driver provides the definitions for
enabling and disabling LED Torch/Flash by requesting it to
PMIC/I2C/GPIO based hardware. It provides the functions for
the Client to control the Flash hardware.

=======================================================
Required Node Structure
=======================================================
The Flash device is described in one level of the device node.

======================================
First Level Node - CAM FLASH device
======================================
- compatible
  Usage: required
  Value type: <string>
  Definition: Should be "qcom,camera-flash".

- cell-index
  Usage: required
  Value type: <u32>
  Definition: Should specify the hardware index id.

- reg
  Usage: required
  Value type: <u32>
  Definition: Register values.

- flash-source
  Usage: required
  Value type: <phandle>
  Definition: Should contain array of phandles to Flash source nodes.

- torch-source
  Usage: required
  Value type: <phandle>
  Definition: Should contain array of phandles to torch source nodes.

- switch-source
  Usage: Optional
  Value type: <phandle>
  Definition: Should contain phandle to switch source nodes.

- slave-id
  Usage: optional
  Value type: <u32>
  Definition: should contain i2c slave address, device id address
		and expected id read value.

- cci-master
  Usage: optional
  Value type: <u32>
  Definition: should contain i2c master id to be used for this camera
		flash.

- max-current
  Usage: optional
  Value type: <u32>
  Definition: Max current in mA supported by flash

- max-duration
  Usage: optional
  Value type: <u32>
  Definition: Max duration in ms flash can glow.

- wled-flash-support
  Usage: optional
  Value type: <boolean>
  Definition: To identity wled flash hardware support.

- gpios
  Usage: optional
  Value type: <u32>
  Definition: should specify the gpios to be used for the flash.

- gpio-req-tbl-num
  Usage: optional
  Value type: <u32>
  Definition: should specify the gpio table index.

- gpio-req-tbl-flags
  Usage: optional
  Value type: <u32>
  Definition: should specify the gpio functions.

- gpio-req-tbl-label
  Usage: optional
  Value type: <u32>
  Definition: should specify the gpio labels.

- gpio-flash-reset
  Usage: optional
  Value type: <u32>
  Definition: should contain index to gpio used by flash's "flash reset" pin.

- gpio-flash-en
  Usage: optional
  Value type: <u32>
  Definition: should contain index to gpio used by flash's "flash enable" pin.

- gpio-flash-now
  Usage: optional
  Value type: <u32>
  Definition: should contain index to gpio used by flash's "flash now" pin.

Example:

led_flash_rear: qcom,camera-flash@0 {
		reg = <0x00 0x00>;
		cell-index = <0>;
		compatible = "qcom,camera-flash";
		flash-source = <&pmi8998_flash0 &pmi8998_flash1>;
		torch-source = <&pmi8998_torch0 &pmi8998_torch1>;
		switch-source = <&pmi8998_switch0>;
		wled-flash-support;
		qcom,slave-id = <0x00 0x00 0x0011>;
		qcom,cci-master = <0>;
		gpios = <&msmgpio 23 0>,
			<&msmgpio 24 0>;
			<&msmgpio 25 0>;
		qcom,gpio-flash-reset = <0>;
		qcom,gpio-flash-en = <0>;
		qcom,gpio-flash-now = <1>;
		qcom,gpio-req-tbl-num = <0 1>;
		qcom,gpio-req-tbl-flags = <0 0>;
		qcom,gpio-req-tbl-label = "FLASH_EN",
			"FLASH_NOW";
		qcom,max-current = <1500>;
		qcom,max-duration = <1200>;
	};
```
