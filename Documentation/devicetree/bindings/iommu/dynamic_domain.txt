## Documentation/devicetree/bindings/leds/leds-qpnp-haptics.txt
```
Qualcomm Technologies, Inc. Haptics driver

QPNP (Qualcomm Technologies, Inc. Plug N Play) Haptics is a peripheral on some
QTI PMICs. It can be interfaced with the host processor via SPMI or I2C bus.

Haptics peripheral can support different actuators or vibrators,
1. Eccentric Rotation Mass (ERM)
2. Linear Resonant Actuator (LRA)

Also, it can support multiple modes of operation: Direct, Buffer, PWM or Audio.

Haptics device is described under a single level of node.

Properties:

- compatible
  Usage:      required
  Value type: <string>
  Definition: "qcom,qpnp-haptics".

- reg
  Usage:      required
  Value type: <u32>
  Definition: Base address of haptics peripheral.

- interrupts
  Usage:      required
  Value type: <prop-encoded-array>
  Definition: Peripheral interrupt specifier.

- interrupt-names
  Usage:      required
  Value type: <stringlist>
  Definition: Interrupt names.  This list must match up 1-to-1 with the
		interrupts specified in the 'interrupts' property. Currently
		supported interrupts are short-circuit and play.

- qcom,pmic-revid
  Usage:      required
  Value type: <phandle>
  Definition: Should specify the phandle of PMIC's revid module. This is used to
		identify the PMIC subtype.

- qcom,pmic-misc
  Usage:      optional
  Value type: <phandle>
  Definition: Should specify the phandle of PMIC's misc module. This is used to
		read the clock trim error register under MISC peripheral.

- qcom,misc-clk-trim-error-reg
  Usage:      optional
  Value type: <u32>
  Definition: Register offset in MISC peripheral to read the clock trim error.
		If this is specified, then qcom,pmic-misc should be specified.

- qcom,actuator-type
  Usage:      optional
  Value type: <u32>
  Definition: Allowed values are 0 for LRA and 1 for ERM. If this is not
		specified, then LRA type will be used by default.

- qcom,play-mode
  Usage:      optional
  Value type: <string>
  Definition: Allowed values are: "direct", "buffer", "pwm", "auto". If not
		specified for LRA actuator, auto mode will be selected by
		default.

- qcom,wave-shape
  Usage:      optional
  Value type: <string>
  Definition: Wave shape to be played. Allowed values: "sine" or "square".
		Default value is "square".

- qcom,wave-play-rate-us
  Usage:      optional
  Value type: <u32>
  Definition: Wave sample duration in microseconds. This should match with
		the frequency the vibrator supports.
		Allowed values are: 0 to 20475. Default value is 5715.

- qcom,max-play-time-us
  Usage:      optional
  Value type: <u32>
  Definition: Maximum play time supported in microseconds. Default value is
		15000.

- qcom,vmax-mv
  Usage:      optional
  Value type: <u32>
  Definition: Maximum output voltage in millivolts. Value specified here will
		be rounded off to the closest multiple of 116 mV.
		Allowed values: 0 to 3596. Default value is 3596.

- qcom,ilim-ma
  Usage:      optional
  Value type: <u32>
  Definition: Output current limit in mA. Allowed values: 400 or 800. Default
		value is 400.

- qcom,en-brake
  Usage:      optional
  Value type: <empty>
  Definition: Enables internal reverse braking.

- qcom,brake-pattern
  Usage:      optional
  Value type: <prop-encoded-array>
  Definition: Brake pattern to be applied. If specified, should be having
		4 elements. Allowed values for each element are:
		0, 1: Vmax/4, 2: Vmax/2, 3: Vmax.

- qcom,sc-dbc-cycles
  Usage:      optional
  Value type: <u32>
  Definition: Short circuit debounce cycles for internal PWM.
		Allowed values: 0, 8, 16 or 32.

- vcc_pon-supply
  Usage:      optional
  Value type: <phandle>
  Definition: PON driver regulator required to force MBG_ON

Following properties are specific only to LRA vibrators.

- qcom,lra-auto-mode
  Usage:      optional
  Value type: <empty>
  Definition: If specified, a set of pre-configured settings will be applied
		based on the pattern duration. For example, for a duration of
		< 20 ms (short duration), one set of settings will be applied
		and for a duration of >= 20 ms (long duration), another set of
		settings will be applied. The parameters configured in the
		driver when this property is specified is based on the LRA
		tested internally. Those parameters should be fine-tuned or
		adjusted based on the LRA used on different hardware platforms.

- qcom,lra-auto-res-mode
  Usage:      optional
  Value type: <string>
  Definition: Auto resonance method. Allowed values are:
		For pmi8998 and chips earlier,
		"none" : No auto resonance
		"zxd" : Zero crossing detection method
		"qwd" : Quarter wave drive method
		"max-qwd" : Maximum QWD
		"zxd-eop" : ZXD + End of Pattern
		For pm660,
		"zxd" : Zero crossing detection method
		"qwd" : Quarter wave drive method

- qcom,lra-high-z
  Usage:      optional
  Value type: <string>
  Definition: High Z configuration for auto resonance. Allowed values are:
		"none", "opt1", "opt2" and "opt3".
		For pm660, "opt0" is valid value for 1 LRA period.

- qcom,lra-res-cal-period
  Usage:      optional
  Value type: <u32>
  Definition: Auto resonance calibration period. Allowed values are:
		For pmi8998 and chips earlier: 4, 8, 16, and 32.
		For pm660: 4, 8, 16, 32, 64, 128 and 256.

- qcom,lra-qwd-drive-duration
  Usage:      optional
  Value type: <u32>
  Definition: LRA drive duration in QWD mode. Applies only for pm660 currently.
		Allowed values are: 0 and 1, for 1/4 and 3/8 LRA period.
		respectively.

- qcom,lra-calibrate-at-eop
  Usage:      optional
  Value type: <u32>
  Definition: Enables calibration at end of pattern. Applies only for pm660
		currently. Allowed values are: 0 and 1.

- qcom,auto-res-err-recovery-hw
  Usage:      optional
  Value type: <empty>
  Definition: Enables Hardware auto resonance error recovery. Applies only for
		pm660 currently.

- qcom,drive-period-code-max-variation-pct
  Usage:      optional
  Value type: <u32>
  Definition: Maximum allowed variation of LRA drive period code in percentage
		above which RATE_CFG registers will not be updated by SW when
		auto resonance is enabled and auto resonance error correction
		algorithm is running. If not specified, default value is 25%.

- qcom,drive-period-code-min-variation-pct
  Usage:      optional
  Value type: <u32>
  Definition: Minimum allowed variation of LRA drive period code in percentage
		below which RATE_CFG registers will not be updated by SW when
		auto resonance is enabled and auto resonance error correction
		algorithm is running. If not specified, default value is 25%.

Following properties are applicable only when "qcom,play-mode" is set to
"buffer".

- qcom,wave-rep-cnt
  Usage:      optional
  Value type: <u32>
  Definition: Repetition count for wave form.
		Allowed values are: 1, 2, 4, 8, 16, 32, 64 and 128. Default
		value is 1.

- qcom,wave-samp-rep-cnt
  Usage:      optional
  Value type: <u32>
  Definition: Repetition count for each sample of wave form. Allowed values
		are: 1, 2, 4 and 8. Default value is 1.

- qcom,wave-samples
  Usage:      optional
  Value type: <prop-encoded-array>
  Definition: Wave samples in an array of 32 elements. Each element takes the
		following representation, bit 0: unused, bits[5:1] : amplitude,
		bit 6: overdrive, bit 7: sign. Default sample value is 0x3E.
		Since the hardware supports configuring upto 8 samples, a set
		of 8 samples will be configured initially and the next set will
		be configured upon the play interrupt until all the samples are
		configured and played.

Following properties are applicable only when "qcom,play-mode" is set to
"pwm".

- pwms
  Usage:      required, if "qcom,play-mode" is set to "pwm".
  Value type: <phandle>
  Definition: PWM device that is feeding its output to Haptics.

- qcom,period-us
  Usage:      required, if "qcom,play-mode" is set to "pwm".
  Value type: <u32>
  Definition: PWM period in us.

- qcom,duty-us
  Usage:      required, if "qcom,play-mode" is set to "pwm".
  Value type: <u32>
  Definition: PWM duty cycle in us.

- qcom,ext-pwm-freq-khz
  Usage:      optional
  Value type: <u32>
  Definition: Frequency for external PWM in KHz.
		Allowed values are: 25, 50, 75 and 100.

- qcom,ext-pwm-dtest-line
  Usage:      optional
  Value type: <u32>
  Definition: DTEST line which is used for external PWM.

Example:
	qcom,haptics@c000 {
		compatible = "qcom,qpnp-haptics";
		reg = <0xc000 0x100>;
		interrupts = <0x3 0xc0 0x0 IRQ_TYPE_EDGE_RISING>,
			     <0x3 0xc0 0x1 IRQ_TYPE_EDGE_BOTH>;
		interrupt-names = "hap-sc-irq", "hap-play-irq";
		qcom,pmic-revid = <&pmi8998_revid>;
		qcom,pmic-misc = <&pmi8998_misc>;
		qcom,misc-clk-trim-error-reg = <0xf3>;
		qcom,actuator-type = <0>;
		qcom,play-mode = "direct";
		qcom,vmax-mv = <3200>;
		qcom,ilim-ma = <800>;
		qcom,sc-dbc-cycles = <8>;
		qcom,wave-play-rate-us = <6667>;
		qcom,en-brake;
		qcom,brake-pattern = <0x3 0x0 0x0 0x0>;
		qcom,lra-high-z = "opt1";
		qcom,lra-auto-res-mode = "qwd";
		qcom,lra-res-cal-period = <4>;
	};
```

## Documentation/devicetree/bindings/leds/leds-qpnp-vibrator-ldo.txt
```
Qualcomm Technologies, Inc. Vibrator-LDO

QPNP (Qualcomm Technologies, Inc. Plug N Play) Vibrator-LDO is a peripheral
on some QTI PMICs. It can be interfaced with the host processor via SPMI.

Vibrator-LDO peripheral supports Eccentric Rotation Mass (ERM) vibrator.

Properties:

- compatible
	Usage:      required
	Value type: <string>
	Definition: "qcom,qpnp-vibrator-ldo".

- reg
	Usage:      required
	Value type: <u32>
	Definition: Base address of vibrator-ldo peripheral.

- qcom,vib-ldo-volt-uv
	Usage:      required
	Value type: <u32>
	Definition: The optimal voltage requirement of the vibrator motor for
		    a normal vibration. Value is specified in microvolts.

- qcom,disable-overdrive
	Usage:      optional
	Value type: <empty>
	Definition: Do not apply overdrive voltage.

- qcom,vib-overdrive-volt-uv
	Usage:      optional and not required if qcom,disable-overdrive present
	Value type: <u32>
	Definition: The voltage in microvolts used as overdrive factor for
		    improving motor reactivity at the start of vibration.
		    If this property not specified, a default value of
		    2 times the value specified in qcom,vib-ldo-volt-uv
		    property is used.

=======
Example
=======

pmi632_vib: qcom,vibrator@5700 {
	compatible = "qcom,qpnp-vibrator-ldo";
	reg = <0x5700 0x100>;
	qcom,vib-ldo-volt-uv = <1504000>;
	qcom,disable-overdrive;
	qcom,vib-overdrive-volt-uv = <3544000>;
};
```

## Documentation/devicetree/bindings/leds/leds-qpnp-wled.txt
```
Qualcomm Technologies QPNP WLED

QPNP (Qualcomm Technologies Plug N Play) WLED (White Light
Emitting Diode) driver is used for controlling display
backlight that is part of PMIC on Qualcomm Technologies
reference platforms. The PMIC is connected to the host
processor via SPMI bus.

Required properties:
- compatible		: should be "qcom,qpnp-wled"
- reg			: base address and size for wled modules
- reg-names		: names associated with base addresses. It
			should be "qpnp-wled-ctrl-base", "qpnp-wled-sink-base",
			"qpnp-wled-ibb-base", "qpnp-wled-lab-base".
- qcom,pmic-revid	: phandle of PMIC revid module. This is used to
			  identify the PMIC subtype.

Optional properties for WLED:
 - interrupts		: Specifies the interrupts associated with WLED. The available
			  interrupts are over voltage protection(ovp) and short circuit(sc).
			  The values for ovp and sc are <0x3 0xd8 0x1> and <0x3 0xd8 0x2>.
 - interrupt-names	: Specify the interrupt names associated with interrupts. Must be
			  one of "ovp-irq" or "sc-irq"
- linux,name		: name of the wled. default is "wled".
- linux,default-trigger	: trigger for the backlight. default is NONE.
- qcom,fdbk-output	: string feedback current output for wled module. The accepted values
			  are "wled1", "wled2", "wled3", "wled4" and "auto". default is "auto".
- qcom,vref-mv		: maximum reference voltage in mv. default is 350.
- qcom,switch-freq-khz	: switch frequency in khz. default is 800.
- qcom,ovp-mv		: Over voltage protection threshold in mV. Default is
			  29500. Supported values are:
			  - 31000, 29500, 19400, 17800 for pmi8994/8952/8996.
			  - 31100, 29600, 19600, 18100 for pmicobalt/pm2falcon.
			  Should only be used if qcom,disp-type-amoled is not
			  specified.
- qcom,ilim-ma		: maximum current limiter in ma. default is 980.
- qcom,boost-duty-ns	: maximum boost duty cycle in ns. default is 104.
- qcom,mod-freq-khz	: modulation frequency in khz. default is 9600.
- qcom,dim-mode		: dimming mode. supporting dimming modes are "analog",
			  "digital", and "hybrid". default is "hybrid".
- qcom,hyb-thres	: threshold value when used in hybrid mode. It represents the
			  percentage of brightntess at which dimming mode is switched
			  from "digital" to "analog". the default value is 6.25%. as the
			  floating point cannot be represented directly, the value is
			  multiplied by 100. so the default is 625.
- qcom,sync-dly-us	: delay for current sync in us. default is 400.
- qcom,fs-curr-ua	: maximum full scale current in ua. default is 25000.
- qcom,en-9b-dim-res	: boolean, specify if 9-bit dim resultion is needed. otherwise 12-bit is used.
- qcom,en-phase-stag	: boolean, specify if phase staggering is needed.
- qcom,en-cabc		: boolean, specify if cabc (content adaptive backlight control) is needed.
- qcom,disp-type-amoled	: specify if the display is amoled
- qcom,led-strings-list	: Wled module has four strings of leds numbered from 0 to 3. each string of leds
			  are operated individually. specify the list of strings used by the device.
			  any combination of led strings can be used. default value is [00 01 02 03]
- qcom,en-ext-pfet-sc-pro : Specify if external pfet short circuit protection is needed
- qcom,cons-sync-write-delay-us : Specify in 'us' the duration of delay between two consecutive writes to
				  SYNC register.
- qcom,sc-deb-cycles	: debounce time for short circuit detection

Optional properties if 'qcom,disp-type-amoled' is mentioned in DT:
- qcom,loop-ea-gm	: control the gm for gm stage in control loop. default is 3.
- qcom,loop-comp-res-kohm	: control to select the compensation resistor in kohm. default is 320.
- qcom,vref-psm-mv	: reference psm voltage in mv. default for amoled is 450.
- qcom,avdd-mode-spmi: Boolean property to enable AMOLED_VOUT programming via SPMI. If not specified,
			AMOLED_VOUT is programmed via S-wire. This can be specified only for newer
			PMICs like pmicobalt/pm2falcon.
- qcom,avdd-target-voltage-mv: The voltage required for AMOLED_VOUT. Accepted values are in the range
				of 5650 to 7900 in steps of 150. Default value is 7600. Unit is in mV.
				For old revisions, accepted values are: 7900, 7600, 7300, 6400, 6100,
				5800.

Example:
	qcom,leds@d800 {
		compatible = "qcom,qpnp-wled";
		reg = <0xd800 0x100>,
			<0xd900 0x100>,
			<0xdc00 0x100>,
			<0xde00 0x100>;
		reg-names = "qpnp-wled-ctrl-base",
				"qpnp-wled-sink-base",
				"qpnp-wled-ibb-base",
				"qpnp-wled-lab-base";
		interrupts = <0x3 0xd8 0x2>;
		interrupt-names = "sc-irq";
		status = "okay";
		linux,name = "wled";
		linux,default-trigger = "bkl-trigger";
		qcom,fdbk-output = "auto";
		qcom,vref-mv = <350>;
		qcom,switch-freq-khz = <800>;
		qcom,ovp-mv = <29500>;
		qcom,ilim-ma = <980>;
		qcom,boost-duty-ns = <26>;
		qcom,mod-freq-khz = <9600>;
		qcom,dim-mode = "hybrid";
		qcom,dim-method = "linear";
		qcom,hyb-thres = <625>;
		qcom,sync-dly-us = <800>;
		qcom,fs-curr-ua = <16000>;
		qcom,en-phase-stag;
		qcom,led-strings-list = [00 01 02 03];
		qcom,en-ext-pfet-sc-pro;
	};
```
