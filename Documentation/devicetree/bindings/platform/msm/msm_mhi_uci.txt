## Documentation/devicetree/bindings/platform/msm/msm_mhi_uci.txt
```
MSM MHI UCI interface device

MHI userpace control interface (UCI) enables userspace software clients to
communicate with device using MHI protocol.

==============
Node Structure
==============

Main node properties:

- compatible
  Usage: required
  Value type: <string>
  Definition: "qcom,mhi-uci"

- qcom,mhi-uci-channels
  Usage: required
  Value type: Array of <u32>
  Definition: Array tuples which define the channel configuration
	parameters.  Each tuple is of length 2, 1st value
	represent channel, and 2nd value represent maximum
	payload supported.  Maximum payload supported is 64
	bytes.  Number of tuples must be even value.  Max # of
	tuples is 46.

- qcom,mhi-uci-ctrlchan
  Usage: optional
  Value type: <u32>
  Definition: Channel that will be handling flow control (DTR/RTS) signals.

=======
Example
=======
qcom,mhi-uci@0 {
	compatible = "qcom,mhi-uci";
	qcom,mhi-uci-channels = <0 0x1000>,
				<1 0x1000>,
				<2 0x1000>,
				<3 0xffff>,
				<10 0x1000>,
				<11 0x1000>,
				<14 0x1000>,
				<15 0x1000>,
				<16 0x1000>,
				<17 0x1000>,
				<18 0x1000>,
				<19 0x1000>,
				<24 0x1000>,
				<25 0x1000>,
				<32 0x1000>,
				<33 0x1000>;
	qcom,mhi-uci-ctrlchan = <18>;
	status = "ok";
};
```

## Documentation/devicetree/bindings/platform/msm/msm_rmnet_mhi.txt
```
MSM MHI RMNET interface device

MHI RMNET provides a network interface over PCIe to transfer IP packets
between modem and apps.

==============
Node Structure
==============

Main node properties:

- compatible
  Usage: required
  Value type: <string>
  Definition: "qcom,mhi-rmnet"

- qcom,mhi-rx-channel
  Usage: optional if mhi-tx-channel is defined.
  Value type: <u32>
  Definition: MHI channel number for incoming data

- qcom,mhi-tx-channel
  Usage: optional if mhi-rx-channel is defined.
  Value type: <u32>
  Definition: MHI channel number for outgoing data

- qcom,mhi-mru
  Usage: required
  Value type: <u32>
  Definition: Default payload size for receive path.

- qcom,mhi-max-mru
  Usage: optional
  Value type: <u32>
  Definition: Maximum payload interface support on receive path.  If
	not defined MHI_MAX_MRU is used.

- qcom,mhi-max-mtu
  Usage: optional
  Value type: <u32>
  Definition: Maximum payload interface support on transmit path.  If
	not defined MHI_MAX_MTU is used.

- qcom,interface-name
  Usage: optional
  Value type: <string>
  Definition: optional string to overwrite default interface name. If
	not defined string RMNET_MHI_DRIVER_NAME is used.

========
Example:
========
mhi_rmnet_0: qcom,mhi-rmnet@0 {
	compatible = "qcom,mhi-rmnet";
	qcom,mhi-rx-channel = <101>;
	qcom,mhi-tx-channel = <100>;
	qcom,mhi-mru = <8000>;
	status = "okay";
};
```

## Documentation/devicetree/bindings/platform/msm/qca1530.txt
```
QCA1530 SoC

QCA1530 is a SoC for position determination using navigation satellites.
Typical scenario includes usage of GPS and GLONASS satellite navigation
systems.

Required properties

- compatible: "qca,qca1530"

Optional properties
- qca,pwr-supply: handle to the regulator device tree node
- qca,pwr2-supply: handle to additional regulator device tree node
- qca,pwr-gpio: handle the power control using GPIO interface
- qca,reset-gpio: GPIO for reset control
- qca,reset-supply: handle to the regulator for reset control
- qca,clk-gpio: handle the clock control using GPIO interface
- qca,xlna-supply: handle to the regulator for xLNA
- qca,xlna-gpio: handle to xLNA power control using GPIO interface
- qca,xlna-voltage-level: list containing minimum and maximum voltage
                          levels for xlna regulator
- qca,xlna-current-level: list containing current values for active
                          operation and sleep modes

Example:
	 gnss_qca1530: qca,qca1530{
		compatible = "qca,qca1530";
		qca,pwr-supply = <&pma8084_l26>;
		qca,reset-gpio = <&msmgpio 128 0>;
		qca,xlna-supply = <&pma8084_l22>;
		qca,xlna-voltage-level = <3000000 3000000>;
		qca,xlna-current-level = <90000 100>;
	};
```

## Documentation/devicetree/bindings/platform/msm/qpnp-clkdiv.txt
```
* qpnp-clkdiv

clkdiv configures the clock frequency of a set of outputs on the PMIC.
These clocks are typically wired through alternate functions on
gpio pins.

Required properties :
 - reg : The address and size of the peripheral. Size should be 0x1000, and the
         address may vary.
 - qcom,cxo-freq : The frequency of the cxo clock in Hz.

Optional properties :
 - qcom,cxo-div : Integer to divide the CXO clock by when constructing the
		  output frequency. Please see the definitions in
		  include/linux/qpnp-clkdiv.h to choose the appropriate value.
 - qcom,enable : 0 == disable clock output
		 1 == enable clock output.

Note: if an optional property is not specified, no device configuration will
      occur at probe time.

Client required properties :
 - <consumer name>-clk : A phandle to the corresponding divclk device. The
			      consumer name refers to the name that will be
			      passed to qpnp_clkdiv_get(), and allows for a
			      client specific name to be associated with each
			      divclk.

Clkdiv device example :

...
	pm8941_clkdiv1: clkdiv@5b00 {
		reg = <0x5b00 0x1000>;
		qcom,cxo-freq = <19200000>;
		qcom,cxo-div = <1>;
		qcom,enable = <1>;
	};

Client device example :
...
	client {
		my-clk = &pm8941_clkdiv1;
	};
```

## Documentation/devicetree/bindings/platform/msm/qpnp-coincell.txt
```
Qualcomm Technologies, Inc. QPNP Coincell - coincell battery charger devices

Required properties:
- compatible:      Must be "qcom,qpnp-coincell".
- reg:             Specifies the SPMI address and size for this coincell device.

Required structure:
- A qcom,qpnp-coincell node must be a child of an SPMI node that has specified
	the spmi-slave-container property.

Optional properties:
- qcom,rset-ohms:	Specifies the resistance of the current limiting
			resistor in ohms.  Four values are supported:
			800, 1200, 1700, and 2100.
- qcom,vset-millivolts:	Specifies the coincell charging voltage in millivolts.
			Four values are supported: 2500, 3000, 3100, and 3200.
- qcom,charge-enable:	Specifies if coincell charging should be enabled or not.
			0 = disable charging, 1 = enabled charging

If any of the optional properties are not specified, then the hardware default
values for the unspecified properties will be used instead.

Example:
	qcom,spmi@fc4c0000 {
		#address-cells = <1>;
		#size-cells = <0>;
		interrupt-controller;
		#interrupt-cells = <3>;

		qcom,pm8941@1 {
			spmi-slave-container;
			reg = <0x1>;
			#address-cells = <1>;
			#size-cells = <1>;

			qcom,coincell@2800 {
				compatible = "qcom,qpnp-coincell";
				reg = <0x2800 0x100>;
				qcom,rset-ohms = <800>;
				qcom,vset-millivolts = <3100>;
				qcom,charge-enable = <1>;
			};
		};
	};
```

## Documentation/devicetree/bindings/platform/msm/qpnp-haptic.txt
```
QPNP Haptic

QPNP (Qualcomm Technologies Plug N Play) Haptic is a peripheral on
Qualcomm Technologies PMICs.  The PMIC is connected to Host processor
via SPMI bus.

This device can be operated in four modes - direct, buffer,
pwm(pulse width modulation) and audio.

Required Properties:
 - compatible: must be "qcom,qpnp-haptic"
 - reg: address of device
 - qcom,actuator-type: must be one of "erm" or "lra"
 - qcom,play-mode : must be one of "buffer", "direct", "pwm" or "audio"

Optional Properties:
 - qcom,timeout-ms: timeout in ms.
 - qcom,vmax-mv : maximum output voltage in milli volts
 - qcom,ilim-ma : maximum output current limit threshold in milli amps
 - qcom,int-pwm-freq-khz : frequency for internal pwm
 - qcom,en-brake : specify to enable internal reverse braking
 - qcom,brake-pattern : 4 byte active brake pattern. Each pattern represents
		2-bit amplitude control 0x00: 0, 0x01: vmax/4, 0x02: vmax/2,
		0x03: vmax. Default values are 0x00.
 - qcom,sc-deb-cycles : short circuit debounce in internal pwm switching clock cycles
 - qcom,use-play-irq : boolean, use this if the device uses irq for play
 - qcom,use-sc-irq : boolean, use this if the device uses irq for play
 - interrupts:	Specifies the interrupt associated with Haptics. The available
		interrupts are play and short circuit. The values for play and
		short circuit are <0x3 0xc0 0x0> and <0x3 0xc0 0x1>.
 - interrupt-names: Specify the interrupt names associated with interrupts. Must be
		    one of "play-irq" or "sc-irq"
 - vcc_pon-supply: power-on driver regulator

Optional properties for buffer play mode:
 - qcom,wave-samples : 8 byte buffer representing the wave. The bits in each sample
		are represented as follows- bit 0: reserved, bits 1 to 5: amplitude
		of the waveform, bit 6: over drive and bit 7: direction.
 - qcom,wave-shape : must be "sine" or "square"
 - qcom,wave-rep-cnt : repetition count for wave form
 - qcom,wave-samp-rep-cnt : repetition count for each sample of wave
 - qcom,wave-play-rate-us : duration at which each sample to be played in micro seconds

Required properties for pwm play mode:
 - qcom,pwm-channel: pwm channel the led will operate on
 - qcom,period-us: pwm period in us
 - qcom,duty-us: pwm duty cycle in us
 - qcom,ext-pwm-dtest-line: dtest line to used with pwm

Optional properties for pwm play mode:
 - qcom,ext-pwm-freq-khz : frequency for external pwm in kilo HZ

Optional properties when qcom,actuator-type is "lra"
 - qcom,correct-lra-drive-freq : boolean, use this to ensure LRA is driven at correct resonant
				 frequency, which may change due to operating conditions.
 - qcom,misc-trim-error-rc19p2-clk-reg-present : boolean, use this if TRIM_ERROR_RC19P2_CLK
				register is present in MISC module. This register holds
				the frequency error in 19.2Mhz RC clock.
 - qcom,lra-auto-res-mode : auto resonance technique, four different modes
			"none" : no auto resonance
			"zxd" : zero crossing based discontinuous method
			"qwd" : quarter wave drive method
			"max-qwd" : Maximum QWD
			"zxd-eop" : ZXD + End of pattern (This is the Default)
 - qcom,lra-high-z : High Z configuration for auto resonance. Possible string values are
			"none", "opt1", "opt2" and "opt3" (default)
 - qcom,lra-res-cal-period : Auto resonance calibration period. The values range from
			4 to 32(default)
 - qcom,perform-lra-auto-resonance-search : boolean, define this property if:
		a) the underlying PMI chip does not have a register in the MISC block to
		read the error percentage in RC clock
		b) the actuator type is LRA
		Defining this causes the auto resonance search algorithm to be be performed
		for such devices.
		c) This property is not defined by default.

- qcom,drive-period-code-max-limit-percent-variation: RATE_CFG1 and RATE_CFG2 registers will
			be updated with the values from AUTO_RES_LO and AUTO_RES_HI registers
			only if the variation from the resonant frequency is within the value
			mentioned by this property on the higher side.
			The default value is 25, which means if the drive period code resulting
			from AUTO_RES register's is more than 25 percent of the existing drive
			period code, then driver does not update RATE_CFG registers.
- qcom,drive-period-code-min-limit-percent-variation: RATE_CFG1 and RATE_CFG2 registers will
			be updated with the values from AUTO_RES_LO and AUTO_RES_HI registers
			only if the variation from the resonant frequency is within the value
			mentioned by this property on the lower side.
                        The default value is 25, which means if the drive period code resulting
                        from AUTO_RES register's is less than 25 percent of the existing drive
                        period code, then driver does not update RATE_CFG registers.

Optional properties when qcom,lra-auto-res-mode is "qwd"
 - qcom,time-required-to-generate-back-emf-us: Time period required to generate sufficient
				back-emf (in case of QWD mode only) in us. For auto resonance
				detection to work properly,sufficient back-emf has to be
				generated. In general, back-emf takes some time to build up.
				When the auto resonance  mode is chosen as QWD, high-z will
				be applied for every LRA cycle and hence there won't be
				enough back-emf at the start-up. So we need to drive the
				motor for a few LRA cycles. Hence, auto resonance detection
				is enabled after this delay period after the PLAY bit is
				asserted. The default value is 20000us.

Example:
		qcom,haptic@c000 {
			status = "disabled";
			compatible = "qcom,qpnp-haptic";
			reg = <0xc000 0x100>;
			interrupts = <0x3 0xc0 0x0>,
				     <0x3 0xc0 0x1>;
			interrupt-names = "sc-irq", "play-irq";
			vcc_pon-supply = <&pon_perph_reg>;
			qcom,play-mode = "direct";
			qcom,wave-play-rate-us = <5263>;
			qcom,actuator-type = "lra";
			qcom,wave-shape = "square";
			qcom,vmax-mv = <2000>;
			qcom,ilim-ma = <800>;
			qcom,sc-deb-cycles = <8>;
			qcom,int-pwm-freq-khz = <505>;
			qcom,en-brake;
			qcom,brake-pattern = [03 03 00 00];
			qcom,use-play-irq;
			qcom,use-sc-irq;
			qcom,wave-samples = [3e 3e 3e 3e 3e 3e 3e 3e];
			qcom,wave-rep-cnt = <1>;
			qcom,wave-samp-rep-cnt = <1>;
			qcom,lra-high-z = "opt1";
			qcom,lra-auto-res-mode = "qwd";
			qcom,lra-res-cal-period = <4>;
			qcom,time-required-to-generate-back-emf-us = <20000>;
		};
```
