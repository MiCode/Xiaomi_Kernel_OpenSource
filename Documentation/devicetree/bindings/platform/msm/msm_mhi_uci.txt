## Documentation/devicetree/bindings/platform/msm/usb-bam.txt
```
MSM USB Bus Access Manager (BAM)

This describes the device used to interface the USB controller
with the Smart Peripheral Subsystem (SPS). The BAM serves to
connect USB directly with other peer peripherals in the system
and is statically configured with a number of unidirectional pipes.

Required properties:
- compatible: should be "qcom,usb-bam-msm"
- reg  : pairs of physical base addresses and region sizes
            of all the memory mapped BAM devices present
- reg-names : Register region name(s), in 1-1 correspondence with the
	    registers in 'reg'. This list should contain at least as many names
            as the number of unique values given in both 'usb-active-bam' and
            all the subnodes' 'usb-bam-type' properties.

            If SSUSB_BAM is used, "ssusb" should be present.
            If HSUSB_BAM is used, "hsusb" should be present.
            If HSIC_BAM is used, "hsic" should be present.

            If a QSCRATCH RAM1 register is designated for providing USB3
            private memory to use as a BAM FIFO, specify "qscratch_ram1_reg".
- interrupts: IRQ lines for BAM devices
- interrupt-names: BAM interrupt name(s), in 1-1 correspondence with
            'interrupts' above.

            If SSUSB_BAM is used, "ssusb" should be present.
            If HSUSB_BAM is used, "hsusb" should be present.
            If HSIC_BAM is used, "hsic" should be present.
- qcom,usb-bam-num-pipes: max number of pipes that can be used

Optional properties:
- qcom,usb-bam-fifo-baseaddr: base address for bam pipe's data and descriptor
  fifos. This can be on chip memory (ocimem) or usb private memory. This
  property is required if sub-node's mem-type is ocimem or usb private mem.

A number of USB BAM pipe parameters are represented as sub-nodes:

Subnode Required:
- label: a string describing uniquely the usb bam pipe. The string can be
  constracted as follows: <core>-<peer>-<direction>-<pipe num>.
	core options: hsusb, ssusb/dwc3, hsic
	peer options: qdss, ipa, a2
	direction options: in (from peer to usb), out (from usb to peer)
	pipe num options: 0..127
- qcom,usb-bam-mem-type: Type of memory used by this PIPE. Can be one of
            0 - Uses SPS's dedicated pipe memory
            1 - USB's private memory residing @ 'qcom,usb-bam-fifo-baseaddr'
            2 - System RAM allocated by driver
	    3 - OCI memory residing @ 'qcom,usb-bam-fifo-baseaddr'
- qcom,bam-type: BAM type can be one of
	0 - SSUSB_BAM
	1 - HSUSB_BAM
	2 - HSIC_BAM
- qcom,dir: pipe direction
	0 - from usb (out)
	1 - to usb (in)
- qcom,pipe-num: pipe number
- qcom,peer-bam: peer BAM can be one of
	0 - A2_P_BAM
	1 - QDSS_P_BAM
	2 - IPA_P_BAM
- qcom,data-fifo-size: data fifo size
- qcom,descriptor-fifo-size: descriptor fifo size

Optional Properties for Subnode:
- qcom,reset-bam-on-connect: If present then BAM is RESET before connecting
  pipe. This may be required if BAM peripheral is also reset before connect.
- qcom,dst-bam-physical-address: destination BAM physical address
- qcom,dst-bam-pipe-index: destination BAM pipe index
- qcom,src-bam-physical-address: source BAM physical address
- qcom,src-bam-pipe-index: source BAM pipe index
- qcom,data-fifo-offset: data fifo offset address
- qcom,descriptor-fifo-offset: descriptor fifo offset address
- qcom,pipe-connection-type: type of pipe connection. Can be one of
	0 - BAM2BAM (default if not specified)
	1 - SYS2BAM (only supported on UL)

Optional properties :
- qcom,bam-mode: BAM mode can be one of.
	0 - BAM_MODE_DEVICE
	1 - BAM_MODE_HOST
	(If not set will be set by default to BAM_MODE_DEVICE)
- qcom,ignore-core-reset-ack: If present then BAM ignores ACK from USB core
	    while performing PIPE RESET
- qcom,disable-clk-gating: If present then disable BAM clock gating.
- qcom,usb-bam-override-threshold: If present then the default 512 byte threshold
		is overriden. This threshold configures the threshold value for Read/Write
		event generation by the BAM towards another BAM.

Example USB BAM controller device node:

	qcom,usbbam@f9a44000 {
		compatible = "qcom,usb-bam-msm";
		reg = <0xf9a44000 0x11000>;
		reg-names = "hsusb";
		interrupts = <0 135 0>;
		interrupt-names = "hsusb";
		qcom,usb-bam-num-pipes = <16>;
		qcom,ignore-core-reset-ack;
		qcom,disable-clk-gating;

		qcom,pipe0 {
			label = "hsusb-ipa-out-0";
			qcom,usb-bam-mem-type = <0>;
			qcom,bam-type = <1>;
			qcom,bam-mode = <0>;
			qcom,dir = <0>;
			qcom,pipe-num = <0>;
			qcom,peer-bam = <2>;
			qcom,src-bam-physical-address = <0xf9a44000>;
			qcom,src-bam-pipe-index = <1>;
			qcom,data-fifo-offset = <0x2200>;
			qcom,data-fifo-size = <0x1e00>;
			qcom,descriptor-fifo-offset = <0x2100>;
			qcom,descriptor-fifo-size = <0x100>;
		};
		qcom,pipe1 {
			label = "hsusb-ipa-in-0";
			qcom,usb-bam-mem-type = <0>;
			qcom,bam-type = <1>;
			qcom,bam-mode = <0>;
			qcom,dir = <1>;
			qcom,pipe-num = <0>;
			qcom,peer-bam = <2>;
			qcom,dst-bam-physical-address = <0xf9a44000>;
			qcom,dst-bam-pipe-index = <0>;
			qcom,data-fifo-offset = <0x300>;
			qcom,data-fifo-size = <0x1e00>;
			qcom,descriptor-fifo-offset = <0>;
			qcom,descriptor-fifo-size = <0x300>;
		};
	};
```

## Documentation/devicetree/bindings/platform/msm/veth_ipa.txt
```
Qualcomm Technologies, Inc. Veth IPA device

This specifies the bindings for QTI VETH_IPA that provides backhaul
connectivity.

Required properties:
- compatible: Must be "qcom,veth-ipa"


Example:
	qcom,veth-ipa {
		compatible = "qcom,veth-ipa";
	};
```

## Documentation/devicetree/bindings/power/bq2419x-charger.txt
```
* bq2419x charger devicetree bindings

Required properties:
- compatible : Should be from the list
  ti,bq2419x
                          to be drawn by the charger from the power source.

Required nodes:
- regulators: There must a regulator subnode each for the following purposes:
              (1) Setting battery charging current.
              (2) Enabling current supply to vbus (To enable otg mode)
              Each of these regulator nodes must have atleast one consumer
              subnode which in turn must have certain mandatory properties
              supplied. To know about these mandatory properties and more about
              consumer subnodes, please refer
              Documentation/devicetree/bindings/regulator/regulator.txt

Additional properties to be added to charger regulator subnode:

Required properties:
- auto-recharge-time      : Time interval in seconds after which the charging
                            should be restarted after the charging is complete.

Optional properties:
- watchdog-timeout        : Watchdog timer expiry timeout value in seconds.
                            When not specified, watchdog timer functionality
                            will be disabled.
- rtc-alarm-time          : Time setting in seconds for the rtc alarm timer
                            which wakes the board up for charging after shutdown.
- ti,temp-range: List of temperatures in degC for thermal profiling.
- ti,charge-current-limit: List of fast charging current limit in mA for
		thermal profiling.
	The value is provided as
	ti,temp-range = <15 60>;
	ti,charge-current-limit = <2048 5200>;

	This will set chargign current limit to
		2048 for <= 15 degC and
		5200 for 16 to 60 degC
	This will result:
		< 0 -> Charger disable. (As by HW)
		0 to 10 -> 1048mA charging current limit (as by 50% HW)
		11 to 15 -> 2048mA
		16 to 60 -> 5200 mA
		> 60 : Charging will be disabled by HW.

Subnode properties:
==================
There is two optional subnodes, vbus and charger.

vbus properties:
================
ti,otg-iusb-gpio: The GPIO which is connected to OTG/IUSB pin.


Example
bq2419x: bq2419x@6b {
	compatible = "ti,bq2419x";
	reg = <0x6b>;
	ti,charging-term-current-mA = <100>;
	charger {
			regulator-name = "batt_regulator";
			regulator-max-microamp = <3000>;
			ti,watchdog-timeout = <40>;
			ti,rtc-alarm-time = <3600>;
			ti,auto-recharge-time = <1800>;
			consumers {
				c1 {
					regulator-consumer-supply = "usb_bat_chg";
					regulator-consumer-device = "tegra-udc.0";
				};
			};
	};
	vbus {
		regulator-name = "vbus_regulator";
		consumers {
			c1 {
				regulator-consumer-supply = "usb_vbus";
				regulator-consumer-device = "tegra-ehci.0";
			};

			c2 {
				regulator-consumer-supply = "usb_vbus";
				regulator-consumer-device = "tegra-otg";
			};
		};
	};
};
```

## Documentation/devicetree/bindings/power/bq28400-battery.txt
```
TI BQ28400 Battery Gas Gauge

The bq28400 monitors the battery temperature, capacity, voltage, current etc.
The device interface is I2C, its I2C slave 7-bit address is 0xb.
The device is usually embedded inside the "smart battery" pack.

Required properties:

 - compatible : Must be "ti,bq28400-battery" or "ti,bq30z55-battery"
 - reg : I2C Address must be 0xb.
 - ti,temp-cold-degc : Cold temperature limit in celsius degree
 - ti,temp-hot-degc : Hot temperature limit in celsius degree

Example:
	i2c@f9967000 {
		battery@b {
			compatible = "ti,bq28400-battery", "ti,bq30z55-battery";
			reg = <0xb>;
			ti,temp-cold-degc = <2>;
			ti,temp-hot-degc = <43>;
		};
	};
```

## Documentation/devicetree/bindings/power/mediatek-mcu_biu.txt
```
* Mediatek MCU BIU

Required properties:
- compatible: Should contain one of the following:
  * "mediatek,mt6735-mcu_biu"
  * "mediatek,mt6735m-mcu_biu"

- reg: Address range of the MCU BIU registers

Example:

	mcu_biu: mcu_biu@10300000 {
		compatible = "mediatek,mt6735-mcu_biu";
		reg = <0x10300000 0x8000>;
	};
```

## Documentation/devicetree/bindings/power/mediatek-ptp_fsm_v1.txt
```
TWL BCI (Battery Charger Interface)

Required properties:
- compatible:
  - "mediatek,psp_fsm"
- reg: The base address ptp register bank
- interrupts: Should contain PTP interrupt.

Examples:

ptp_fsm@1100b000 {
	compatible = "mediatek,psp_fsm";
	reg = <0x1100B000 0x1000>;
	interrupts = <GIC_SPI 125 IRQ_TYPE_LEVEL_LOW>;
};
```

## Documentation/devicetree/bindings/power/mediatek-vcorefs.txt
```
* Mediatek Vcore DVFS

Required properties:
- compatible should contain:
  * "mediatek,vcorefs"

- reg: The base address of the AXI register bank

- clocks: device clocks

- clock-name: Should be the names of the clocks
   - "mux_axi" for the AXI clock source
   - "syspll_d5" for the 218MHz
   - "syspll1_d4" for the 136MHz

Example:

	vcorefs {
		compatible = "mediatek,vcorefs";
		clocks = <&topckgen TOP_MUX_AXI>,
			 <&topckgen TOP_SYSPLL_D5>,
			 <&topckgen TOP_SYSPLL1_D4>;
		clock-names = "mux_axi",
			      "syspll_d5",
			      "syspll1_d4";
	};
```
