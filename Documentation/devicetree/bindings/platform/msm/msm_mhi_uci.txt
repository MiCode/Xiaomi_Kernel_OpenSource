## Documentation/devicetree/bindings/platform/msm/qpnp-power-on.txt
```
Qualcomm QPNP power-on

The qpnp-power-on is a driver which supports the power-on(PON)
peripheral on Qualcomm PMICs. The supported functionality includes
power on/off reason, key press/release detection, PMIC reset configurations
and other PON specifc features. The PON module supports multiple physical
power-on (KPDPWR_N, CBLPWR) and reset (KPDPWR_N, RESIN, KPDPWR+RESIN) sources.
This peripheral is connected to the host processor via the SPMI interface.

Required properties:
- compatible:	Must be "qcom,qpnp-power-on"
- reg:		Specifies the SPMI address and size for this PON (power-on) peripheral
- interrupts:	Specifies the interrupt associated with PON.
- interrupt-names:	Specify the interrupt names associated with interrupts. Must be
			one of "kpdpwr", "kpdpwr-bark", "resin", "resin-bark", "cblpwr",
			"kpdpwr-resin-bark". Bark interrupts are associated with system
			reset configuration to allow default reset configuration to be
			activated. If system reset configuration is not supported then
			bark interrupts are nops. Additionally, the "pmic-wd-bark"
			interrupt can be added if the system needs to handle PMIC
			watch dog barks.

Optional properties:
- qcom,pon-dbc-delay		The debounce delay for the power-key interrupt
				specified in us. The value ranges from 2 seconds
				to 1/64 of a second. Possible values are -
				- 2, 1, 1/2, 1/4, 1/8, 1/16, 1/32, 1/64
				- Intermediate value is rounded down to the
				nearest valid value.
- qcom,pon_1 ...pon_n		These represent the child nodes which describe
				the properties (reset, key) for each of the pon
				reset source. All the child nodes are optional.
				If none of them is specified, the driver fails
				to register.
- qcom,system-reset		Specifies that this PON peripheral can be used
				to reset the system. This property can only be
				used by one device on the system. It is an error
				to include it more than once.
- qcom,s3-debounce		The debounce delay for stage3 reset trigger in
				secs. The values range from 0 to 128.
- qcom,s3-src			The source for stage 3 reset. It can be one of
				"kpdpwr", "resin", "kpdpwr-or-resin" or
				"kpdpwr-and-resin". The default value is
				"kpdpwr-and-resin".
- qcom,uvlo-panic		If this property is present, the device will set to panic during reboot if this reboot is due to under voltage lock out
- qcom,clear-warm-reset		Specifies that the WARM_RESET reason registers
				need to be cleared for this target. The property
				is used for the targets which have a hardware feature
				to catch resets which aren't triggered by the MSM.
				In such cases clearing WARM_REASON registers across
				MSM resets keeps the registers in good state.
- qcom,secondary-pon-reset	Boolean property which indicates that the PON
				peripheral is a secondary PON device which needs
				to be configured during reset in addition to the
				primary PON device that is configured for system
				reset through qcom,system-reset property.
				This should not be defined along with the
				qcom,system-reset property.
- qcom,store-hard-reset-reason	Boolean property which if set will store the hardware
				reset reason to SOFT_RB_SPARE register of the core PMIC
				PON peripheral.
- qcom,warm-reset-poweroff-type		Poweroff type required to be configured on
					PS_HOLD reset control register when the system
					goes for warm reset. If this property is not
					specified, then the default type, warm reset
					will be configured to PS_HOLD reset control
					register.
- qcom,hard-reset-poweroff-type		Same description as qcom,warm-reset-poweroff-type
					but this applies for the system hard reset case.
- qcom,shutdown-poweroff-type		Same description as qcom,warm-reset-poweroff-type
					but this applies for the system shutdown case.


All the below properties are in the sub-node section (properties of the child
node).

Sub-nodes (if defined) should belong to either a PON configuration or a
regulator configuration.

Regulator sub-node required properties:
- regulator-name		Regulator name for the PON regulator that
				is being configured.
- qcom,pon-spare-reg-addr	Register offset from the base address of the PON
				peripheral that needs to be configured for the
				regulator being controlled.
- qcom,pon-spare-reg-bit	Bit position in the specified register that
				needs to be configured for the regulator being
				controlled.

PON sub-node required properties:
- qcom,pon-type			The type of PON/RESET source. The driver
				currently supports KPDPWR(0), RESIN(1) and
				CBLPWR(2) pon/reset sources.

PON sub-node optional properties:
- qcom,pull-up			The initial state of the reset pin under
				consideration.
				0 = No pull-up
				1 = pull-up enabled
				This property is set to '0' if not specified.
- qcom,support-reset		Indicates if this PON source supports
				reset functionality.
				0 = Not supported
				1 = Supported
				If this property is not defined, then do not modify S2 reset
				values.
- qcom,use-bark                 Specify if this pon type needs to handle bark irq
- linux,code                    The input key-code associated with the reset source.
                                The reset source in its default configuration can be
                                used to support standard keys.

The below mentioned properties are required only when qcom,support-reset DT property is defined
and is set to 1.

- qcom,s1-timer			The debounce timer for the BARK interrupt for
				that reset source. Value is specified in ms.
				Supported values are -
				- 0, 32, 56, 80, 128, 184, 272, 408, 608, 904
				  1352, 2048, 3072, 4480, 6720, 10256
- qcom,s2-timer			The debounce timer for the S2 reset specified
				in ms. On the expiry of this timer, the PMIC
				executes the reset sequence. Supported values -
				- 0, 10, 50, 100, 250, 500, 1000, 2000
- qcom,s2-type			The type of reset associated with this source.
				The supported resets are -
				SOFT(0), WARM(1), SHUTDOWN(4), HARD(7)

Example:
	qcom,power-on@800 {
		compatible = "qcom,qpnp-power-on";
		reg = <0x800 0x100>;
		interrupts = <0x0 0x8 0x0>,
			     <0x0 0x8 0x1>,
			     <0x0 0x8 0x4>,
			     <0x0 0x8 0x5>;
		interrupt-names = "kpdpwr", "resin",
				"resin-bark", "kpdpwr-resin-bark";
		qcom,pon-dbc-delay = <15625>;
		qcom,system-reset;
		qcom,s3-debounce = <32>;
		qcom,s3-src = "resin";
		qcom,clear-warm-reset;
		qcom,store-hard-reset-reason;

		qcom,pon_1 {
			qcom,pon-type = <0>;
			qcom,pull-up = <1>;
			linux,code = <116>;
		};

		qcom,pon_2 {
			qcom,pon-type = <1>;
			qcom,support-reset = <1>;
			qcom,pull-up = <1>;
			qcom,s1-timer = <0>;
			qcom,s2-timer = <2000>;
			qcom,s2-type = <1>;
			linux,code = <114>;
			qcom,use-bark;
		};

		qcom,pon_3 {
			qcom,pon-type = <3>;
			qcom,support-reset = <1>;
			qcom,s1-timer = <6720>;
			qcom,s2-timer = <2000>;
			qcom,s2-type = <7>;
			qcom,pull-up = <1>;
			qcom,use-bark;
		};
	};
	qcom,power-on@800 {
		compatible = "qcom,qpnp-power-on";
		reg = <0x800 0x100>;
		qcom,secondary-pon-reset;
		qcom,hard-reset-poweroff-type = <PON_POWER_OFF_SHUTDOWN>;

		pon_perph_reg: qcom,pon_perph_reg {
			regulator-name = "pon_spare_reg";
			qcom,pon-spare-reg-addr = <0x8c>;
			qcom,pon-spare-reg-bit = <1>;
		};
	};
```

## Documentation/devicetree/bindings/platform/msm/qpnp-revid.txt
```
QPNP-REVID

QPNP-REVID provides a way to read the PMIC part number and revision.

Required properties:
- compatible : should be "qcom,qpnp-revid"
- reg : offset and length of the PMIC peripheral register map.

Example:
	qcom,revid@100 {
		compatible = "qcom,qpnp-revid";
		reg = <0x100 0x100>;
	};
```

## Documentation/devicetree/bindings/platform/msm/qpnp-usbdetect.txt
```
QPNP External USB VBUS Detection Circuit

Discrete USB VBUS detection circuitry can be connected to Qualcomm PMICs.
Such circuits can be used to detect the when a USB cable is connected to
an upstream port such as a standard host or a wall charger by detecting
the presence of VBUS voltage. The PMIC is notified by a detection event
via SPMI bus interrupt. A software driver can in turn notify the USB
subsytem using the power_supply framework.

Required Properties:
 - compatible: must be "qcom,qpnp-usbdetect"
 - interrupts: an interrupt triggered by the output of the detection circuit
 - interrupt-names: must be "vbus_det_irq"
 - vin-supply: phandle to a regulator that supplies 5V to this circuit

Example:

	usb_detect {
		compatible = "qcom,qpnp-usbdetect";
                interrupt-parent = <&spmi_bus>;
                interrupts = <0x0 0xCA 0x0>;  /* PMA8084 GPIO 11 */
                interrupt-names = "vbus_det_irq";
                vin-supply = <&vbus_det_reg>;
	};
```

## Documentation/devicetree/bindings/platform/msm/qpnp-vibrator.txt
```
QPNP Vibrator

QPNP (Qualcomm Plug N Play) vibrator is a peripheral on
Qualcomm PMICs.  The PMIC is connected to Host processor
via SPMI bus.

Required Properties:
 - status: default status is set to "disabled.  Must be "okay"
 - compatible: must be "qcom,qpnp-vibrator"
 - label: name which describes the device
 - reg: address of device

Optional Properties:
 - qcom,vib-timeout-ms: timeout of vibrator, in ms.  Default 15000 ms
 - qcom,vib-vtg-level-mV: voltage level, in mV.  Default 3100 mV
 - qcom,mode: mode in which vibrator is operating. It can be one of
		"manual", "dtest1", "dtest2" and "dtest3"
 - qcom,active-low: boolean to specify if the dtestx is operated
		in active low or high

Required Properties for "dtestx" mode:
 - qcom,pwm-channel: pwm channel number
 - qcom,period-us: period for pwm in micro secs
 - qcom,duty-us: duty cycle for pwm in micro secs


Example:
		qcom,vib@c000 {
			status = "okay";
			compatible = "qcom,qpnp-vibrator";
			reg = <0xc000 0x100>;
			label = "vibrator";
			qcom,vib-timeout-ms = <15000>;
			qcom,vib-vtg-level-mV = <3100>;
			qcom,mode = "dtest3";
			qcom,pwm-channel = <5>;
			qcom,period-us = <1000>;
			qcom,duty-us = <750>;
			qcom,active-low;
		};
```

## Documentation/devicetree/bindings/platform/msm/rmnet_ipa.txt
```
* Qualcomm Technologies, Inc. RmNet IPA driver module

This module enables embedded data calls using IPA HW.

Required properties:
- compatible:		Must be "qcom,rmnet-ipa"

Optional:
- qcom,rmnet-ipa-ssr: determine if modem SSR is supported
- qcom,ipa-loaduC: indicate that ipa uC should be loaded
- qcom,ipa-advertise-sg-support: determine how to respond to a query
regarding scatter-gather capability
- qcom,ipa-napi-enable: Boolean context flag to indicate whether
                        to enable napi framework or not
- qcom,wan-rx-desc-size: size of WAN rx desc fifo ring, default is 256

Example:
	qcom,rmnet-ipa {
		compatible = "qcom,rmnet-ipa";
		qcom,wan-rx-desc-size = <256>;
	}
```

## Documentation/devicetree/bindings/platform/msm/rmnet_ipa3.txt
```
* Qualcomm Technologies, Inc. RmNet IPA driver module

This module enables embedded data calls using IPA v3 HW.

Required properties:
- compatible:		Must be "qcom,rmnet-ipa3"

Optional:
- qcom,rmnet-ipa-ssr: determine if modem SSR is supported
- qcom,ipa-loaduC: indicate that ipa uC should be loaded
- qcom,ipa-advertise-sg-support: determine how to respond to a query
regarding scatter-gather capability

Example:
	qcom,rmnet-ipa3 {
		compatible = "qcom,rmnet-ipa3";
	}
```

## Documentation/devicetree/bindings/platform/msm/spss.txt
```
MSM Standby Processing Sub-System (SPSS) Controller

Required properties:
- compatible : Should be "qcom,msm-spss"
- reg : Offset and length of the register region for the device
- reg-names : Register region name referenced in 'reg' above
	The only required register resource entry is:
	"base"       : SPSS controller register block

The SPSS device may optionally have either or both of GENI-IR and
HDMI-CEC devices as the child devices.

The address-cells, size-cells and ranges properties ensure that the SPSS child
devices are properly enumerated.

Example:
	qcom,msm-spss@fc5c3000 {
		#address-cells = <1>;
		#size-cells = <1>;
		ranges;
		compatible = "qcom,msm-spss";
		reg-names = "base";
		reg = <0xfc5c3000 0x1000>;

		geni_ir_1: qcom,msm-geni-ir@fc5c1000 {

		...

		};
	};
```

## Documentation/devicetree/bindings/platform/msm/ssm.txt
```
* Qualcomm Technologies, Inc. Secure Service Module driver

This module enables framework to which a client can register itself
specifying different attributes and defining various permission levels
associated with different combination of attribute values and mode of the system.

Required properties:
- compatible:		Must be "qcom,ssm"

Example:
	qcom,ssm {
		compatible = "qcom,ssm";
	};
```

## Documentation/devicetree/bindings/platform/msm/uim_hs_lite.txt
```
* User Identification Module (UIM)

UIM provides an interface for UIM applications to communicate with UIM
cards in the UIM slots.

Required properties:
- compatible:	Must be "qcom,uim"
- reg :	Offset and length of the register regions for the device
- interrupts :	Interrupt numbers used by this controller

Optional properties:
- qcom,uim-1v8:	This property specifies that operation voltage
			of UIM interface is 1.8V.
- qcom,uim-clk-gpio:	This property specifies the GPIO number for
			UIM clock signal.
- qcom,uim-data-gpio:	This property specifies the.GPIO number for
			UIM data signal.
- qcom,uim-card-detect-gpio: This property specifies the GPIO number
			for UIM card detect signal.
- qcom,uim-reset-gpio:	This property specifies the GPIO number for
			UIM reset signal.

Example:
	uim@f995d000 {
		compatible = "qcom,uim";
		reg = <0xf995d000 0x1000>;
		interrupts = <0 101 0>;
		qcom,uim-1v8;
		qcom,uim-data-gpio = <&msmgpio 24 0>;
		qcom,uim-clk-gpio = <&msmgpio 25 0>;
		qcom,uim-reset-gpio = <&msmgpio 26 0>;
		qcom,uim-card-detect-gpio = <&msmgpio 27 0>;
	};
```
