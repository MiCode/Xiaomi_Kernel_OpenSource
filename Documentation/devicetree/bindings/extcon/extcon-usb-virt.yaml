## block/cpq/Kconfig
```kconfig
config CPQ_IOSCHED
    tristate "cpq io scheduler"
    default n
    help
      define this config to modify  io scheduler for gki.
```

## drivers/input/fingerprint/Kconfig
```kconfig
#
#Fingerprint
#
menu "Fingerprint support"
	depends on INPUT

config INPUT_FINGERPRINT
	tristate "Mediatek Fingerprint"
	default n
	help
	  Fingerprint mtk driver enable/disable
	  in the kernel.Say Y here if you want to
	  use mediatek fingerprint driver,fingerprint
	  driver will support fingerprint function

config XIAOMI_FINGERPRINT
    tristate "xiaomi fingerprint"
    default n
    help
      xiaomi fingerprint and mitee

endmenu
```

## drivers/input/fingerprint/mi_fp/Kconfig
```kconfig
config FINGERPRINT_MI_FP
	tristate "Finger print card mi_fp"
	default n
	depends on INPUT_FINGERPRINT
	help
	  Say Y here to enable support for retrieving self-test reports.
	  If unsure, say N.
	  To compile this driver as a module, choose M here.

config FP_HAVE_MULTI_SCREEN
	bool "Have multi screen"
	default n
	help
	  Enable register two screen in driver

config SIDE_FINGERPRINT
	bool "Side fingerprint"
	default n
	help
	  Side fingerprint configuration

config FOD_FINGERPRINT
	bool "Fod fingerprint"
	default n
	help
	  Fod fingerprint configuration

config ULTRA_FINGERPRINT_P11
	bool "ULTRA fingerprint"
	default n
	help
	  ULTRA fingerprint configuration

config ULTRA_AP_CTRL_INTR2
	bool "ULTRA fingerprint"
	default n
	help
	  ULTRA fingerprint intr2 configuration
```

## drivers/input/fingerprint/xiaomi_fp/Kconfig
```kconfig
config XIAOMI_FINGERPRINT
	tristate "Fingerprint card xiaomi_fingerprint"
	depends on INPUT_FINGERPRINT
	help
	  Say Y here to enable support for retrieving self-test reports.

	  If unsure, say N.

	  To compile this driver as a module, choose M here.
```

## drivers/input/misc/fs3002_haptic/Kconfig
```kconfig
#
# Foursemi fs3002 driver
#
config INPUT_FS3002_HAPTIC
	tristate "Foursemi FS3002 HAPTIC"
	depends on I2C
	help
	  Say Y here if you have Foursemi FS3002 haptic controller
	  chip in your system.

	  If unsure, say N.

	  To compile this driver as a module, choose M here.
```

## drivers/mi_ufs/Kconfig
```kconfig
# SPDX-License-Identifier: GPL-2.0-only
#
# MI UFS feature configuration
#

source "drivers/mi_ufs/mi_memory/Kconfig"
source "drivers/mi_ufs/mi_ffu/Kconfig"
source "drivers/mi_ufs/wb_check/Kconfig"
source "drivers/mi_ufs/cld/Kconfig"
config UFS_WB
	bool "UFS WB"
	depends on SCSI_UFS_QCOM
```

## drivers/mihw/Kconfig
```kconfig
config CFS_BANDWIDTH_MI
	tristate "cfs bandwidth by xiaomi"
	default n

config MI_DCVS_ARBI
        tristate "mi dcvs arbi"
        default n
        depends on MIHW
        help
          The case is used to manager multi voter clients of dcvs
```

## drivers/mihw/dcvs_arbi/Kconfig
```kconfig
# SPDX-License-Identifier: GPL-2.0-only
#
# MI DCVS ARBI configuration
#

config MI_DCVS_ARBI
	bool "MI DCVS ARBI Support"
	depends on QCOM_DCVS
	help
	  This option enables MI DCVS ARBI support for dynamic voltage
	  and frequency scaling arbitration.

	  This includes scheduler-based frequency control that adjusts
	  CPU and DDR frequencies based on run queue occupancy.

	  Features:
	  - Real-time run queue monitoring
	  - Cluster-based frequency control
	  - DDR frequency synchronization
	  - Fast switching between power modes
```

## drivers/misc/radio_cable_det/Kconfig
```kconfig
config RFCABLE_DETECT
	tristate "LXCOM radio cable detection"
	default n
	help
	  Say 'm' here to support radio cable detection
```

## drivers/misc/xiaomi/Kconfig
```kconfig
# SPDX-License-Identifier: GPL-2.0-only
#
# Misc memory devices
#

menu "Xiaomi Misc devices"
source "$(KCONFIG_EXT_PREFIX)drivers/misc/xiaomi/iorap2/Kconfig"
source "$(KCONFIG_EXT_PREFIX)drivers/misc/xiaomi/mi_wq_dynamic_priority/Kconfig"
endmenu
```

## drivers/misc/xiaomi/iorap2/Kconfig
```kconfig
config MI_IORAP
	tristate "app launch boost"
	default n
	help
	  This driver used for preread io for app launch.
```

## drivers/misc/xiaomi/mi_wq_dynamic_priority/Kconfig
```kconfig
config MI_FEATURE_WQ_DYNPRIO
    tristate "workqueue dynamic priority"
    default n
    help
      define this config to modify workqueue priority for gki.
```

## drivers/mist_factory_temp/Kconfig
```kconfig
config LX_THERMAL_INTERFACE
	tristate "lx factory thermal NTC GET TEMP"
	depends on THERMAL
	default n
	help
	  This is lx factory thermal NTC GET TEMP.
```

## drivers/power/policy/xm_smart_chg/Kconfig
```kconfig
config XM_SMART_CHG
	tristate "support xiaomi smart charge features"
	default n
	help
	  Say yes here to enable xm smart chg driver.
	  This driver contains charging control flow and
	  maintains charging status.
	  Say no if not xm smart chg driver.

config XM_DFX_CHARGER
	tristate "dfs Charger"
	depends on REGULATOR
	select EXTCON
	help
	  Say Y to enable dfs charger support, which allows multiple
	  chargers attached to a battery and multiple batteries attached to a
	  system. The dfs also can monitor charging status in
	  runtime and in suspend-to-RAM by waking up the system periodically
	  with help of suspend_again support.
```

## drivers/power/supply/battery_secret/Kconfig
```kconfig
config LC_BATTERY_SECRET
	tristate "lc battery secret ic drivers"
	default n
	help
		It needs a onewire physical controller to work.
```

## drivers/power/supply/lx_chg/Kconfig
```kconfig
# SPDX-License-Identifier: GPL-2.0
#charge_policy
source "drivers/power/supply/lx_chg/charger_policy/Kconfig"

#charger_ic
source "drivers/power/supply/lx_chg/charger_ic/Kconfig"

#protocol
source "drivers/power/supply/lx_chg/charger_ic/protocol/Kconfig"

#subpmic_sc6601a
source "drivers/power/supply/lx_chg/charger_ic/subpmic_sc6601a/Kconfig"

#subpmic_nu6601
source "drivers/power/supply/lx_chg/charger_ic/subpmic_nu6601/Kconfig"

#chargepump
source "drivers/power/supply/lx_chg/charger_ic/chargepump/Kconfig"

#fuelgauge
source "drivers/power/supply/lx_chg/fuelgauge/Kconfig"

config LX_CHARGER_IC
	tristate "support lx charger ic"
	default n
	help
		Say Y here to support lx charger ic.

config LX_ADAPTER_CLASS
	tristate "support lx charger adapter class"
	default n
	help
		Say Y here to support lx charger adapter class.

config LX_CHARGER_CLASS
	tristate "support lx charger class"
	default n
	help
		Say Y here to support lx charger class.

config LX_CP_CLASS
	tristate "support lx chager pump class"
	default n
	help
		Say Y here to support lx chager pump class.

config LX_LED_CLASS
	tristate "support lx led calss"
	default n
	help
		Say Y here to support lx led calss.

config PD_BATTERY_SECRET
	tristate "pd battery secret"
	default n
	help
		Say Y here to support pd battery secret.

config XIAOMI_SMART_CHG
        tristate "support xiaomi smart charge"
        default n
        help
                Say Y here to support xiaomi smart charge.

config XM_CHG_ANIMATION
        tristate "support xiaomi charge animation"
        default n
        help
                Say Y here to support xiaomi charge animation.

config XM_FG_I2C_ERR
        tristate "support xiaomi fg i2c error"
        default n
        help
                Say Y here to support xiaomi fg i2c error.

config RUST_DETECTION
        tristate "support lx charger manager"
        default n
        help
                Say Y here to support lx charger class.

config LX_ADAPTIVE_POWEROFF_VOLTAGE
        tristate "support adaptive poweroff voltage strategy."
        default n
        help
                Say Y here to adaptive poweroff voltage strategy.
```

## drivers/power/supply/lx_chg/charger_ic/Kconfig
```kconfig
#SPDX-License-Identifier: GPL-2.0

config CHARGEPUMP
	tristate "support chargepump"
	default n
	help
		Say Y here to support chargepump.

config SUBPMIC_SC6601A_DRIVER
	tristate "support subpmic sc6601a driver"
	default n
	help
		Say Y here to support subpmic sc6601a driver.


config SUBPMIC_NU6601_DRIVER
	tristate "support subpmic nu6601 driver"
	default n
	help
		Say Y here to support subpmic nu6601 driver.

config XM_SUB_PMIC
	tristate "support xm sub pmic"
	default n
	help
		Say Y here to support xm sub pmic.
```

## drivers/power/supply/lx_chg/charger_ic/chargepump/Kconfig
```kconfig
# SPDX-License-Identifier: GPL-2.0

config SC853X_CHARGER
	tristate "SC853X_CHARGER Driver"
	help
	  If you say yes here you will get support for the SC853x Charge Pump.
	  This driver can give support for SC853x Interface.

config BQ25960_CHARGER
	tristate "BQ25960_CHARGER Driver"
	help
	  If you say yes here you will get support for the bq25960 Charge Pump.
	  This driver can give support for bq25960 Interface.
```

## drivers/power/supply/lx_chg/charger_ic/protocol/Kconfig
```kconfig
menuconfig PROTOCOL
	tristate "support protocol for southchip"
	help
	  Say Y here to support protocol.

if PROTOCOL

source "drivers/power/supply/lx_chg/charger_ic/protocol/bc12/Kconfig"

endif
```

## drivers/power/supply/lx_chg/charger_policy/Kconfig
```kconfig
#SPDX-License-Identifier: GPL-2.0

config LX_CHARGER_MANAGER
	tristate "support lx charger manger"
	default n
	help
		Say Y here to support lx charger manger.

config LX_CP_POLICY
	tristate "support lx charger pump policy"
	default n
	help
		Say Y here to support lx charger class.

config LX_QC_POLICY
	tristate "support lx qc policy"
	default n
	help
		Say Y here to support lx charger class.
```
