## Documentation/devicetree/bindings/power/supply/qcom/qpnp-smblite.txt
```
Qualcomm Technologies, Inc. SMBLITE Charger Specific Bindings

SMBLITE Charger is an efficient programmable battery charger capable of charging a
lithium-ion battery over micro-USB or USB Type-C.

=======================
Required Node Structure
=======================

SMBLITE Charger must be described in two levels of devices nodes.

===================================
First Level Node - SMBLITE Charger
===================================

Charger specific properties:
- compatible
  Usage:      required
  Value type: <string>
  Definition: "qcom,qpnp-smblite".

- qcom,pmic-revid
  Usage:      required
  Value type: phandle
  Definition: Should specify the phandle of PMI's revid module. This is used to
		identify the PMI subtype.

- io-channels
- io-channel-names
  Usage:      optional
  Value type: <phandle>
  Definition: For details about IIO bindings see:
		Documentation/devicetree/bindings/iio/iio-bindings.txt

- qcom,batteryless-platform
  Usage:      optional
  Value type: <empty>
  Definition: Boolean flag which indicates that the platform does not have a
		battery, and therefore charging should be disabled. In
		addition battery properties will be faked such that the device
		assumes normal operation.

- qcom,fcc-max-ua
  Usage:      optional
  Value type: <u32>
  Definition: Specifies the maximum fast charge current in micro-amps in
		battery profile.
		If the value is not present, 1Amp is used as default.

- qcom,fv-max-uv
  Usage:      optional
  Value type: <u32>
  Definition: Specifies the maximum float voltage in micro-volts in
		battery profile.
		If the value is not present, 4.35V is used as default.

- qcom,usb-icl-ua
  Usage:      optional
  Value type: <u32>
  Definition: Specifies the USB input current limit in micro-amps.
		 If the value is not present, 1.5Amps is used as default.

- qcom,thermal-mitigation
  Usage:      optional
  Value type: Array of <u32>
  Definition: Array of fast charge current limit values for
		different system thermal mitigation levels.
		This should be a flat array that denotes the
		maximum charge current in mA for each thermal
		level.

- qcom,chg-inhibit-threshold-mv
  Usage:      optional
  Value type: <u32>
  Definition: Charge inhibit threshold in milli-volts. Charging will be
		inhibited when the battery voltage is within this threshold
		from Vfloat at charger insertion. If this is not specified
		then charge inhibit will be disabled by default.
		Allowed values are: 50, 100, 200, 300.

- qcom,chg-term-src
  Usage:      optional
  Value type: <u32>
  Definition: Specify either the ADC or analog comparators to be used in order
		to set threshold values for charge termination current.
		0 - Unspecified
		1 - Select ADC comparator
		2 - Select ANALOG comparator

- qcom,chg-term-current-ma
  Usage:      optional
  Value type: <u32>
  Definition: When ADC comparator is selected as qcom,chg-term-src, this
		parameter should be set to the desired upper threshold.

- qcom,chg-term-base-current-ma
  Usage:      optional
  Value type: <u32>
  Definition: When ADC comparator is selected as qcom,chg-term-src, this
		parameter should be set to the desired lower threshold.

- qcom,auto-recharge-soc
  Usage:      optional
  Value type: <u32>
  Definition: Specifies the SOC threshold at which the charger will
		restart charging after termination. The value specified
		ranges from 0 - 100. The feature is enabled if this
		property is specified with a valid SOC value.

- qcom,auto-recharge-vbat-mv
  Usage:      optional
  Value type: <u32>
  Definition: Specifies the battery voltage threshold at which the charger
		will restart charging after termination. The value specified
		is in milli-volts.

- qcom,suspend-input-on-debug-batt
  Usage:      optional
  Value type: <empty>
  Definition: Boolean flag which when present enables input suspend for
		debug battery.

- qcom,fake-chg-status-on-debug-batt
  Usage:      optional
  Value type: <empty>
  Definition: Boolean flag which when present shows charging status as
		unknown for debug battery. This needs to be specified only if
		the device needs to be kept powered on always with
		"svc power stayon true".

- qcom,typec-legacy-rp-icl
  Usage:       optional
  Value type:  bool
  Definition:  Boolean property to enable setting ICL based on Rp for
		Type-C non-compliant legacy cables.

- qcom,wd-bark-time-secs
  Usage:      optional
  Value type: <u32>
  Definition: WD bark-timeout in seconds. The possible values are
		16, 32, 64, 128. If not defined it defaults to 64.

- qcom,battery-data
  Usage:      optional
  Value type: <phandle>
  Definition: Specifies the phandle of the node which contains the battery
		profiles supported on the device.

- qcom,flash-derating-soc
  Usage:      optional
  Value type: <u32>
  Definition: SOC threshold in percentage below which hardware will start
		derating flash. This is only applicable to certain PMICs like
		PMI632 which has SCHGM_FLASH peripheral.

- qcom,flash-disable-soc
  Usage:      optional
  Value type: <u32>
  Definition: SOC threshold in percentage below which hardware will disable
		flash. This is only applicable to certain PMICs like PMI632
		which has SCHGM_FLASH peripheral.

- qcom,headroom-mode
  Usage:      optional
  Value type: <u32>
  Definition: Specifies flash hardware headroom management policy. The
		possible values are:
		<0>: Fixed mode, constant 5V at flash input.
		<1>: Adaptive mode allows charger output voltage to be
		dynamically controlled by the flash module based on the
		required flash headroom.
		This is only applicable to certain PMICs like PMI632 which
		has SCHGM_FLASH peripheral.

- qcom,fcc-stepping-enable
  Usage:      optional
  Value type: bool
  Definition: Boolean flag which when present enables stepwise change in FCC.
		The default stepping rate is 100mA/sec.

- qcom,disable-suspend-on-collapse
  Usage:      optional
  Value type: bool
  Definition: Boolean flag which when present disables suspend on collapse
		feature of charger hardware.

- qcom,fcc-step-delay-ms
  Usage:      optional
  Value type: <u32>
  Definition: Specifies the delay between each step of FCC stepper algorithm.
		If left unspecified, the default value is 1 Sec.

- qcom,fcc-step-size-ua
  Usage:      optional
  Value type: <u32>
  Definition: Specifies the step size of each step of FCC stepper algorithm.
		If left unspecified, the default value is 100mA.

=================================================
Second Level Nodes - SMBLITE Charger Peripherals
=================================================

Peripheral specific properties:
- reg
  Usage:      required
  Value type: <prop-encoded-array>
  Definition: Address and size of the peripheral's register block.

- interrupts
  Usage:      required
  Value type: <prop-encoded-array>
  Definition: Peripheral interrupt specifier.

- interrupt-names
  Usage:      required
  Value type: <stringlist>
  Definition: Interrupt names.  This list must match up 1-to-1 with the
	      interrupts specified in the 'interrupts' property.

=======
Example
=======

pm2250_charger: qcom,qpnp-smblite {
	compatible = "qcom,qpnp-smblite";
	#address-cells = <1>;
	#size-cells = <1>;
	#cooling-cells = <2>;

	qcom,pmic-revid = <&pm2250_revid>;
	qcom,chgr@1000 {
		reg = <0x1000 0x100>;
		interrupts =
			<0x0 0x10 0x1 IRQ_TYPE_EDGE_RISING>,
			<0x0 0x10 0x0 IRQ_TYPE_EDGE_RISING>,
			<0x0 0x10 0x4 IRQ_TYPE_EDGE_RISING>,
			<0x0 0x10 0x7 IRQ_TYPE_EDGE_RISING>;

		interrupt-names = "chgr-error",
			"chg-state-change",
			"buck-oc",
			"vph-ov";
	};

	qcom,dcdc@1100 {
		reg = <0x1100 0x100>;
		interrupts =
			<0x0 0x11 0x0 IRQ_TYPE_EDGE_RISING>,
			<0x0 0x11 0x1 IRQ_TYPE_EDGE_RISING>,
			<0x0 0x11 0x2 IRQ_TYPE_EDGE_RISING>,
			<0x0 0x11 0x6 IRQ_TYPE_EDGE_RISING>,
			<0x0 0x11 0x7 IRQ_TYPE_EDGE_BOTH>;

		interrupt-names = "otg-fail",
			"otg-fault",
			"skip-mode",
			"input-current-limiting",
			"switcher-power-ok";
	};

	qcom,batif@1200 {
		reg = <0x1200 0x100>;
		interrupts =
			<0x0 0x12 0x0 IRQ_TYPE_EDGE_BOTH>,
			<0x0 0x12 0x1 IRQ_TYPE_EDGE_BOTH>,
			<0x0 0x12 0x2 IRQ_TYPE_EDGE_BOTH>,
			<0x0 0x12 0x3 IRQ_TYPE_EDGE_BOTH>,
			<0x0 0x12 0x4 IRQ_TYPE_EDGE_RISING>;

		interrupt-names = "bat-temp",
			"bat-therm-or-id-missing",
			"bat-low",
			"bat-ov",
			"bsm-active";
	};

	qcom,usb@1300 {
		reg = <0x1300 0x100>;
		interrupts =
			<0x0 0x13 0x0 IRQ_TYPE_EDGE_BOTH>,
			<0x0 0x13 0x1 IRQ_TYPE_EDGE_BOTH>,
			<0x0 0x13 0x2 IRQ_TYPE_EDGE_BOTH>,
			<0x0 0x13 0x3 IRQ_TYPE_EDGE_BOTH>,
			<0x0 0x13 0x4 IRQ_TYPE_EDGE_RISING>,
			<0x0 0x13 0x6 IRQ_TYPE_EDGE_RISING>;

		interrupt-names = "usbin-plugin",
			"usbin-collapse",
			"usbin-uv",
			"usbin-ov",
			"usbin-gtvt",
			"usbin-icl-change";
	};

	qcom,typec@1500 {
		reg = <0x1500 0x100>;
		interrupts =
			<0x0 0x15 0x0 IRQ_TYPE_EDGE_BOTH>,
			<0x0 0x15 0x1 IRQ_TYPE_EDGE_BOTH>,
			<0x0 0x15 0x2 IRQ_TYPE_EDGE_RISING>,
			<0x0 0x15 0x4 IRQ_TYPE_EDGE_BOTH>,
			<0x0 0x15 0x5 IRQ_TYPE_EDGE_RISING>,
			<0x0 0x15 0x6 IRQ_TYPE_EDGE_RISING>,
			<0x0 0x15 0x7 IRQ_TYPE_EDGE_RISING>;

		interrupt-names = "typec-or-rid-detect-change",
			"typec-vpd-detect",
			"typec-cc-state-change",
			"typec-vbus-change",
			"typec-attach-detach",
			"typec-legacy-cable-detect",
			"typec-try-snk-src-detect";
	};

	qcom,misc@1600 {
		reg = <0x1600 0x100>;
		interrupts =
			<0x0 0x16 0x0 IRQ_TYPE_EDGE_RISING>,
			<0x0 0x16 0x1 IRQ_TYPE_EDGE_RISING>,
			<0x0 0x16 0x2 IRQ_TYPE_EDGE_RISING>,
			<0x0 0x16 0x3 IRQ_TYPE_EDGE_RISING>,
			<0x0 0x16 0x4 IRQ_TYPE_EDGE_RISING>,
			<0x0 0x16 0x5 IRQ_TYPE_EDGE_RISING>,
			<0x0 0x16 0x6 IRQ_TYPE_EDGE_BOTH>;

		interrupt-names = "wdog-snarl",
			"wdog-bark",
			"aicl-fail",
			"aicl-done",
			"imp-trigger",
			"all-chnl-cond-done",
			"temp-change";
	};
};
```

## Documentation/devicetree/bindings/power/supply/qcom/smb1351-charger.txt
```
Summit smb1351 battery charger

SMB1351 is a single-cell battery charger. It can charge
the battery and power the system via the USB/AC adapter input.

The smb1351 interface is via I2C bus.

Required Properties:
- compatible			Must be "qcom,smb1351-charger".
- reg				The device 7-bit I2C address.

Required Properties for standalone charger:
- regulator-name		A string used as a descriptive name for OTG regulator.
- pinctrl-names			The state name of the pin configuration. Only
				support "default".
- pinctrl-0			The phandle of the pin configuration node in
				pinctrl for smb_int_pin.

Optional Properties:

- interrupts			This indicates the IRQ number of the GPIO
				connected to the STAT pin.
- qcom,fastchg-current-max-ma 	Fast Charging current in mA. Supported range is
				from 1000mA to 4500mA.
- qcom,chg-autonomous-mode	This is a bool property and it indicates that the
				charger is configured for autonomous operation and
				does not require any software configuration.
- qcom,disable-apsd		This is a bool property which disables automatic
				power source detection (APSD). If this is set
				charger detection is done by DCIN UV irq.
- qcom,charging-disabled	This is a bool property which disables charging.
- qcom,using-pmic-therm		This property indicates thermal pin connected to pmic or smb.
- qcom,bms-psy-name		This is a string and it points to the bms
				power supply name.
- qcom,iterm-ma			Specifies the termination current to indicate end-of-charge.
				Possible values in mA - 70, 100, 200, 300, 400, 500, 600, 700.
- qcom,iterm-disabled		Disables the termination current feature. This is a bool
				property.
- qcom,float-voltage-mv	 	Float Voltage in mV - the maximum voltage up to which
				the battery is charged. Supported range 3500mV to 4500mV
- qcom,recharge-mv		Recharge threshold in mV - the offset from the float-volatge
				as which the charger restarts charging. Possible
				values are 50mV and 100mV.
- qcom,recharge-disabled	Boolean value which disables the auto-recharge.
- qcom,bms-controlled-charging	This property enables BMS to control EOC and
				recharge. BMS and charger communicates with each
				other via power_supply framework. This
				property should be used with 'qcom,iterm-disabled'
				to ensure EOC detection in charger is disabled.
- qcom,force-hvdcp-2p0		Boolean value which allows to force hvdcp working on 2.0 mode.
- qcom,parallel-charger		Boolean value which enables the parallel charger.
- qcom,chg-vadc			Corresponding VADC device's phandle.
- qcom,chg-adc_tm		phandle to the corresponding VADC device to read the ADC channels.
- qcom,batt-cold-decidegc	Cold battery temperature in decidegC.
- qcom,batt-hot-decidegc	Hot battery temperature in decidegC.
- qcom,batt-missing-decidegc	This is a property indicating battery missing temperature, if
				higher than it, battery should exist.
- qcom,batt-warm-decidegc:	Warm battery temperature in decidegC. After hitting this threshold,
				"qcom,warm-bat-ma" defines maximum charging current and
				"qcom,warm-bat-mv" defines maximum target voltage.
- qcom,batt-cool-decidegc:       Cool battery temperature in decidegC. After hitting this threshold,
				"qcom,cool-bat-ma" defines maximum charging current and
				"qcom,cool-bat-mv" defines maximum target voltage.
- qcom,batt-warm-ma:		Maximum warm battery charge current in milli-amps.
- qcom,batt-cool-ma:		Maximum cool battery charge current in milli-amps.
- qcom,batt-warm-mv:		Maximum warm battery target voltage in milli-volts.
- qcom,batt-cool-mv:		Maximum cool battery target voltage in milli-volts.
- qcom,parallel-en-pin-polarity Specify the polarity of enable signal controlled
				via pin in a parallel-charger configuration.
				0 - Active low and 1  - Active high.
				If not specified the default value is active-low.

Example for standalone charger:

&i2c_4 {
	smb1351_otg_supply: smb1351-charger@57 {
		compatible = "qcom,smb1351-charger";
		reg = <0x57>;
		interrupt-parent = <&msm_gpio>;
		interrupts = <62 2>;
		pinctrl-names = "default";
		pinctrl-0 = <&smb_int_default>;
		qcom,float-voltage-mv = <4350>;
		qcom,iterm-ma = <100>;
		qcom,recharge-mv = <100>;
		qcom,bms-psy-name = "bms";
		regulator-name = "smb1351_otg_vreg";
		qcom,using-pmic-therm;
		qcom,chg-adc_tm = <&pm8916_adc_tm>;
		qcom,chg-vadc = <&pm8916_vadc>;
		qcom,batt-hot-decidegc = <550>;
		qcom,batt-cold-decidegc = <0>;
		qcom,batt-missing-decidegc = <(-200)>;
		qcom,batt-warm-decidegc = <500>;
		qcom,batt-cool-decidegc = <50>;
		qcom,batt-warm-ma = <350>;
		qcom,batt-cool-ma = <350>;
		qcom,batt-warm-mv = <4200>;
		qcom,batt-cool-mv = <4200>;
	};
};

Example for parallel charger:

&i2c_11 {
	smb1351-charger@1d {
		compatible = "qcom,smb1351-charger";
		reg = <0x1d>;
		qcom,parallel-charger;
		qcom,float-voltage-mv = <4400>;
		qcom,recharge-mv = <100>;
	};
};
```
