## Documentation/devicetree/bindings/power/supply/qcom/smb1355-charger.txt
```
Qualcomm Technologies, Inc. SMB1355 Charger Specific Bindings

SMB1355 slave charger is paired with QTI family of standalone chargers to
enable a high current, low profile Li+ battery charging system.

The device provides 28V DC withstand, wide operating input range of 3.8 to
14.2V for standard 5V USB inputs as well as a wide variety of HVDCP Travel
Adapters and is compatible with QTI's Quick Charge technology.

=======================
Required Node Structure
=======================

SMB1355 Charger must be described in two levels of device nodes.

==================================
First Level Node - SMB1355 Charger
==================================

Charger specific properties:
- compatible
  Usage:      required
  Value type: <string>
  Definition: "qcom,smb1355".

- qcom,pmic-revid
  Usage:      required
  Value type: phandle
  Definition: Should specify the phandle of SMB's revid module. This is used
	      to identify the SMB subtype.

- qcom,disable-ctm
  Usage:      optional
  Value type: <empty>
  Definition: boolean flag. Usually a thermistor near usb/typeC connector is
	      connected to AUX. Set this flag to indicate the thermistor
	      doesn't exist.

- qcom,parallel-mode
  Usage:      optional
  Value type: <u32>
  Definition: Specifies parallel charging mode. If not specified, MID-MID
              option is selected by default.

- qcom,stacked-batfet
  Usage:      optional
  Value type: <empty>
  Definition: boolean flag. Specifies if parallel charger has stacked BATFET
              configuration.
	      In stacked batfet the main and parallel charger's batfet are
	      stacked one after the other and thus all the charge current
	      (FCC) flows through main. In a non-stacked configuration each
	      charger controls the charge current (FCC) separately.

- qcom,die-temp-threshold-degc
  Usage:      optional
  Value type: <u32>
  Definition: Specifies DIE temp threshold beyond which h/w starts mitigation.
	      If not sepcified, 90 degrees centigrade is used.

- qcom,hw-die-temp-mitigation
  Usage:      optional
  Value type: bool
  Definition: Boolean property to enable h/w controlled die temp mitigation.

- pinctrl-names
  Usage:      optional
  Value type: <string-list>
  Definition: Should be "default".
		Please refer to pinctrl-bindings.txt

- pinctrl-0
  Usage:      optional
  Value type: <phandle-list>
  Definition: phandle of the pin configuration.
		Please refer to pinctrl-bindings.txt

================================================
Second Level Nodes - SMB1355 Charger Peripherals
================================================

Peripheral specific properties:
- reg
  Usage:      required
  Value type: <prop-encoded-array>
  Definition: Address and size of the peripheral's register block.

- interrupts
  Usage:      required
  Value type: <prop-encoded-array>
  Definition: Peripheral interrupt specifier.

- interrupt-names
  Usage:      required
  Value type: <stringlist>
  Definition: Interrupt names.  This list must match up 1-to-1 with the
	      interrupts specified in the 'interrupts' property.

=======
Example
=======

smb1355_charger: qcom,smb1355-charger {
	compatible = "qcom,smb1355";
	#address-cells = <1>;
	#size-cells = <1>;

	qcom,chgr@1000 {
		reg = <0x1000 0x100>;
		interrupts = <0x10 0x1 IRQ_TYPE_EDGE_BOTH>;
		interrupt-names = "chg-state-change";
	};

	qcom,chgr-misc@1600 {
		reg = <0x1600 0x100>;
		interrupts = <0x16 0x1 IRQ_TYPE_EDGE_BOTH>;
		interrupt-names = "wdog-bark";
	};
};
```

## Documentation/devicetree/bindings/power/supply/qcom/smb1390-charger-psy.txt
```
Qualcomm Technologies, Inc. SMB1390 Charger Specific Bindings

SMB1390 charge pump is paired with QTI family of standalone chargers to
enable a high current, high efficiency Li+ battery charging system.

=======================
Required Node Structure
=======================

SMB1390 Charger must be described in two levels of device nodes.

==================================
First Level Node - SMB1390 Charger
==================================

Charger specific properties:
- compatible
  Usage:      required
  Value type: <string>
  Definition: "qcom,smb1390-charger-psy".

- qcom,pmic-revid
  Usage:      required
  Value type: phandle
  Definition: Should specify the phandle of SMB's revid module. This is used
	      to identify the SMB subtype.

- io-channels
- io-channel-names
  Usage:      required
  Value type: <phandle>
  Definition: For details about IIO bindings see:
	      Documentation/devicetree/bindings/iio/iio-bindings.txt

================================================
Second Level Nodes - SMB1390 Charger Peripherals
================================================

Peripheral specific properties:
- interrupts
  Usage:      required
  Value type: <prop-encoded-array>
  Definition: Peripheral interrupt specifier.

- interrupt-names
  Usage:      required
  Value type: <stringlist>
  Definition: Interrupt names.  This list must match up 1-to-1 with the
	      interrupts specified in the 'interrupts' property.

=======
Example
=======

smb1390_charger: qcom,charge_pump {
	compatible = "qcom,smb1390-charger-psy";
	qcom,pmic-revid = <&smb1390_revid>;
	interrupt-parent = <&smb1390>;
	status = "disabled";

	io-channels = <&pm8150b_vadc ADC_AMUX_THM2>;
	io-channel-names = "cp_die_temp";

	qcom,core {
		interrupts = <0x10 0x0 IRQ_TYPE_EDGE_RISING>,
			     <0x10 0x1 IRQ_TYPE_EDGE_RISING>,
			     <0x10 0x2 IRQ_TYPE_EDGE_RISING>,
			     <0x10 0x3 IRQ_TYPE_EDGE_RISING>,
			     <0x10 0x4 IRQ_TYPE_EDGE_RISING>;
		interrupt-names = "switcher-off-window",
				  "switcher-off-fault",
				  "vph-ov-soft",
				  "ilim",
				  "temp-alarm";
	};
};
```

## Documentation/devicetree/bindings/power/supply/qcom/smb1390-charger.txt
```
Qualcomm Technologies, Inc. SMB1390 Charger Specific Bindings

SMB1390 charge pump is paired with QTI family of standalone chargers to
enable a high current, high efficiency Li+ battery charging system.

=======================
Required Node Structure
=======================

SMB1390 Charger must be described in two levels of device nodes.

==================================
First Level Node - SMB1390 Charger
==================================

Charger specific properties:
- compatible
  Usage:      required
  Value type: <string>
  Definition: "qcom,smb1390-charger".

- qcom,pmic-revid
  Usage:      required
  Value type: phandle
  Definition: Should specify the phandle of SMB's revid module. This is used
	      to identify the SMB subtype.

- qcom,channel-num
  Usage:      required
  Value type: <u32>
  Definition: Specifies the ADC channel number for reading die temperature.

================================================
Second Level Nodes - SMB1390 Charger Peripherals
================================================

Peripheral specific properties:
- interrupts
  Usage:      required
  Value type: <prop-encoded-array>
  Definition: Peripheral interrupt specifier.

- interrupt-names
  Usage:      required
  Value type: <stringlist>
  Definition: Interrupt names.  This list must match up 1-to-1 with the
	      interrupts specified in the 'interrupts' property.

=======
Example
=======

smb1390_charger: qcom,charge_pump {
	compatible = "qcom,smb1390-charger";
	qcom,pmic-revid = <&smb1390_revid>;
	qcom,channel-num = <15>
	interrupt-parent = <&smb1390>;
	qcom,smb-vadc = <&pm8998_vadc>;
	status = "disabled";

	qcom,core {
		interrupts = <0x10 0x0 IRQ_TYPE_EDGE_RISING>,
			     <0x10 0x1 IRQ_TYPE_EDGE_RISING>,
			     <0x10 0x2 IRQ_TYPE_EDGE_RISING>,
			     <0x10 0x3 IRQ_TYPE_EDGE_RISING>,
			     <0x10 0x4 IRQ_TYPE_EDGE_RISING>;
		interrupt-names = "switcher-off-window",
				  "switcher-off-fault",
				  "vph-ov-soft",
				  "ilim",
				  "temp-alarm";
	};
};
```

## Documentation/devicetree/bindings/power/supply/qcom/smb1398-charger.txt
```
Qualcomm Technologies, Inc. SMB1398 Charger Specific Bindings

SMB1398 combo charge chip can be working in different modes:
(1) DIV2 charge pump mode to work as a companion charger that can be paired
    with Qualcomm Technologies, Inc. family of standalone chargers;
(2) DIV2 and 3-level buck combo mode to regulate output power from wireless
    charger receiver and provide input power for downstream chargers.

=======================
Required Node Structure
=======================

SMB1398 Charger must be described in two levels of device nodes.

==================================
First Level Node - SMB1398 Charger
==================================

Charger specific properties:
- compatible
  Usage:      required
  Value type: <string>
  Definition: "qcom,smb1396-div2-cp-master" for SMB1396 working in DIV2
	      mode as a companion master charger.
	      "qcom,smb1396-div2-cp-slave" for SMB1396 working in DIV2
	      mode as a companion slave charger.
	      "qcom,smb1398-pre-regulator" for SMB1398 working in combo
	      mode (auto transition between DIV2 CP and 3-level buck) as a
	      pre-regulator stand between wireless receiver and downstream
	      chargers.

- interrupts
  Usage:      optional
  Value type: <prop-encoded-array>
  Definition: Peripheral interrupt specifier. This is required when SMB1396
	      working as a DIV2 CP master.

- interrupt-names
  Usage:      optional
  Value type: <stringlist>
  Definition: Interrupt names.  This list must match up 1-to-1 with the
	      interrupts specified in the 'interrupts' property. This is
	      required when SMB1396 working as a DIV2 CP master.

- io-channels
- io-channel-names
  Usage:      optional
  Value type: <phandle>
  Definition: The IIO channel for measuring SMB1398 die temperature,
	      io-channel-names should be "die-temp". For other details about
	      IIO bindings see:
	             Documentation/devicetree/bindings/iio/iio-bindings.txt
	      These properties are required when SMB1396 working as a DIV2 CP
	      master.

- qcom,div2-cp-min-ilim-ua
  Usage:      optional
  Value type: <u32>
  Definition: The minimum ILIM settings to enable SMB1398 working in DIV2 mode.
	      The switcher is disabled when ILIM is below this value.
	      If this values is not specified, the default minimum ILIM is 1A.
	      This is only applicable when SMB1396 working as a DIV2 CP master.

- qcom,max-cutoff-soc
  Usage:      optional
  Value type: <u32>
  Definition: SOC beyond which SMB1398 is kept disabled.
	      If this value is not specified then default value is 85%.
	      This is only applicable when SMB1396 working as a DIV2 CP master.

- qcom,ilim-ua-disable-slave
  Usage:      optional
  Value type: <u32>
  Definition: The minimum ILIM setting to disable slave CP after hitting taper.
	      If this value is not specified, the default value is 3 times of
	      "qcom,div2-cp-min-ilim-ua". This is only applicable when both
	      SMB1396 DIV2 CP master and slave are present.

Peripheral specific properties:
=======
Example
=======

smb1398_charger: qcom,combo_charger {
	compatible = "qcom,smb1396-div2-cp-master";
	interrupt-parent = <&smb1398>;
	status = "disabled";

	io-channels = <&pm8150b_vadc ADC_AMUX_THM2>;
	io-channel-names = "die_temp";

	interrupts = <0x26 0x1 IRQ_TYPE_EDGE_RISING>,
		     <0x26 0x3 IRQ_TYPE_EDGE_RISING>,
		     <0x26 0x5 IRQ_TYPE_EDGE_RISING>,
		     <0x26 0x7 IRQ_TYPE_EDGE_RISING>,
		     <0x27 0x5 IRQ_TYPE_EDGE_RISING>,
		     <0x27 0x6 IRQ_TYPE_EDGE_RISING>,
		     <0x27 0x7 IRQ_TYPE_EDGE_RISING>;
	interrupt-names = "temp-shdwn",
			  "div2-irev",
			  "usbin-uv",
			  "usbin-ov",
			  "div2-ilim",
			  "div2-win-uv",
			  "div2-win-ov";
};
```

## Documentation/devicetree/bindings/power_supply/bq27441_battery.txt
```
bq27441 battery
~~~~~~~~~~~~~~~~

Required properties :
 - compatible : Should contain "ti,bq27441".
 - ti,tz-name : Thermal zone name.
Optional properties :
 - ti,design-capacity : The designed battery capacity used for
   gauge's predictions. in mAh.
 - ti,design-energy : The designed battery energy. in mWh.
 - ti,taper-rate : The current threshold below which your charger
   IC is set to stop charging once it considers the battery to be
   full. in mA.
 - ti,terminate-voltage : Should be set to the minimum operating
   voltage of your system. This is the target where the gauge
   typically reports 0% capacity. in mV.
 - ti,v-at-chg-term : Voltage at charge termination. in mV.

Example:

	bq27441@55 {
		compatible = "ti,bq27441";
		ti,design-capacity = <7800>;
		ti,design-energy = <28314>;
		ti,taper-rate = <167>;
		ti,terminate-voltage = <3150>;
		ti,v-at-chg-term = <4200>;
		ti,tz-name = "battery-temp";
	};
```

## Documentation/devicetree/bindings/power_supply/cw201x_battery.txt
```
cw201x_battery
~~~~~~~~~~~~~~~~

Required properties :
 - compatible : Should contain "cw,cw201x".
 - alert-threshold : Alert threshold. in %(percentage). 0~32.
 - profile-tbl : Custom profile data. This should be 64 entries(64 bytes).
     This value depends on custom model.

Contact Cellwise for details on how to configure the values involved with custom model.

Example:
	cw201x@62 {
		compatible = "cw,cw201x";
		reg = <0x62>;
		alert-threshold = <0>;
		profile-tbl = <0x15 0x7E 0x64 0x63 0x60 0x5A 0x53 0x50
			0x4E 0x4B 0x49 0x46 0x48 0x43 0x2F 0x22
			0x18 0x0F 0x0D 0x12 0x21 0x36 0x48 0x58
			0x4F 0xA2 0x08 0xF6 0x1D 0x3B 0x46 0x4C
			0x59 0x5C 0x5C 0x60 0x3F 0x1B 0x6C 0x45
			0x26 0x41 0x20 0x56 0x86 0x95 0x96 0x0E
			0x45 0x6A 0x96 0xC1 0x80 0xB8 0xF0 0xCB
			0x2F 0x7D 0x72 0xA5 0xB5 0xC1 0x5B 0x1D>;
	};
```

## Documentation/devicetree/bindings/power_supply/lc709203f_battery.txt
```
lc709203f battery
~~~~~~~~~~~~~~~~

Required properties :
 - compatible : Should contain "onsemi,lc709203f".
 - onsemi,initial-rsoc : INITIAL_RSOC register value to be written

Optional properties:
 - onsemi,tz-name : Thermal zone name.
 - onsemi,thermistor-beta : THERMISTOR_B register value to be written
 - onsemi,appli-adjustment: adjustment appli of parameter.
 - onsemi,thermistor-adjustment: adjustment thermistor pack.
 - onsemi,kernel-threshold-soc: Minimum SoC for kernel read from device.
	Bootloader jumps to kernel when SoC is more than this value.
	Driver make this SoC as 0% before reporting it to teh framework.
 - onsemi,kernel-maximum-soc: Maximum SoC for kernel read from device.
	Kernel read maximum SoC from device for given battery. Kernel
	translate the SoC to 100% before reporting to framework if it
	reads equal/more than this value.

Note: The device has capabilty to read battery temp through thermistor.
This also calulate SoC based on temperature of battery. If thermistor
is not connected to this device on a given platform then the temp can be
written on the the device register to consider the battery temperature
on SoC calculation.

If battery thermistor is connected to the device's Tsense pin then following
properties are required:
	onsemi,thermistor-beta

if battery thermistor isnot connected to device and temperature is read from
other source then following properties are required:
	onsemi,tz-name

Example:

	lc709203f@0b {
		compatible = "onsemi,lc709203f";
		onsemi,tz-name = "battery-temp";
		onsemi,thermistor-beta = 0x0d34;
		onsemi,initial-rsoc = 0xAA55;
		onsemi,kernel-threshold-soc = <5>;
		onsemi,kernel-maximum-soc = <99>;
	};
```
