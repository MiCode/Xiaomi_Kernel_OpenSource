## Documentation/devicetree/bindings/power_supply/max17048_battery.txt
```
max17048_battery
~~~~~~~~~~~~~~~~

Required properties :
 - compatible : Should contain "maxim,max17048".
 - alert-threshold : Alert threshold. in %(percentage). 0~32.
 - one-percent-alerts : 1% alert mode control.
     1=enable, 0=disable.
 - valert-max : Maximum Voltage threshold for alert. in mV.
     This value should be multiple of 20mV. 0~5100mV.
 - valert-min : Minimum voltage threshold for alert. in mV.
     This value should be multiple of 20mV. 0~5100mV.
 - vreset-threshold : Voltage threshold for reset. in mV.
     This value should be multiple of 40mV. 0~5080mV.
 - vreset-disable : Voltage threshold reset control.
     1=disable, 0=enable
 - hib-thhreshold : Threshold to enter hibernate mode. in 0.208%/hr. 0~255.
     If the absolute value of CRATE is less than this for longer than 6min,
     the IC enters hibernate mode.
 - hib-active-threshold : Hibernate active threshold. in 1.25mV. 0~255.
     If at any ADC sample is greater than this, the IC exits hibernate mode
     and 6min timer is reset.
 - bits : 19-bit or 18-bit model.
     19=19-bit model, 18=18-bit model.
     This value is depends on custom model.
 - rcomp : Starting RCOMP value. 0~255.
     This value is depends on custom model.
 - rcomp-seg : RCOMPSEG register.
     This value is depends on custom model.
 - soccheck-a : SOC check low value. in %(percentage).
     This value is depends on custom model.
 - soccheck-b : SOC check high value. in %(percentage).
     This value is depends on custom model.
 - ocvtest : OCV test value.
     This value is depends on custom model.
 - data-tbl : Custom model data. This should be 64 entries(64 bytes).
     This value is depends on custom model.

Contact Maxim for details on how to configure the values involved with custom model.

Optional properties :
 - use-ac : Use AC charging.
     If not present, AC charging will not be used.
 - use-usb : Use USB charging.
     If not present, USB charging will not be used.

Example:

	max17048@36 {
		compatible = "maxim,max17048";
		reg = <0x36>;
		use-ac;
		use-usb;
		alert-threshold = <0>;
		one-percent-alerts = <0>;
		valert-max = <0>;
		valert-min = <0>;
		vreset-threshold = <0>;
		vreset-disable = <0>;
		hib-threshold = <0>;
		hib-active-threshold = <0>;
		bits = <0>;
		rcomp = <0>;
		rcomp-seg = <0x0000>;
		soccheck-a = <0>;
		soccheck-b = <0>;
		ocvtest = <0>;
		data-tbl = <0x00 0x00 0x00 0x00 0x00 0x00 0x00 0x00
			0x00 0x00 0x00 0x00 0x00 0x00 0x00 0x00
			0x00 0x00 0x00 0x00 0x00 0x00 0x00 0x00
			0x00 0x00 0x00 0x00 0x00 0x00 0x00 0x00
			0x00 0x00 0x00 0x00 0x00 0x00 0x00 0x00
			0x00 0x00 0x00 0x00 0x00 0x00 0x00 0x00
			0x00 0x00 0x00 0x00 0x00 0x00 0x00 0x00
			0x00 0x00 0x00 0x00 0x00 0x00 0x00 0x00>;
	};
```

## Documentation/devicetree/bindings/power_supply/msm-poweroff.txt
```
MSM Restart Driver

A power supply hold (ps-hold) bit is set to power the msm chipsets.
Clearing that bit allows us to restart/poweroff. The difference
between poweroff and restart is determined by unique power manager IC
settings.

Required Properties:
-compatible: "qcom,pshold"
-reg: Specifies the physical address of the ps-hold register
      This value must correspond to "pshold-base" as defined in reg-names
-reg-names: must contain "pshold-base"
	    may also contain "tcsr-boot-misc-detect"

Optional Properties:
-reg: A secondary reg address/size pair may be provided, to specify the address
      of the TCSR_BOOT_MISC_DETECT register. This address is typically used to
      configure the type of reset desired. Omitting this address implies that
      the reset type shall be configured by means of a call to the secure
      environment. This value must correspond to "tcsr-boot-misc-detect" as
      defined in reg-names
-reg-names: must contain "tcsr-boot-misc-detect" if the secondary address/size
      pair described above is defined.

Example:

	restart@fc4ab000 {
		compatible = "qcom,pshold";
		reg = <0xfc4ab000 0x4>;
	};
```

## Documentation/devicetree/bindings/pps/pps-gpio.txt
```
Device-Tree Bindings for a PPS Signal on GPIO

These properties describe a PPS (pulse-per-second) signal connected to
a GPIO pin.

Required properties:
- compatible: should be "pps-gpio"
- gpios: one PPS GPIO in the format described by ../gpio/gpio.txt

Optional properties:
- assert-falling-edge: when present, assert is indicated by a falling edge
                       (instead of by a rising edge)
- use-system-time-ts: use the system time via pps_get_ts as the timestamp
                      if this is not defined then the timestamp will come
                      from the monotonic boot time

Example:
	pps {
		compatible = "pps-gpio";
		gpios = <&gpio2 6 0>;

		assert-falling-edge;
	};
```

## Documentation/devicetree/bindings/prng/msm-rng.txt
```
* RNG (Random Number Generator)

Required properties:
- compatible : Should be "qcom,msm-rng"
- reg        : Offset and length of the register set for the device

Optional property:
- qcom,msm-rng-iface-clk : If the device uses iface-clk.
- qcom,no-qrng-config    : Flag to decide whether the driver do the hardware configuration or not.

Example:

	qcom,msm-rng@f9bff000 {
		compatible = "qcom,msm-rng";
		reg = <0xf9bff000 0x200>;
		qcom,msm-rng-iface-clk;
		qcom,no-qrng-config;
	};
```

## Documentation/devicetree/bindings/ptp/qcom,ptp_virtual.txt
```
* Qcom virtual gPTP Data based shared memory IPC

Required properties:
- compatible: should contain the core compatibility string
              and the SoC compatibility string. The SoC
              compatibility string is to handle SoC specific
              hardware differences.
              Core compatibility string:
                 "qcom,ptp_virtual"
- reg: address and length of the shared memory for gPTP data

Example:

ptp_virtual {
	compatible = "qcom,ptp_virtual";
	reg = <0xeb600000 0x1000>;
};
```

## Documentation/devicetree/bindings/pwm/pwm-qcom.txt
```
Qualcomm Technologies Inc. PWM controller

PDM is used for generating density modulated signals that, after passing
through a filter, become analog signals. It can produce fixed densities
or alternate between densities to create variations in the analog signal.

PWM has the following use:
1) Duty cycle control of the backlight.


Required properties:
- compatible: should be "qcom,pdm-pwm"

- reg: physical base address and length of the controller's registers.

- clocks: clocks required for enabling PWM block.

- #pwm-cells: shall contain 2.

- pwm@<num> : defines pwm instances.

- frame-index : each pwm has 10 frames 0-9 and they are designed to stand by
		themselves independent of the other frame. For this reason,
		each PWM instance has its own set of configuration registers.
- frame-offset: offset of each pwm instance from base.

Example:

	pdm_pwm0: pdm_pwm_test@600000 {
		compatible = "qcom,pdm-pwm";
		reg = <0x600000 0xc000>;
		clocks = <&clock_gcc GCC_PDM_AHB_CLK>,
			<&clock_gcc GCC_PWM0_XO512_CLK>;
		clock-names = "pdm_ahb_clk", "pwm_core_clk";
		#pwm-cells = <2>;

		pwm@0{
			frame-index = <0>;
			frame-offset = <0x1000>;
		};
	};
```

## Documentation/devicetree/bindings/pwm/pwm-qti-lpg.txt
```
Qualcomm Technologies, Inc. LPG driver specific bindings

This binding document describes the properties of LPG (Light Pulse Generator)
device module in Qualcomm Technologies, Inc. PMIC chips.

- compatible:
	Usage: required
	Value type: <string>
	Definition: Must be "qcom,pwm-lpg".

- reg:
	Usage: required
	Value type: <prop-encoded-array>
	Definition: Register base and length for LPG and LUT modules. LPG size
		      or length available per channel varies depending on the
		      number of channels in PMIC.

- reg-names:
	Usage: required
	Value type: <string>
	Definition: The name of the register defined in the reg property.
		      It must have "lpg-base", "lut-base" is optional but
		      it's required if any LPG channels support LUT mode.

- #pwm-cells:
	Usage: required
	Value type: <u32>
	Definition: The number of cells in "pwms" property specified in
		      PWM user nodes. It should be 2. The first cell is
		      the PWM channel ID indexed from 0, and the second
		      cell is the PWM default period in nanoseconds.

- qcom,lut-patterns:
	Usage: optional
	Value type: <prop-encoded-array>
	Definition: Duty ratios in percentages for LPG working at LUT mode.
		      These duty ratios will be translated into PWM values
		      and stored in LUT module. The LUT module has resource
		      to store 47 PWM values at max and shared for all LPG
		      channels. This property is required if any LPG channels
		      support LUT mode.

- qcom,sync-channel-ids:
	Usage: optional
	Value type: <prop-encoded-array>
	Definition: The hardware IDs of the LPG channel that required be
		      grouped together. These channels will share the same LUT
		      ramping configuration so that they will be enabled with a
		      synchronized pattern. If the LUT ramping configuration
		      differs for the channels grouped for synchronization,
		      configuration of the first channel will be applied for
		      all others.

Subnode is optional if LUT mode is not required, it's required if any LPG
channels expected to be supported in LUT mode.

Subnode properties:
Subnodes for each LPG channel (lpg@X) can be defined if any of the following
parameters needs to be configured for that channel.

- qcom,lpg-chan-id:
	Usage: required
	Value type: <u32>
	Definition: The LPG channel's hardware ID indexed from 1. Allowed
		      range is 1 - 8. Maximum value depends on the number of
		      channels supported on PMIC.

- qcom,ramp-step-ms:
	Usage: required
	Value type: <u32>
	Definition: The step duration in milliseconds for LPG staying at each
		      duty specified in the LUT pattern. Allowed range is
		      1 - 511.

- qcom,ramp-high-index:
	Usage: required
	Value type: <u32>
	Definition: The high index of the LUT pattern where LPG ends up
		      ramping to. Allowed range is 1 - 47.

- qcom,ramp-low-index:
	Usage: required
	Value type: <u32>
	Definition: The low index of the LUT pattern from where LPG begins
		      ramping from. Allowed range is 0 - 46.

- qcom,ramp-from-low-to-high:
	Usage: optional
	Value type: <empty>
	Definition: The flag to specify the LPG ramping direction. The ramping
		      direction is from low index to high index of the LUT
		      pattern if it's specified.

- qcom,ramp-pattern-repeat:
	Usage: optional
	Value type: <empty>
	Definition: The flag to specify if LPG would be ramping with the LUT
		      pattern repeatedly.

- qcom,ramp-toggle:
	Usage: optional
	Value type: <empty>
	Definition: The flag to specify if LPG would toggle the LUT pattern
		      in ramping. If toggling enabled, LPG would return to the
		      low index when high index is reached, or return to the high
		      index when low index is reached.

- qcom,ramp-pause-hi-count:
	Usage: optional
	Value type: <u32>
	Definition: The step count that LPG stop the output when it ramped up
		      to the high index of the LUT.

- qcom,ramp-pause-lo-count:
	Usage: optional
	Value type: <u32>
	Definition: The step count that LPG stop the output when it ramped up
		      to the low index of the LUT.
Example:

	pmi8998_lpg: lpg@b100 {
		compatible = "qcom,pwm-lpg";
		reg = <0xb100 0x600>, <0xb000 0x100>;
		reg-names = "lpg-base", "lut-base";
		#pwm-cells = <2>;
		qcom,lut-patterns = <0 14 28 42 56 70 84 100
					100 84 70 56 42 28 14 0>;
		qcom,sync-channel-ids = <3 4 5>;
		lpg@3 {
			qcom,lpg-chan-id = <3>;
			qcom,ramp-step-ms = <200>;
			qcom,ramp-pause-hi-count = <10>;
			qcom,ramp-pause-lo-count = <10>;
			qcom,ramp-low-index = <0>;
			qcom,ramp-high-index = <15>;
			qcom,ramp-from-low-to-high;
			qcom,ramp-pattern-repeat;
		};
		lpg@4 {
			qcom,lpg-chan-id = <4>;
			qcom,ramp-step-ms = <200>;
			qcom,ramp-pause-hi-count = <10>;
			qcom,ramp-pause-lo-count = <10>;
			qcom,ramp-low-index = <0>;
			qcom,ramp-high-index = <15>;
			qcom,ramp-from-low-to-high;
			qcom,ramp-pattern-repeat;
		};
		lpg@5 {
			qcom,lpg-chan-id = <5>;
			qcom,ramp-step-ms = <200>;
			qcom,ramp-pause-hi-count = <10>;
			qcom,ramp-pause-lo-count = <10>;
			qcom,ramp-low-index = <0>;
			qcom,ramp-high-index = <15>;
			qcom,ramp-from-low-to-high;
			qcom,ramp-pattern-repeat;
		};
	};
```
