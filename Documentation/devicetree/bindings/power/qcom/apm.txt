## Documentation/devicetree/bindings/power/qpnp-typec.txt
```
QPNP USB Type-C module

QPNP USB Type-C module supports USB type-c ports and detection of
USB Type-C chargers that can supply upto 3A Vbus current for charging.

The QPNP USB Type-C interfaces via the SPMI bus.

Required properties :
- compatible : Must be "qcom,qpnp-typec"
- reg:			The SPMI address for this peripheral
- interrupts:		Specifies the interrupt associated with the peripheral.
- interrupt-names:	Specifies the interrupt names for the peripheral. Every
			available interrupt needs to have an associated name
			with it to indentify its purpose.

			- vrd-change:		Triggers on change in current
						capability of charger.
			- ufp-detach:		Triggers on cable detach in
						UFP mode.
			- ufp-detect:		Triggers on charger insertion.
			- dfp-detach:		Triggers on cable detach in
						DFP mode.
			- dfp-detect:		Triggers on OTG cable insertion.
			- vbus-err:		Triggers if VBUS is not
						detected within 275 msec after
						CC detection in UFP mode.
			- vconn-oc:		Triggers on VCONN overcurrent
						in DFP mode with active cable.

Optional properties:
- pinctrl-names : This should be defined if a target uses pinctrl framework
  for SSMUX control pin. See "pinctrl" in
  Documentation/devicetree/bindings/pinctrl/pinctrl-bindings.txt.
  It should specify the names of the configs that pinctrl can install in driver.
  Following are the pinctrl config that can be installed:
      "typec_ssmux_config" : Default configuration of pins.
- <supply-name>-supply: handle to the regulator device tree node.
        "supply-name" is "ss-mux" regulator to drive super-speed MUX chip.

Example:
	qcom,qpnp-typec@bf00 {
		compatible = "qcom,qpnp-typec";
		reg = <0xbf00 0x100>;
		interrupts =	<0x0 0xbf 0x0>,
				<0x0 0xbf 0x1>,
				<0x0 0xbf 0x2>,
				<0x0 0xbf 0x3>,
				<0x0 0xbf 0x4>,
				<0x0 0xbf 0x6>,
				<0x0 0xbf 0x7>;

		interrupt-names =	"vrd-change",
					"ufp-detach",
					"ufp-detect",
					"dfp-detach",
					"dfp-detect",
					"vbus-err",
					"vconn-oc";
	};
```

## Documentation/devicetree/bindings/power/qpnp-vm-bms.txt
```
Qualcomm's QPNP Voltage-Mode(VM) PMIC Battery Management System

QPNP PMIC VM BMS provides interface to clients to read properties related
to the battery. Its main function is to calculate the SOC (state of charge)
of the battery based on periodic sampling of the VBAT (battery voltage).

Parent node required properties:
- compatible	: Must be  "qcom,qpnp-vm-bms" for the BM driver.
- reg		: Offset and length of the PMIC peripheral register map.
- interrupts	: The interrupt mappings.
		  The format should be
		  <slave-id peripheral-id interrupt-number>.
- interrupt-names : names for the mapped bms interrupt
		The following interrupts are required:
		0 : leave CV state
		1 : enter CV state
		2 : good ocv generated
		3 : ocv_thr
		4 : fifo update
		5 : fsm state chnaged

Additionally, optional subnodes may be included:
- qcom,batt-pres-status : A subnode with a register address for the SMBB
		battery interface's BATT_PRES_STATUS register. If this node is
		added, then the BMS will try to detect offmode battery removal
		via the battery interface's offmode battery removal circuit.
- qcom,battery-data : A phandle to a node containing the available batterydata
		profiles. See the batterydata bindings documentation for more
		details.

Parent node required properties:
- qcom,v-cutoff-uv : cutoff voltage where the battery is considered dead in
			micro-volts.
- qcom,max-voltage-uv : maximum voltage for the battery in micro-volts.
- qcom,r-conn-mohm : connector resistance in milli-ohms.
- qcom,shutdown-soc-valid-limit : If the ocv upon restart is within this
			distance of the shutdown ocv, the BMS will try to force
			the new SoC to the old one to provide charge continuity.
			That is to say,
				if (abs(shutdown-soc - current-soc) < limit)
				then use old SoC.
- qcom,low-soc-calculate-soc-threshold : The SoC threshold for when
			the periodic calculate_soc work speeds up. This ensures
			SoC is updated in userspace constantly when we are near
			shutdown.
- qcom,low-voltage-threshold : The battery voltage threshold in micro-volts for
			when the BMS tries to wake up and hold a wakelock to
			ensure a clean shutdown.
- qcom,low-voltage-calculate-soc-ms : The time period between subsequent
			SoC recalculations when the current voltage is below
			qcom,low-voltage threshold. This takes precedence over
			qcom,low-soc-calculate-soc-ms.
- qcom,low-soc-calculate-soc-ms : The time period between subsequent
			SoC recalculations when the current SoC is below
			qcom,low-soc-calculate-soc-threshold. This takes
			precedence over qcom,calculate-soc-ms.
- qcom,calculate-soc-ms : The time period between subsequent SoC
			recalculations when the current SoC is above or equal
			qcom,low-soc-calculate-soc-threshold.
- qcom,bms-vadc: Corresponding VADC device's phandle.
- qcom,bms-adc_tm: Corresponding ADC_TM device's phandle to set recurring
                        measurements and receive notifications for vbatt.
- qcom,pmic-revid : Phandle pointing to the revision peripheral node.

Parent node Optional properties
- qcom,s1-sample-interval-ms: The sampling rate in ms of the accumulator in state
			S1. (i.e) the rate at which the accumulator is being
			filled with vbat samples. Minimum value = 0 and
			Maximum value = 2550ms.
- qcom,s2-sample-interval-ms: The sampling rate in ms of the accumulator in state
			S2. (i.e) the rate at which the accumulator is being
			filled with vbat samples. Minimum value = 0 and
			Maximum value = 2550ms.
- qcom,s1-sample-count: The number of samples to be accululated for one FIFO in
			state S1. Possible values are - 0, 4, 8, 16, 32, 64, 128,
			256.
- qcom,s2-sample-count: The number of samples to be accululated for one FIFO in
			state S2. Possible values are - 0, 4, 8, 16, 32, 64, 128,
			256.
- qcom,s1-fifo-legth:	Number of FIFO's to be filled in state S1, to generate
			the fifo_update_done interrupt. Possile values - 0 to 8
- qcom,s2-fifo-legth:	Number of FIFO's to be filled in state S2, to generate
			the fifo_update_done interrupt. Possible values- 0 to 8
- qcom,force-s3-on-suspend : Bool property to force the BMS into S3 (sleep) state
			while entering into system suspend.
- qcom,force-bms-active-on-charger: Bool property to keep BMS FSM active
				if charger is present.
- qcom,report-charger-eoc : Bool property to indicate if BMS needs to indicate
			EOC to charger.
- qcom,ignore-shutdown-soc: A boolean that controls whether BMS will
			try to force the startup SoC to be the same as the
			shutdown SoC. Defining it will make BMS ignore the
			shutdown SoC.
- qcom,use-voltage-soc : A boolean that controls whether BMS will use
			voltage-based SoC instead of a coulomb counter based
			one. Voltage-based SoC will not guarantee linearity.
- qcom,disable-bms :	Bool property to disable the VMBMS hardware module.
			Enable this property if BMS is not supported or an external
			fuel gauge is used.
- qcom,s3-ocv-tolerence-uv : The S3 state OCV tolerence threshold in uV. The
			LSB value is 300uV and maximum value is 76500uV.
- qcom,low-soc-fifo-length : The fifo length (of S2 STATE) to be used at lower
			SOCs. If this value is not specified the system uses
			default lenght.
- qcom,resume-soc:	Capacity in percent at which charging should resume
			when a fully charged battery drops below this level.
- qcom,low-temp-threshold : The temperature threshold below which the IBAT
			averaging and UUC smoothening is disabled. This value
			is in deci-degrees centigrade. If not specified it
			defaults to 0.
- qcom,ibat-avg-samples : The number of samples to be averaged for IBAT
			estimation. If not specified it defaults to 16.
			The possible values are 1 to 16.
- qcom,batt-aging-comp : A boolean that defines if battery aging compensation
			is enabled.
- qcom,use-reported-soc : Bool property to enable the reported_soc logic. To
			enable this feature, qcom,resume-soc must be defined as
			a proper value. The BMS is also required to control the
			charging, discharging and recharging.

qcom,batt-pres-status node required properties:
- reg : offset and length of the PMIC LBC battery interface BATT_PRES_STATUS
		register.

qcom,qpnp-chg-pres required properties:
- reg : offset and length of the PMIC LBC charger interafce CHARGER_OPTION
		register.

Example:
pm8916_bms: qcom,qpnp-vm-bms {
	spmi-dev-container;
	compatible = "qcom,qpnp-vm-bms";
	#address-cells = <1>;
	#size-cells = <1>;
	status = "disabled";

	qcom,v-cutoff-uv = <3400000>;
	qcom,max-voltage-uv = <4200000>;
	qcom,r-conn-mohm = <18>;
	qcom,shutdown-soc-valid-limit = <20>;
	qcom,low-soc-calculate-soc-threshold = <15>;
	qcom,low-voltage-threshold = <3420000>;
	qcom,low-voltage-calculate-soc-ms = <1000>;
	qcom,low-soc-calculate-soc-ms = <5000>;
	qcom,low-soc-fifo-length = <2>;
	qcom,calculate-soc-ms = <20000>;
	qcom,s3-ocv-tolerence-uv = <1200>;
	qcom,battery-data = <&mtp_batterydata>;
	qcom,bms-vadc = <&pm8916_vadc>;
	qcom,bms-adc_tm = <&pm8916_adc_tm>;

	qcom,batt-pres-status@1208 {
		reg = <0x1208 0x1>;
	}

	qcom,qpnp-chg-pres@1208 {
		reg = <0x1108 0x1>;
	}

	qcom,bms-bms@4000 {
		reg = <0x4000 0x100>;
		interrupts =	<0x0 0x40 0x0>,
				<0x0 0x40 0x1>,
				<0x0 0x40 0x2>,
				<0x0 0x40 0x3>,
				<0x0 0x40 0x4>,
				<0x0 0x40 0x5>,

		interrupt-names = "leave_cv",
				  "enter_cv",
				  "good_ocv",
				  "ocv_thr",
				  "fifo_updtaed",
				  "fsm_state_change";
	};
};
```

## Documentation/devicetree/bindings/power/reset/msm-vm-poweroff.txt
```
MSM VM Restart Driver

A restart driver to trigger memdump on msm virtual machine.

Required Properties:
-compatible: "qcom,vm-restart"

Example:

	vm_restart: restart {
		compatible = "qcom,vm-restart";
		status = "ok";
	};
```

## Documentation/devicetree/bindings/power/reset/mtk-reboot.txt
```
Generic MTK RGU mapped register reset driver

This is a reset driver using toprgu to map its non-volatile register.
The reset is generally performed with a write to the non-volatile register
defined by the register map pointed by toprgu reference plus the offset
with the mask defined in the reboot-mode node.

Required properties:
- compatible: should contain "toprgu-reboot-mode"
- regmap: this is phandle to the register map node
- offset: offset in the register map for the reboot-mode register (in bytes)
- mask: the reset value written to the reboot register (32 bit access)

Examples:
	reboot-mode {
	   compatible = "toprgu-reboot-mode";
	   regmap = <&toprgu>;
	   offset = <0x24>;
	   mask = <0xF>;
	};

Optional properties - reboot mode value that will keep in toprgu nonrst RG:
- mode-charger = <BOOT_CHARGER>;
- mode-recovery = <BOOT_RECOVERY>;
- mode-bootloader = <BOOT_BOOTLOADER>;
- mode-dm-verity-dev-corrupt = <BOOT_DM_VERITY>;
- mode-kpoc = <BOOT_KPOC>;
- mode-ddr-reserve = <BOOT_DDR_RSVD>;
- mode-meta = <BOOT_META>;
- mode-rpmbpk = <BOOT_RPMBPK>;
```

## Documentation/devicetree/bindings/power/reset/palmas-poweroff.txt
```
Power off for Palmas series devices.

Required Properties:
 - compatible : Must be "ti,palmas-pm"

Optional Properties:
 - system-pmic-power-off : Use system PMIC to power off device.
 - system-pmic-power-reset : Use system PMIC to power reset device.

Example:
palmas_power {
	compatible = "ti,palmas-pm";
	system-pmic-power-off;
	system-pmic-power-reset;
};
```

## Documentation/devicetree/bindings/power/reset/sc27xx-poweroff.txt
```
UNISOC Poweroff Driver

This IP block in the unisoc SoC that only deals with different ways to power the system down.

Required properties:
- compatible:
  -"sprd,sc27xx-poweroff" for SC27xx poweroff
  -"sprd,ump9620-poweroff" for UMP9620 poweroff
- reg: Specifies the physical address of the poweroff register.

Example:
poweroff@1820 {
	compatible = "sprd,sc27xx-poweroff", "sprd,sc2730-poweroff";
	reg = <0x1820>;
};
```

## Documentation/devicetree/bindings/power/smb1351-charger.txt
```
Summit smb1351 battery charger

SMB1351 is a single-cell battery charger. It can charge
the battery and power the system via the USB/AC adapter input.

The smb1351 interface is via I2C bus.

Required Properties:
- compatible			Must be "qcom,smb1351-charger".
- reg				The device 7-bit I2C address.

Required Properties for standalone charger:
- regulator-name		A string used as a descriptive name for OTG regulator.
- pinctrl-names			The state name of the pin configuration. Only
				support "default".
- pinctrl-0			The phandle of the pin configuration node in
				pinctrl for smb_int_pin.

Optional Properties:

- interrupts			This indicates the IRQ number of the GPIO
				connected to the STAT pin.
- qcom,fastchg-current-max-ma 	Fast Charging current in mA. Supported range is
				from 1000mA to 4500mA.
- qcom,chg-autonomous-mode	This is a bool property and it indicates that the
				charger is configured for autonomous operation and
				does not require any software configuration.
- qcom,disable-apsd		This is a bool property which disables automatic
				power source detection (APSD). If this is set
				charger detection is done by DCIN UV irq.
- qcom,charging-disabled	This is a bool property which disables charging.
- qcom,bms-psy-name		This is a string and it points to the bms
				power supply name.
- qcom,iterm-ma			Specifies the termination current to indicate end-of-charge.
				Possible values in mA - 70, 100, 200, 300, 400, 500, 600, 700.
- qcom,iterm-disabled		Disables the termination current feature. This is a bool
				property.
- qcom,float-voltage-mv	 	Float Voltage in mV - the maximum voltage up to which
				the battery is charged. Supported range 3500mV to 4500mV
- qcom,recharge-mv		Recharge threshold in mV - the offset from the float-volatge
				as which the charger restarts charging. Possible
				values are 50mV and 100mV.
- qcom,recharge-disabled	Boolean value which disables the auto-recharge.
- qcom,bms-controlled-charging	This property enables BMS to control EOC and
				recharge. BMS and charger communicates with each
				other via power_supply framework. This
				property should be used with 'qcom,iterm-disabled'
				to ensure EOC detection in charger is disabled.
- qcom,parallel-charger		Boolean value which enables the parallel charger.

Example for standalone charger:

&i2c_4 {
	smb1351_otg_supply: smb1351-charger@1d {
		compatible = "qcom,smb1351-charger";
		reg = <0x1d>;
		interrupt-parent = <&msm_gpio>;
		interrupts = <62 2>;
		pinctrl-names = "default";
		pinctrl-0 = <&smb_int_default>;
		qcom,float-voltage-mv = <4350>;
		qcom,iterm-ma = <100>;
		qcom,recharge-mv = <100>;
		qcom,bms-psy-name = "bms";
		regulator-name = "smb1351_otg_vreg";
	};
};

Example for parallel charger:

&i2c_11 {
	smb1351-charger@1d {
		compatible = "qcom,smb1351-charger";
		reg = <0x1d>;
		qcom,parallel-charger;
		qcom,float-voltage-mv = <4400>;
		qcom,recharge-mv = <100>;
	};
};
```
