## Documentation/devicetree/bindings/power/smb358-charger.txt
```
Summit smb358 battery charger

SMB358 is a single-cell battery charger. It can charge
the battery and power the system via the USB/AC adapter input.

The smb358 interface is via I2C bus.

Required Properties:
- compatible			Must be "qcom,smb358-charger".
- reg				The device 7-bit I2C address.
- interrupt-parent		parent of interrupt.
- interrupts			This indicates the IRQ number of the GPIO
				connected to the STAT pin.
- qcom,irq-gpio			GPIO which receives interrupts from STAT output.
- qcom,bms-psy-name		This is a string and it points to the bms
				power supply name.
- qcom,float-voltage-mv		Float Voltage in mV - the maximum voltage up to which
				the battery is charged. Supported range 3500mV to 4500mV

Optional Properties:

- qcom,fastchg-current-max-ma	Fast Charging current in mA. Supported range is
				from 200mA to 2000mA.
- qcom,chg-valid-gpio		GPIO which indicates the charger presence.
				This GPIO is connected to the SYSOK pin.
- qcom,chg-autonomous-mode	This is a bool property and it indicates that the
				charger is configured for autonomous operation and
				does not require any software configuration.
- qcom,disable-apsd		This is a bool property which disables automatic
				power source detection (APSD). If this is set
				charger detection is done by DCIN UV irq.
- qcom,charger-disabled		This is a bool property which disables charging.
- qcom,using-pmic-therm		This property indicates thermal pin connected to pmic or smb.
- qcom,vcc-i2c-supply           Power source required to power up i2c bus.
- qcom,bms-controlled-charging	This property indicates integrating with VMBMS, charger
				driver and BMS communicates with each other via power_supply
				framework. Property "qcom,iterm-disabled" also needs defined
				if using this feature to make sure that the charger doesn't
				terminate charging on its own.
- qcom,iterm-ma			Specifies the termination current to indicate end-of-charge.
				Possible values in mA - 30, 40, 60, 80, 100, 125, 150, 200.
- qcom,iterm-disabled		Disables the termination current feature. This is a bool
				property.
- qcom,recharge-mv		Recharge threshold in mV - the offset from the float-volatge
				as which the charger restarts charging. Possible
				values are 50mV to 300mV.
- qcom,recharge-disabled	Boolean value which disables the auto-recharge.
- qcom,chg-inhibit-disabled	This is a bool property which disables charger inhibit.
				Charger inhibit option prevents battery charging upon insertion
				of the charger when battery voltage is above the programmed inhibit
				threshold.
- qcom,chg-adc_tm		phandle to the corresponding VADC device to read the ADC channels.
- qcom,cold-bat-decidegc	Cold battery temperature in decidegC.
- qcom,hot-bat-decidegc		Hot battery temperature in decidegC.
- qcom,bat-present-decidegc	This is a property indicating battery present temperature, if
				higher than it, battery should exist. Default value is negative,
				if this property is 200, it stands for -200 decidegC.
- qcom,warm-bat-decidegc:	Warm battery temperature in decidegC. After hitting this threshold,
				"qcom,warm-bat-ma" defines maximum charging current and
				"qcom,warm-bat-mv" defines maximum target voltage.
- qcom,cool-bat-decidegc:       Cool battery temperature in decidegC. After hitting this threshold,
				"qcom,cool-bat-ma" defines maximum charging current and
				"qcom,cool-bat-mv" defines maximum target voltage.
- qcom,warm-bat-ma:		Maximum warm battery charge current in milli-amps.
- qcom,cool-bat-ma:		Maximum cool battery charge current in milli-amps.
- qcom,warm-bat-mv:		Maximum warm battery target voltage in milli-volts.
- qcom,cool-bat-mv:		Maximum cool battery target voltage in milli-volts.
- qcom,chg-vadc			Corresponding VADC device's phandle.
- qcom,skip-usb-suspend-for-fake-battery:	A boolean property to skip suspending USB path for fake
				battery. If this property is not present then 'qcom,batt-id-vref-uv' and
				'qcom,batt-id-rpullup-kohm' should be present.
- qcom,batt-id-vref-uv		The reference voltage on the battery-ID line
				specified in micro-volts.
- qcom,batt-id-rpullup-kohm	The pull-up resistor connected on the battery-ID
				(vref) line.
- qcom,using-vbat-sns		Bool property to indicate that VBAT sense can be
				done by PMIC.

Example:
	i2c@f9967000 {
		smb358-charger@1b {
			compatible = "qcom,smb358-charger";
			reg = <0x1b>;
			interrupt-parent = <&msmgpio>;
			interrupts = <17 0x0>;
			qcom,irq-gpio = <&msmgpio 17 0x00>;
			qcom,vcc-i2c-supply = <&pm8226_lvs1>;
			qcom,float-voltage-mv = <4350>;
			qcom,disable-apsd;
			qcom,chg-inhibit-disabled;
			qcom,bms-controlled-charging;
			qcom,fastchg-current-max-ma = <1500>;
			qcom,bms-psy-name = "bms";
			qcom,chg-vadc = <&pm8226_vadc>;
			qcom,chg-adc_tm = <&pm8226_adc_tm>;
			qcom,hot-bat-decidegc = <500>;
			qcom,cold-bat-decidegc = <0>;
			qcom,bat-present-decidegc = <200>;
			qcom,warm-bat-decidegc = <450>;
			qcom,cool-bat-decidegc = <100>;
			qcom,warm-bat-ma = <350>;
			qcom,cool-bat-ma = <350>;
			qcom,warm-bat-mv = <4200>;
			qcom,cool-bat-mv = <4200>;
		};
	};
```

## Documentation/devicetree/bindings/power/stc311x-fg.txt
```
STC311x Fuel Gauge device

STC311x FG provides interface to clients to read properties related
to the battery. Its main function is to retrieve the State of Charge (SOC),
a 0-100 percentage representing the amount of charge left in the battery.

- compatible
	Usage:		Required
	Value:		<string>
	Definition:	Must be  "st,stc311x" for the driver.

- reg
	Usage:		Required
	Value:		<u32>
	Definition:	The device 7-bit I2C address.

- st,float-voltage-mv
	Usage:		Required
	Value type:	<u32> in mV.
	Definition:	Float Voltage in mV - the maximum voltage up to which
			the battery is charged.

- st,rsense-mohm
	Usage:		Required
	Value type:	<u32> in mohm.
	Definition:	Current sense resistance value.

- st,nom-capacity-mah
	Usage:		Required
	Value type:	<u32> in mah.
	Definition:	This specifies nominal capacity of battery.

- st,rbatt-mohm
	Usage:		Required
	Value type:	<u32> in mohm.
	Definition:	This specifies battery internal resistance.

- st,ocv-tbl
	Usage:		Required
	Value type:	<u16 array> in mV.
	Definition:	This specifies an array of battery open circuit voltages at
			different SOC points.

- st,soc-tbl
	Usage:		Required
	Value type:	<u8 array>.
	Definition:	This specifies an array of SOC points associated with
			OCV table.

- st,vmtemp-tbl
	Usage:		Required
	Value type:	<u16 array>
	Definition:	This specifies an array of VCNF compensation table at
			different temperatures.

- st,temp-tbl
	Usage:		Required
	Value type:	<s16 array in DeciDegC>
	Definition:	This specifies an array of temperature points used in
			vtemp table and adaptive capacity tables.

- st,cutoff-voltage-mv
	Usage:		Optional
	Value type:	<u32> in mV
	Definition:	This is the minimum allowed system voltage. The FG
			will report SOC = 0 at this volatge. This value is
			also used to configure alarm voltage threshold.
			If not specified default value is set to 3400mV.

- st,alarm-soc
	Usage:		Optional
	Value type:	<u32> in %
	Definition:	This is the alarm SOC threshold.
			If not specified default value is set to 10%.

- st,term-current-ma
	Usage:		Optional
	Value type:	<u32> in mA
	Definition:	This is the maximum current threshold limit used to
			decide end of charge.
			If not specified value is set to

- st,relax-current-ma
	Usage:		Optional
	Value type:	<u32> in mA
	Definition:	This is the current threshold to decide automatic mode
			switch between voltage and moxec mode.
			If not specified value is set to

- st,adaptive-capacity-tbl
	Usage:		Optional
	Value type:	<u16 array, each element is in 0.1%>
	Definition:	This table specifies capacity degradation with
			temperature.

- st,force-voltage-mode
	Usage:		Optional
	Value type:	Boolean
	Definition:	This is to force FG always in low power voltage mode.

- st,enable-soc-correction
	Usage:		Optional
	Value type:	Boolean
	Definition:	This is to enable soc correction algorithm.

-st,empty-soc-uv
	Usage:		Optional
	Value type:	<u32> in uV
	Definition:	This is the battery voltage threshold to reporting 0%
			SOC. If this property is present then 'qcom,fg-adc_tm'
			and 'qcom,fg-vadc' are required properties.

-qcom,fg-adc_tm
	Usage:		Optional
	Value type:	<phandle>
	Definition:	ADC_TM device's phandle to receive notifications when
			battery voltage crosses configured thresholds.

- qcom,fg-vadc
	Usage:		Optional
	Value type:	<phandle>
	Definition:	VADC device's phandle to read battery voltage using
			ADC channel.

Example:
	st-fg@70 {
		compatible = "st,stc3117";
		reg = <0x70>;

		st,rbatt-mohm = <210>;
		st,nom-capacity-mah = <1500>;
		st,rsense-mohm = <10>;
		st,float-voltage-mv = <4200>;

		st,alarm-soc = <10>;
		st,alarm-voltage-mv = <3400>;

		st,term-current-ma = <150>;
		st,relax-current-ma = <200>;

		st,adaptive-capacity-tbl = /bits/ 16 <0 0 0 5 13 42 71>;
		st,ocv-tbl = /bits/ 16 <3300 3528 3667 3731 3753 3765 3772
					3792 3827 3900 3929 3957 3513 4072
					4167>;
		st,soc-tbl = /bits/ 8 <0 3 6 10 15 20 25 30 40 50 60 65
					70 80 90 100>;
		st,vmtemp-tbl = /bits/ 16 <85 90 100 160 320 440 840>
		st,temp-tbl = /bits/ 16 <60 40 25 10 0 (-10) (-20)>;

		st,empty-soc-uv = <3300000>;
		qcom,fg-vadc = <&pm8916_vadc>;
		qcom,fg-adc_tm = <&pm8916_adc_tm>;
	};
```

## Documentation/devicetree/bindings/power/supply/hl6111r.txt
```
Halo Microelectronics Co. Ltd. HL6111R Specific Bindings

HL6111R is a wireless charging power receiver IC that has a maximum
power output of 15 W, a maximum current output of 2.2 A, and a
programmable output voltage range of 4 V to 20 V with different step
sizes. It supports both the A4WP and WPC wireless charging standards.

Required properties:

- compatible
	Usage:		required
	Value type: 	<string>
	Definition:	Must be "halo,hl6111r"

- reg
	Usage:		required
	Value type: 	<u32>
	Definition:	7-bit I2C address of the device.

Example:

halo,hl6111r@25 {
	compatible = "halo,hl6111r";
	reg = <0x25>;
	status = "ok";
}
```

## Documentation/devicetree/bindings/power/supply/nx30p6093.txt
```
Binding for NXP NX30P6093 moisture detection module

NX30P6093 is an I2C controlled module and features an input impedance detection
function, along with OVP protection upto 29V. The impedance detection can detect
moisture or dust on USB lines and report the same to system to take necessary
steps to avoid circuit damage to the Type-C port power supply pin.

=======================
Supported Properties
=======================

- compatible
	Usage:      required
	Value type: <string>
	Definition: should be "nxp,nx30p6093".

- reg
	Usage:      required
	Value type: <u32>
	Definition: The device 8-bit I2C address.

- interrupts
	Usage:      required
	Value type: <prop-encoded-array>
	Definition: Moisture detect interrupt specifier.

- nxp,always-on-detect
	Usage:      optional
	Value type: <boolean>
	Definition: If specified, the NX30P6093 is configured to perform
		    mositure detection on every detection duty cycle configured
		    in "nxp,always-on-tduty-val" property.

- nxp,always-on-tduty-ms
	Usage:      required if "nxp,always-on-detect" specified
	Value type: <u32>
	Definition: The detection duty cycle (Tduty) in milliseconds.
		    Supported values are 10, 20, 50, 100, 200, 500, 1000,
		    2000, 3000, 6000, 12000, 30000, 60000, 120000 and 300000.
		    If this property is not specified a default value of
		    300000 milliseconds is used.

- nxp,long-wakeup-sec
	Usage:      required if "nxp,always-on-detect" not specified.
	Value type: <u32>
	Definition: A longer time interval in seconds maintained between
		    moisture detection events after a previous moisture
		    detection event resulted in a good impedance detected
		    on USB lines. If this property is not specified a default
		    value of 28800 seconds (8 hrs) is used.

- nxp,short-wakeup-ms
	Usage:      required if "nxp,always-on-detect" not specified.
	Value type: <u32>
	Definition: A shorter time interval in milliseconds maintained
		    between moisture detection events after a previous
		    moisture detection event resulted in a bad impedance
		    detected on USB lines. If this property is not specified
		    a default value of 180000 milliseconds (3 mins) is used.

=======
Example
=======

nx30p6093@0 {
	compatible = "nxp,nx30p6093";
	reg = <0x36>;
	interrupt-parent = <&tlmm>;
	interrupts = <5 IRQ_TYPE_NONE>;
	nxp,long-wakeup-sec = <28800>; /* 8 hours */
	nxp,short-wakeup-ms = <180000>; /* 3 mins */
};
```

## Documentation/devicetree/bindings/power/supply/qcom/qcom,qbg.yaml
```yaml
%YAML 1.2
---
$id: http://devicetree.org/schemas/bindings/power/supply/qcom/qcom,qbg.yaml#
$schema: http://devicetree.org/meta-schemas/core.yaml#

title: Qualcomm Technologies, Inc. Battery Gauge (QBG) binding

maintainers:
  - Shyam Kumar Thella <sthella@qti.qualcomm.com>

description: |
  Qualcomm Technologies, Inc. Battery Gauge (QBG) uses the periodic samples of
  battery voltage and current to determine the battery state-of-charge (SOC)
  and supports other battery management features.

properties:
  compatible:
    const: qcom,qbg

  reg:
    description: Base address of QBG MAIN peripheral.
    maxItems: 1

  interrupts:
    description: Specifies the interrupts for nvmem devices used by QBG.
    maxItems: 1

  interrupt-names:
    description: Specifies the interrupt names for nvmem devices used by QBG.
    minItems: 1
    items:
      - const: qbg-sdam
    $ref: /schemas/types.yaml#/definitions/string-array

  qcom,num-data-sdams:
    $ref: /schemas/types.yaml#/definitions/uint32
    description: Number of SDAMs used for storing QBG FIFO data.

  qcom,sdam-base:
    $ref: /schemas/types.yaml#/definitions/uint32
    description: Base address of QBG SDAM peripheral.

  qcom,vbat-cutoff-mv:
    allOf:
      - $ref: "/schemas/types.yaml#/definitions/uint32"
    description: The battery voltage threshold (in mV) at which the battery
      power cuts off. The SOC is forced to 0 when battery voltage reaches
      this value.
    default: 3100

  qcom,ibat-cutoff-ma:
    allOf:
      - $ref: /schemas/types.yaml#/definitions/uint32
    description: The battery current threshold (in mA) at which the battery
      power cuts off. The SOC is forced to 0 when battery current reaches
      this value.
    default: 150

  qcom,vph-min-mv:
    allOf:
      - $ref: /schemas/types.yaml#/definitions/uint32
    description: Minimum sustainable system power (in mV).
    default: 2700

  qcom,iterm-ma:
    allOf:
      - $ref: /schemas/types.yaml#/definitions/uint32
    description: The battery current (in mA) at which the QBG algorithm
      converges the SOC to 100% during charging and can be used to terminate
      charging.
    default: 100

  qcom,rconn-mohm:
    $ref: /schemas/types.yaml#/definitions/uint32
    description: Resistance of the battery connector in mOhms.

required:
  - compatible
  - reg
  - interrupt-names
  - interrupts
  - qcom,num-data-sdams
  - qcom,sdam-base

examples:
  - |
    #include <dt-bindings/interrupt-controller/irq.h>
    spmi_bus {
      #address-cells = <2>;
      #size-cells = <0>;
      interrupt-controller;
      #interrupt-cells = <4>;

      qcom,pm5100@0 {
        #address-cells = <1>;
        #size-cells = <0>;

        qbg@4f00 {
          compatible = "qcom,qbg";
          reg = <0x4f00>;
          #address-cells = <1>;
          #size-cells = <1>;
          interrupt-names = "qbg-sdam";
          interrupts = <0x0 0x76 0x1 IRQ_TYPE_EDGE_RISING>;
          qcom,num-data-sdams = <6>;
          qcom,sdam-base = <0x7600>;
        };
      };
    };
...
```
