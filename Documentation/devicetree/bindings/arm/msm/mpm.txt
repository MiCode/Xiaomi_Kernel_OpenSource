## Documentation/devicetree/bindings/arm/msm/msm_core.txt
```
MSM Core Energy Aware driver

The Energy Aware driver provides per core power and temperature
information to the scheduler for it to make more power efficient
scheduling decision.

The required properties for the Energy-aware driver are:

- compatible:    "qcom,apss-core-ea"
- reg:           Physical address mapped to this device

Required nodes:
- ea@X: Parent node that has the sensor mapping for each cpu.
                 This node's phandle is provided within cpu node
                 to invoke/probe energy-aware only for available cpus.
                 There should be one such node present for each cpu.

Optional properties:
- qcom,low-hyst-temp: Degrees C below which the power numbers
                 need to be recomputed for the cores and reset
                 the threshold. If this is not present, the default
                 value is 10C.
- qcom,high-hyst-temp: Degrees C above which the power numbers
                 need to be recomputed for the cores and reset
                 the threshold. If this property is not present,
                 the default value is 5C.
- qcom,polling-interval: Interval for which the power numbers
                 need to be recomputed for the cores if there
                 is no change in threshold. If this property is not
                 present, the power is recalculated only on
                 temperature threshold notifications.
-qcom,throttling-temp: Temperature threshold for cpu frequency mitigation.
                 The value should be set same as the threshold temperature
                 in thermal module - 5 C, such that there is a bandwidth to
                 control the cores before frequency mitigation happens.

[Second level nodes]
Require properties to define per core characteristics:
- sensor:  Sensor phandle to map a particular sensor to the core.
                If this property is not present, then the core is assumed
                to be at 40C for all the power estimations. No sensor
                threshold is set. This phandle's compatible property is
                "qcom,sensor-information". This driver relies on the
                sensor-type and scaling-factor information provided in this
                phandle.

Example

qcom,msm-core@0xfc4b0000 {
	compatible = "qcom,apss-core-ea";
	reg = <0xfc4b0000 0x1000>;
	qcom,low-hyst-temp = <10>;
	qcom,high-hyst-temp = <5>;
	qcom,polling-interval = <50>;

	ea0: ea0 {
		sensor = <&sensor_information0>;
	};

	ea1: ea1 {
		sensor = <&sensor_information1>;
	};

};

CPU0: cpu@0 {
	device_type = "cpu";
	compatible = "arm,cortex-a53";
	reg = <0x0>;
	qcom,ea = <&ea0>;
};
```

## Documentation/devicetree/bindings/arm/msm/msm_demod_wrapper.txt
```
Demod Wrapper - HW block in broadcast subsystem

The Demod wrapper block contains HW units that
are responsible for navigating and filtering an analog TV or
digital TV signal to integrated demodulators.
The driver supports the operation of those units and provides
a way to set and configure a desired signal path.
documentation: Documentation/arm/msm/demod_wrapper.txt.

The devicetree representation of the MSM_DEMOD_WRAPPER block should be:

Required properties:

- compatible: "qcom,msm-demod-wrapper"
- reg: physical memory base addresses and sizes for demod_wrapper.
- vdd-supply: power regulator (GDSC) supplying power to the broadcast subsystem.
- adc-supply: power regulator supplying power to adcs in the demod wrapper block.

Example :

	dw: msm-demod-wrapper@fc600000 {
		compatible = "qcom,msm-demod-wrapper";
		reg = <0xfc600000 0xdd000>;
		vdd-supply = <&gdsc_bcss>;
		adc-supply = <&pma8084_l27>;
	};
```

## Documentation/devicetree/bindings/arm/msm/msm_ensigma_uccp330.txt
```
Ensigma UCCP330 - Broadcast demodulator

Ensigma UCCP330 is a multistandard broadcast demodulator.
For information on the Ensigma UCCP330 driver, please refer to the
Ensigma UCCP330 driver.
documentation: Documentation/arm/msm/ensigma_uccp330.txt.

The devicetree representation of the Ensigma UCCP330 block should be:

Required properties:

- compatible: "qcom,msm-demod"
- reg: physical memory base addresses and sizes for the following:
	Ensigma UCCP330, TOP BCSS
- reg-names: names of the memory regions:
	msm-demod, top-bcss
- vdd-supply
	GDSC - gdsc_bcss

Example:

	demod: msm-demod@fc600000 {
		compatible = "qcom,msm-demod";
		reg = <0xfc600000 0xd0008>,<0xfc747000 0x1000>;
		reg-names = "msm-demod", "top-bcss";
		vdd-supply = <&gdsc_bcss>;
	};
```

## Documentation/devicetree/bindings/arm/msm/msm_gladiator_erp.txt
```
* MSM Gladiator error reporting driver

Required properties:
- compatible: Should be "qcom,msm-gladiator" or "qcom,msm-gladiator-v2" or
"qcom,msm-gladiator-v3"
- reg: I/O address Gladiator H/W block
- reg-names: Should be "gladiator_base"
- interrupts: Should contain the gladiator error interrupt number
- clock-names: Should be "atb_clk"
- clocks: Handles to clocks specified in "clock-names" property.

Example:

qcom,msm-gladiator-v2@b1c0000 {
	compatible = "qcom,msm-gladiator";
	reg = <0xb1c0000 0xe000>;
	reg-names = "gladiator_base";
	interrupts = <0 34 0>;
	clock-names = "atb_clk";
	clocks = <&clock_gcc clk_qdss_clk>;
}
```

## Documentation/devicetree/bindings/arm/msm/msm_gladiator_hang_detect.txt
```
Gladiator Hang Detection provides sysfs entries for configuring
thresholds and enable on ACE_port, IO_port, M1_port, M2_port,
and PCIO_port

If gladiator is hung for threshold time (value * 5ns) and no
heart beat event from gladiator port to gladiator hang monitor
detection, gladiator hang interrupt would be generated to reset
the SOC to collect all cores context.

Gladiator hang detection can be enabled on different ports.

Writing 1 into ace_enabled sysfs entry, enables gladiator hang
detection on ACE port
Writing 1 into io_enabled sysfs entry, enables gladiator hang
detection on IO port
Writing 1 into ace_enabled sysfs entry, enables gladiator hang
detection on M1 port
Writing 1 into ace_enabled sysfs entry, enables gladiator hang
detection on M2 port
Writing 1 into pcio_enabled sysfs entry, enables gladiator hang
detection on PCIO port

Required properties:
- compatible : "qcom,gladiator-hang-detect"
- qcom, threshold-arr:
		Array of APCS_COMMON_GLADIATOR_HANG_THRESHOLD_n register
		address
- qcom, config-reg:
		APCS_COMMON_GLADIATOR_HANG_CONFIG register address

Optional properties:

Example:
	For msmcobalt:
		qcom,ghd {
				compatible = "qcom,gladiator-hang-detect";
				qcom,threshold-arr = <0x179d141c 0x179d1420
					0x179d1424 0x179d1428 0x179d1420 0x179d1430>;
				qcom,config-reg = <0x179d1434>;
		};
```

## Documentation/devicetree/bindings/arm/msm/msm_hang_detect.txt
```
* Qualcomm MSM Core Hang Detection

Core Hang Detection provides the three sysfs entries for configuring
threshold, PMU event mux select and to enable hang detection.

If core is hung for threshold time (value X 10ns) and no
heart beat event from pmu to core hang monitor detection, core hang
interrupt would be generated to reset the SOC via secure watchdog
to collect all cores context.

PMU event mux select can be programmed to one of the supported
events, for example-
1) Load Instruction executed,
2) Store Instructions executed
3) Instruction architecturally executed and etc.

Writing 1 into enable sysfs entry, enables core hang detection and
if there is no selected PMU mux event for 10ns core hang counter
gets incremented. Once counter reaches the programmed threshold value,
core hang interrupts generated to reset the SOC.


The device tree parameters for the core hang detection are:

Required properties:

- compatible : "qcom,core-hang-detect"
- label: unique name used to created sysfs entry
- qcom,threshold-arr :
	Array of APCS_ALIAS*_CORE_HANG_THRESHOLD register address
	for each core.
- qcom,config-arr :
	Array of APCS_ALIAS*_CORE_HANG_CONFIG register address
	for each core.

Optional properties:

Example:
  For msm8937:
	qcom,chd {
		compatible = "qcom,core-hang-detect";
		qcom,threshold-arr = <0xB088094 0xB098094 0xB0A8094
			0xB0B8094 0xB188094 0xB198094 0xB1A8094 0xB1B8094>;
		qcom,config-arr = <0xB08809C 0xB09809C 0xB0A809C
			0xB0B809C 0xB18809C 0xB19809C 0xB1A809C 0xB1B809C>;
	};

  For msmtitanium:
	qcom,chd {
		compatible = "qcom,core-hang-detect";
		qcom,threshold-arr = <0xB1880B0 0xB1980B0 0xB1A80B0
			0xB1B80B0 0xB0880B0 0xB0980B0 0xB0A80B0 0xB0B80B0>;
		qcom,config-arr = <0xB1880B8 0xB1980B8 0xB1A80B8
			0xB1B80B8 0xB0880B8 0xB0980B8 0xB0A80B8 0xB0B80B8>;
	};
```

## Documentation/devicetree/bindings/arm/msm/msm_iommu_domains.txt
```
IOMMU Domains

An IOMMU domain is a collection of IOMMU context banks and an optional
virtual address space that is to be used with the domain. Domains that are
defined will be created at bootup and associated with an iommu group. Clients
can then refer to the iommu group and perform operations on the iommu group
instead of individual devices/contexts.

Required properties

- compatible: "qcom,iommu-domains"

- At least one child that defines a domain is required with the
  following properties:

	- label: Name of the domain
	- qcom,iommu-contexts: List of phandles to context that belongs to
	  this domain.

	Optional properties

		- qcom,virtual-addr-pool: List of <start_address size> pairs
		  that define the virtual address space for this domain.
		- qcom,secure-domain: boolean indicating that this is a secure
		  domain that is to be programmed by Trustzone.
		- qcom,l2-redirect: boolean indicating that page tables should
		  be cached in L2 cache.
Example:
	qcom,iommu-domains {
		compatible = "qcom,iommu-domains";

		qcom,iommu-domain1 {
			label = "lpass_secure";
			qcom,iommu-contexts = <&lpass_q6_fw>;
			qcom,virtual-addr-pool = <0x00000000 0x0FFFFFFF
						  0xF0000000 0x0FFFFFFF>;
		};

		qcom,iommu-domain2 {
			label = "lpass_audio";
			qcom,iommu-contexts = <&lpass_audio_shared>;
			qcom,virtual-addr-pool = <0x10000000 0x0FFFFFFF>;
		};

		qcom,iommu-domain3 {
			label = "lpass_video";
			qcom,iommu-contexts = <&lpass_video_shared>;
			qcom,virtual-addr-pool = <0x20000000 0x0FFFFFFF>;
		};
	};
```

## Documentation/devicetree/bindings/arm/msm/msm_ion.txt
```
ION Memory Manager (ION)

ION is a memory manager that allows for sharing of buffers between different
processes and between user space and kernel space. ION manages different
memory spaces by separating the memory spaces into "heaps".

Required properties for Ion

- compatible: "qcom,msm-ion"


All child nodes of a qcom,msm-ion node are interpreted as Ion heap
configurations.

Required properties for Ion heaps

- reg: The ID of the ION heap.
- qcom,ion-heap-type: The heap type to use for this heap. Should be one of
  the following:
    - "SYSTEM"
    - "CARVEOUT"
    - "DMA"
    - "HYP_CMA"
    - "SYSTEM_SECURE"
    - "SECURE_DMA"

Optional properties for Ion heaps

- memory-region: phandle to memory region associated with heap.

Example:
	qcom,ion {
                 compatible = "qcom,msm-ion";
                 #address-cells = <1>;
                 #size-cells = <0>;

                 system_heap: qcom,ion-heap@25 {
                        reg = <25>;
                        qcom,ion-heap-type = "SYSTEM";
                 };

                 qcom,ion-heap@22 { /* ADSP HEAP */
                        reg = <22>;
                        memory-region = <&adsp_mem>;
                        qcom,ion-heap-type = "DMA";
                 };

                 qcom,ion-heap@10 { /* SECURE DISPLAY HEAP */
                        reg = <10>;
                        memory-region = <&secure_display_memory>;
                        qcom,ion-heap-type = "HYP_CMA";
                 };

                 qcom,ion-heap@9 {
                        reg = <9>;
                        qcom,ion-heap-type = "SYSTEM_SECURE";
                 };

        };
```

## Documentation/devicetree/bindings/arm/msm/msm_ion.yaml
```yaml
%YAML 1.2
---
$id: "http://devicetree.org/schemas/arm/msm/msm_ion.yaml#"
$schema: "http://devicetree.org/meta-schemas/core.yaml#"

title: ION Memory Manager binding

maintainers:
  - Isaac J. Manjarres <isaacm@quicinc.com>

description: |
  ION is a memory manager that allows for sharing of buffers between different
  processes and between user space and kernel space. ION manages different
  memory spaces by separating the memory spaces into heaps.

  All child nodes of a qcom,msm-ion node are interpreted as ION heap
  configurations.

properties:
  $nodename:
    const: qcom,ion
    description: Container of ION heap nodes

  compatible:
    items:
      -const: qcom,msm-ion

  '#address-cells':
    const: 1

  '#size-cells':
    const: 0

patternProperties:
  '^qcom,ion-heap@[0-9]+$':
    properties:
      reg:
        maxItems: 1
        description: The ID assigned to this heap.

      memory-region:
        $ref: '/schemas/types.yaml#/definitions/phandle'
        maxItems: 1
        description: |
          Specifies the reserved memory region that this heap will allocate
          memory from. This property is only required for heaps that draw memory
          from a particular reserved memory region. Refer to
          Documentation/devicetree/bindings/reserved-memory/reserved-memory.txt
          for more information.

      qcom,ion-heap-type:
        $ref: '/schemas/types.yaml#/definitions/string'
        maxItems: 1
        items:
          - enum:
              - SYSTEM
              - CARVEOUT
              - SECURE_CARVEOUT
              - DMA
              - HYP_CMA
              - SYSTEM_SECURE
              - SECURE_DMA
        description: |
          The heap type to use for this heap. Heaps of type SECURE_CARVEOUT
          are expected to contain multiple child nodes, as seen below.

      qcom,dynamic-heap:
      Usage: optional
      Value type: <boolean>
      Definition: Denotes whether a heap can have memory dynamically added and
           subtracted from it. Heaps with this property are assumed to start off
           with no memory, and must have memory added to them prior to any use.

      $nodename:
        properties:
          memory-region:
            $ref: '/schemas/types.yaml#/definitions/phandle'
            maxItems: 1
            description: |
              Specifies the reserved memory region that this heap will allocate
              memory from. Refer to the reserved-memory binding documentation
              for more information.

          token:
            $ref: '/schemas/types.yaml#/definitions/uint32'
            minItems: 1
            description: |
              Specifies the set of secure domains which will be able to access
              the memory-region.

        required:
          - memory-region
          - token

    required:
      - reg
      - qcom,ion-heap-type

required:
  - compatible
  - '#address-cells'
  - '#size-cells'

examples:
  - |
    qcom,ion {
        compatible = "qcom,msm-ion";
        #address-cells = <1>;
        #size-cells = <0>;

        system_heap: qcom,ion-heap@25 {
            reg = <25>;
            qcom,ion-heap-type = "SYSTEM";
        };

        qcom,ion-heap@22 { /* ADSP HEAP */
            reg = <22>;
            memory-region = <&adsp_mem>;
            qcom,ion-heap-type = "DMA";
        };

        qcom,ion-heap@10 { /* SECURE DISPLAY HEAP */
            reg = <10>;
            memory-region = <&secure_display_memory>;
            qcom,ion-heap-type = "HYP_CMA";
        };

        qcom,ion-heap@9 {
            reg = <9>;
            qcom,ion-heap-type = "SYSTEM_SECURE";
        };

        qcom,ion-heap@14 {
            reg = <14>;
            qcom,ion-heap-type = "SECURE_CARVEOUT";
            node1 {
                memory-region = <&cp_region>;
                token = <ION_FLAG_CP_TOUCH>;
            };
        };
    };
```
