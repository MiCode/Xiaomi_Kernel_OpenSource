## Documentation/devicetree/bindings/arm/msm/mpm.txt
```
* MSM Sleep Power Manager (mpm-v2)

The MPM acts a sleep power manager to shutdown the clock source and put the
device into a retention mode to save power. The MPM is also responsible for
waking up and bringing up the resources from sleep. The MPM driver configures
interrupts monitored by the MPM hardware before entering sleep through a
RPM interface.

The required nodes for the MPM driver are:

- compatible: "qcom, mpm-v2"
- reg: Specifies the base physical address(s) and the size of the MPM
	registers. The MPM driver access two memory regions for confifure the
	virtual MPM driver on the RPM. The first region is the memory space
	shared with the virtual MPM driver. The second region is the address
	to the register that triggers a interrupt to the RPM.
- reg-names: "vmpm" - string to identify the shared memory space region
	     "ipc" - string to identify the register that triggers a interrupt
- clocks: clock identifers used by clock driver while looking up mpm clocks.
- clock-names: name of the clock used by mpm driver.
- qcom,ipc-bit-offset: The bit to set in the ipc register that triggers a interrupt
	to the RPM
- qcom,gic-parent: phandle to the gic interrupt controller
- qcom,gic-map: Provides a mapping of how a GIC interrupt is connect to a MPM. The
	mapping is presented in tuples. Each tuple represents a MPM pin and
	which GIC interrupt is routed to it. Since MPM monitors interrupts
	only during system wide low power mode, system interrupts originating
	from other processors can be ignored and assigned an MPM pin mapping
	of 0xff.
- qcom,gpio-parent: phandle to the GPIO interrupt controller
- qcom,gpio-map: Provides a mapping of how a GPIO interrupt is connect to a MPM. The
	mapping is presented in tuples. Each tuple represents a MPM pin and
	which GIC interrupt is routed to it. Since MPM monitors interrupts
	only during system wide low power mode, system interrupts originating
	from other processors can be ignored and assigned an MPM pin mapping
	of 0xff.

Example:
	qcom,mpm@fc4281d0 {
		compatible = "qcom,mpm-v2";
		reg = <0xfc4281d0 0x1000>, /* MSM_RPM_MPM_BASE 4K*/
		    <0xfa006000 0x1000>;   /* MSM_APCS_GCC_BASE 4K*/
		reg-names = "vmpm", "ipc"
			interrupts = <0 171 1>;
		clocks = <&clock_rpm clk_xo_lpm_clk>;
		clock-names = "xo";

		qcom,ipc-bit-offset = <0>;

		qcom,gic-parent = <&intc>;
		qcom,gic-map = <25 132>,
			<27 111>,
			<0xff 48>,
			<0xff 51>,
			<0xff 52>,
			<0xff 53>,
			<0xff 54>,
			<0xff 55>;

		qcom,gpio-parent = <&msmgpio>;
		qcom,gpio-map = <1  46>,
			<2 150>,
			<4 103>,
			<5 104>,
			<6 105>,
			<7 106>,
			<8 107>,
			<53 37>,
			<54 24>,
			<55 14>;
	};
```

## Documentation/devicetree/bindings/arm/msm/mpm_counter.txt
```
* MSM MPM sleep counter (mpm-v2)

The MPM provides a timetick that starts when the device is powered up and
is not reset by any of the boot loaders or the HLOS. The MPM timetick counter
driver provides an api to get this value.

The required nodes for the MPM timetick counter driver are:

- compatible: "qcom,mpm2-sleep-counter"
- reg: Specifies the physical address of the timetick count register.
- clock-frequency: the physical counter frequency.

Example:
	qcom,mpm2-sleep-counter@fc4a3000 {
		compatible = "qcom,mpm2-sleep-counter";
		reg = <0xfc4a3000 0x1000>;
		clock-frequency = <32768>;
	};
```

## Documentation/devicetree/bindings/arm/msm/msm-cpufreq.txt
```
Qualcomm MSM CPUfreq device

msm-cpufreq is a device that represents the list of usable CPU frequencies
and provides a device handle for the CPUfreq driver to get the CPU and cache
clocks.

Required properties:
- compatible:		Must be "qcom,msm-cpufreq"
- qcom,cpufreq-table:	A list of usable CPU frequencies (KHz)

Optional properties:
- clock-names:		When DT based binding of clock is available, this
			provides a list of CPU subsystem clocks.
			"cpuX_clk" for every CPU that's present.
			"l2_clk" when an async cache/CCI is present.

Example:
	qcom,msm-cpufreq@0 {
		regs = <0 4>
		compatible = "qcom,msm-cpufreq";
		qcom,cpufreq-table =
			<  300000 >,
			<  422400 >,
			<  652800 >,
			<  729600 >,
			<  883200 >,
			<  960000 >,
			< 1036800 >,
			< 1190400 >,
			< 1267200 >,
			< 1497600 >,
			< 1574400 >,
			< 1728000 >,
			< 1958400 >,
			< 2265600 >;
	};
```

## Documentation/devicetree/bindings/arm/msm/msm-id.txt
```
* MSM-ID

The qcom,msm-id entry specifies the MSM chipset, platform, hardware revision
and optional manufactured foundry.  It can optionally be an array of these to
indicate multiple hardware that use the same device tree.  It is expected that
the bootloader will use this information at boot-up to decide which device tree
to use when given multiple device trees, some of which may not be compatible
with the actual hardware.  It is the bootloader's responsibility to pass the
correct device tree to the kernel.

Format:

It is expected that the qcom,msm-id entry be at the top level of the device
tree structure.  The format can take one of the two forms below:

   qcom,msm-id = <chipset_foundry_id, platform_id, rev_id> [, <c2, p2, r2> ...]
   qcom,msm-id = <chipset_foundry_id, rev_id> [, <c2, r2> ...]

If the second format is used one must also define the board-id.

The "chipset_foundry_id" consists of three fields as below:

   bits 0-15  = The unique MSM chipset id.
   bits 16-23 = The optional foundry id. If bootloader doesn't find a device
		tree which has exact matching foundry-id with hardware it
		chooses the device tree with foundry-id = 0.
   bits 24-31 = Reserved.

Example:
   qcom,msm-id = <0x1007e 15 0>;

   qcom,board-id= <15 2>;
   qcom,msm-id = <0x1007e 0>;
```

## Documentation/devicetree/bindings/arm/msm/msm-machine-name.txt
```
Msm Machine Name

Machine name is used to:
	1. show up in the beginning of kernel message.
	Example:
		[    0.000000] Machine: Qualcomm Technologies, Inc. MSM8953 PMI8950 MTP
	2. show up as arch description when do dump stack.
	Example:
		[    1.222319] WARNING: CPU: 2 PID: 1 at kernel/lib/debugobjects.c:263 debug_print_object+0xa8/0xb0
		[    1.222334] Modules linked in:
		[    1.222362] CPU: 2 PID: 1 Comm: swapper/0 Not tainted 4.9.65+ #71
		[    1.222376] Hardware name: Qualcomm Technologies, Inc. MSM8953 PMI8950 MTP (DT)
		[    1.222392] task: ffffffc0ed1b0080 task.stack: ffffffc0ed1b8000
		[    1.222408] PC is at debug_print_object+0xa8/0xb0
		[    1.222424] LR is at debug_print_object+0xa8/0xb0

Msm machine name is a string concatenated from:
	1. constant string contain msm information: "Qualcomm Technologies, Inc.".
	2. string of device tree property "qcom,msm-name".
	3. string of device tree property "qcom,pmic-name".
	4. string of device tree property "model".

The reason for using msm machine Name is single board overlay device tree
may applied to multiple soc device trees. The "model" property in soc device
tree is overwritten with board overlay device tree. So the final string in
"model" property can only contain Board information. And "qcom,msm-name"
and "qcom,pmic-name" property is introduced.

Optional properties:
- qcom,msm-name: The name string of MSM SoC chip
- qcom,pmic-name: The name string of MSM Pmic chip

Required properties:
- model: in soc device tree
	Contain the soc and pmic information.
	Will be overwritten by model string in board overlay device tree.
	It will be used in bootloader for debug purpose.
- model: in board overlay device tree
	Contain the board information. It is the final model string that
	kernel can see.

Note:
When device tree property qcom,msm-name and qcom,pmic-name exist, it will
use concatenated msm machine name string for final machine name.
When device tree property qcom,msm-name and qcom,pmic-name doesn't exist,
it will use model property string for final machine name.

Example:
* In soc device tree:
	/ {
		model = "Qualcomm Technologies, Inc. APQ 8953 + PMI8950 SOC";
		compatible = "qcom,apq8053";
		qcom,pmic-id = <0x010016 0x010011 0x0 0x0>;
		qcom,pmic-name = "PMI8950";
		qcom,msm-id = <293 0x0>;
		qcom,msm-name = "APQ8053";
	};
* In board overlay device tree:
	/ {
		model = "MTP";
		compatible = "qcom,mtp";
	};
```

## Documentation/devicetree/bindings/arm/msm/msm.txt
```
* Qualcomm Technologies, Inc. MSM

MSM uses a combination of DTS and DTSI files to describe the hardware on various
SoCs and boards. Typically, a SoC-specific DTSI file describes the devices
present on a given SoC, and a board-specific DTSI file describes the devices
external to the SoC, although some targets may follow a more simplified
approach. Additionally, the SoC-specific DTSI files may further consist of a
base chip-specific file and a version-specific DTSI file, to facilitate reuse
of device definitions among multiple revisions of the same SoC.

Required properties:
- compatible: Every device present on the MSM SoC shall have a 'qcom,' prefix
  in its compatible string

Example:
restart@fc4ab000 {
	compatible = "qcom,pshold";
	reg = <0xfc4ab000 0x4>;
};


* Compatible strings:

SoCs:
- MDM9607
  compatible = "qcom,mdm9607"

- APQ8016
  compatible = "qcom,apq8016"

- APQ8084
  compatible = "qcom,apq8084"

- APQ8096
  compatible = "qcom,apq8096"

- MSM8916
  compatible = "qcom,msm8916"

- MSM8960
  compatible = "qcom,msm8960"

- MSM8996
  compatible = "qcom,msm8996"

- SM8150
  compatible = "qcom,sm8150"

- SM8150P
  compatible = "qcom,sm8150p"

- SDMSHRIKE
  compatible = "qcom,sdmshrike"

- SM6150
  compatible = "qcom,sm6150"

- QCS405
  compatible = "qcom,qcs405"

- QCS403
  compatible = "qcom,qcs403"

- QCS401
  compatible = "qcom,qcs401"

- QCS404
  compatible = "qcom,qcs404"

- QCS407
  compatible = "qcom,qcs407"

- SDXPRAIRIE
  compatible = "qcom,sdxprairie"

- SDMMAGPIE
  compatible = "qcom,sdmmagpie"

- TRINKET
  compatible = "qcom,trinket"

- ATOLL
  compatible = "qcom,atoll"

- QCS610
  compatible = "qcom,qcs610"

- QCS410
  compatible = "qcom,qcs410"

- SDM660
  compatible = "qcom,sdm660"

- SDA660
  compatible = "qcom,sda660"

- SDM429
  compatible = "qcom,sdm429"

- SDA429
  compatible = "qcom,sda429"

- SDM429W
  compatible = "qcom,sdm429w"

- SDA429W
  compatible = "qcom,sda429w"

- SA2145P
  compatible = "qcom,sa2145p"

- SA2150P
  compatible = "qcom,sa2150p"

Generic board variants:

- CDP device:
  compatible = "qcom,cdp"

- IDP device:
  compatible = "qcom,idp"

- MTP device:
  compatible = "qcom,mtp"

- ATP device:
  compatible = "qcom,atp"

- FLUID device:
  compatible = "qcom,fluid"

- LIQUID device:
  compatible = "qcom,liquid"

- Dragonboard device:
  compatible = "qcom,dragonboard"

- SBC device:
  compatible = "qcom,sbc"

- SURF device:
  compatible = "qcom,surf"

- QRD device:
  compatible = "qcom,qrd"

- HDK device:
  compatible = "qcom,hdk"

- ADP device:
  compatible = "qcom,adp"

- Simulator device:
  compatible = "qcom,sim"

- RUMI device:
  compatible = "qcom,rumi"

- IOT device:
  compatible = "qcom,iot"

- TTP device:
  compatible = "qcom,ttp"

- TRINKET-IOT
  compatible = "qcom,trinket-iot"

- TRINKETP-IOT
  compatible = "qcom,trinketp-iot"

Boards (SoC type + board variant):

compatible = "qcom,apq8016"
compatible = "qcom,apq8084-cdp"
compatible = "qcom,apq8084-liquid"
compatible = "qcom,apq8084-mtp"
compatible = "qcom,apq8084-sbc"
compatible = "qcom,apq8094-cdp"
compatible = "qcom,apq8096-cdp"
compatible = "qcom,apq8096-mtp"
compatible = "qcom,apq8096-dragonboard"
compatible = "qcom,apq8096-sbc"
compatible = "qcom,apq8096-liquid"
compatible = "qcom,msm8916-cdp"
compatible = "qcom,msm8916-mtp"
compatible = "qcom,msm8916-qrd-skuh"
compatible = "qcom,msm8916-qrd-skuhf"
compatible = "qcom,msm8916-qrd-skui"
compatible = "qcom,msm8916-qrd-skuic"
compatible = "qcom,msm8916-qrd-skuid"
compatible = "qcom,msm8916-qrd-skut1"
compatible = "qcom,msm8916-rumi"
compatible = "qcom,msm8916-sim"
compatible = "qcom,msm8960-cdp"
compatible = "qcom,msm8974-cdp"
compatible = "qcom,msm8974-fluid"
compatible = "qcom,msm8974-liquid"
compatible = "qcom,msm8974-mtp"
compatible = "qcom,msm8974-rumi"
compatible = "qcom,msm8974-sim"
compatible = "qcom,msm8996-rumi"
compatible = "qcom,msm8996-sim"
compatible = "qcom,msm8996-cdp"
compatible = "qcom,msm8996-dtp"
compatible = "qcom,msm8996-fluid"
compatible = "qcom,msm8996-liquid"
compatible = "qcom,msm8996-mtp"
compatible = "qcom,msm8996-adp"
compatible = "qcom,sm8150-rumi"
compatible = "qcom,sm8150-mtp"
compatible = "qcom,sm8150-cdp"
compatible = "qcom,sm8150-qrd"
compatible = "qcom,sm8150-hdk"
compatible = "qcom,sm8150p-cdp"
compatible = "qcom,sm8150p-mtp"
compatible = "qcom,sm8150p-qrd"
compatible = "qcom,sm8150p-hdk"
compatible = "qcom,sdmshrike-rumi"
compatible = "qcom,sdmshrike-mtp"
compatible = "qcom,sdmshrike-cdp"
compatible = "qcom,sm6150-rumi"
compatible = "qcom,sm6150-mtp"
compatible = "qcom,sm6150-cdp"
compatible = "qcom,sm6150-qrd"
compatible = "qcom,sm6150-idp"
compatible = "qcom,sm6150p-idp"
compatible = "qcom,sm6150p"
compatible = "qcom,sm6150p-qrd"
compatible = "qcom,sa6155-adp-star"
compatible = "qcom,sa6155p-adp-star"
compatible = "qcom,sa6155p"
compatible = "qcom,sa6155-adp-air"
compatible = "qcom,sa6155p-adp-air"
compatible = "qcom,qcs405-rumi"
compatible = "qcom,qcs405-iot"
compatible = "qcom,sa2150p-ccard"
compatible = "qcom,sa2145p-ccard"
compatible = "qcom,qcs403-iot"
compatible = "qcom,qcs401-iot"
compatible = "qcom,qcs404-iot"
compatible = "qcom,qcs407-iot"
compatible = "qcom,sa8155-adp-star"
compatible = "qcom,sa8155p-adp-star"
compatible = "qcom,sa8195p-adp-star"
compatible = "qcom,sa8195p-v2-adp-air"
compatible = "qcom,sa8195p"
compatible = "qcom,adp-star"
compatible = "qcom,sa8155-v2-adp-air"
compatible = "qcom,sa8155p-v2-adp-air"
compatible = "qcom,adp-air"
compatible = "qcom,sa8155-adp-alcor"
compatible = "qcom,adp-alcor"
compatible = "qcom,sa8155p-adp-alcor"
compatible = "qcom,sdxprairie-rumi"
compatible = "qcom,sdxprairie-mtp"
compatible = "qcom,sdxprairie-cdp"
compatible = "qcom,sa515m-ccard"
compatible = "qcom,sa515m-ttp"
compatible = "qcom,sdmmagpie-rumi"
compatible = "qcom,sdmmagpie-idp"
compatible = "qcom,sdmmagpie-atp"
compatible = "qcom,sdmmagpie-qrd"
compatible = "qcom,sdmmagpiep-idp"
compatible = "qcom,sdmmagpiep-atp"
compatible = "qcom,sdmmagpiep"
compatible = "qcom,sdmmagpiep-qrd"
compatible = "qcom,trinket-rumi"
compatible = "qcom,trinket-idp"
compatible = "qcom,trinket-qrd"
compatible = "qcom,atoll-rumi"
compatible = "qcom,atoll-idp"
compatible = "qcom,atoll-atp"
compatible = "qcom,atoll-qrd"
compatible = "qcom,atollp"
compatible = "qcom,atollp-idp"
compatible = "qcom,atollp-atp"
compatible = "qcom,atollp-qrd"
compatible = "qcom,atoll-ab"
compatible = "qcom,atoll-ab-idp"
compatible = "qcom,atoll-ab-atp"
compatible = "qcom,atoll-ab-qrd"
compatible = "qcom,qcs610-iot"
compatible = "qcom,qcs410-iot"
compatible = "qcom,mdm9607-mtp"
compatible = "qcom,sdm660-cdp"
compatible = "qcom,sdm660-mtp"
compatible = "qcom,sdm660-qrd"
compatible = "qcom,sdm660-sim"
compatible = "qcom,sda660-mtp"
compatible = "qcom,sda660-cdp"
compatible = "qcom,sda660-qrd"
compatible = "qcom,mdm9607-cdp"
compatible = "qcom,sdm429-cdp"
compatible = "qcom,sdm429w-cdp"
compatible = "qcom,sdm429-mtp"
compatible = "qcom,sdm429w-mtp"
compatible = "qcom,sdm429-qrd"
compatible = "qcom,sdm429w-qrd"
compatible = "qcom,sda429-cdp"
compatible = "qcom,sda429w-cdp"
compatible = "qcom,sda429-mtp"
compatible = "qcom,sda429w-mtp"
compatible = "qcom,sda429w-qrd"
compatible = "qcom,sda429-qrd"
compatible = "qcom,sdm429w-wtp"
compatible = "qcom,sdm429-wtp"
compatible = "qcom,sda429w-wtp"
compatible = "qcom,sda429-wtp"
compatible = "qcom,sda429w-wdp"
compatible = "qcom,sda429-wdp"
compatible = "qcom,sdm429w-wdp"
compatible = "qcom,sdm429-wdp"
compatible = "qcom,trinket-iot"
compatible = "qcom,trinketp-iot"
compatible = "qcom,trinket-iot-idp"
compatible = "qcom,trinketp-iot-idp"
compatible = "qcom,qcs610-idp"
```
