## Documentation/devicetree/bindings/arm/msm/msm_ipc_router.txt
```
Qualcomm IPC Router

Required properties:
-compatible:	should be "qcom,ipc_router"
-qcom,node-id:	unique ID to identify the node in network

Optional properties:
-qcom,default-peripheral: String property to indicate the default peripheral
			  to communicate

Example:
	qcom,ipc_router {
		compatible = "qcom,ipc_router";
		qcom,node-id = <1>;
		qcom,default-peripheral = "modem";
	};
```

## Documentation/devicetree/bindings/arm/msm/msm_ipc_router_fifo_xprt.txt
```
Qualcomm Technologies, Inc. IPC Router FIFO Transport

Required properties:
- compatible:	should be "qcom,ipcr_fifo_xprt"
- reg:		the irq register to raise an interrupt
- interrupts:	the receiving interrupt line
- qcom,ipc-shm:	Reference to shared memory phandle

Example:

	fifo_vipc_irq@176 {
		compatible = "qcom,ipcr-fifo-xprt";
		reg = <0x176>;
		interrupts = <0x0 0x142 0x1>;
		qcom,ipc-shm = <&ipc-shm>;
	};

	ipc-shm: shared-buffer@85af7000 {
		compatible = "qcom,hypervisor-shared-memory";
		phandle = <0x1e4>;
		reg = <0x0 0x85af7000 0x0 0x9000>;
		label = "ipc_shm";
		qcom,tx-is-first;
	};
```

## Documentation/devicetree/bindings/arm/msm/msm_ipc_router_glink_xprt.txt
```
Qualcomm Technologies, Inc. IPC Router G-Link Transport

Required properties:
-compatible:		should be "qcom,ipc_router_glink_xprt"
-qcom,ch-name:		the G-Link channel name used by the G-Link transport
-qcom,xprt-remote:	string that defines the edge of the transport
-qcom,glink-xprt:	string that describes the underlying physical transport
-qcom,xprt-linkid:	unique integer to identify the tier to which the link
			belongs to in the network and is used to avoid the
			routing loops while forwarding the broadcast messages
-qcom,xprt-version:	unique version ID used by G-Link transport header

Optional properties:
-qcom,fragmented-data:	Boolean property to indicate that G-Link transport
			supports fragmented data
-qcom,pil-label: 	string that defines remote subsystem name understood
			by pil. Absence of this property indicates that
			subsystem loading through pil voting is disabled for
			that subsystem.
-qcom,dynamic-wakeup-source:	Boolean property to indicate that G-Link
				transport supports dynamic wakeup source
-qcom,low-latency-xprt:		Boolean property to indicate that G-Link
				transport is low latency trasport.

Example:
	qcom,ipc_router_modem_xprt {
		compatible = "qcom,ipc_router_glink_xprt";
		qcom,ch-name = "IPCRTR";
		qcom,xprt-remote = "mpss";
		qcom,glink-xprt = "smem";
		qcom,xprt-linkid = <1>;
		qcom,xprt-version = <1>;
		qcom,fragmented-data;
		qcom,pil-label = "modem";
	};

	qcom,ipc_router_q6_xprt {
		compatible = "qcom,ipc_router_glink_xprt";
		qcom,ch-name = "IPCRTR";
		qcom,xprt-remote = "lpass";
		qcom,glink-xprt = "smem";
		qcom,xprt-linkid = <1>;
		qcom,xprt-version = <1>;
		qcom,fragmented-data;
		qcom,pil-label = "adsp";
	};
```
