## Documentation/devicetree/bindings/arm/msm/msm_aop_ddr_msgs.txt
```
AOP (Always-On-Processor) DDR Related Messaging

The AOP DDR messaging driver is used to send messages to the AOP,
using the mailbox interface, to lower the DDR frequency during reboot.

Required properties

- compatible : "qcom,aop-ddr-msgs"
- mbox : QMP mailbox phandle and channel identifier

Optional properties:
-mbox-name: name of the mailbox

Example:
	qcom,aop-ddr-msgs {
		compatible = "qcom,aop-ddr-msgs";
		mboxes = <&qmp_aop 0>;
	};
```

## Documentation/devicetree/bindings/arm/msm/msm_aop_ddrss_cmd.txt
```
AOP (Always-On-Processor) DDRSS Commands

The AOP DDRSS commands driver is used to send commands
to the AOP, using the mailbox interface, to affect the
behavior of the DDR.

Required properties

- compatible : "qcom,aop-ddrss-cmds"
- mbox : QMP mailbox phandle and channel identifier

Optional properties:
-mbox-name: name of the mailbox

Example:
	qcom,aop-ddrss-cmds {
		compatible = "qcom,aop-ddrss-cmds";
		mboxes = <&qmp_aop 0>;
	};
```

## Documentation/devicetree/bindings/arm/msm/msm_bandwidth_monitor.txt
```
Bandwidth Monitor driver(BW_MONITOR)
=====================================

Bandwidth Monitor driver creates logical sensor nodes with thermal core
framework for the specified bus. This logical sensor will be used to monitor
and mitigate the bus bandwidth. This driver can be configured to register
any bus bandwidth as a sensor for it to be monitored.

The device tree parameters for bandwidth monitor driver(BW_MONITOR) driver are:

Properties:

- compatible:
        Usage: required
        Value type: <string>
        Definition: shall be "qcom,bm-sensors"

- <child node>
        Usage: required
        Definition: Each child node represents a bandwidth sensor and name of
			the node will be used as bandwidth sensor name. Each
			sensor can represent either single bus bandwidth or
			aggregation of multiple bus bandwidth.

Child node Properties:
- qcom,bm-sensor:
        Usage: required
        Value type: <array of phandle>
        Definition: This bandwidth sensor monitors aggregated bandwidth of
			these bus bandwidth.

- qcom,bm-sensor-field:
        Usage: required
        Value type: <string>
	Definition: This property defines the bandwidth to be monitored,
			either average bandwidth(ab) or instantaneous
			bandwidth(ib).

Example:
	qcom,bm-sensors {
		compatible = "qcom,bm-sensors";

		bw_mm {
			qcom,bm-sensor = <&slv_snoc_bimc_0 &slv_snoc_bimc_2>;
			qcom,bm-sensor-field = "ab";
		};

		bw_apps {
			qcom,bm-sensor = <&mas_apps_proc>;
			qcom,bm-sensor-field = "ib";
		};
	};
```

## Documentation/devicetree/bindings/arm/msm/msm_bbif.txt
```
QTI Base Band InterFace (BBIF)

This is a platform driver for accessing the DAC/ADCs in femto (FSM9900
and FSM9010) chipsets.

Required properties:

-compatible: should be "qcom,bbif-fsm9900" or "qcom,bbif-fsm9010"
-reg: specifies the base address of bbif registers.

Optional properties:

vdd-lbbrx-supply: regulator used to control low voltage of Base Band RX.
vdd-hbbrx-supply: regulator used to control high voltage of Base Band RX.

Example 1:
	qcom,bbif@fd300000 {
		compatible = "qcom,bbif-fsm9900";
		reg = <0xfd300000 0x10000>;
		vdd-lbbrx-supply = <&pma8084_l4>;
		vdd-hbbrx-supply = <&pma8084_l14>;
	};

Example 2:
	qcom,bbif@fd300000 {
		compatible = "qcom,bbif-fsm9010";
		reg = <0xfd300000 0x10000>;
	};
```

## Documentation/devicetree/bindings/arm/msm/msm_bus.txt
```
MSM Bus Devices

The bus devices (fabrics/NoCs) are the interconnects between various
components on chipsets. These devices form the backbone of the chip
topology. Entire topology of the chipset is built using the
device-tree data of these bus devices.

To add the bus devices following properties are required:

compatible:		The bus devices need to be compatible with
			msm-bus-fabric
cell-id:		A 32 bit integer unique per bus per chipset. The IDs
			for buses are in multiples of 1024.
label:			Bus name
qti,fabclk-dual:	Dual set (active/sleep) bus clock name
qti,fabclk-active:	Active set bus clock name
qti,nfab:		An integer property which specifies the total number
			of buses on the chipset.

The following properties are optional as a bus might not support
these features:

qti,ntieredslaves:	Number of tiered slaves on the bus.
qti,qos-freq:		QoS frequency (In Hz)
qti,hw-sel:		A string which decides whether QoS data
			should be sent to RPM, set using BIMC or NoCs.
			It can be set to "RPM", "NoC" or "BIMC".
qti,rpm-en:		A boolean flag indicating whether RPM transactions are
			supported for nodes of the bus.
qti,ahb:		A boolean flag indicating whether the bus is ahb type.
qti,virt:		A boolean property indicating this is a virtual bus.
reg:			Register space of the bus device. Not required in case
			the bus is virtual.

The following properties are optional as collecting data via coresight might
not be supported for every bus. The documentation for coresight properties
can be found in:
Documentation/devicetree/bindings/coresight/coresight.txt

coreisght-id		Unique integer identifier for the bus.
coresight-name		Unique descriptive name of the bus.
coresight-nr-inports	Number of input ports on the bus.
coresight-outports	List of output port numbers on the bus.
coresight-child-list	List of phandles pointing to the children of this
			component.
coresight-child-ports	List of input port numbers of the children.


Any interconnect on the bus is represented as a child node.
A child node can be of type: master, slave or a gateway.
A gateway is an interconnect between buses and can be of both
master and slave type.

The following properties are available to characterize a child node.
The properties can be chosen depending on the type of child node.

cell-id:		For a master the ID is between 0 - 512
			For a slave the ID is between 512 - 1024
label:			Name of the master/slave/gateway
qti,masterp:		Hardware master port number(s)
qti,tier:		The tier to which a master/slave belongs.
			Note that tiering might not be supported on
			all architectures.
qti,hw-sel:		A string which decides whether QoS data should be sent
			to RPM, set using BIMC or NoCs.
			It can be set to "RPM", "NoC" or "BIMC".
qti,mode:		Used for masters on NoC/BIMC. Indicates which of the
			four modes (Fixed/Limiter/Bypass/Regulator) the master
			belongs to.
qti,perm-mode:		Permissible mode switches. Indicates which of the four
			modes are supported of the master node. Generally,
			modes are set at boot-up and not switched at run-time.
qti,qport:		QoS port number. This can be different from the
			master-port number.
qti,ws:			Window size (in Hz), used for NoC/BIMC masters to
			calculate saturation values.
qti,mas-hw-id:		A unique hardware ID agreed upon by processors across
			the system. This ID is assigned to every master. It can
			be used to send master specific data from
			Apps/Modem/LPASS to RPM.
qti,slv-hw-id:		A unique hardware ID agreed upon by processors across
			the system. This ID is assigned to every slave. It can
			be used to send slave specific data from
			Apps/Modem/LPASS to RPM.
qti,gateway:		Flag indicating whether a particular node is a gateway.
qti,slavep:		Hardware slave port number(s).
qti,buswidth:		Width of the interconnect between a node and the bus.
			(In Bytes).
qti,prio-rd:		Read priority for a BIMC bus master (Can be 0/1/2)
qti,prio-wr:		Write priority for a BIMC bus master (Can be 0/1/2)
qti,prio0:		Priority low signal for a NoC bus master
			(Can be 0/1/2).
qti,prio1:		Priority high signal for a NoC bus master
			(Can be 0/1/2)
qti,dual-conf:		Indicates whether a BIMC/NoC master can be configured
			in multiple modes at run-time. (Boolean)
qti,mode-thresh:	Threshold mode for a BIMC/NoC master. Beyond a certain
			threshold frequency, a threshold mode can be used.
			(Can be Fixed/Limiter/Bypass/Regulator)
qti,bimc,bw:		Bandwidth limit for a BIMC master using dual modes.
			This bandwidth is used to calculate Grant count and
			other parameters used in Limiter and Regular mode
			for static BKE configuration. It is defined in KBps.
qti,bimc,gp:		Grant Period for configuring a master in limiter
			mode. This is an integer value in nano-seconds.
qti,bimc,thmp:		Medium threshold percentage for BIMC masters.
			This percentage is used to calculate medium threshold
			value for BIMC Masters in Limiter mode for static
			configuration. This can be any integer value between
			1 and 100.
qti,thresh:		Beyond this threshold frequency, the mode usage is
			switched from mode specified by property qti,mode
			to the one specified by qti,mode-thresh. In case the
			requested IB value falls below this threshold, the mode
			is switched back to qti,mode. Frequency is specified in
			KBps.





Example:


	msm-mmss-noc@fc478000 {
		compatible = "msm-bus-fabric";
		reg = <0xfc478000 0x00004000>;
		cell-id = <2048>;
		label = "msm_mmss_noc";
		qti,fabclk-dual = "bus_clk";
		qti,fabclk-active = "bus_a_clk";
		qti,ntieredslaves = <0>;
		qti,qos-freq = <4800>;
		qti,hw-sel = "NoC";
		qti,rpm-en;
		qti,nfab = <6>;

		mas-gfx3d {
			cell-id = <26>;
			label = "mas-gfx3d";
			qti,masterp = <2 3>;
			qti,tier = <2>;
			qti,hw-sel = "NoC";
			qti,perm-mode = "Bypass";
			qti,mode = "Bypass";
			qti,ws = <10000>;
			qti,qport = <2 3>;
			qti,mas-hw-id = <6>;
		};

		mas-jpeg {
			cell-id = <62>;
			label = "mas-jpeg";
			qti,masterp = <4>;
			qti,tier = <2>;
			qti,hw-sel = "NoC";
			qti,perm-mode = "Bypass";
			qti,mode = "Bypass";
			qti,qport = <0>;
			qti,ws = <10000>;
			qti,mas-hw-id = <7>;
		};
	};

	msm-bimc@0xfc380000 {
		compatible = "msm-bus-fabric";
		reg = <0xfc380000 0x0006A000>;
		cell-id = <0>;
		label = "msm_bimc";
		qti,fabclk-dual = "mem_clk";
		qti,fabclk-active = "mem_a_clk";
		qti,ntieredslaves = <0>;
		qti,qos-freq = <19200>;
		qti,hw-sel = "BIMC";
		qti,rpm-en;

		coresight-id = <55>;
		coresight-name = "coresight-bimc";
		coresight-nr-inports = <0>;
		coresight-outports = <0>;
		coresight-child-list = <&funnel_in1>;
		coresight-child-ports = <3>;

		mas-ampss-m0 {
			cell-id = <1>;
			label = "mas-ampss-m0";
			qti,masterp = <0>;
			qti,tier = <2>;
			qti,hw-sel = "BIMC";
			qti,mode = "Limiter";
			qti,qport = <0>;
			qti,ws = <10000>;
			qti,mas-hw-id = <0>;
			qti,prio-rd = <0>;
			qti,prio-wr = <0>;
			qti,mode-thresh = "Fixed";
			qti,thresh = <2000000>;
			qti,dual-conf;
			qti,bimc,bw = <300000>;
			qti,bimc,gp = <5>;
			qti,bimc,thmp = <50>;
		};
	};




The bus scaling driver also provides the ability to configure
bus performance parameters across the entire chip-set.
Various clients use MSM scaling APIs to request bandwidth
between multiple master-slave pairs. The bus driver then finds
the optimal path between the master and the slave, and aggregates
the bandwidth and clock requests for all master-slave pairs on
that path, and programs hardware accordingly.

The device-tree data required for bus-scaling can be embedded within
the clients' device nodes. The clients can register with the bus driver
using the following properties:

- qti,msm-bus,name:		String representing the client-name
- qti,msm-bus,num-cases:	Total number of usecases
- qti,msm-bus,active-only:	Boolean context flag for requests in active or
				dual (active & sleep) contex
- qti,msm-bus,num-paths:	Total number of master-slave pairs
- qti,msm-bus,vectors-KBps:	Arrays of unsigned integers representing:
				master-id, slave-id, arbitrated bandwidth
				in KBps, instantaneous bandwidth in KBps

Example:

	qti,msm-bus,name = "client-name";
	qti,msm-bus,num-cases = <3>;
	qti,msm-bus,active-only;
	qti,msm-bus,num-paths = <2>;
	qti,msm-bus,vectors =
			<22 512 0 0>, <26 512 0 0>,
			<22 512 320000 3200000>, <26 512 3200000 3200000>,
			<22 512 160000 1600000>, <26 512 1600000 1600000>;
```
