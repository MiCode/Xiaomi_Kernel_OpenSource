## Documentation/devicetree/bindings/arm/msm/glink_rpm_native_xprt.txt
```
Qualcomm Technologies, Inc. G-link RPM Native Transport

Required properties:
-compatible : should be "qcom,glink-rpm-native-xprt"
-reg : the location and size of RPM message RAM
	the irq register base address for triggering interrupts
-reg-names : "msgram" - string to identify the RPM message RAM region
		"irq-reg-base" - string to identify the irq register region
-qcom,irq-mask : the bitmark to trigger an interrupt
-interrupts : the receiving interrupt line

Example:

	qcom,glink-rpm-native-xprt@68000 {
		compatible = "qcom,glink-rpm-native-xprt";
		reg = <0x68000 0x8000>,
			<0xfa006008 0x4>;
		reg-names = "msgram", "irq-reg-base";
		qcom,irq-mask = <0x1000>;
		interrupts = <0 25 1>;
	};
```

## Documentation/devicetree/bindings/arm/msm/glink_smem_native_xprt.txt
```
Qualcomm Technologies, Inc. G-link SMEM Native Transport

Required properties:
-compatible : should be "qcom,glink-smem-native-xprt"
-reg : the location and size of shared memory
	the irq register base address for triggering interrupts
-reg-names : "smem" - string to identify the shared memory region
		"irq-reg-base" - string to identify the irq register region
-qcom,irq-mask : the bitmark to trigger an interrupt
-interrupts : the receiving interrupt line
-label : the name of the subsystem this link connects to

Optional properties:
-cpu-affinity: Cores to pin the interrupt and receiving work thread to.
-qcom,qos-config: Reference to the qos configuration elements.It depends on
		ramp-time.
-qcom,ramp-time: Worst case time in microseconds to transition to this power
		state. Power states are numbered by array index position.

Example:

	qcom,glink-smem-native-xprt-modem@fa00000 {
		compatible = "qcom,glink-smem-native-xprt";
		reg = <0xfa00000 0x200000>,
			<0xfa006008 0x4>;
		reg-names = "smem", "irq-reg-base";
		qcom,irq-mask = <0x1000>;
		interrupts = <0 25 1>;
		label = "mpss";
	};

	qcom,glink-smem-native-xprt-adsp@fa00000 {
		compatible = "qcom,glink-smem-native-xprt";
		reg = <0xfa00000 0x200000>,
			<0xfa006008 0x4>;
		reg-names = "smem", "irq-reg-base";
		qcom,irq-mask = <0x1000>;
		interrupts = <0 25 1>;
		label = "lpass";
		cpu-affinity = <1 2>;
		qcom,qos-config = <&glink_qos_adsp>;
		qcom,ramp-time = <0x10>,
				     <0x20>,
				     <0x30>,
				     <0x40>;
	};

	glink_qos_adsp: qcom,glink-qos-config-adsp {
		compatible = "qcom,glink-qos-config";
		qcom,flow-info = <0x80 0x0>,
				 <0x70 0x1>,
				 <0x60 0x2>,
				 <0x50 0x3>;
		qcom,mtu-size = <0x800>;
		qcom,tput-stats-cycle = <0xa>;
	};
```

## Documentation/devicetree/bindings/arm/msm/glink_spi_xprt.txt
```
Qualcomm Technologies, Inc. G-link SPI Transport

Required properties:
-compatible : should be "qcom,glink-spi-xprt".
-label : the name of the subsystem this link connects to.

Optional properties:
-qcom,remote-fifo-config: Reference to the FIFO configuratio in the remote
			processor.
-qcom,qos-config: Reference to the qos configuration elements.It depends on
		ramp-time.
-qcom,ramp-time: Worst case time in microseconds to transition to this power
		state. Power states are numbered by array index position.

Example:

	glink_spi_xprt_wdsp: qcom,glink-spi-xprt-wdsp {
		compatible = "qcom,glink-spi-xprt";
		label = "wdsp";
		qcom,remote-fifo-config = <&glink_fifo_wdsp>;
		qcom,qos-config = <&glink_qos_wdsp>;
		qcom,ramp-time = <0x10>,
				     <0x20>,
				     <0x30>,
				     <0x40>;
	};

	glink_fifo_wdsp: qcom,glink-fifo-config-wdsp {
		compatible = "qcom,glink-fifo-config";
		qcom,out-read-idx-reg = <0x12000>;
		qcom,out-write-idx-reg = <0x12004>;
		qcom,in-read-idx-reg = <0x1200C>;
		qcom,in-write-idx-reg = <0x12010>;
	};

	glink_qos_wdsp: qcom,glink-qos-config-wdsp {
		compatible = "qcom,glink-qos-config";
		qcom,flow-info = <0x80 0x0>,
				 <0x70 0x1>,
				 <0x60 0x2>,
				 <0x50 0x3>;
		qcom,mtu-size = <0x800>;
		qcom,tput-stats-cycle = <0xa>;
	};
```

## Documentation/devicetree/bindings/arm/msm/glink_ssr.txt
```
Qualcomm Technologies, Inc. G-Link SSR

[Root level node]
Required properties:
-compatible : should be "qcom,glink_ssr"
-label : The name of this subsystem.
-qcom,edge : The name of the edge to this subsystem.
-qcom,notify-edges : Reference to other subsystems to notify when this
	subsystem goes down.

Optional properties:
-qcom,xprt : The name of the transport on which to notify this subystem.

Example:

	glink_mpss: qcom,glink-ssr-modem {
		compatible = "qcom,glink_ssr";
		label = "modem";
		qcom,edge = "mpss";
		qcom,notify-edges = <&glink_adsp>, <&glink_wcnss>;
		qcom,xprt = "smem";
	};

	glink_adsp: qcom,glink-ssr-adsp {
		compatible = "qcom,glink_ssr";
		label = "adsp";
		qcom,edge = "adsp";
		qcom,notify-edges = <&glink_mpss>, <&glink_wcnss>;
	};

	glink_wcnss: qcom,glink-ssr-wcnss {
		compatible = "qcom,glink_ssr";
		label = "wcnss";
		qcom,edge = "wcnss";
		qcom,notify-edges = <&glink_mpss>;
	};
```

## Documentation/devicetree/bindings/arm/msm/glinkpkt.txt
```
Qualcomm Technologies, Inc. G-Link Packet Driver (glinkpkt)

[Root level node]
Required properties:
-compatible : should be "qcom,glinkpkt"

[Second level nodes]
qcom,glinkpkt-channel-names
Required properties:
-qcom,glinkpkt-transport : the glinkpkt transport layer
-qcom,glinkpkt-edge : the remote subsystem name
-qcom,glinkpkt-ch-name : the glink channel name

Example:

	qcom,glinkpkt {
		compatible = "qcom,glinkpkt";

		qcom,glinkpkt-glink1 {
			qcom,glinkpkt-transport = "smem";
			qcom,glinkpkt-edge = "mpss";
			qcom,glinkpkt-ch-name = "glink1";
		};

		qcom,glinkpkt-loopback {
			qcom,glinkpkt-transport = "smem";
			qcom,glinkpkt-edge = "mpss";
			qcom,glinkpkt-ch-name = "glink_pkt_loopback";
		};
	};
```

## Documentation/devicetree/bindings/arm/msm/heap-sharing.txt
```
* Memory Share Driver (MEMSHARE)

The Memshare driver implements a Kernel QMI service on the
LA-APSS, which is responsible for providing contiguous physical
memory to MPSS for use cases when the modem requires additional
memory (e.g. GPS).

Required properties for Memshare

-Root Node-

- compatible:	Must be "qcom,memshare"

Required properties for child nodes:

- compatible:	Must be "qcom,memshare-peripheral"

- qcom,peripheral-size: Indicates the size (in bytes) required for that child.

- qcom,client-id: Indicates the client id of the child node.

- label: Indicates the peripheral information for the node. Should be one of
  the following:
  - modem	/* Represent Modem Peripheral */
  - adsp	/* Represent ADSP Peripheral */
  - wcnss	/* Represent WCNSS Peripheral */

Optional properties for child nodes:

- qcom,allocate-boot-time: Indicates whether clients needs boot time memory allocation.

Example:

qcom,memshare {
	compatible = "qcom,memshare";

	qcom,client_1 {
		compatible = "qcom,memshare-peripheral";
		qcom,peripheral-size = <0x200000>;
		qcom,client-id = <0>;
		qcom,allocate-boot-time;
		label = "modem";
	};
};
```

## Documentation/devicetree/bindings/arm/msm/hh_watchdog.yaml
```yaml
%YAML 1.2
---
$id: http://devicetree.org/schemas/bindings/arm/msm/hh_watchdog.yaml#
$schema: http://devicetree.org/meta-schemas/core.yaml#

title: QTI HH Watchdog

maintainers:

description: |+
  Watchdog timer is configured with a bark and a bite time.
  If the watchdog is not "pet" at regular intervals, the system
  is assumed to have become non responsive and needs to be reset.
  A warning in the form of a bark timeout leads to a bark interrupt
  and a kernel panic. If the watchdog timer is still not reset,
  a bite timeout occurs, which leads to a reset of the VM via
  the hypervisor. The driver needs the petting time, and the bark
  timeout to be programmed into the watchdog, as well as the bark irq.

  The device tree parameters for the watchdog are:

properties:
  compatible:
    Usage: required
    Value type: <string>
    Definition: Must be "qcom,hh-watchdog"

  interrupts:
     Usage: required
     Value type: <prop-encoded-array>
     Definition: should contain the bark irq number

example:
  - |
    wdog_hh: qcom,wdt_hh {
		    compatible = "qcom,hh-watchdog";
		    interrupts = <0 0 IRQ_TYPE_LEVEL_HIGH>;
	    };
...
```

## Documentation/devicetree/bindings/arm/msm/hidqvr-smp2p.txt
```
Qualcomm Technologies, Inc. HID QVR (hid-qvr) driver

Required properties:
-compatible :
	To communicate with cdsp
		qcom,smp2p_interrupt_qvrexternal_5_out (outbound)

Example:
	qcom,smp2p_interrupt_qvrexternal_5_out {
		compatible = "qcom,smp2p-interrupt-qvrexternal-5-out";
		qcom,smem-states = <&smp2p_qvrexternal5_out 0>;
		qcom,smem-state-names = "qvrexternal-smp2p-out";
	};
```

## Documentation/devicetree/bindings/arm/msm/imem.txt
```
Qualcomm IMEM

IMEM is fast on-chip memory used for various debug features and dma transactions.

Required properties

-compatible: "qti,msm-imem"
-reg: start address and size of imem memory

If any children nodes exist the following properties are required:
-#address-cells: should be 1
-#size-cells: should be 1
-ranges: A triplet that includes the child address, parent address, &
	 length.  The child address is assumed to be 0.

Child nodes:
------------

Peripheral Image Loader (pil):
------------------------------
Required properties:
-compatible: "qti,msm-imem-pil"
-reg: start address and size of PIL region in imem

Bootloader Stats:
-----------------
Required properties:
-compatible: "qti,msm-imem-boot_stats"
-reg: start address and size of boot_stats region in imem

Cache error reporting:
-----------------
Required properties:
-compatible: "qti,msm-imem-cache_erp"
-reg: start address and size of cache_erp region in imem

Memory Dump:
------------
Required properties:
-compatible: "qti,msm-imem-mem_dump_table"
-reg: start address and size of mem_dump_table region in imem

Example:

	qti,msm-imem {
		compatible = "qti,msm-imem";
		reg = <0xdeadbeef 0x1000>; /* < start_address size > */
		ranges = <0x0 0xdeadbeef 0x1000>;
		#address-cells = <1>;
		#size-cells = <1>;

		imem_cache_erp: cache_erp@6a4 {
			compatible = "qti,msm-imem-cache_erp";
			reg = <0x6a4 4>;
		};

		boot_stats@6b0 {
			compatible = "qti,msm-imem-boot_stats";
			reg = <0x6b0 32>;
		};

		pil@94c {
			compatible = "qti,msm-imem-pil";
			reg = <0x94c 200>;
		};
	};
```

## Documentation/devicetree/bindings/arm/msm/imem.yaml
```yaml
%YAML 1.2
---
$id: http://devicetree.org/schemas/bindings/arm/msm/imem.yaml#
$schema: http://devicetree.org/meta-schemas/core.yaml#

title: QTI IMEM

maintainers:
  - Raghavendra Rao Ananta <rananta@quicinc.com>

description: |
  IMEM is fast on-chip memory used for various debug features and dma transactions.

properties:
  compatible:
    const: qcom,msm-imem

  reg:
    description: start address and size of imem memory

  '#address-cells':
    const: 1

  '#size-cells':
    const: 1

  ranges: true
    description:
      Includes the child address, parent address, & ength.  The child address is
      assumed to be 0.

patternProperties:
  "[a-zA-Z0-9]@[a-z0-9]"
  type: object

  properties:
    compatible:
      oneOf:
        - const: qcom,msm-imem-pil
          description: Peripheral Image Loader (PIL)

        - const: qcom,msm-imem-boot_stats
          description: Bootloader Stats

        - const: qcom,msm-imem-cache_erp
          description: Cache error reporting

        - const: qcom,msm-imem-mem_dump_table
          desciption: Memory Dump table

        - const: qcom,msm-imem-restart_reason
          description: Device restart reason

        - const: qcom,msm-imem-dload-type
          description: Download Mode Type

        - const: qcom,msm-imem-download_mode
          description: Download Mode

        - const: qcom,msm-imem-emergency_download_mode
          description: Emergency Download Mode

        - const: qcom,msm-imem-kaslr_offset
          description: Kernel Address Space Layout Randomization (KASLR) offset

        - const: qcom,msm-imem-minidump
          description: Subsystem Restart's (SSR) Minidump Offset

        - const: qcom,msm-imem-diag-dload
          description: USB Diag download mode region

        - const: qcom,msm-imem-pil-disable-timeout
          description: Offset to set PIL debug cookie

    reg:
      description: Start address and the size of the region

    required:
      - compatible
      - reg

required:
  - compatible
  - reg

examples:
  - |
    qcom,msm-imem {
      compatible = "qcom,msm-imem";
      reg = <0xdeadbeef 0x1000>; /* < start_address size > */
      ranges = <0x0 0xdeadbeef 0x1000>;
      #address-cells = <1>;
      #size-cells = <1>;

      download_mode@0 {
        compatible = "qcom,msm-imem-download_mode";
        reg = <0x0 8>;
      };

      restart_reason@65c {
        compatible = "qcom,msm-imem-restart_reason";
        reg = <0x65c 4>;
      };

      imem_cache_erp: cache_erp@6a4 {
        compatible = "qcom,msm-imem-cache_erp";
        reg = <0x6a4 4>;
      };

      boot_stats@6b0 {
        compatible = "qcom,msm-imem-boot_stats";
        reg = <0x6b0 32>;
      };

      kaslr_offset@6d0 {
        compatible = "qcom,msm-imem-kaslr_offset";
        reg = <0x6d0 12>;
      };


      pil@94c {
        compatible = "qcom,msm-imem-pil";
        reg = <0x94c 200>;
      };

      emergency_download_mode@fe0 {
        compatible = "qcom,msm-imem-emergency_download_mode";
        reg = <0xfe0 12>;
      };

      ss_mdump@b88 {
        compatible = "qcom,msm-imem-minidump";
        reg = <0xb88 28>;
      };
    };
```

## Documentation/devicetree/bindings/arm/msm/ipc-spinlock.txt
```
Qualcomm Technologies, Inc. Interprocessor Communication Spinlock

--Dedicated Hardware Implementation--
Required properties:
- compatible : should be "qcom,ipc-spinlock-sfpb"
- reg : the location and size of the spinlock hardware
- qcom,num-locks : the number of locks supported

Example:

	qcom,ipc-spinlock@fd484000 {
		compatible = "qcom,ipc-spinlock-sfpb";
		reg = <0xfd484000 0x1000>;
		qcom,num-locks = <32>;
	};

--LDREX Implementation--
Required properties:
- compatible : should be "qcom,ipc-spinlock-ldrex"
- reg : the location and size of the shared lock memory

Example:

	qcom,ipc-spinlock@fa00000 {
		compatible = "qcom,ipc-spinlock-ldrex";
		reg = <0xfa00000 0x200000>;
	};
```

## Documentation/devicetree/bindings/arm/msm/jtag-fuse.txt
```
* JTAG-FUSE

The jtag-fuse entry specifies the memory mapped addresses for the fuse
registers. The jtag-fuse driver uses these to provide api(s) that can be used
by jtag save and restore driver(s) to query whether the Hardware they manage
is functionally disabled or not and take corresponding steps.

Required Properties:
compatible: component name used for driver matching, should be "qcom,jtag-fuse"
reg: physical base address and length of the register set
reg-names: should be "fuse-base"

Example:
	jtag_fuse: jtagfuse@fc4be024 {
		compatible = "qcom,jtag-fuse";
		reg = <0xfc4be024 0x8>;
		reg-names = "fuse-base";
	};
```
