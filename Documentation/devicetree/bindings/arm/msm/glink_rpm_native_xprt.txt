## Documentation/devicetree/bindings/arm/msm/jtag-mm.txt
```
* JTAG-MM

The jtag-mm entry specifies the memory mapped addresses for the debug and ETM
registers. The jtag-mm driver uses these to save and restore the registers
using memory mapped access during power collapse so as to retain their state
accross power collapse. This is necessary in case cp14 access to the registers
is not permitted.

Required Properties:
compatible: component name used for driver matching, should be:
	"qcom,jtag-mm"  - for jtag-mm device
	"qcom,jtagv8-mm" - for jtagv8-mm device supporting ARMv8 targets
reg: physical base address and length of the register set
reg-names: should be "etm-base" for etm register set and "debug-base" for debug
	register set.
qcom,coresight-jtagmm-cpu : specifies phandle for the cpu associated with the
			    jtag-mm device
qcom,si-enable : boolean, indicating etm save and restore is supported via
		 system instructions
qcom,save-restore-disable : boolean, to disable etm save and restore
			    functionality

Example:
jtag_mm: jtagmm@fc332000 {
	compatible = "qcom,jtag-mm";
	reg = <0xfc332000 0x1000>,
		<0xfc333000 0x1000>;
	reg-names = "etm-base","debug-base";

	qcom,coresight-jtagmm-cpu = <&CPU0>;
	};
```

## Documentation/devicetree/bindings/arm/msm/kraitbw-l2pm.txt
```
MSM Krait L2 performance monitor counters for bandwidth measurement device

krait-l2pm is a device that represents the Krait L2 PM counters that can be
used to measure the bandwidth of read/write traffic from the Krait CPU
subsystem.

Required properties:
- compatible:		Must be "qcom,kraitbw-l2pm"
- interrupts:		Lists the L2 PM counter overflow IRQ.
- qcom,bytes-per-beat:	The number of bytes transferred in one data beat from
			the Krait CPU subsystem.
- qcom,target-dev:	Target device for cache scaling

Example:
	qcom,kraitbw-l2pm {
		compatible = "qcom,kraitbw-l2pm";
		interrupts = <0 1 1>;
		qcom,bytes-per-beat = <8>;
		qcom,target-dev = <&cache>;
	};
```

## Documentation/devicetree/bindings/arm/msm/l2cache-pmu.txt
```
L2 cache performance monitor unit

L2 cache controllers have a performance monitor unit to measure
events such as cache hits and misses. There is one L2 cache PMU
for each cluster of CPUs.

Required properties:

- compatible : should be "qcom,qcom-l2cache-pmu"
- interrupts : 1 interrupt for each cluster.
- qcom,cpu-affinity: specifies the id of the first CPU in the cluster.

Example:

	l2cache-pmu {
		    compatible = "qcom,qcom-l2cache-pmu";
		    interrupts = <0 0 1>, <0 8 1>;
		    qcom,cpu-affinity = <0>, <2>
	};
```

## Documentation/devicetree/bindings/arm/msm/l2ccc.txt
```
L2 Cache Clock Controller

The L2 Cache Clock Controller provides clock, power domain, and
reset control to a L2-cache for a cluster. There is L2CCC register
region per CPU Cluster.

Required properties:
- compatible:	Can be one of:
		"qcom,8916-l2ccc"
		"qcom,8953-l2ccc"
		"qcom,8937-l2ccc"
- reg:		This specifies the base address and size of
		the register region.

Example:

	clock-controller@f900f000 {
		compatible = "qcom,8916-l2ccc"";
		reg = <0xf900f000 0x1000>;
	}
```

## Documentation/devicetree/bindings/arm/msm/limits_lmh.txt
```
Limits Management Hardware Driver
================================
LMH driver provides API to interact with the LMH hardware. All the calls to
the LMH hardware are routed via secure space.

The device tree parameters for LMH driver are:

Device/Asic specific properties:
- reg : Base address of the LMH Lite hardware's interrupt status register
		and its size in bytes. 'reg' parameter is required if
		'qcom,lmh-trim-err-offset' is set.
- qcom,lmh-trim-err-offset : This property defines the bit in the LMH
		interrupt status register, which shows whether there is a
		trim error in LMH hardware.
- vdd-apss-supply : This property should hold the phandle of APSS regulator.
		When defined, the M4M DPM will be notified for the APSS
		voltage change.
- qcom,lmh-odcm-disable-threshold-mA : This property holds the APSS rail
		current threshold below which the ODCM will be disabled.
		This property requires the "vdd-apss-supply" property
		defined.

Required parameters:
- compatible: Must be either "qcom,lmh" or "qcom,lmh_v1".
		The driver based on the compatible string will decide
		the default profile.
- interrupts: LMH Lite hardware interrupt details.

Example:

qcom,lmh {
	compatible = "qcom,lmh";
	interrupts = <0 332 4>;
	reg = <0xF9117000 0x4>;
	qcom,lmh-trim-err-offset = <18>;
	vdd-apss-supply = <&pm8994_s11>;
	qcom,lmh-odcm-disable-threshold-mA = <850>;
};

Or for asics that don't have trim err and don't require the voltage change
update for DPM.

qcom,lmh {
	compatible = "qcom,lmh_v1";
	interrupts = <0 332 4>;
};
```

## Documentation/devicetree/bindings/arm/msm/limits_supply_lm.txt
```
PMIC supply(S1) current limiting driver(SUPPLY_LM)
=====================================

This driver is a current limit management module to help manage
instantaneous peak current drawn by multiple subsystems on shared
supply. The inputs to the mitigation algorithm are current states
of different subsystems sharing this supply like cpu frequency,
gpu frequency, number of cores online, soc temperature, core leakage,
and modem state. It throttles cpu frequency and limits number of
online cores to reduce the dynamic current so as to keep the total
current drawn from supply in safe limits.

The device tree parameters for SUPPLY_LM driver are:

Required parameters:
- compatible :	Must be "qcom,supply-lm"
- interrupts :	SUPPLY_LM modem to apps interrupt details.
- reg :         Base addresses of the SUPPLY_LM modem interrupt data and
		its size in bytes.
- reg-names :   Name of SUPPLY_LM modem register in reg node.
- qcom,supply-lm-very-hot-temp-range : SUPPLY_LM very hot temperature range
		info. It expects trigger and clear thresholds in order.
- qcom,supply-lm-hot-temp-range : SUPPLY_LM hot temperature range info.
		It expects trigger and clear thresholds in order.
- gpu-dev-opp:	Phandle for gpu dev.
Example:

	qcom,supply-lm {
		compatible = "qcom,supply-lm";
		interrupts = <0 133 4>;
		reg =	<0x01946000 0x8>; /* TCSR_TCSR_S1LM_MODEM_TO_APPS_INT and
					   * TCSR_TCSR_S1LM_MODEM_TO_APPS_INT_DATA */
		reg-names = "intr_reg";
		qcom,supply-lm-very-hot-temp-range = <75 72>;
		qcom,supply-lm-hot-temp-range = <65 62>;
		gpu-dev-opp = <&msm_gpu>;
	};
```

## Documentation/devicetree/bindings/arm/msm/lmh-dcvs.txt
```
Limits Management Hardware - DCVS

The LMH-DCVS block is a hardware IP for every CPU cluster, to handle quick
changes in thermal limits. The hardware responds to thermal variation amongst
the CPUs in the cluster by requesting limits on the clock frequency and
voltage on the OSM hardware.

The LMH DCVS driver exports a virtual sensor that can be used to set the
thermal limits on the hardware. The thermal zone is not capable of reading out
a temperature.

Properties:

- compatible:
	Usage: required
	Value type: <string>
	Definition: shall be "qcom,msm-hw-limits"
- interrupts:
	Usage: required
	Value type: <interrupt_type interrupt_number interrupt_trigger_type>
	Definition: Should specify interrupt information about the debug
			interrupt generated by the LMH DCVSh hardware. LMH
			DCVSh hardware will generate this interrupt whenever
			it makes a new cpu DCVS decision.

Example:

	lmh_dcvs0: qcom,limits-dcvs@0 {
		compatible = "qcom,msm-hw-limits";
		interrupts = <GIC_SPI 38 IRQ_TYPE_LEVEL_HIGH>;
	};
```
