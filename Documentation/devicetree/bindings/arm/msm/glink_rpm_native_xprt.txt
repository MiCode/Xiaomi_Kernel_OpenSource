## Documentation/devicetree/bindings/arm/msm/mdm-modem.txt
```
Attached MDM Modem Devices

External modems are devices that are attached to the msm and controlled by gpios.
There is also a data channel between the msm and the external modem that sometimes needs
to be reset.

Required Properties:
- compatible:	The bus devices need to be compatible with
		"qcom,mdm2-modem", "qcom,ext-mdm9x25", "qcom,ext-mdm9x35", "qcom,ext-mdm9x45",
		"qcom,ext-mdm9x55", "qcom,ext-apq8096".

Required named gpio properties:
- qcom,mdm2ap-errfatal-gpio: gpio for the external modem to indicate to the apps processor
		of an error fatal condition on the modem.
- qcom,ap2mdm-errfatal-gpio: gpio for the apps processor to indicate to the external modem
		of an error fatal condition on the apps processor.
- qcom,mdm2ap-status-gpio: gpio to indicate to the apps processor when there is a watchdog
		bite on the external modem.
- qcom,ap2mdm-status-gpio: gpio for the apps processor to indicate to the modem that an apps
		processor watchdog bite has occurred.
- qcom,ap2mdm-soft-reset-gpio: gpio for the apps processor to use to soft-reset the external
		modem. If the flags parameter has a value of 0x1 then the gpio is active LOW.

Required Interrupts:
- "err_fatal_irq": Interrupt generated on the apps processor when the error fatal gpio is pulled
		high by the external modem.
- "status_irq": Interrupt generated on the apps processor when the mdm2ap-status gpio falls low
		on the external modem. This usually indicates a watchdog bite on the modem.
- "plbrdy_irq": Interrupt generated on the aps processor when the mdm2ap-pblrdy gpio is pulled
		either high or low by the external modem. This is an indication that the modem
		has rebooted.
- "mdm2ap_vddmin_irq": Interrupt generated on the apps processor when the external modem goes
		into vddmin power state.

Optional named gpio properties:
- qcom,mdm2ap-pblrdy-gpio: gpio used by some external modems to indicate when the modem has
		booted into the PBL bootloader.
- qcom,ap2mdm-wakeup-gpio: gpio used by the apps processor to wake the external modem
		out of a low power state.
- qcom,ap2mdm-chnl-rdy-gpio: gpio used by the apps processor to inform the external modem
		that data link is ready.
- qcom,mdm2ap-wakeup-gpio: gpio from the external modem to the apps processor to wake it
		out of a low power state.
- qcom,ap2mdm-vddmin-gpio: gpio to indicate to the external modem when the apps processor
		is about to enter vddmin power state.
- qcom,mdm2ap-vddmin-gpio: gpio used by the external modem to inform the apps processor
		when it is about to enter vddmin power state.
- qcom,ap2mdm-kpdpwr-gpio: gpio used to simulate a power button press on the external
		modem. Some modems use this as part of their initial power-up sequence.
		If the "flags" parameter has a value of 0x1 then it is active LOW.
- qcom,ap2mdm-pmic-pwr-en-gpio: Some modems need this gpio for the apps processor to enable
		the pmic on the external modem.
- qcom,use-usb-port-gpio: some modems use this gpio to switch a port connection from uart to usb.
		This is used during firmware upgrade of some modems.
- qcom,mdm-link-detect-gpio: some modems may support two interfaces. This gpio
		indicates whether only one or both links can be used.

Optional driver parameters:
- qcom,ramdump-delay-ms: time in milliseconds to wait before starting to collect ramdumps.
		This interval is the time to wait after an error on the external modem is
		signaled to the apps processor before starting to collect ramdumps. Its
		value depends on the type of external modem (e.g. MDM vs QSC), and how
		error fatal handing is done on the modem.
		The default value is 2 seconds (2000 milliseconds) as specified by the
		mdm9x15 software developer. Consultation with the developer of the modem
		software is required to determine this value for that modem.
- qcom,ps-hold-delay-ms: minimum delay in milliseconds between consecutive PS_HOLD toggles.
		SGLTE targets that use a QSC1215 modem require a minimum delay between consecutive
		toggling of the PS_HOLD pmic input. For one target it is 500 milliseconds but it
		may vary depending on the target and how the external modem is connected. The value
		is specified by the hardware designers.
- qcom,early-power-on: boolean flag to indicate if to power on the modem when the device is probed.
- qcom,sfr-query: boolean flag to indicate if to query the modem for a reset reason.
- qcom,no-powerdown-after-ramdumps: boolean flag to indicate if to power down the modem after ramdumps.
- qcom,no-a2m-errfatal-on-ssr: boolean to tell driver not to raise ap2mdm errfatal during SSR.
- qcom,no-reset-on-first-powerup: boolean to tell driver not to reset the modem when first
		powering up the modem.
- qcom,ramdump-timeout-ms: ramdump timeout interval in milliseconds.
		This interval is the time to wait for collection of the external modem's ramdump
		to complete. It's value depends on the speed of the data connection between the
		external modem and the apps processor on the platform. If the connection is a
		UART port then this delay needs to be longer in order to avoid premature timeout
		of the ramdump collection.
		The default value is 2 minutes (120000 milliseconds) which is based on the
		measured time it takes over a UART connection. It is reduced when the data
		connection is an HSIC port. The value is usually tuned empirically for a
		particular target.
- qcom,image-upgrade-supported: boolean flag to indicate if software upgrade is supported.
- qcom,support-shutdown: boolean flag to indicate if graceful shutdown is supported.
- qcom,vddmin-drive-strength: drive strength in milliamps of the ap2mdm-vddmin gpio.
		The ap2mdm_vddmin gpio is controlled by the RPM processor. It is pulled low
		to indicate to the external modem that the apps processor has entered vddmin
		state, and high to indicate the reverse. Its parameters are passed to the RPM
		software from the HLOS because the RPM software has to way of saving this type
		of configuration when an external modem is attached.
		The value of the drive strength is specified by the hardware designers. A value
		of 8 milliamps is typical.
		This property is ignored if the property "qcom,ap2mdm-vddmin-gpio" is
		not set.
- qcom,vddmin-modes: a string indicating the "modes" requested for the ap2mdm-vddmin gpio.
		This value is passed to RPM and is used by the RPM module to determine the
		gpio mux function. The only currently supported modes string is "normal" and
		corresponds to the value 0x03 that is passed to RPM.
- qcom,restart-group: List of subsystems that will need to restart together.
- qcom,mdm-dual-link: Boolean indicates whether both links can used for
		communication.
- qcom,ssctl-instance-id: Instance id used by the subsystem to connect with the SSCTL service.
- qcom,sysmon-id: platform device id that sysmon is probed with for the subsystem.
- qcom,pil-force-shutdown: Boolean. If set, the SSR framework will not trigger graceful shutdown
			   on behalf of the subsystem driver.
- qcom,mdm-auto-boot: Boolean. To indicate this instance of esoc boots independently.
- qcom,mdm-statusline-not-a-powersource: Boolean. If set, status line to esoc device is not a
		power source.
- qcom,mdm-userspace-handle-shutdown: Boolean. If set, userspace handles shutdown requests.
- qcom,mdm-link-info: a string indicating additional info about the physical link.
			For example: "devID_domain.bus.slot" in case of PCIe.

Example:
	mdm0: qcom,mdm0 {
                compatible = "qcom,mdm2-modem";
		cell-index = <0>;
		#address-cells = <0>;
                interrupt-parent = <&mdm0>;
                interrupts = <0 1 2 3>;
                #interrupt-cells = <1>;
                interrupt-map-mask = <0xffffffff>;
                interrupt-map =
			<0 &msmgpio 82 0x3
			1 &msmgpio 46 0x3
			2 &msmgpio 80 0x3
			3 &msmgpio 27 0x3>;
                interrupt-names =
			"err_fatal_irq",
			"status_irq",
			"plbrdy_irq",
			"mdm2ap_vddmin_irq";

                qcom,mdm2ap-errfatal-gpio = <&msmgpio 82 0x00>;
		qcom,ap2mdm-errfatal-gpio = <&msmgpio 106 0x00>;
		qcom,mdm2ap-status-gpio   = <&msmgpio 46 0x00>;
		qcom,ap2mdm-status-gpio   = <&msmgpio 105 0x00>;
		qcom,ap2mdm-soft-reset-gpio = <&msmgpio 24 0x00>;
		qcom,mdm2ap-pblrdy-gpio = <&msmgpio 80 0x00>;
		qcom,ap2mdm-wakeup-gpio = <&msmgpio 104 0x00>;
		qcom,ap2mdm-vddmin-gpio = <&msmgpio 108 0x00>;
		qcom,mdm2ap-vddmin-gpio = <&msmgpio 27 0x00>;

                qcom,ramdump-delay-ms = <2000>;
                qcom,ramdump-timeout-ms = <120000>;
                qcom,vddmin-modes  = "normal";
                qcom,vddmin-drive-strength = <8>;
		qcom,ssctl-instance-id = <10>;
		qcom,sysmon-id = <20>;
        };
```

## Documentation/devicetree/bindings/arm/msm/memory-offline.txt
```
Memory offline driver
=====================

The memory offline driver supports the onlining and offlining of DDR memory.
Through the mem-offline node you can configure how much of the DDR will
support being offlined/onlined.
By default all memory is onlined when the device has booted up.

Note that offlinable memory can only support 'movable' memory allocations so
designating too much memory as offlinable can result in system performance and
stability issues.

For more information on how to request the onlining and offlining of memory
see the memory hotplug documentation (Documentation/memory-hotplug.txt).

Required properties:
- compatible: "qcom,mem-offline"
- granule: The minimum granule size in mega-bytes for memory onlining/offlining.
- mem-percent: Percentage of the DDR which will support being onlined/offlined.
	The system will round down the value to align with the minimum offlinable
	granule size supported by DDR.
- mboxes: Reference to the mailbox used by the driver to make requests to
	online/offline memory.

Example:
  mem-offline {
	compatible = "qcom,mem-offline";
	granule = <512>;
	mem-percent = "35";
	mboxes = <&qmp_aop 0>;
  };
```

## Documentation/devicetree/bindings/arm/msm/memory-reserve.txt
```
* Memory reservations for MSM targets

Large contiguous allocations (generally sizes greater than 64KB) must be
allocated from a carved out memory pool. The size of the carved out pools
is based on the sizes drivers need. To properly size the pools, devices
must specify the size and type of the memory needed. Any driver wanting to
allocate contiguous memory should indicate this via device tree bindings:

Required parameters:
- qcom,memory-reservation-type: type of memory to be reserved. This is a
string defined in arch/arm/mach-msm/memory.c
- qcom,memory-reservation-size: size of memory to be reserved

Example:

	qcom,a-driver {
		compatible = "qcom,a-driver";
		qcom,memory-reservation-type = "EBI1" /* reserve EBI memory */
		qcom,memory-reservation-size = <0x400000>; /* size 4MB */
	};

Under some circumstances, it may be necessary to remove a chunk of memory
from the kernel completely using memblock remove. Note this is different
than adjusting the memory tags passed in via the bootloader as the virtual
range is not affected. Any driver needing to remove a block of memory should
add the appropriate binding:

Required parameters:
- qcom,memblock-remove: array of the base and size of blocks to be removed

	qcom,a-driver {
		compatible = "qcom,a-driver";
		/* Remove 4MB at 0x200000 and 2MB at 0x800000*/
		qcom,memblock-remove = <0x200000 0x400000
					0x800000 0x200000>;
	};

In order to ensure memory is only reserved when a driver is actually enabled,
drivers are required to add EXPORT_COMPAT(<name of compatible string>) some
where in the driver. For the examples above, the driver must add
EXPORT_COMPAT("qcom,a-driver") to the driver, similar to EXPORT_SYMBOL.
The EXPORT_COMPAT is to ensure that memory is only carved out if the
driver is actually enabled, otherwise the memory will not be used.

If a reservation is needed that isn't associated directly with any one
driver, the compatible string "qcom,msm-contig-mem" can be used. For
example:

	qcom,msm-contig-mem {
		compatible = "qcom,msm-contig-mem";
		qcom,memory-reservation-type = "EBI1";
		qcom,memory-reservation-size = <0x280000>; /* 2.5M EBI1 buffer */
	};


In order to specify the size and address of the fixed memory which has
previously been removed the memory-fixed binding can be used. This assumes
that the region has been removed by a separate memblock-remove property
present in the device tree.

Required parameters:
-qcom,memory-fixed: base and size of the fixed memory region

	qcom,a-driver {
		compatible = "qcom,a-driver";
		/* Fixed Memory region of 4MB at 0x200000*/
		qcom,memory-fixed = <0x200000 0x400000>;
	};

This region is assumed to be a part of a separate hole that has been removed
and this binding specifies the fixed location and size of the region within
that hole.


Some drivers may only wish to reserve memory from the system. Reserved memory
is still tracked internally by the Linux page allocator. The memory is reserved
from the buddy allocator at bootup but may be freed back at a later point in
time with memblock_free and free_bootmem_late.

Required parameters:
-qcom,memblock-reserve: base and size of block to be reserved. Drivers should
call memblock_is_reserved before attempting to use the base address to ensure
the memory was completely reserved.

	qcom,a-driver {
		compatible = "qcom,a-driver";
		/* reserve a 4MB region @ 0x200000 for use later */
		qcom,memblock-reserve = <0x200000 0x400000>;
	};
```
