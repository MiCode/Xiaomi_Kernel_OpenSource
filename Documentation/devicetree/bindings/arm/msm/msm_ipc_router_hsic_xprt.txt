## Documentation/devicetree/bindings/arm/msm/msm_tsc.txt
```
MSM TSC - Transport Stream Controller

TSC is a HW unit for routing MPEG-2 Transport Stream packets and communicating
with the CAM over Common Interface.
For information on the TSC driver, please refer to the TSC driver
documentation: Documentation/arm/msm/tsc.txt.

The device tree representation of the TSPP2 block should be:

Required properties:

- compatible: "qcom,msm-tsc"
- reg: physical memory base addresses and sizes for the TSC.
- reg-names: name of the memory region: "tsc-base".
- interrupts: represents IRQ numbers for the TSC.
- interrupt-names: TSC interrupt names: "cam-cmd" and "card-detect".
- qcom,iommu-group: phandle for the Broadcast HLOS IOMMU domain.
	The Broadcast HLOS IOMMU domain includes a context bank and virtual address
	pools definitions, used for mapping non-secured pipe memory buffers.
- qcom,iommu-partition: partition number in the HLOS IOMMU domain.
- vdd-supply: phandle of the Broadcast GDSC as defined in msm-gdsc.dtsi.
- Refer to "Documentation/devicetree/bindings/arm/msm/msm_bus.txt" for
	the below optional properties:
	- qcom,msm-bus,name
	- qcom,msm-bus,num-cases
	- qcom,msm-bus,num-paths
	- qcom,msm-bus,vectors-KBps
- qcom,tsc-reset-cam-gpio: gpio for HW reset to the CAM.

Optional properties:

- pinctrl-states: the names of the pinctrl states that used by the driver to
	configure the TLMM pins. The allowed states are subset of the following
	list: disable, ts-in-0, ts-in-1, dual-ts, pc-card, ci-card, ci-plus,
	ts-in-0-pc-card, ts-in-0-ci-card, ts-in-0-ci-plus, ts-in-1-pc-card,
	ts-in-1-ci-card, ts-in-1-ci-plus, dual-ts-pc-card, dual-ts-ci-card,
	dual-ts-ci-plus.
- pinctrl-#: a list of pinctrl phandles for the different pinctrl states. Refer
	to "Documentation/devicetree/bindings/pinctrl/pinctrl-bindings.txt" for the
	pinctrl handles definitions. Each pinctrl-# corresponds to the respective
	state name that appears under pinctrl-state list.

Example for a device without PCMCIA, with TS0-in-b serial and TS1-in-a parallel,
both TSIFs with valid and start:

	tsc: msm_tsc@fc74a000 {
		compatible = "qcom,msm-tsc";
		reg = <0xfc74a000 0x1110>;
		reg-names = "tsc-base";
		interrupts = <0 267 0>, /* cam-cmd */
			<0 268 0>; /* card-detect */
		interrupt-names = "cam-cmd",
				"card-detect";
		qcom,iommu-group = <&bcast_domain_hlos>;
		qcom,iommu-partition = <1>;
		vdd-supply = <&gdsc_bcss>;
		qcom,msm-bus,name = "tsc-bus";
		qcom,msm-bus,num-cases = <2>;
		qcom,msm-bus,num-paths = <1>;
		qcom,msm-bus,vectors-KBps = <96 512 0 0>, /* No vote */
					<96 512 448 896>; /* Max. 7Mbps */
		qcom,tsc-reset-cam-gpio = <&msm_gpio 138 0>;	/* reset-pin controller */
		pinctrl-states = "disable", "ts-in-0", "ts-in-1", "dual-ts";
		pinctrl-0 = <&ts_in_0_b_start_sleep
					&ts_in_0_b_valid_sleep
					&ts_in_0_b_ser_sleep
					&ts_in_1_a_start_sleep
					&ts_in_1_a_valid_sleep
					&ts_in_1_a_ser_sleep
					&ts_in_1_a_par_sleep>;	/* disable */
		pinctrl-1 = <&ts_in_0_b_start_active
					&ts_in_0_b_valid_active
					&ts_in_0_b_ser_active
					&ts_in_1_a_start_sleep
					&ts_in_1_a_valid_sleep
					&ts_in_1_a_ser_sleep
					&ts_in_1_a_par_sleep>; /* ts-in-0 */
		pinctrl-2 = <&ts_in_0_b_start_sleep
					&ts_in_0_b_valid_sleep
					&ts_in_0_b_ser_sleep
					&ts_in_1_a_start_active
					&ts_in_1_a_valid_active
					&ts_in_1_a_ser_active
					&ts_in_1_a_par_active>;	/* ts-in-1 */
		pinctrl-3 = <&ts_in_0_b_start_active
					&ts_in_0_b_valid_active
					&ts_in_0_b_ser_active
					&ts_in_1_a_start_active
					&ts_in_1_a_valid_active
					&ts_in_1_a_ser_active
					&ts_in_1_a_par_active>;	/* dual-ts */
	};

Example for a device with pcmcia, TS0-in-a serial with start and error, and
without TS1-in:

		tsc: msm_tsc@fc74a000 {
		compatible = "qcom,msm-tsc";
		reg = <0xfc74a000 0x1110>;
		reg-names = "tsc-base";
		interrupts = <0 267 0>, /* cam-cmd */
			<0 268 0>; /* card-detect */
		interrupt-names = "cam-cmd",
				"card-detect";
		qcom,iommu-group = <&bcast_domain_hlos>;
		qcom,iommu-partition = <1>;
		vdd-supply = <&gdsc_bcss>;
		qcom,msm-bus,name = "tsc-bus";
		qcom,msm-bus,num-cases = <2>;
		qcom,msm-bus,num-paths = <1>;
		qcom,msm-bus,vectors-KBps = <96 512 0 0>, /* No vote */
					<96 512 448 896>; /* Max. 7Mbps */
		qcom,tsc-reset-cam-gpio = <&msm_gpio 138 0>;	/* reset-pin controller */
		pinctrl-states = "disable", "ts-in-0", "pc-card", "ci-card", "ci-plus",
					"ts-in-0-pc-card", "ts-in-0-ci-card", "ts-in-0-ci-plus";
		pinctrl-0 = <&ts_in_0_a_start_sleep
					&ts_in_0_a_err_sleep
					&ts_in_0_a_ser_sleep
					&tsc_cd_pins_active
					&tsc_pcmcia_8ma_down_pc_card_sleep
					&tsc_pcmcia_8ma_up_pc_card_sleep
					&tsc_cam_reset_pc_card_sleep
					&tsc_pcmcia_8ma_none_pc_card_sleep
					&tsc_pcmcia_ireq_pc_card_sleep
					&tsc_pcmcia_2_pc_card_sleep
					&tsc_pcmcia_1_down_ci_sleep
					&tsc_pcmcia_1_up_ci_sleep
					&tsc_pcmcia_1_none_ci_sleep
					&tsc_pcmcia_4_ci_sleep>;		/* disable */
		pinctrl-1 = <&ts_in_0_a_start_active
					&ts_in_0_a_err_active
					&ts_in_0_a_ser_active
					&tsc_cd_pins_active
					&tsc_pcmcia_8ma_down_pc_card_sleep
					&tsc_pcmcia_8ma_up_pc_card_sleep
					&tsc_cam_reset_pc_card_sleep
					&tsc_pcmcia_8ma_none_pc_card_sleep
					&tsc_pcmcia_ireq_pc_card_sleep
					&tsc_pcmcia_2_pc_card_sleep
					&tsc_pcmcia_1_down_ci_sleep
					&tsc_pcmcia_1_up_ci_sleep
					&tsc_pcmcia_1_none_ci_sleep
					&tsc_pcmcia_4_ci_sleep>; 		/* ts-in-0 */
		pinctrl-2 = <&ts_in_0_a_start_sleep
					&ts_in_0_a_err_sleep
					&ts_in_0_a_ser_sleep
					&tsc_cd_pins_active
					&tsc_pcmcia_8ma_down_pc_card_active
					&tsc_pcmcia_8ma_up_pc_card_active
					&tsc_cam_reset_pc_card_active
					&tsc_pcmcia_8ma_none_pc_card_active
					&tsc_pcmcia_ireq_pc_card_active
					&tsc_pcmcia_2_pc_card_active
					&tsc_pcmcia_1_down_ci_sleep
					&tsc_pcmcia_1_up_ci_sleep
					&tsc_pcmcia_1_none_ci_sleep
					&tsc_pcmcia_4_ci_sleep>;		/* pc-card */
		pinctrl-3 = <&ts_in_0_a_start_sleep
					&ts_in_0_a_err_sleep
					&ts_in_0_a_ser_sleep
					&tsc_cd_pins_active
					&tsc_pcmcia_8ma_down_pc_card_active
					&tsc_pcmcia_8ma_up_pc_card_active
					&tsc_cam_reset_pc_card_active
					&tsc_pcmcia_8ma_none_pc_card_active
					&tsc_pcmcia_ireq_pc_card_sleep
					&tsc_pcmcia_2_pc_card_active
					&tsc_pcmcia_1_down_ci_active
					&tsc_pcmcia_1_up_ci_active
					&tsc_pcmcia_1_none_ci_active
					&tsc_pcmcia_4_ci_active?;		/* ci-card */
		pinctrl-4 = <&ts_in_0_a_start_sleep
					&ts_in_0_a_err_sleep
					&ts_in_0_a_ser_sleep
					&tsc_cd_pins_active
					&tsc_pcmcia_8ma_down_pc_card_active
					&tsc_pcmcia_8ma_up_pc_card_active
					&tsc_cam_reset_pc_card_active
					&tsc_pcmcia_8ma_none_pc_card_active
					&tsc_pcmcia_ireq_pc_card_active
					&tsc_pcmcia_2_pc_card_active
					&tsc_pcmcia_1_down_ci_active
					&tsc_pcmcia_1_up_ci_active
					&tsc_pcmcia_1_none_ci_active
					&tsc_pcmcia_4_ci_active?;		/* ci-plus */
		pinctrl-5 = <&ts_in_0_a_start_active
					&ts_in_0_a_err_active
					&ts_in_0_a_ser_active
					&tsc_cd_pins_active
					&tsc_pcmcia_8ma_down_pc_card_active
					&tsc_pcmcia_8ma_up_pc_card_active
					&tsc_cam_reset_pc_card_active
					&tsc_pcmcia_8ma_none_pc_card_active
					&tsc_pcmcia_ireq_pc_card_active
					&tsc_pcmcia_2_pc_card_active
					&tsc_pcmcia_1_down_ci_sleep
					&tsc_pcmcia_1_up_ci_sleep
					&tsc_pcmcia_1_none_ci_sleep
					&tsc_pcmcia_4_ci_sleep>;		/* ts-in-0-pc-card */
		pinctrl-6 = <&ts_in_0_a_start_active
					&ts_in_0_a_err_active
					&ts_in_0_a_ser_active
					&tsc_cd_pins_active
					&tsc_pcmcia_8ma_down_pc_card_active
					&tsc_pcmcia_8ma_up_pc_card_active
					&tsc_cam_reset_pc_card_active
					&tsc_pcmcia_8ma_none_pc_card_active
					&tsc_pcmcia_ireq_pc_card_sleep
					&tsc_pcmcia_2_pc_card_active
					&tsc_pcmcia_1_down_ci_active
					&tsc_pcmcia_1_up_ci_active
					&tsc_pcmcia_1_none_ci_active
					&tsc_pcmcia_4_ci_active?;		/* ts-in-0-ci-card */
		pinctrl-7 = <&ts_in_0_a_start_active
					&ts_in_0_a_err_active
					&ts_in_0_a_ser_active
					&tsc_cd_pins_active
					&tsc_pcmcia_8ma_down_pc_card_active
					&tsc_pcmcia_8ma_up_pc_card_active
					&tsc_cam_reset_pc_card_active
					&tsc_pcmcia_8ma_none_pc_card_active
					&tsc_pcmcia_ireq_pc_card_active
					&tsc_pcmcia_2_pc_card_active
					&tsc_pcmcia_1_down_ci_active
					&tsc_pcmcia_1_up_ci_active
					&tsc_pcmcia_1_none_ci_active
					&tsc_pcmcia_4_ci_active?;		/* ts-in-0-ci-plus */
	};
```

## Documentation/devicetree/bindings/arm/msm/msm_tspp.txt
```
TSPP Driver

For information on the TSPP driver, please refer to the TSPP driver
documentation: Documentation/arm/msm/tspp.txt.

The devicetree representation of the TSPP block should be:

Required properties:

- compatible: "qcom,msm_tspp"
- reg: physical memory base addresses and sizes for the following:
	TSIF0, TSIF1, TSPP and TSPP_BAM.
- reg-names: names of the memory regions.
- interrupts: represents IRQ numbers for the following:
	TSIF_TSPP_IRQ, TSIF0_IRQ, TSIF1_IRQ, TSIF_BAM_IRQ.
- interrupt-names: TSPP, TSIF and BAM interrupt names.
- pinctrl-names: the names of the pinctrl states that are used by the driver to
	configure the TLMM pins. The allowed states are:
	disabled - both tsif inputs are not used
	tsif0-mode1 - only tsif0 is active in mode 1 (no sync signal)
	tsif0-mode2 - only tsif0 is used in mode 2 (with sync signal)
	tsif1-mode1 - only tsif1 is active in mode 1 (no sync signal)
	tsif1-mode2 - only tsif1 is used in mode 2 (with sync signal)
	dual-tsif-mode1 - both tsif0 and tsif1 are active, in mode 1
	dual-tsif-mode1 - both tsif0 and tsif1 are active, in mode 2
- pinctrl-#: a list of pinctrl phandles for the different pinctrl states. Refer
	to "Documentation/devicetree/bindings/pinctrl/pinctrl-bindings.txt" for
	the pinctrl handles definitions. Each pinctrl-# corresponds to the
	respective state name that appears under pinctrl-state list.
	Note that when switching from one state to another, any pins in
	the old state which do not appear in the new state are automatically
	disabled by the pinctrl framework.

Optional properties:

- vdd_cx-supply: Reference to the regulator that supplies the CX rail.
	Some hardware platforms (e.g. 8974-v2) require the voltage of the rail
	supplying power to the TSIF hardware block to be elevated before
	enabling the TSIF clocks.
- Refer to "Documentation/devicetree/bindings/arm/msm/msm_bus.txt" for
	the below optional properties:
	- qcom,msm-bus,name
	- qcom,msm-bus,num-cases
	- qcom,msm-bus,num-paths
	- qcom,msm-bus,vectors-KBps

Example (for 8974 platform, avaialble at msm8974.dtsi):

	tspp: msm_tspp@f99d8000 {
		compatible = "qcom,msm_tspp";
		reg = <0xf99d8000 0x1000>, /* MSM_TSIF0_PHYS */
		      <0xf99d9000 0x1000>, /* MSM_TSIF1_PHYS */
		      <0xf99da000 0x1000>, /* MSM_TSPP_PHYS  */
		      <0xf99c4000 0x14000>; /* MSM_TSPP_BAM_PHYS */
		reg-names = "MSM_TSIF0_PHYS",
			"MSM_TSIF1_PHYS",
			"MSM_TSPP_PHYS",
			"MSM_TSPP_BAM_PHYS";
		interrupts = <0 153 0>, /* TSIF_TSPP_IRQ */
			<0 151 0>, /* TSIF0_IRQ */
			<0 152 0>, /* TSIF1_IRQ */
			<0 154 0>; /* TSIF_BAM_IRQ */
		interrupt-names = "TSIF_TSPP_IRQ",
			"TSIF0_IRQ",
			"TSIF1_IRQ",
			"TSIF_BAM_IRQ";

		pinctrl-names = "disabled",
			"tsif0-mode1", "tsif0-mode2",
			"tsif1-mode1", "tsif1-mode2",
			"dual-tsif-mode1", "dual-tsif-mode2";

		pinctrl-0 = <>;				/* disabled */
		pinctrl-1 = <&tsif0_signals_active>;	/* tsif0-mode1 */
		pinctrl-2 = <&tsif0_signals_active
			&tsif0_sync_active>;		/* tsif0-mode2 */
		pinctrl-3 = <&tsif1_signals_active>;	/* tsif1-mode1 */
		pinctrl-4 = <&tsif1_signals_active
			&tsif1_sync_active>;		/* tsif1-mode2 */
		pinctrl-5 = <&tsif0_signals_active
			&tsif1_signals_active>;		/* dual-tsif-mode1 */
		pinctrl-6 = <&tsif0_signals_active
			&tsif0_sync_active
			&tsif1_signals_active
			&tsif1_sync_active>;		/* dual-tsif-mode2 */

		qcom,msm-bus,name = "tsif";
		qcom,msm-bus,num-cases = <2>;
		qcom,msm-bus,num-paths = <1>;
		qcom,msm-bus,vectors-KBps =
				<82 512 0 0>, /* No vote */
				<82 512 12288 24576>; /* Max. bandwidth, 2xTSIF, each max of 96Mbps */
	};
```

## Documentation/devicetree/bindings/arm/msm/msm_tspp2.txt
```
TSPP2 - Transport Stream Packet Processor v2

TSPP2 is a HW accelerator for processing MPEG-2 Transport Stream packets.
For information on the TSPP2 driver, please refer to the TSPP2 driver
documentation: Documentation/arm/msm/tspp2.txt.

The devicetree representation of the TSPP2 block should be:

Required properties:

- compatible: "qcom,msm_tspp2"
- cell-index: represents device ID.
- reg: physical memory base addresses and sizes for the following:
	TSPP2, TSIF0, TSIF1, TSPP2_BAM.
- reg-names: names of the memory regions:
	MSM_TSPP2, MSM_TSIF0, MSM_TSIF1, MSM_TSPP2_BAM.
- interrupts: represents IRQ numbers for the following:
	TSIF_TSPP2, TSIF0, TSIF1, TSIF_BAM.
- interrupt-names: TSPP2, TSIF and BAM interrupt names.
- vdd-supply: power regulator (GDSC) supplying power to the broadcast subsystem.
Refer to "Documentation/devicetree/bindings/arm/msm/msm_bus.txt"
for more information on the following four properties:
- qcom,msm-bus,name: String representing the client name ("tspp2").
- qcom,msm-bus,num-cases: 3 cases - no bandwidth, minimal bandwidth for register
	access, and maximum bandwidth required for full operation.
- qcom,msm-bus,num-paths
- qcom,msm-bus,vectors-KBps: represents the bandwidths required for the above
	usecases.
- qcom,iommu-hlos-group: Name of the Broadcast HLOS IOMMU domain as defined in
	<target>-iommu-domains.dtsi.
	The Broadcast HLOS IOMMU domain includes a context bank and virtual
	address pools definitions, used for mapping non-secured pipe memory
	buffers.
- qcom,iommu-hlos-partition: Partition number in the HLOS IOMMU domain.
- qcom,iommu-cpz-group: Name of the Broadcast CPZ IOMMU domain as defined in
	<target>-iommu-domains.dtsi.
	The Broadcast CPZ IOMMU domain includes a context bank and virtual
	address pool definitions, used for mapping secured pipe memory buffers.
- qcom,iommu-cpz-partition: Partition number in the CPZ IOMMU domain.

Example:

	tspp2: msm_tspp2@fc724000 {
		compatible = "qcom,msm_tspp2";
		cell-index = <0>;
		reg = <0xfc724000 0x7000>, /* MSM_TSPP2  */
		      <0xfc72b000 0x0200>, /* MSM_TSIF0 */
		      <0xfc72b200 0x0200>, /* MSM_TSIF1 */
		      <0xfc704000 0x20000>; /* MSM_TSPP2_BAM */
		reg-names = "MSM_TSPP2",
			"MSM_TSIF0",
			"MSM_TSIF1",
			"MSM_TSPP2_BAM";
		interrupts = <0 297 0>, /* TSPP2 */
			<0 295 0>, /* TSIF0 */
			<0 296 0>, /* TSIF1 */
			<0 294 0>; /* TSIF_BAM */
		interrupt-names = "TSPP2",
			"TSIF0",
			"TSIF1",
			"TSPP2_BAM";
		vdd-supply = <&gdsc_bcss>;
		qcom,msm-bus,name = "tspp2";
		qcom,msm-bus,num-cases = <3>;
		qcom,msm-bus,num-paths = <1>;
		qcom,msm-bus,vectors-KBps =
				<96 512 0 0>, /* No vote */
				<96 512 1024 1024>, /* Register access only. 8Mbps should be more than enough */
				<96 512 24576 61440>; /* Max. bandwidth required is 480Mbps */
		qcom,iommu-hlos-group = "bcast_hlos";
		qcom,iommu-hlos-partition = <0>;
		qcom,iommu-cpz-group = "bcast_cpz";
		qcom,iommu-cpz-partition = <0>;
	};
```
