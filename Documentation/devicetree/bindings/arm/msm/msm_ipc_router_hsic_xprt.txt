## Documentation/devicetree/bindings/arm/msm/msm_watchdog.txt
```
* Qualcomm MSM Watchdog

Watchdog timer is configured with a bark and a bite time.
if the watchdog is not "pet" at regular intervals, the system
is assumed to have become non responsive and needs to be reset.
A warning in the form of a bark timeout leads to a bark interrupt
and a kernel panic. if the watchdog timer is still not reset,
a bite timeout occurs, which is an interrupt in the secure mode,
which leads to a reset of the SOC via the secure watchdog. The
driver needs the petting time, and the bark timeout to be programmed
into the watchdog, as well as the bark and bite irqs.

The device tree parameters for the watchdog are:

Required properties:

- compatible : "qcom,msm-watchdog"
- reg : offset and length of the register set for the watchdog block.
- reg-names : names corresponding to each reg property value.
	"wdt-base" - physical base address of watchdog timer registers
	"wdt-absent-base" - physical base address of watchdog absent register
- interrupts : should contain bark and bite irq numbers
- qcom,pet-time : Non zero time interval at which watchdog should be pet in ms.
- qcom,bark-time : Non zero timeout value for a watchdog bark in ms.
- qcom,userspace-watchdog :
	(boolean) Allow enabling the userspace-watchdog feature. This feature
	requires userspace to pet the watchdog every qcom,pet-time interval
	in addition to the existing kernel-level checks.
	This feature is supported through device sysfs files.


Optional properties:

- qcom,ipi-ping : (boolean) send keep alive ping to other cpus if present
- qcom,wakeup-enable : (boolean) enable non secure watchdog to freeze / unfreeze
			automatically across suspend / resume path.
- qcom,scandump-size : size of scan dump memory region

Example:

	qcom,wdt@f9017000 {
		compatible = "qcom,msm-watchdog";
		reg = <0xf9017000 0x1000>;
		reg-names = "wdt-base";
		interrupts = <0 3 0>, <0 4 0>;
		qcom,bark-time = <11000>;
		qcom,pet-time = <10000>;
		qcom,ipi-ping;
		qcom,wakeup-enable;
	};
```

## Documentation/devicetree/bindings/arm/msm/npa-dump.txt
```
* NPA Dump

RPM maintains the shared resources using the Node Power Architecture (NPA)
framework. The framework aggregates requests from different clients for a
resource and determines the final value. The NPA framework also provides an
option to log a snapshot of the resource active values and the client
requests. RPM provides a command to initiate and log this snapshot in the
shared ram

The required properties for npa-dump are:

- compatible: "qcom,npa-dump".
- reg: The address on RPM RAM from where the start address of log to be read.
       The second tuple would be the start of the RPM address and the size of
       the log.

Example:

	qcom,npa-dump@0xfc190020 {
		compatible = "qcom,npa-dump";
		reg = <0xfc190020 0x4>, <0xfc000000 0x1c00>;
	};
```

## Documentation/devicetree/bindings/arm/msm/perfmap.txt
```
* MSM Perfmap interface for performance monitors

Perfmap provides mapping of the base address for performance monitors and
allows user-space to access it via mmap call. It create a character device
driver which is accessed from user-space.

The required nodes for Perfmap are:

- compatible: "qcom,perfmap"
- reg: base address and size of mapped area

Example:
	qcom,perfmap@0xfc330000 {
		compatible = "qcom,perfmap";
		reg = <0xfc330000 0x3000>;
	};
```

## Documentation/devicetree/bindings/arm/msm/pm-8x60.txt
```
* MSM PM-8x60

PM-8x60 is the low power management device for MSM (Snapdragon class) chipsets.
This device sets up different components to do low power modes and registers with
the kernel to be notified of idle and suspend states and when called, follows
through the set of instructions in putting the application cores to the lowest
power mode possible.
The PC debug counter reserves 16 registers in the IMEM memory space which maintains
a count on the state of power collapse on each core. This count will be useful to
debug the power collapse state on each core.

The required properties for PM-8x60 are:

- compatible: "qcom,pm-8x60"
- qcom,lpm-levels: phandle for associated lpm_levels device.

The optional properties are:

- reg: physical IMEM address reserved for PC counters and the size
- qcom,use-sync-timer: Indicates whether the target uses the synchronized QTimer.
- qcom,pc-mode: Indicates the type of power collapse used by the target. The
           valid values for this are:
	"tz_l2_int"  (Power collapse terminates in TZ; integrated L2 cache controller)
	"no_tz_l2_ext", (Power collapse doesn't terminate in TZ; external L2 cache controller)
	"tz_l2_ext"  (Power collapse terminates in TZ; external L2 cache controller)
- qcom,saw-turns-off-pll: Version of SAW2.1 or can turn off the HFPLL, when
	doing power collapse and so the core need to switch to Global PLL before
	PC.
- qcom,synced-clocks: Indicates that all cpus running off a single clock source and to
	instantiate the necessary clock source.
- qcom,cpus-as-clocks: Indicates that the CPU clocks are implemented using clock APIs and should
	switch to using generic clock APIs to enable/disable power collapse.
	If set, the pm driver would ignore clock API errors and continue to call acpuclock API directly.
- qcom,pc-resets-timer: Indicates that the timer gets reset during power collapse.

Example:

qcom,pm-8x60@fe800664 {
		compatible = "qcom,pm-8x60";
		reg = <0xfe800664 0x40>;
		qcom,pc-mode = "tz_l2_int";
		qcom,use-sync-timer;
		qcom,lpm-levels = <&lpm_levels>;
	};
```

## Documentation/devicetree/bindings/arm/msm/pm-boot.txt
```
* Power Management boot configuration (pm-boot)

Low power management drivers need to specify the warmboot entry path for the
application processors to resume from sleep/suspend. The boot configuration
can vary if the core does/does not support a secure boot mode. The secure
boot configuration boots the core sets up the core sub system registers and
calls into the kernel entry point. In the absence of a secure boot mode, the
core when powered on from reset will need to be configured with the warmboot
entry pointer. The physical and the virtual address for the entry pointer
need to provided to the driver.


The device tree parameters for pm-boot are:

Required parameters:

- compatible: Must be "qcom,pm-boot"
- qcom,mode: The mode that the target will use for booting
	"tz" = MSM_PM_BOOT_CONFIG_TZ,
	"reset_vector_phys" = MSM_PM_BOOT_CONFIG_RESET_VECTOR_PHYS,
	"reset_vector_virt" = MSM_PM_BOOT_CONFIG_RESET_VECTOR_VIRT,
	"remap_boot_addr" = MSM_PM_BOOT_CONFIG_REMAP_BOOT_ADDR,

Optional parameters (based on the mode chosen):

- qcom,phy-addr: The physical address that will be used for warmboot entry if
	the processor remap register can be programmed.
	Needed for modes = { MSM_PM_BOOT_CONFIG_RESET_VECTOR_PHYS,
				MSM_PM_BOOT_CONFIG_REMAP_BOOT_ADDR }
- qcom,virt-addr: The virtual address at which the processor start booting from
	Needed for modes = { MSM_PM_BOOT_CONFIG_RESET_VECTOR_VIRT,
				MSM_PM_BOOT_CONFIG_REMAP_BOOT_ADDR }


Example:

	qcom,pm-boot {
		compatible = "qcom,pm-boot";
		qcom,mode = "tz"; /* MSM_PM_BOOT_CONFIG_TZ */
	};
```

## Documentation/devicetree/bindings/arm/msm/pm.txt
```
* MSM PM

PM is the low power management device for MSM (Snapdragon class) chipsets.
This device sets up different components to do low power modes and registers with
the kernel to be notified of idle and suspend states and when called, follows
through the set of instructions in putting the application cores to the lowest
power mode possible.
The PC debug counter reserves 16 registers in the IMEM memory space which maintains
a count on the state of power collapse on each core. This count will be useful to
debug the power collapse state on each core.

The required properties for PM are:

- compatible: "qcom,pm"

The optional properties are:

- reg: physical IMEM address reserved for PC counters and the size
- qcom,use-sync-timer: Indicates whether the target uses the synchronized QTimer.
- qcom,synced-clocks: Indicates that all cpus running off a single clock source and to
	instantiate the necessary clock source.
- qcom,pc-resets-timer: Indicates that the timer gets reset during power collapse.
- qcom,tz-flushes-cache: Indicates that TZ flushes all of the cache during
power collapse. MSM PM can decide to not perform cache flush operations to
reduce latency associated with L2 PC.
- qcom,saw-turns-off-pll: Indicates that the CPU's PLL can be managed from SAW
	hardware. On such targets software mangement of PLL is not required. If
	this property is specified then qcom,synced-clocks would be ignored.

Example 1:

qcom,pm@fe800664 {
		compatible = "qcom,pm";
		reg = <0xfe800664 0x40>;
		qcom,use-sync-timer;
	};

Example 2:

qcom,pm@fe800664 {
		compatible = "qcom,pm";
		reg = <0xfe800664 0x40>;
		qcom,saw-turns-off-pll;
	};
```
