## Documentation/devicetree/bindings/arm/msm/msm_rfic.txt
```
QTI Radio Frequency IC (RFIC)

This is a kernel platform driver which enables the RF interfaces supported by
QTI. This driver uses SSBI driver to access the low level registers. This has
support for Pulse Density Modulation(PDM) and General purpose RF Control(GRFC)s.
It is also possible to access GRFC without going through SSBI. There are 2
sections listed below, one using ssbi parent driver and the other direct access.

1. Driver access to get/set GRFC registers using ssbi driver.

Required properties:
-compatible: parent should be "qcom,ssbi"
-reg: physical base address and length of the register set
-reg-names: RFIC device is a child node of ssbi and uses the base address of
the parent driver. RFIC uses a large set of registers, hence base address is
defined here.
-qcom,controller-type: controller type could be "geni-ssbi-arbiter" or
"geni-ssbi2-arbiter"
-compatible: child should be "qcom,rfic-fsm9900" or "qcom,rfic-fsm9010"

Example for rfic driver using SSBI as a parent:
	ssbi1:  qcom,ssbi@f9b18000 {
		compatible = "qcom,ssbi";
		reg = <0xf9b18000 0x4000>;
		reg-names = "ssbi1_base";
		qcom,controller-type = "geni-ssbi-arbiter";

		rfic@1 {
			compatible = "qcom,rfic-fsm9900", "qcom,rfic-fsm9010";
		};
	};

2. Driver access to set/get GRFC registers without going thru SSBI. The following
driver entry is independent and does not use ssbi driver.

Required properties:
-compatible: should be "qcom,rfic-fsm9900" or "qcom,rfic-fsm9010"
-reg: specifies the base address of the GRFC registers.

Optional properties:
vdd-switch-supply: regulator used to control RF switches.
vdd-wtr-supply: regulator used to control WTR.
vdd-ftr1-supply: regulator used to control FTR1.
vdd-ftr2-supply: regulator used to control FTR2.
vdd-1v8-supply: regulator used to control 1.8V to all RFICs.
vdd-1v3-supply: regulator used to control 1.3V to all RFICs

- pinctrl-states: the names of the pinctrl states that used by the driver to
	configure the TLMM pins.
	rf_ssbi - Sets TLMM properties to SSBI lines.
	grfc_f2 - Sets TLMM properties to GRFC lines using alt-func 2.
	grfc_f3 - Sets TLMM properties to GRFC lines using alt-func 3.
	grfc_f4 - Sets TLMM properties to GRFC lines using alt-func 4.
	grfc_f5 - Sets TLMM properties to GRFC lines using alt-func 5.
	grfc_f6 - Sets TLMM properties to GRFC lines using alt-func 6.
	grfc_f7 - Sets TLMM properties to GRFC lines using alt-func 7.
	pdm_f2 - Sets TLMM properties to PDM lines.

- pinctrl-#: a list of pinctrl phandles for the different pinctrl states. Refer
	to "Documentation/devicetree/bindings/pinctrl/pinctrl-bindings.txt" for the
	pinctrl handles definitions. Each pinctrl-# corresponds to the respective
	state name that appears under pinctrl-state list.

- clocks: clock identifers used by clock driver while looking up pdm clocks.
- clock-names: name of the clock used by rfic driver.

rfic driver uses 3 resources as mentioned below in reg entry and resources
are exttracted using array number by platform_get_resource().

Example 1:
	qcom,rfic@fd4a4090 {
		compatible = "qcom,rfic-fsm9900";
		reg = <0xfd4a4090 0x40>,
			<0x3a000000 0xa00000>,
			<0xf9b10000 0x8000>;

		reg = <0xfd4a4090 0x40>;
		vdd-switch-supply = <&pma8084_l18>;
		vdd-wtr-supply = <&pma8084_l19>;
		vdd-ftr1-supply = <&pma8084_l23>;
		vdd-ftr2-supply = <&pma8084_l25>;
		vdd-1v8-supply = <&pma8084_l26>;
		vdd-1v3-supply = <&pma8084_l11>;
	};

	qcom,pdm@f9b10000 {
		compatible = "qcom,rfic-fsm9900";
		reg = <0xf9b10000 0x8000>;
	};

Example 2:
	qcom,rfic@fd4a4090 {
		compatible = "qcom,rfic-fsm9010";
		reg = <0xfd4a4090 0x40>,
			<0x29000000 0xa00000>,
			<0xf9b10000 0x8000>,
			<0xfd510000 0x4000>;
		clocks = <&clock_gcc clk_gcc_pdm2_clk>,
			<&clock_gcc clk_gcc_pdm2_ahb_clk>;
		clock-names = "pdm2_clk", "ahb_clk";
		pinctrl-names = "default";
		pinctrl-0 = <&rf_ssbi_default>
	};

	qcom,pdm@f9b10000 {
		compatible = "qcom,rfic-fsm9010";
		reg = <0xf9b10000 0x8000>;
	};
```

## Documentation/devicetree/bindings/arm/msm/msm_rtb.txt
```
Register Trace Buffer (RTB)

The RTB is used to log discrete events in the system in an uncached buffer that
can be post processed from RAM dumps. The RTB must reserve memory using
the msm specific memory reservation bindings (see
Documentation/devicetree/bindings/arm/msm/memory-reserve.txt).

Required properties

- compatible: "qcom,msm-rtb"
- qcom,rtb-size: size of the RTB buffer in bytes

Optional properties:

- linux,contiguous-region: phandle reference to a CMA region

Example:

	qcom,msm-rtb {
		compatible = "qcom,msm-rtb";
		qcom,rtb-size = <0x100000>;
	};
```

## Documentation/devicetree/bindings/arm/msm/msm_test_pacman.txt
```
* msm-test-pacman - The MSM Peripheral Access Control Manager test

Required Properties:

 - compatible:	"qcom,msm-test-pacman"

Aliases:

  An alias is required to properly map the test driver to a Qualcomm
  Universal Peripheral (QUP) ID. The alias is of the form 'qup<n>', where
  <n> is an integer specifying the QUP ID.

Example:

	aliases {
		qup10 = &test_pacman;
	};

	test_pacman: test@f9966000 {
		compatible = "qcom,msm-test-pacman";
	};
```
