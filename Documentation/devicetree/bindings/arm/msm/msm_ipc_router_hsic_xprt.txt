## Documentation/devicetree/bindings/arm/msm/msm_ipc_router_hsic_xprt.txt
```
Qualcomm Technologies, Inc. IPC Router HSIC Transport

Required properties:
-compatible:		should be "qcom,ipc_router_hsic_xprt"
-qcom,ch-name:		the HSIC channel name used by the HSIC transport
-qcom,xprt-remote:	string that defines the edge of the transport (PIL Name)
-qcom,xprt-linkid:	unique integer to identify the tier to which the link
			belongs to in the network and is used to avoid the
			routing loops while forwarding the broadcast messages
-qcom,xprt-version:	unique version ID used by HSIC transport header

Example:
	qcom,ipc_router_external_modem_xprt {
		compatible = "qcom,ipc_router_hsic_xprt";
	        qcom,ch-name = "ipc_bridge";
		qcom,xprt-remote = "external-modem";
		qcom,xprt-linkid = <1>;
		qcom,xprt-version = <3>;
	};
```

## Documentation/devicetree/bindings/arm/msm/msm_ipc_router_mhi_dev_xprt.txt
```
Qualcomm Technologies, Inc. IPC Router MHI_DEV Transport

Required properties:
-compatible:		should be "qcom,ipc-router-mhi-dev-xprt".
-qcom,out-chan-id:	MHI Channel ID for the transmit path.
-qcom,in-chan-id:	MHI Channel ID for the receive path.
-qcom,xprt-remote:	string that defines the edge of the transport.
-qcom,xprt-linkid:	unique integer to identify the tier to which the link
			belongs to in the network and is used to avoid the
			routing loops while forwarding the broadcast messages.
-qcom,xprt-version:	unique version ID used by MHI transport header.

Example:
	qcom,ipc_router_external_ap_xprt {
		compatible = "qcom,ipc-router-mhi-dev-xprt";
	        qcom,out-chan-id = <34>;
		qcom,in-chan-id = <35>;
		qcom,xprt-remote = "external-ap";
		qcom,xprt-linkid = <2>;
		qcom,xprt-version = <1>;
	};
```

## Documentation/devicetree/bindings/arm/msm/msm_ipc_router_sdio_xprt.txt
```
IPC Router SDIO Transport

Required properties:
-compatible:		should be "qcom,ipc_router_sdio_xprt"
-qcom,ch-name:		the SDIO channel name used by the SDIO transport
-qcom,xprt-remote:	string that defines the edge of the transport (PIL Name)
-qcom,xprt-linkid:	unique integer to identify the tier to which the link
			belongs to in the network and is used to avoid the
			routing loops while forwarding the broadcast messages
-qcom,xprt-version:	unique version ID used by SDIO transport header

Example:
	qcom,ipc_router_external_modem_xprt {
		compatible = "qcom,ipc_router_sdio_xprt";
	        qcom,ch-name = "ipc_bridge_sdio";
		qcom,xprt-remote = "external-modem";
		qcom,xprt-linkid = <1>;
		qcom,xprt-version = <3>;
	};
```

## Documentation/devicetree/bindings/arm/msm/msm_ipc_router_smd_xprt.txt
```
Qualcomm IPC Router SMD Transport

Required properties:
-compatible:		should be "qcom,ipc_router_smd_xprt"
-qcom,ch-name:		the SMD channel name used by the SMD transport
-qcom,xprt-remote:	string that defines the edge of the transport (PIL Name)
-qcom,xprt-linkid:	unique integer to identify the tier to which the link
			belongs to in the network and is used to avoid the
			routing loops while forwarding the broadcast messages
-qcom,xprt-version:	unique version ID used by SMD transport header

Optional properties:
-qcom,fragmented-data:	Indicate the SMD transport supports fragmented data
-qcom,disable-pil-loading: Disable PIL Loading of the remote subsystem

Example:
	qcom,ipc_router_modem_xprt {
		compatible = "qcom,ipc_router_smd_xprt";
		qcom,ch-name = "IPCRTR";
		qcom,xprt-remote = "modem";
		qcom,xprt-linkid = <1>;
		qcom,xprt-version = <1>;
		qcom,fragmented-data;
		qcom,disable-pil-loading;
	};

	qcom,ipc_router_q6_xprt {
		compatible = "qcom,ipc_router_smd_xprt";
		qcom,ch-name = "IPCRTR";
		qcom,xprt-remote = "adsp";
		qcom,xprt-linkid = <1>;
		qcom,xprt-version = <1>;
		qcom,fragmented-data;
	};
```

## Documentation/devicetree/bindings/arm/msm/msm_ipc_router_usb_xprt.txt
```
Qualcomm Technologies, Inc. IPC Router USB Transport

Required properties:
-compatible:		should be "qcom,ipc_router_usb_xprt"
-qcom,ch-name:		the USB channel name used by the USB transport
-qcom,xprt-remote:	string that defines the edge of the transport (PIL Name)
-qcom,xprt-linkid:	unique integer to identify the tier to which the link
			belongs to in the network and is used to avoid the
			routing loops while forwarding the broadcast messages
-qcom,xprt-version:	unique version ID used by USB transport header

Example:
	qcom,ipc_router_external_modem_xprt {
		compatible = "qcom,ipc-router-usb-xprt";
	        qcom,ch-name = "ipc_bridge";
		qcom,xprt-remote = "external-modem";
		qcom,xprt-linkid = <1>;
		qcom,xprt-version = <3>;
	};
```

## Documentation/devicetree/bindings/arm/msm/msm_klmd.txt
```
KLM - Key Ladder Module

KLM is a HW module which generates and decrypt keys in a secured manner.
The KLM transfers generated keys securely into TSPP2 Key Table.

The devicetree representation of the KLM block should be:

Required properties:

- compatible: "qcom,klm"
- reg: physical memory base addresses and sizes for the following:
	KLM, TSPP2, BCSS_HLOS, BCSS_KLM.
- reg-names: names of the memory regions:
	MSM_KLM, MSM_BCSS_TSPP2, MSM_BCSS_HLOS, MSM_BCSS_KLM
- vdd-supply: power regulator (GDSC) supplying power to the broadcast subsystem.

Example:

	klm: msm-klm@fc560000 {
		compatible = "qcom,klm";
		reg = <0xfc560000 0x1000>, /* KLM registers */
		      <0xfc724000 0x7000>, /* TSPP2 registers */
		      <0xfc747000 0x1000>, /* KLM debug mode */
		      <0xfc748200 0x100>;  /* Key Tables */
		reg-names = "MSM_KLM", "MSM_BCSS_TSPP2", "MSM_BCSS_HLOS", "MSM_BCSS_KLM";
		vdd-supply = <&gdsc_bcss>;
	};
```

## Documentation/devicetree/bindings/arm/msm/msm_mct.txt
```
MSM Maximum Current Throttling (MSM-MCT) driver

The MCT driver provides support to enable/disable the MCT
mechanism and to modify the MCT control parameters. The
MCT mechanism's main goal is to limit the CPU's max power
consumption over a period of time by assessing the number
and type of instructions that are executed and then by mitigating
the CPU's instruction execution rate. The MCT works on a user
defined power budget for every cycle and when the CPU's average
power consumption exceeds this budget for a particular period of time,
then the CPU's instruction execution rate is throttled.

The devicetree representation of the MCT block should be:
Required Properties:
- compatible            : "qcom,max-current-throttling"

Optional Properties:
- qcom,mct-wr-weight    : Energy weight of integer instruction.
- qcom,mct-vxwr-weight  : Energy weight of VeNum arithmetic operations.
- qcom,mct-vlswr-weight : Energy weight of VeNum memory operations.
- qcom,mct-vaw-energy   : Energy associated with clocking the VeNum unit.
- qcom,mct-ulim         : The maximum energy debt that can be incurred
                          before throttling will be engaged.
- qcom,mct-dcnt         : The per-cycle energy budget.
- <mct-regulator-name>-supply = <&phandle_of_regulator> : mct-regulator-name
                          is the regulator name that's defined in the mct
                          driver. phandle_of_regulator should be the phandle
                          for mct regulator, defined by regulator device tree.
- qcom,mct-regulators   : List of MCT regulators corresponding to each CPU.
                          These regulators will be enabled/disabled, whenever
                          the MCT feature for that particular CPU is
                          enabled/disabled in the driver. User can specify
                          regulators for specific CPU's and give empty string
                          for the rest. The phandle for the regulator supply
                          should be defined.

Example:
qcom,msm-mct {
	compatible = "qcom,max-current-throttling";
	krait0-mct-supply = <&krait0_adj_reg>;
	krait1-mct-supply = <&krait1_adj_reg>;
	krait2-mct-supply = <&krait2_adj_reg>;
	krait3-mct-supply = <&krait3_adj_reg>;
	qcom,mct-regulators = "krait0-mct", "krait1-mct",
				"krait2-mct", "krait3-mct";
	qcom,mct-wr-weight = <0x14221120>;
	qcom,mct-vxwr-weight = <0xf8436430>;
	qcom,mct-vlswr-weight = <0xa5846330>;
	qcom,mct-vaw-energy = <0x1>;
	qcom,mct-ulim = <0x007f>;
	qcom,mct-dcnt = <0x0c>;
};
```

## Documentation/devicetree/bindings/arm/msm/msm_memory_dump.txt
```
Qualcomm Technologies Inc. memory dump driver

QTI memory dump driver allows various client subsystems to register and allocate respective
dump regions. At the time of deadlocks or cpu hangs these dump regions
are captured to give a snapshot of the system at the time of the crash.

Required properties:

-compatible: "qcom,mem-dump"
-memory-region: phandle to the CMA region. The size of the CMA region
		should be greater than sum of size of all child nodes
		to account for padding.

If any child nodes exist the following property are required:

-qcom,dump-size: The size of memory that needs to be allocated for the
		 particular node.
-qcom,dump-id: The ID within the data dump table where this entry needs
	       to be added.

Example:

	mem_dump {
		compatible = "qcom,mem-dump";
		memory-region = <&dump_mem>;

		rpmh_dump {
			qcom,dump-size = <0x2000000>;
			qcom,dump-id = <0xEC>;
		};
	};
```

## Documentation/devicetree/bindings/arm/msm/msm_memory_hole.txt
```
Memory Hole

The msm_mem_hole module exists for the express purpose of removing
memory via the msm memory-remove mechanism (see
memory-reserve.txt). Compiling this module into a kernel is
essentially the means by which any nodes in the device tree with
compatible = "qcom,msm-mem-hole" will be "activated", thus providing a
convenient mechanism for enabling/disabling memory removal
(qcom,memory-*).


Required properties

- compatible: "qcom,msm-mem-hole"

	qcom,msm-mem-hole {
		compatible = "qcom,msm-mem-hole";
		qcom,memblock-remove = <0x8100000 0x7e00000>; /* Address and Size of Hole */
	};
```

## Documentation/devicetree/bindings/arm/msm/msm_pacman.txt
```
* msm-pacman - The MSM Peripheral Access Control Manager

Required Properties:

 - compatible:	"qcom,msm-pacman"

Aliases:

  An alias is required to properly map the i2c/SPI bus driver to a Qualcomm
  Universal Peripheral (QUP) ID. The alias is of the form 'qup<n>', where
  <n> is an integer specifying the QUP ID.

Example:

	aliases {
		i2c2 = &i2c_2;
		qup2 = &ic2_2;
	};

	qcom,msm-pacman {
		compatible = "qcom,msm-pacman";
	};
```

## Documentation/devicetree/bindings/arm/msm/msm_pp2s.txt
```
QTI Femtocell Pulse Per 2 Second (PP2S)

PP2S is a hardware generated pulse that occurs every two seconds and
is used for synchronizing certain system behaviors as they relate to
time.

The PP2S notification driver will be used by applications for two
reasons:

  1) So that they can be informed when PP2S interrupts occur, and

  2) So that the wall clock time registers can be accessed/manipulated
     from within the driver and from user space.

Two device tree nodes have been added.

The first is for the PP2S interrupt. It is made up of the following
required properties:

- compatible: "qcom,pp2s"
- interrupts: The interrupt number
- interrupt-names: the interrupt name

Example:

    qcom,pp2s {
        compatible = "qcom,pp2s";
        interrupts = <0 219 0>;
        interrupt-names = "pp2s_irq";
    };

The second is for mapping the wall clock regisers into usable
memory. It is made up of the required following:

- compatible: "qcom,wallclock"
- reg-names: The names given to the two memory bank locations
- reg: The base address and length for each bank

Example:

    qcom,wallclock@fd4aa000 {
        compatible = "qcom,wallclock";
        reg-names = "wallclock_time_bank", "wallclock_cntrl_bank";
        reg = <0xfd4aa000 0x20>, <0xfd4a9000 0x40>;
    };
```

## Documentation/devicetree/bindings/arm/msm/msm_qmp.txt
```
Qualcomm Technologies, Inc. QTI Mailbox Protocol

QMP Driver
===================

Required properties:
- compatible : should be "qcom,qmp-mbox".
- label : the name of the remote proc this link connects to.
- reg : The location and size of shared memory.
	The irq register base address for triggering interrupts.
- reg-names : "msgram" - string to identify the shared memory region.
	"irq-reg-base" - string to identify the irq register region.
- qcom,irq-mask : the bitmask to trigger an interrupt.
- interrupt : the receiving interrupt line.
- mbox-desc-offset : offset of mailbox descriptor from start of the msgram.
- priority : the priority of this mailbox compared to other mailboxes.
- #mbox-cells: Common mailbox binding property to identify the number of cells
		required for the mailbox specifier, should be 1.

Optional properties:
- mbox-offset : offset of the mcore mailbox from the offset of msgram. If this
			property is not used, qmp will use the configuration
			provided by the ucore.
- mbox-size : size of the mcore mailbox. If this property is not used, qmp will
			use the configuration provided by the ucore.

Example:
	qmp_aop: qcom,qmp-aop {
		compatible = "qcom,qmp-mbox";
		label = "aop";
		reg = <0xc300000 0x100000>,
			<0x1799000C 0x4>;
		reg-names = "msgram", "irq-reg-base";
		qcom,irq-mask = <0x1>;
		interrupt = <0 389 1>;
		mbox-desc-offset = <0x100>;
		priority = <1>;
		mbox-offset = <0x500>;
		mbox-size = <0x400>;
		#mbox-cells = <1>;
	};

Mailbox Client
==============
"mboxes" and the optional "mbox-names" (please see
Documentation/devicetree/bindings/mailbox/mailbox.txt for details). Each value
of the mboxes property should contain a phandle to the mailbox controller
device node and second argument is the channel index. It must be 0 (qmp
supports only one channel).The equivalent "mbox-names" property value can be
used to give a name to the communication channel to be used by the client user.

Example:
	qmp-client {
		compatible = "qcom,qmp-client";
		mbox-names = "aop";
		mboxes = <&qmp_aop 0>,
	};
```
