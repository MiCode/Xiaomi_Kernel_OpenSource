## Documentation/devicetree/bindings/arm/msm/rpm-regulator-smd.txt
```
Qualcomm RPM Regulators

rpm-regulator-smd is a regulator driver which supports regulators inside of
PMICs which are controlled by the RPM processor.  Communication with the RPM
processor takes place over SMD.

Required structure:
- RPM regulators must be described in two levels of devices nodes.  The first
	level describes the interface with the RPM.  The second level describes
	properties of one regulator framework interface (of potentially many) to
	the regulator.

[First Level Nodes]

Required properties:
- compatible:          Must be "qcom,rpm-regulator-smd-resource"
- qcom,resource-name:  Resource name string for this regulator to be used in RPM
			transactions.  Length is 4 characters max.
- qcom,resource-id:    Resource instance ID for this regulator to be used in RPM
			transactions.
- qcom,regulator-type: Type of this regulator.  Supported values are:
				0 = LDO
				1 = SMPS
				2 = VS
				3 = NCP

Optional properties:
- qcom,allow-atomic:   Flag specifying if atomic access is allowed for this
			regulator.  Supported values are:
				0 or not present = mutex locks used
				1 = spinlocks used
- qcom,enable-time:    Time in us to delay after enabling the regulator
- qcom,hpm-min-load:   Load current in uA which corresponds to the minimum load
			which requires the regulator to be in high power mode.

[Second Level Nodes]

Required properties:
- compatible:          Must be "qcom,rpm-regulator-smd"
- regulator-name:      A string used as a descriptive name for regulator outputs
- qcom,set:            Specifies which sets that requests made with this
			regulator interface should be sent to.  Regulator
			requests sent in the active set take effect immediately.
			Requests sent in the sleep set take effect when the Apps
			processor transitions into RPM assisted power collapse.
			Supported values are:
				1 = Active set only
				2 = Sleep set only
				3 = Both active and sleep sets



Optional properties:
- parent-supply:               phandle to the parent supply/regulator node
- qcom,system-load:            Load in uA present on regulator that is not
				captured by any consumer request
- qcom,use-voltage-corner:     Flag that signifies if regulator_set_voltage
				calls should modify the corner parameter instead
				of the voltage parameter.  When used, voltages
				specified inside of the regulator framework
				represent corners that have been incremented by
				1.  This value shift is necessary to work around
				limitations in the regulator framework which
				treat 0 uV as an error.
- qcom,use-voltage-floor-corner:  Flag that signifies if regulator_set_voltage
				calls should modify the floor corner parameter
				instead of the voltage parameter.  When used,
				voltages specified inside of the regulator
				framework represent corners that have been
				incremented by 1.  The properties
				qcom,use-voltage-corner and
				qcom,use-voltage-floor-corner are mutually
				exclusive.  Only one may be specified for a
				given regulator.
- qcom,always-send-voltage:    Flag which indicates that updates to the voltage
				or voltage corner set point should always be
				sent immediately to the RPM.  If this flag is
				not specified, then voltage set point updates
				are only sent if the given regulator has also
				been enabled by a Linux consumer.
- qcom,always-send-current:    Flag which indicates that updates to the load
				current should always be sent immediately to the
				RPM.  If this flag is not specified, then load
				current updates are only sent if the given
				regulator has also been enabled by a Linux
				consumer.
The following properties specify initial values for parameters to be sent to the
RPM in regulator requests.
- qcom,init-enable:            0 = regulator disabled
			       1 = regulator enabled
- qcom,init-voltage:           Voltage in uV
- qcom,init-current:           Current in mA
- qcom,init-ldo-mode:          Operating mode to be used with LDO regulators
				Supported values are:
					0 = mode determined by current requests
					1 = force HPM (NPM)
- qcom,init-smps-mode:         Operating mode to be used with SMPS regulators
				Supported values are:
					0 = auto; hardware determines mode
					1 = mode determined by current requests
					2 = force HPM (PWM)
- qcom,init-pin-ctrl-enable:   Bit mask specifying which hardware pins should be
				used to enable the regulator, if any; supported
				bits are:
					0 = ignore all hardware enable signals
					BIT(0) = follow HW0_EN signal
					BIT(1) = follow HW1_EN signal
					BIT(2) = follow HW2_EN signal
					BIT(3) = follow HW3_EN signal
- qcom,init-pin-ctrl-mode:     Bit mask specifying which hardware pins should be
				used to force the regulator into high power
				mode, if any.  Supported bits are:
					0 = ignore all hardware enable signals
					BIT(0) = follow HW0_EN signal
					BIT(1) = follow HW1_EN signal
					BIT(2) = follow HW2_EN signal
					BIT(3) = follow HW3_EN signal
					BIT(4) = follow PMIC awake state
- qcom,init-frequency:         Switching frequency divisor for SMPS regulators.
				Supported values are n = 0 to 31 where
				freq = 19.2 MHz / (n + 1).
- qcom,init-head-room:         Voltage head room in mV required for the
				regulator.  This head room value should be used
				in situations where the device connected to the
				output of the regulator has low noise tolerance.
				Note that the RPM independently enforces a
				safety head room value for subregulated LDOs
				which is sufficient to account for LDO drop-out
				voltage.
- qcom,init-quiet-mode:        Specify that quiet mode is needed for an SMPS
				regulator in order to have lower output noise.
				Supported values are:
					0 = No quiet mode
					1 = Quiet mode
					2 = Super quiet mode
- qcom,init-freq-reason:       Consumer requiring specified frequency for an
				SMPS regulator.  Supported values are:
					0 = None
					1 = Bluetooth
					2 = GPS
					4 = WLAN
					8 = WAN
- qcom,init-voltage-corner:    Performance corner to use in order to determine
				voltage set point.  This value corresponds to
				the actual value that will be sent and is not
				incremented by 1 like the values used inside of
				the regulator framework.  The meaning of corner
				values is set by the RPM.  It is possible that
				different regulators on a given platform or
				similar regulators on different platforms will
				utilize different corner values.  These are
				corner values supported on MSM8974 for PMIC
				PM8841 SMPS 2 (VDD_Dig); nominal voltages for
				these corners are also shown:
					0 = None         (don't care)
					1 = Retention    (0.5000 V)
					2 = SVS Krait    (0.7250 V)
					3 = SVS SOC      (0.8125 V)
					4 = Normal       (0.9000 V)
					5 = Turbo        (0.9875 V)
					6 = Super Turbo  (1.0500 V)
- qcom,init-disallow-bypass:   Specify that bypass mode should not be used for a
				given LDO regulator.  When in bypass mode, an
				LDO performs no regulation and acts as a simple
				switch.  The RPM can utilize this mode for an
				LDO that is subregulated from an SMPS when it is
				possible to reduce the SMPS voltage to the
				desired LDO output level.  Bypass mode may be
				disallowed if lower LDO output noise is
				required.  Supported values are:
					0 = Allow RPM to utilize LDO bypass mode
						if possible
					1 = Disallow LDO bypass mode
- qcom,init-voltage-floor-corner:  Minimum performance corner to use if any
				processor in the system is awake.  This property
				supports the same values as
				qcom,init-voltage-corner.

All properties specified within the core regulator framework can also be used in
second level nodes.  These bindings can be found in:
Documentation/devicetree/bindings/regulator/regulator.txt.

Example:

rpm-regulator-smpb1 {
	qcom,resource-name = "smpb";
	qcom,resource-id = <1>;
	qcom,regulator-type = <1>;
	qcom,hpm-min-load = <100000>;
	compatible = "qcom,rpm-regulator-smd-resource";
	status = "disabled";

	pm8841_s1: regulator-s1 {
		regulator-name = "8841_s1";
		qcom,set = <3>;
		regulator-min-microvolt = <900000>;
		regulator-max-microvolt = <1150000>;
		qcom,init-voltage = <1150000>;
		compatible = "qcom,rpm-regulator-smd";
	};
	pm8841_s1_ao: regulator-s1-ao {
		regulator-name = "8841_s1_ao";
		qcom,set = <1>;
		regulator-min-microvolt = <900000>;
		regulator-max-microvolt = <1150000>;
		compatible = "qcom,rpm-regulator-smd";
	};
	pm8841_s1_corner: regulator-s1-corner {
		regulator-name = "8841_s1_corner";
		qcom,set = <3>;
		regulator-min-microvolt = <1>;
		regulator-max-microvolt = <6>;
		qcom,init-voltage-corner = <3>;
		qcom,use-voltage-corner;
		compatible = "qcom,rpm-regulator-smd";
	};
};
```

## Documentation/devicetree/bindings/arm/msm/rpm-smd.txt
```
Resource Power Manager(RPM)

RPM is a dedicated hardware engine for managing shared SoC resources,
which includes buses, clocks, power rails, etc.  The goal of RPM is
to achieve the maximum power savings while satisfying the SoC's
operational and performance requirements.  RPM accepts resource
requests from multiple RPM masters.  It arbitrates and aggregates the
requests, and configures the shared resources.  The RPM masters are
the application processor, the modem processor, as well as hardware
accelerators. The RPM driver communicates with the hardware engine using
SMD.

The devicetree representation of the RPM block should be:

Required properties

- compatible: "qcom,rpm-smd"
- rpm-channel-name: The string corresponding to the channel name of the
			peripheral subsystem. Required for both smd and
			glink transports.
- rpm-channel-type: The interal SMD edge for this subsystem found in
			<soc/qcom/smd.h>
- interrupts: The IRQ used by remote processor to inform APSS about
				reception of response message packet.

Optional properties
- rpm-standalone: Allow RPM driver to run in standalone mode irrespective of RPM
			channel presence.
- reg: Contains the memory address at which rpm messaging format version is
  stored. If this field is not present, the target only supports v0 format.

Example:

	qcom,rpm-smd@68150 {
		compatible = "qcom,rpm-smd";
		reg = <0x68150 0x3200>;
		interrupts = <GIC_SPI 168 IRQ_TYPE_EDGE_RISING>;
		qcom,rpm-channel-name = "rpm_requests";
		qcom,rpm-channel-type = 15; /* SMD_APPS_RPM */
	}
}
```

## Documentation/devicetree/bindings/arm/msm/rpm-stats.txt
```
* RPM Sleep Stats

RPM maintains sleep data in the RPM RAM. A device tree node is added
that will hold the address of the RPM RAM from where sleep stats are read.
Additionally a version number is added to distinguish the type of data
structure being read from the RAM.

RPM maintains free heap space availability in the RPM RAM. RPM free heap space
value is required for debugging purpose.

The required properties for rpm-stats are:

- compatible: "qcom,rpm-stats"
- reg: The address on the RPM RAM from where stats are read.

	Second register(optional) specifies the offset of the rpm
	stats start address pointer. If the second register is
	available, the offset value read is added to the first
	register address to read the stats.

	Third register(optional) specifies the offset of the rpm
	free heap space value.
- reg-names: Name given the register holding address.
- qcom,sleep-stats-version: Version number.

Example 1:

qcom,rpm-stats@fc19dbd0 {
		compatible = "qcom,rpm-stats";
		reg = <0xfc19dbd0 0x1000>;
		reg-names = "phys_addr_base";
		qcom,sleep-stats-version = <2>;
};

Example 2:

qcom,rpm-stats@fc000000 {
		compatible = "qcom,rpm-stats";
		reg = <0xfc000000 0x1000>,
			<0xfc190014 0x4>;
		reg-names = "phys_addr_base";
		qcom,sleep-stats-version = <2>;
};
```

## Documentation/devicetree/bindings/arm/msm/rpm_master_stats.txt
```
* RPM Stats

RPM maintains a counter of the masters i.e APPS, MPPS etc
number of times the SoC entered a deeper sleep mode involving
lowering or powering down the backbone rails - Cx and Mx and
the oscillator clock, XO.

PROPERTIES

- compatible:
	Usage: required
	Value type: <string>
	Definition: Should be "qcom,rpm-master-stats".

- reg:
	Usage: required
	Value type: <prop-encoded-array>
	Definition: The address on the RPM RAM from where the stats are read
	            should be provided as "phys_addr_base". The offset from
	            which the stats are available should be provided as
	            "offset_addr".

- reg-names:
	Usage: required
	Value type: <prop-encoded-array>
	Definition: Provides labels for the reg property.

- qcom,masters:
	Usage: required
	Value tye: <string list>
	Defination: Provides the masters list.

qcom,master-offset:
	Usage: required
	Value tye: <prop-encoded-array>
	Defination: Provides the masters list

EXAMPLE:

qcom,rpm-master-stats@60150 {
		compatible = "qcom,rpm-master-stats";
		reg = <0x60150 0x5000>;
		qcom,masters = "APSS", "MPSS", "PRONTO", "TZ", "LPASS";
		qcom,master-stats-version = <2>;
		qcom,master-offset = <4096>;
	};
```

## Documentation/devicetree/bindings/arm/msm/rpm_stats.txt
```
* RPM Stats

RPM maintains a counter of the number of times the SoC entered a deeper sleep
mode involving lowering or powering down the backbone rails - Cx and Mx and
the oscillator clock, XO.

PROPERTIES

- compatible:
	Usage: required
	Value type: <string>
	Definition: Should be "qcom,rpm-stats".

- reg:
	Usage: required
	Value type: <prop-encoded-array>
	Definition: The address on the RPM RAM from where the stats are read
	            should be provided as "phys_addr_base". The offset from
	            which the stats are available should be provided as
	            "offset_addr".

- reg-names:
	Usage: required
	Value type: <prop-encoded-array>
	Definition: Provides labels for the reg property.

EXAMPLE:

	qcom,rpm-stats@c000000 {
		compatible = "qcom,rpm-stats";
		reg = <0xC000000 0x1000>, <0x3F0000 0x4>;
		reg-names = "phys_addr_base", "offset_addr";
	};
```

## Documentation/devicetree/bindings/arm/msm/rpmh-master-stat.txt
```
* RPMH Master Stats

Differet Subsystems maintains master data in SMEM.
It tells about the individual masters information at any given
time like "system sleep counts", "system sleep last entered at"
and "system sleep accumulated duration" etc. These stats can be
show to the user using the debugfs interface of the kernel.
To achieve this, device tree node has been added.

The required properties for rpmh-master-stats are:

- compatible: "qcom,rpmh-master-stats".

Example:

qcom,rpmh-master-stats {
	compatible = "qcom,rpmh-master-stats";
};
```

## Documentation/devicetree/bindings/arm/msm/sdx-ext-ipc.txt
```
Modem chipset attached to Application processor

Modem chipset can be connected to an external apss processor. The control
channel between the two chipsets consists of gpios that can relay the
state of one subsytem to another. Modem can indicate different events
(bootup/crash etc.) to AP and can get the same information from AP.

Required Properties:
- compatible:	"qcom,sdx-ext-ipc".

Optional named gpio properties:
- qcom,status-out-gpio: gpio to indicate the boot status to remote processor.

- qcom,status-in-gpio: gpio for remote processor to indicate the boot status.

- qcom,status-out2-gpio: gpio to indicate to remote processor that it is in
		E911 call or doing firmware upgrade.

- qcom,default-policy-nop: Set default policy from PANIC to NOP.

- qcom,wakeup-gpio-out: gpio to wakeup remote AP or modem.

- qcom,wakeup-gpio-in: input gpio to receive wakeup signal from remote AP or
		modem.

Example:
	sdx_ext_ipc: qcom,sdx_ext_ipc {
		compatible = "qcom,sdx-ext-ipc";
		qcom,status-in-gpio = <&tlmm 64 0x00>;
		qcom,status-out-gpio = <&tlmm 63 0x00>;
		qcom,status-out2-gpio = <&tlmm 66 0x00>;
		qcom,wakeup-gpio-in = <&tlmm 67 0x00>;
		qcom,wakeup-gpio-out = <&tlmm 68 0x00>;
	};
```
