## Documentation/devicetree/bindings/arm/msm/sleepstate-smp2p.txt
```
Qualcomm Technologies, Inc. SMSM Point-to-Point (SMP2P) Sleepstate driver

Required properties:
-compatible : should be one of the following:
- "qcom,smp2p-sleepstate"
-qcom,smem-states : the relevant outgoing smp2p entry
- interrupt-parent: specifies the phandle to the parent interrupt controller
  this one is cascaded from
- interrupts: specifies the interrupt number, the irq line to be used
- interrupt-names: Interrupt name string, must be "smp2p-sleepstate-in"

Example:
qcom,smp2p_sleepstate {
	compatible = "qcom,smp2p-sleepstate";
	qcom,smem-states = <&sleepstate_smp2p_out 0>;
	interrupt-parent = <&sleepstate_smp2p_in>;
	interrupts = <0 0>;
	interrupt-names = "smp2p-sleepstate-in";
};



Required properties:
-compatible : should be "qcom,smp2pgpio_sleepstate_3_out";
-gpios : the relevant gpio pins of the entry.

Example:
        qcom,smp2pgpio-sleepstate-3-out {
                compatible = "qcom,smp2pgpio_sleepstate_3_out";
                gpios = <&smp2pgpio_sleepstate_3_out 0 0>;
        };
```
