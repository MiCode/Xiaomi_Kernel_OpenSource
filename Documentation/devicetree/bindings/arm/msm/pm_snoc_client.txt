## Documentation/devicetree/bindings/arm/msm/pm_snoc_client.txt
```
* MSM PM SNOC client

MSM PM SNOC client device is used to setup a bus request for 100 Mhz for the
SNOC bus when the Apps cores are active. This bus request helps mitigate the
exit latency from power collapse in cases where there aren't any active bus
requests for SNOC.

This device is dependent on the pm-8x60 device, which configures the low power
mode of respective cores.

The required properties of this device are:

- compatible: qcom,pm-snoc-client
- qcom,msm-bus,name:            String representing the client-name
- qcom,msm-bus,num-cases:       Total number of usecases
- qcom,msm-bus,active-only:     Boolean context flag for requests in active or
                                dual (active & sleep) contex
- qcom,msm-bus,num-paths:       Total number of master-slave pairs
- qcom,msm-bus,vectors-KBps:    Arrays of unsigned integers representing:
                                master-id, slave-id, arbitrated bandwidth
                                in KBps, instantaneous bandwidth in KBps


Example:
	qcom,pm-snoc-client {
		compatible = "qcom,pm-snoc-client";
		qcom,msm-bus,name = "ocimem_snoc";
		qcom,msm-bus,num-cases = <2>;
		qcom,msm-bus,active-only;
		qcom,msm-bus,num-paths = <1>;
		qcom,msm-bus,vectors =
			<22 512 0 0>,
			<22 512 320000 3200000>;
	};
```

## Documentation/devicetree/bindings/arm/msm/pmic-id.txt
```
* PMIC-ID

The qcom,pmic-id entry specifies the PMIC chips used on a given MSM platform.

It is expected that the bootloader will use this information at boot-up to
decide which device tree to use when given multiple device trees, some of which
may not be compatible with the actual hardware. It is the bootloader's
responsibility to pass the correct device tree to the kernel.

The cell layout of the qcom,pmic-id property is as follows:

    qcom,pmic-id = <pmic1 pmic2 pmic3 pmic4> [, <pmic1 pmic2 pmic3 pmic4> ...];

where a given "pmic#" cell is a 32-bit integer which is defined as follows:
    bits 31-24 = unused
    bits 23-16 = PMIC major version
    bits 15-8  = PMIC minor version
    bits 7-0   = PMIC model number

The PMIC values in each tuple must be listed in ascending order of their global
SPMI slave id for a given board. Note that any missing entries need to be
denoted by 0x0 to complete a given tuple. The ordering of tuples within the
property is arbitrary.

Examples:
    qcom,pmic-id = <0x10009 0x1000A 0x1000C 0x0>;

    qcom,pmic-id = <0x10009 0x1000C 0x0 0x0>;

    qcom,pmic-id = <0x10009 0x1000A 0x0 0x0>,
                   <0x20109 0x1000A 0x0 0x0>;
```

## Documentation/devicetree/bindings/arm/msm/pmu.txt
```
* Qcom Performance Monitor Units
Qcom cores have several PMUs for counting CPU side, L2 and bus side events.

For the L1CC PMU:
In most cases the L1 cache controller PMU is a per cpu unit. The irq-is-percpu
flag becomes a requirement if this is the case.

Required Properties:

- compatible : Should be "qcom,krait-pmu"
- interrupts : 1 combined interrupt or 1 per core. See the devicetree/bindings/gic.txt for more details on this format.

Optional:

- qcom,irq-is-percpu: 	Define this if the IRQ of the PMU is a PPI. This will tell perf to use
			the per_cpu IRQ API for request and free.
- qcom,apply-cti-pmu-wa: Indicates if the driver needs to apply the CTI PMU Workaround. Relevant for 8994V1.

Example:

 arm-pmu {
                compatible = "qcom,krait-pmu";
                qcom,irq-is-percpu;
                interrupts = <1 7 0xf00>;
        };

For the L2CC PMU:
If the L2 cache controller PMU is available, its DT bindings should be defined as
follows.

Required Properties:

- compatible: Should be "qcom,l2-pmu"
- interrupts : 1 combined interrupt.

Example:

  l2-pmu {
                compatible = "qcom,l2-pmu";
                interrupts = <0 1 0>;
        };
```

## Documentation/devicetree/bindings/arm/msm/qcom,kpss-gcc.txt
```
Krait Processor Sub-system (KPSS) Global Clock Controller (GCC)

PROPERTIES

- compatible:
	Usage: required
	Value type: <string>
	Definition: should be one of:
			"qcom,kpss-gcc"

- reg:
	Usage: required
	Value type: <prop-encoded-array>
	Definition: base address and size of the register region

- clock-output-names:
	Usage: required
	Value type: <string>
	Definition: Name of the output clock. Typically acpu_l2_aux indicating
		    an L2 cache auxiliary clock.

Example:

	l2cc: clock-controller@2011000 {
		compatible = "qcom,kpss-gcc";
		reg = <0x2011000 0x1000>;
		clock-output-names = "acpu_l2_aux";
	};
```

## Documentation/devicetree/bindings/arm/msm/qcom,llcc.txt
```
== Introduction==

LLCC (Last Level Cache Controller) provides last level of cache memory in SOC,
that can be shared by multiple clients. Clients here are different cores in the
SOC, the idea is to minimize the local caches at the clients and migrate to
common pool of memory. Cache memory is divided into partitions called slices
which are assigned to clients. Clients can query the slice details, activate
and deactivate them.

Properties:
- compatible:
	Usage: required
	Value type: <string>
	Definition: must be "qcom,llcc-v1", "qcom,llcc-v2" or "lagoon-llcc-v1"

- reg:
	Usage: required
	Value Type: <prop-encoded-array>
	Definition: The first element specifies the llcc base start address and
		    the size of the register region. The second element specifies
		    the llcc broadcast base address and size of the register region.

- reg-names:
	Usage: required
	Value Type: <stringlist>
	Definition: Register region names. Must be "llcc_base", "llcc_broadcast_base".

- interrupts:
	Usage: required
	Definition: The interrupt is associated with the llcc edac device.
		    It's used for llcc cache single and double bit error detection
		    and reporting.

- cap-based-alloc-and-pwr-collapse:
	Usage: optional
	Value Type: Boolean
	Definition: Property to express that HLOS can enable/disable capacity
	based allocation and power collapse retention for a client. Include
	this property to set it. If not set, it will be treated as false.

Example:

	cache-controller@9200000 {
		compatible = "qcom,llcc-v2";
		reg = <0x9200000 0x200000> <0x9600000 0x50000>;
		reg-names = "llcc_base", "llcc_broadcast_base";
		interrupts = <GIC_SPI 582 IRQ_TYPE_LEVEL_HIGH>;
	};
```
