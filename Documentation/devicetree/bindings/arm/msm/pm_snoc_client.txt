## Documentation/devicetree/bindings/arm/msm/qcom,osm.txt
```
Qualcomm Technologies, Inc. OSM Bindings

Operating State Manager (OSM) is a hardware engine used by some Qualcomm
Technologies, Inc. (QTI) SoCs to manage frequency and voltage scaling
in hardware. OSM is capable of controlling frequency and voltage requests
for multiple clusters via the existence of multiple OSM domains.

Properties:
- compatible
	Usage:      required
	Value type: <string>
	Definition: must be "qcom,clk-cpu-osm" or "qcom,clk-cpu-osm-sdmshrike"
			or "qcom,clk-cpu-osm-sm6150" or
			"qcom,clk-cpu-osm-sdmmagpie" or
			"qcom,clk-cpu-osm-trinket" or
			"qcom,clk-cpu-osm-atoll".

- reg
	Usage:      required
	Value type: <prop-encoded-array>
	Definition: Addresses and sizes for the memory of the OSM controller.

- reg-names
	Usage:      required
	Value type: <stringlist>
	Definition: Address names. Must be "osm_l3_base", "osm_pwrcl_base",
		    and "osm_perfcl_base". Can optionally have
		    "osm_perfpcl_base".
		    Must be specified in the same order as the corresponding
		    addresses are specified in the reg property.

- l3-devs
	Usage: optional
	Value type: <phandle>
	Definition: List of phandles to devices that the OPP tables with the L3
		    frequency and voltage mappings are loaded for.

Example:
	clock_cpucc: qcom,cpucc {
		compatible = "qcom,clk-cpu-osm";
		reg = <0x18321000 0x1400>,
			<0x18323000 0x1400>,
			<0x18325800 0x1400>,
			<0x18327800 0x1400>;
		reg-names = "osm_l3_base", "osm_pwrcl_base",
			"osm_perfcl_base", "osm_perfpcl_base";

		l3-devs = <&phandle0 &phandle1 &phandle2>;

		#clock-cells = <1>;
	};
```

## Documentation/devicetree/bindings/arm/msm/qcom,qsee_irq.txt
```
Binding for the QTI Secure Execution Environment IRQ controller
===============================================================

The QTI Secure Execution Environment (QSEE) IRQ controller facilitates receiving
and clearing interrupts from QSEE. Each interrupt from QSEE has a set of control
registers to mask, clear and get the status of interrupts. This controller will
create an interrupt for clients to register with based on the bits available in
the control registers.

- compatible:
	Usage: required
	Value type: <string>
	Definition: must be one of:
		    "qcom,sm8150-qsee-irq"

- syscon:
	usage: required
	Value type: <prop-encoded-array>
	Definition: phandle to a syscon node representing the scsr registers

- interrupts:
	Usage: required
	Value type: <prop-encoded array>
	Definition: multiple entries specifying the interrupts from QSEE

- interrupt-names:
	Usage: required
	Value type: <string>
	Definition: Interrupt names should be one of the following to map the
		    interrupt back to the correct registers.
		    - sp_ipc%d
		    - sp_rmb

- interrupt-controller:
	Usage: required
	Value type: <empty>
	Definition: Identifies this node as an interrupt controller

- #interrupt-cells
	Usage: required
	Value type: <u32>
	Definition: must be 3 - for interrupts to encode these properties:
		    - u32 denoting index of desired interrupt in @interrupts
		    - u32 denoting bit of interrupt bank
		    - u32 denoting IRQ flags

= EXAMPLE
The following example shows the QSEE_IRQ setup with the GLINK SPSS node, defined
from the sm8150 apps processor's point-of-view. In this example the GLINK node
registers for the sp_ipc0 interrupt(index 0 in interrupt-names) and the 0th
bit on the sp_ipc0 interrupt bank.

sp_scsr_block: syscon@1880000 {
	compatible = “syscon”;
	reg = <0x1880000 0x10000>;
};

intsp: qcom,qsee_irq {
	compatible = "qcom,sm8150-qsee-irq";

	syscon = <&sp_scsr_block>;
	interrupts = <0 348 IRQ_TYPE_LEVEL_HIGH>,
		     <0 349 IRQ_TYPE_LEVEL_HIGH>;

	interrupt-names = "sp_ipc0",
			  "sp_ipc1";

	interrupt-controller;
	#interrupt-cells = <3>;
};

spss {
	...
	glink {
		qcom,remote-pid = <8>;
		mboxes = <&sp_scsr 0>;
		mbox-names = "spss_spss";
		interrupts = <&intsp 0 0 IRQ_TYPE_EDGE_RISING>;
	};
};
```

## Documentation/devicetree/bindings/arm/msm/qcom-wdog-debug.txt
```
* Qualcomm's Watchdog Debug Image Controller

The Qualcomm's Watchdog debug image controller is used for enabling/disabling of
watchdog debug image feature.

Required properties:
- compatible : should be "qcom,msm-wdog-debug"
- reg : base page aligned physical base address of the controller and length of
	memory mapped region.

Example:

	qcom,msm-wdog-debug@fc401000 {
		compatible = "qcom,msm-wdogi-debug";
		reg = <0xfc401000 0x1000>;
	};
```

## Documentation/devicetree/bindings/arm/msm/qdss_mhi.txt
```
Qualcomm Technologies, Inc. QDSS bridge Driver

This device will enable routing debug data from modem
subsystem to APSS host.

Required properties:
-compatible : "qcom,qdss-mhi".
-qcom,mhi : phandle of MHI Device to connect to.

Example:
	qcom,qdss-mhi {
		compatible = "qcom,qdss-mhi";
		qcom,mhi = <&mhi_0>;
	};
```

## Documentation/devicetree/bindings/arm/msm/qmp-debugfs-client.txt
```
QMP debugfs client:
-----------------

QTI Messaging Protocol(QMP) debugfs client is an interface for clients to
send data to the Always on processor using QMP.

Required properties :
- compatible : must be "qcom,debugfs-qmp-client"
- mboxes : list of QMP mailbox phandle and channel identifier tuples.
- mbox-names : names of the listed mboxes

Example :
	qcom,qmp-client {
		compatible = "qcom,debugfs-qmp-client";
		mboxes = <&qmp_aop 0>;
		mbox-names = "aop";
	};
```

## Documentation/devicetree/bindings/arm/msm/qsee_ipc_irq_bridge.txt
```
Qualcomm Technologies, Inc. Secure Execution Environment IPC Interrupt Bridge

[Root level node]
Required properties:
-compatible : should be "qcom,qsee-ipc-irq-bridge";

[Second level nodes]
qcom,qsee-ipc-irq-subsystem
Required properties:
-qcom,dev-name: the bridge device name
-interrupt: IPC interrupt line from remote subsystem to QSEE
-label : The name of this subsystem.

Required properties if interrupt type is IRQ_TYPE_LEVEL_HIGH[4]:
-qcom,rx-irq-clr : the register to clear the level triggered rx interrupt
-qcom,rx-irq-clr-mask : the bitmask to clear the rx interrupt

Example:

	qcom,qsee_ipc_irq_bridge {
		compatible = "qcom,qsee-ipc-irq-bridge";

		qcom,qsee-ipc-irq-spss {
			qcom,rx-irq-clr = <0x1d08008 0x4>;
			qcom,rx-irq-clr-mask = <0x2>;
			qcom,dev-name = "qsee_ipc_irq_spss";
			interrupts = <0 349 4>;
			label = "spss";
		};
	};
```

## Documentation/devicetree/bindings/arm/msm/rdbg-smp2p.txt
```
Qualcomm Technologies, Inc. Remote Debugger (RDBG) driver

Required properties:
-compatible : Should be one of
	To communicate with adsp
		qcom,smp2p-interrupt-rdbg-2-in (inbound)
		qcom,smp2p-interrupt-rdbg-2-out (outbound)
	To communicate with cdsp
		qcom,smp2p-interrupt-rdbg-5-in (inbound)
		qcom,smp2p-interrupt-rdbg-5-out (outbound)

Example:
	qcom,smp2p_interrupt_rdbg_2_in {
            compatible = "qcom,smp2p-interrupt-rdbg-2-in";
	};

Required properties:
-compatible : Should be one of
        To communicate with modem
                qcom,smp2pgpio_client_rdbg_2_in (inbound)
                qcom,smp2pgpio_client_rdbg_2_out (outbound)
        To communicate with modem
                qcom,smp2pgpio_client_rdbg_1_in (inbound)
                qcom,smp2pgpio_client_rdbg_1_out (outbound)
-gpios : the relevant gpio pins of the entry.

Example:
        qcom,smp2pgpio_client_rdbg_2_in {
                compatible = "qcom,smp2pgpio_client_rdbg_2_in";
                gpios = <&smp2pgpio_rdbg_2_in 0 0>;
        };
```

## Documentation/devicetree/bindings/arm/msm/rpm-log.txt
```
* RPM Log

RPM maintains Ulog in the RPM RAM. A device tree node is added
that will hold the address of the RPM RAM region from where
Ulog is read. The physical address from the RPM RAM region
contains a header where various parameters to read the log are
defined. These parameter's offsets in the header are also stored
as a part of the device tree node.

The required properties for rpm-log are:

- compatible: "qcom,rpm-log"
- reg: Specifies the base physical address and the size of the RPM
	registers from where ulog is read.
- qcom,rpm-addr-phys: RPM reads physical address of the RPM RAM region
		differently when compared to Apps. Physical address of
		the RPM RAM region is at an offset when seen from Apps.
		This property specifies the offset which will get added
		to the physical address of RPM RAM to make it
		accessible to the Apps.
- qcom,offset-version: Offset from the start of the phys_addr_base where version
			information is stored.
- qcom,offset-page-buffer-addr: Offset from the start of the phys_addr_base
				where raw log start address is stored. Raw log
				start address is the start of raw log in the
				RPM address space as it should be seen from rpm.
- qcom,offset-log-len: Offset from the start of the phy_addr_base where log
			length is stored.
- qcom,offset-log-len-mask: Offset from the start of the phy_addr_base where
				log length mask is stored.
- qcom,offset-page-indices: Offset from the start of the phy_addr_base where
				index to the writer is stored.
Example:
qcom,rpm-log@fc19dc00 {
	compatible = "qcom,rpm-log";
	reg = <0xfc19dc00 0x2000>,
	qcom,offset-rpm-addr = <0xfc000000>;
	qcom,offset-version = <4>;
	qcom,offset-page-buffer-addr = <36>;
	qcom,offset-log-len = <40>;
	qcom,offset-log-len-mask = <44>;
	qcom,offset-page-indices = <56>;
};
```

## Documentation/devicetree/bindings/arm/msm/rpm-master-stats.txt
```
* RPM Master Stats

RPM maintains each master data in RPM message RAM at a specific
offset. It tells about the individual masters information at
any given time like "number of active cores in sub system",
"number of shutdowns" and "wakeup reason for SS" etc. These stats
can be show to the user using the debugfs interface of the kernel.
To achieve this device tree node has been added and it will hold
the address of the RPM RAM from where master stats are read.
Added version number to distinguish the type of data structure
being read from the RAM for different targets.

The required properties for rpm-master-stats are:

- compatible: "qcom,rpm-master-stats".
- reg: The address on the RPM RAM from where stats are read.
- qcom,masters: Each master name.
- qcom,master-offset: Offset required to access each master stats area.
- qcom,master-stats-version: Version number.

Example:

qcom,rpm-stats@fc428150 {
		compatible = "qcom,rpm-stats";
		reg = <0xfc428150 0x1000>;
		qcom,masters = "APSS", "MPSS", "LPSS", "PRONTO";
		qcom,master-offset = <2560>;
		qcom,master-stats-version = <2>;
};
```

## Documentation/devicetree/bindings/arm/msm/rpm-rail-stats.txt
```
* RPM Rail Stats

RPM maintains rail and corner data in the RPM RAM. A device tree node
will hold the address of the RPM RAM from where rail stats are read.

RPM maintains free heap space availability in the RPM RAM. RPM free heap
space value is required for debugging purpose.

The required properties for rpm-rail-stats are:

- compatible: "qcom,rpm-rail-stats"
- reg: The address on the RPM RAM from where stats are read.

	Second register specifies the offset of the rpm rail
	stats start address pointer.

- reg-names: Name of the register holding address.

Example:

qcom,rpm-stats@200000 {
		compatible = "qcom,rpm-stats";
		reg = <0x200000 0x100>,
			<0x290000 0x4>;
		reg-names = "phys_addr_base",
				"offset_addr"
};
```

## Documentation/devicetree/bindings/arm/msm/rpm-rbcpr-stats.txt
```
* RPM RBCPR

The RBCPR(Rapid Bridge Core Power Reduction) is  module on RPM that controls
the voltage level on the chip based on feedback received through various
sensors on the chip that allow compensation of the chip process variation,
temperature etc.
RPM maintains RBCPR (Rapid Bridge Core Power Reduction) related stats in
data memory. This module allows users to read those stats.

The required properties for rpm-stats are:

- compatible: "qcom,rpmrbcpr-stats"
- reg: Pointer to the start of the RPM Data Memory. The size of the memory
		is inclusive of the entire RPM data memory.
- qcom,start_offset: The offset at which the RBCPR stats are maintained. The
			driver module reads this parameter to get another offset
			that contain the rbcpr stats.


Example:

qcom,rpm-rbcpr-stats@fc000000 {
	compatible = "qcom,rpmrbcpr-stats";
	reg = <0xfc000000 0x1a0000>;
	qcom,start-offset = <0x190010>;
};
```
