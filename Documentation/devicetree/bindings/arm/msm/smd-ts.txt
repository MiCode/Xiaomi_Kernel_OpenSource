## Documentation/devicetree/bindings/arm/msm/spss_utils.txt
```
Qualcomm Technologies, Inc. Secure Processor SubSystem Utilities (spss_utils)

The Secure Processor SubSystem (SPSS) is a dedicated subsystem for security.
It has its own CPU, memories, and cryptographic engine.
It shall provide cryptographic services to other subsystems.
The SPSS firmware is loaded by PIL driver.
The communication with SPSS is done via spcom driver, using glink.

The spss_utils driver selects the SPSS firmware file,
according to a dedicated fuse and the platform HW version.

The spss_utils driver supports SPU Insider Attack Resistance (IAR) Feature.
SPU ROM code (PBL) expects a unique cmac for the spu firmware and spu apps.
The spss_utils driver registers an IAR callback to the PIL notification driver.
When SPU reset detected (SSR) the PIL calls the IAR callback to place the
required cmac in shared memory in DDR.

Required properties:
-compatible : should be "qcom,spss_utils"
-qcom,spss-fuse1-addr: fuse1 register physical address
-qcom,spss-fuse1-bit: fuse1 relevant bit
-qcom,spss-fuse2-addr: fuse2 register physical address
-qcom,spss-fuse2-bit: fuse2 relevant bit
-qcom,spss-fuse3-addr: fuse3 register physical address
-qcom,spss-fuse3-bit: fuse3 relevant bit
-qcom,spss-fuse4-addr: fuse4 register physical address
-qcom,spss-fuse4-bit: fuse4 relevant bit
-qcom,spss-dev-firmware-name: dev firmware file name
-qcom,spss-test-firmware-name: test firmware file name
-qcom,spss-prod-firmware-name: production firmware file name
-qcom,spss-debug-reg-addr: debug register physical address
-qcom,spss-emul-type-reg-addr: soc emulation type register physical address
-qcom,pil-mem: pointer to pil_spss_mem node, to get PIL memory address
-qcom,pil-mem: PIL memory size, spu firmware size is padded to 960 KB

Example:
spss_utils: qcom,spss_utils {
	compatible = "qcom,spss-utils";

	qcom,spss-fuse1-addr = <0x00780234>;
	qcom,spss-fuse1-bit = <27>;
	qcom,spss-fuse2-addr = <0x00780234>;
	qcom,spss-fuse2-bit = <26>;
	qcom,spss-fuse3-addr = <0x007801E8>;
	qcom,spss-fuse3-bit = <10>;
	qcom,spss-fuse4-addr = <0x00780218>;
	qcom,spss-fuse4-bit = <1>;
	qcom,spss-dev-firmware-name  = "spss1d";  /* 8 chars max */
	qcom,spss-test-firmware-name = "spss1t";  /* 8 chars max */
	qcom,spss-prod-firmware-name = "spss1p";  /* 8 chars max */
	qcom,spss-debug-reg-addr = <0x01886020>;
	qcom,spss-emul-type-reg-addr = <0x01fc8004>;
	pil-mem = <&pil_spss_mem>;
	qcom,pil-size = <0x0F0000>;
};
```

## Documentation/devicetree/bindings/arm/msm/subsystem_notif_virt.txt
```
Subsystem Notification Virtual Driver

The guest VM uses this driver to communicate
subsystem state notifications to a backend driver
via the virtual device's registers.

[Root level node]
Required Properties:
-compatible : Should be "qcom,subsys-notif-virt"
-reg : The start and size of the virtual device's
	register set.
-reg-names :  Should be "vdev_base" for virtual device's
	base address.

[Child nodes]
-subsys-names : The name of the subsystem that the
	driver is registering to notifications for.
-offset : The offset from the virtual device's register
	base where the subsystem state will be written.
-type : The type of the subsystem.
	"virtual" - When the subsystem is loaded by the host VM
	"native" - When the subsystem is loaded by the guest VM

Required Property for "virtual" subsystem types:
-interrupts : Tuple defining the interrupt which the driver must
		register for to receive subsystem state notifications
		from the backend.
-interrupt-names: Must be "state-irq"

Example:

	subsys_notif_virt: qcom,subsys_notif_virt@2D000000 {
		compatible = "qcom,subsys-notif-virt";
		reg = <0x2D000000 0x400>;
		reg-names = "vdev_base";
		adsp {
			subsys-name = "adsp";
			interrupts = <0 43 0>;
			interrupt-names = "state-irq";
			type = "virtual";
			offset = <0>;
		};
		mpss {
			subsys-name = "modem";
			type = "native";
			offset = <256>;
		};
	};
```

## Documentation/devicetree/bindings/arm/msm/system_health_monitor.txt
```
System Health Monitor

[Root level node]
Required properties:
-compatible: should be "qcom,system-health-monitor"

[Second level nodes]
Information about subsystems that are monitored by System Health Monitor.
Subsystems include modem, adsp, wcnss, external MDM(esoc).
Required properties:
-qcom,subsys-name: Name as identified by a subsystem
-qcom,ssrestart-string:	String used by subsystem restart to identify
			the subsystem

Example:
	qcom,system-health-monitor {
		compatible = "qcom,system-health-monitor";

		qcom,modem {
			qcom,subsys-name = "msm_mpss";
			qcom,ssrestart-string = "modem";
		};
		qcom,adsp {
			qcom,subsys-name = "msm_adsp";
			qcom,ssrestart-string = "adsp";
		};
		qcom,wcnss {
			qcom,subsys-name = "msm_wcnss";
			qcom,ssrestart-string = "wcnss";
		};
		qcom,esoc {
			qcom,subsystem-name = "mdm";
			qcom,ssrestart-string = "esoc";
		};
	};
```

## Documentation/devicetree/bindings/arm/msm/system_pm.txt
```
SYSTEM PM

System PM device is a virtual device that handles all CPU subsystem low power
mode activties. When entering core shutdown, resource state that were requested
from the processor may be relinquished and set to idle and restored when the
cores are brought out of sleep.

PROPERTIES

- compatible:
	Usage: required
	Value type: <string>
	Definition: must be "qcom,system-pm".

-mboxes:
	Usage: optional
	Value type: <phandle>
	Definition: phandle the TCS mailbox controller for the CPU subsystem.
	This property is generally set only for SoCs that use RPMH communication
	through a mailbox controller.

EXAMPLE

	system_pm {
		compatible = "qcom,system-pm";
		mboxes = <&apps_rsc 0>;
	};
```

## Documentation/devicetree/bindings/arm/msm/system_stats.txt
```
* System sleep stats

Resource Power manager maintains information about system sleep and the time
each master spent in respective sleep modes. These were previously exported
through two modules, one for system and another for the respective master
votes. The two modules are now combined into a system stats drivers to provide
better visibility into system sleep modes.

Main node properties

- compatible
	Usage: Required
	Value type: <string>
	Definition: must be "qcom,system-stats".

- qcom,rpm-msg-ram
	Usage: Required
	Value type: <phandle>
	Definition: phandle to RPM's message ram registers.

- qcom,rpm-code-ram
	Usage: Required
	Value type: <phandle>
	Definition: phandle to RPM's code ram registers.

- qcom,masters:
	Usage: Required
	Value type: <string list>

Definition of memory DT phandles that system stats module is dependent on.

qcom,rpm-msg-ram:

The required phandle pointed to by qcom,rpm-msg-ram are:
Node properties:
- compatible:
	Usage: Required
	Value Type: <string>
	Definition: must be "qcom,rpm-msg-ram"

- reg:
	Usage: Required
	Value Type: <prop-encoded-array>
	Definition: Addresses and sizes for RPM address as visible to Apps and
	Stats address location.

- reg-names:
	Usage: Required
	Value Type: <stringlist>
	Definition: Address names. Must be "phys_addr_base" or "msg-ram-base".
			Must be specified in the same order as the
			corresponding addresses in the reg property.

qcom,rpm-code-ram:
The required phandle pointed to by qcom,rpm-msg-ram are:

Node properties:
- compatible:
	Usage: Required
	Value Type: <string>
	Definition: must be "qcom,rpm-code-ram".
- reg:
	Usage: Required
	Value Type: <prop-encoded-array>
	Definition: Address and size for RPM code address.

- reg-names:
	Usage: Required
	Value Type: <stringlist>
	Definition: Address names. Must be "msg-ram-base"

Example:

	rpm_code_ram: rpm-memory@0x68000 {
		compatible = "qcom,rpm-code-ram";
		reg = <0x68000 0x5000>;
		reg-name = "msg-ram-base";
	};

	rpm_msg_ram: memory@0x200000 {
		compatible = "qcom,rpm-msg-ram";
		reg = <0x200000 0x1000>,
			<0x290000 0x1000>;
		reg-names = "phys_addr_base",
			"code-ram-base";
	};

	qcom,system-stats@68140 {
		compatible = "qcom,system-stats";
		qcom,rpm-msg-ram = <&rpm_msg_ram>;
		qcom,rpm-code-ram = <&rpm_code_ram>;
		qcom,masters = "APSS", "MPSS", "ADSP", "SLPI";
	};
```

## Documentation/devicetree/bindings/arm/msm/tv-tuner.txt
```
TVTUNER driver (VIDEO_TVTUNER)

VIDEO_TVTUNER is a sample kernel platform driver that is used to control the tv
tuner hardware for the capture of Tv tuner received a/v signal.

The devicetree representation of the VIDEO_TVTUNER block should be:

Required properties

- compatible: "qcom,tv-tuner"

Example:
	qcom,tv-tuner {
		compatible = "qcom,tv-tuner";
	};
```

## Documentation/devicetree/bindings/arm/msm/tz-log.txt
```
* TZLOG (Trust Zone Log)

The tz_log driver is a platform device driver that exposes a debugfs
interface for accessing and displaying diagnostic information
related to secure code (Trustzone/QSEE).

Required properties:
- compatible : Should be "qcom,tz-log"
- reg        : Offset and size of the register set for the device

Example:

	qcom,tz-log@fe805720 {
		compatible = "qcom,tz-log";
                reg = <0xfe805720 0x1000>;
	};
```

## Documentation/devicetree/bindings/arm/msm/vsens.txt
```
Voltage Sensors

Voltage Sensors are hardware blocks that sense the voltage at
a particular point in hardware. The device is capable of issuing
interrupts when a programmed min or max threshold is crossed.

Required Properties
- compatible:
	Must be 'qcom,msm-vsens'

- reg:
	specifies the address and size of the Voltage Sensor block

- reg-names:
	"base" to identify the physical address base of the
	Voltage Sensor block.

- label:
	String indicating this vsens instance.

- qcom,vsens-cpus:
	Array of CPU phandles which correspond to the cores which are
	supplied power by the rail monitored by this vsens device.

- qcom,vsens-cal-id:
	The VSENS rail id to index into the SMEM data which points to
	the calibarated voltage and vsens-codes. This value is determined
	based on the number of voltage-sensors supported on a target.

Optional Properties
- interrupts:
	IRQ lines used by Voltage Sensors

- interrupt-names:
	Descriptive names for IRQs used by Voltage Sensors.
	"max": maximum threshold crossed IRQ
	"min": minium threshold crossed IRQ

- qcom,temperature-pct:
	The percentage shift in voltage values over operational
	temperature range. This value is used to lower the floor
	and raise a ceiling voltage to account for temperature
	shifts. If not specified a default value of 15% is used.

- qcom,min-operational-floor-uv:
	The min floor voltage below which the voltage sensor
	is not operational and must be disabled. If this
	is not specified the voltage sensor is assumed to be
	operational for all voltage ranges.

- clocks:
	Array of clock tuples in which each tuple consists of a
	phandle to a clock device and a clock ID number.

- clock-names:
	The name of the voltage-sensor clock. The supported
	clock-name is 'vsens-clk'.

- qcom,corner-clock-rate:
	The clock rate (HZ) of the voltage sensor clock
	for each corner. The number of entries should match
	the 'qcom,num-corners'.

- qcom,calib-clock-rate:
	The clock rate (HZ) at which the VSENS calibration
	is done.

- qcom,num-corners:
	The number of corners supported by the voltage sensor.
	Its determined by the number of operating frequencies of
	the vsens-clk.

Sub Node required regulators
- qcom,vsens-voltage:
	A node to indicate the voltage range monitored by the sensor.

- qcom,vsens-corner:
	A node to indicate the current corner of the voltage sensor.

Sub-nodes required properties for 'qcom,vsens-voltage' regulator

- regulator-name:		A string used to describe the regulator
- regulator-min-microvolt:	Minimum voltage level expected to be
				monitored by the voltage sensor for
				a rail.
- regulator-max-microvolt:	Maximum voltage level expected to be
				monitored by the voltage sensor for
				a rail.

Sub-nodes required properties for 'qcom,vsens-corner' regulator

- regulator-name:		A string used to describe the regulator
- regulator-min-microvolt:	The lowest corner supported by the voltage
				sensor. Its value is 1.
- regulator-max-microvolt:	The max corner supported by the voltage sensor.
				Its value is equal to 'qcom,num-corners'.

Any property defined as part of the core regulator binding, defined in
regulator.txt, can also be used.

Example:
	vsens_apc0: vsens@b1d6000 {
		compatible = "qcom,msm-vsens";
		reg = <0xb1d6000 0xc>;
		reg-names = "base";
		interrupts = <0 265 0>,
				<0 266 0>;
		interrupt-names = "max",
				  "min";
		label = "vsens-acpu0";

		qcom,vsens-cal-id = <3>;
		qcom,vsens-cpus = <&CPU0 &CPU1 &CPU2 &CPU3>;

		clock-names = "vsens_clk";
		clocks = <&clock_gcc clk_gcc_aps_0_clk>;

		qcom,num-corners = <2>;
		qcom,corner-clock-rate =
			<300000000 540000000>;
		qcom,calib-clock-rate = <540000000>;
		qcom,min-operational-floor-uv = <500000>;
		qcom,temperature-pct = <20>;

		vsens_apc0_voltage:qcom,vsens-voltage {
			regulator-name = "msm-vsens-apc0-voltage";
			regulator-min-microvolt = <700000>;
			regulator-max-microvolt = <1165000>;
		};

		vsens_apc0_corner:qcom,vsens-corner {
			regulator-name = "msm-vsens-apc0-corner";
			regulator-min-microvolt = <1>;
			regulator-max-microvolt = <2>;
		};
	};
```
