## Documentation/devicetree/bindings/arm/tegra/nvidia,tegra30-dvfs.txt
```
NVIDIA Tegra30 DVFS tables

dvfs-tables node:
All the tables must be contained in dvfs-tables parent node. This node is just
container for all dvfs tables, it does not have any compatible property.

Tables:
Required properties for child nodes of dvfs-tables:

compatible: Must be any of
		"nvidia,tegra30-cpu-dvfs" for CPU dvfs tables or
		"nvidia,tegra30-cpu0-dvfs" for cpu0 dvfs tables or
		"nvidia,tegra30-core-dvfs" for core dvfs tables.

voltage-table: Voltage steps for rail. Unit for voltage value is mV.

#address-cells: Should be 0.
#size-cells: Should be 1.

Frequency tables:

Frequency tables are grouped using the combination of speedo-id, process-id and manual-dvfs.

Required properties:

reg: Can be any number but same as used in node name. Should be unique within the dvfs table.
clock-name: Clock name for which frequencies are mentioned in table.
frequencies: Array of frequencies. Unit for frequency is KHz.

Optional properties:
speedo-id: If not present, speedo id value will be -1.
process-id: If not present, process id value will be -1.
manual-dvfs: If not present, dvfs for the clocks in this frequency table is auto.

Example:

        dvfs-tables {
                cpudvfs {
                        compatible = "nvidia,tegra30-cpu-dvfs";
                        voltage-table = <800 825 850 875 900 916 950 975 1000 1007 1025 1050 1075 1100 1125 1150 1175 1200 1212 1237>;

			frequency-table@1 {
				reg = <1>;
				speedo-id = <0>;
				process-id = <0>;
				clock-name = "cpu_g";
				frequencies = <1 1 684000 684000 817000 817000 817000 1026000 1102000 1102000 1149000 1187000 1225000 1282000 1300000>;
			};
		};
	};
```

## Documentation/devicetree/bindings/ata/ahci-msm.txt
```
* Advanced Host Controller Interface (AHCI) MSM SATA driver

SATA nodes are defined to describe on-chip AHCI SATA host controllers.
Each SATA controller instance should have its own node.

Required properties:
- compatible        : compatible list, contains "qcom,msm-ahci"
- interrupts        : <interrupt mapping for AHCI host controller IRQ>
- reg               : <registers mapping>
- phys              : refer to Documentation/devicetree/bindings/phy/phy-bindings.txt
- phy-names         : refer to Documentation/devicetree/bindings/phy/phy-bindings.txt

Optional properties:
- clocks                : List of phandle and clock specifier pairs
- clock-names           : List of clock input name strings sorted in the same
                          order as the clocks property.
- max-clock-frequency-hz : List of maximum operating frequency stored in the same
                           order as the clocks property. If this property is not
			   defined or a value in the array is "0" then it is assumed
			   that the frequency is set by the parent clock or a
			   fixed rate clock source.
Note: If above properties are not defined it can be assumed that the clocks are always on.

Example:
	sata@0xfc580000 {
		compatible = "qcom,msm-ahci";
		reg = <0xfc580000 0x400>;
		interrupts = <0 31 0>;

		phys = <&sataphy0>;
		phy-names = "sata-6g";
		clocks = <&core 0>, <&iface 0>, <&pmalive 0>,
				<&rxoob0 0>, <&asic0 0>, <&rbc0 0>;
		clock-names = "core_clk", "iface_clk", "pmalive_clk",
				"rxoob_clk", "asic0_clk", "rbc0_clk";
		max-clock-frequency-hz = <0 0 100000000
					100000000 300000000 300000000>;
	};
```

## Documentation/devicetree/bindings/bif/bif.txt
```
BIF (Battery Interface) Controllers

Optional properties:
- qcom,known-device-addresses:  Specifies a list of integers which correspond to
                                the 8-bit BIF bus device addresses of BIF slaves
                                found on the target.

BIF Consumers

Optional properties:
- qcom,bif-ctrl:                phandle of parent BIF controller device node

Example:
	foo_ctrl: foo-controller {
		...
		qcom,known-device-addresses = <0x80, 0x81>;
	};

	bar-consumer {
		...
		qcom,bif-ctrl = <&foo_ctrl>;
	};
```

## Documentation/devicetree/bindings/bif/qpnp-bsi.txt
```
Qualcomm QPNP BSI - battery serial interface devices

qpnp-bsi is a BIF driver which supports the BSI peripheral inside of PMICs
that utilize the MSM SPMI implementation.

Required properties:
- compatible:      Must be "qcom,qpnp-bsi".
- reg:             Specifies the SPMI address and size for this BSI device as
                    well as the address of the BATT_ID status register.
- reg-names:       A list of strings identifying the reg property entries.  The
                    list must contain both "bsi-base" and "batt-id-status".
- label:           A string used as a descriptive name for this BIF controller.
- interrupts:      Specifies a list of four interrupts corresponding to
                    IRQ ERR, IRQ RX, IRQ TX, and IRQ BATT_PRESENT in any order.
- interrupt-names: Must be a list of strings containing all three of these
                    strings: "err", "rx", "tx", "batt-present".  The ordering of
                    these strings must match the ordering of the interrupts in
                    the "interrupts" property.

Required structure:
- A qcom,qpnp-bsi node must be a child of an SPMI node that has specified the
	spmi-slave-container property.

Optional properties:
- qcom,min-clock-period:  This property specifies a minimum clock period for the
                           Tau BIF reference in nanoseconds.  It can be used to
                           impose a minimum period which is higher (i.e. more
                           restrictive) than that supported by the hardware.
                           The BSI module supports 8 possible periods between
                           2080 ns and 150420 ns.
- qcom,max-clock-period:  This property specifies a maximum clock period for the
                           Tau BIF reference in nanoseconds.  It can be used to
                           impose a maximum period which is lower (i.e. more
                           restrictive) than that supported by the hardware.
                           The BSI module supports 8 possible periods between
                           2080 ns and 150420 ns.
- qcom,sample-rate:       Specifies the rate at which the BIF BCL should be
                           sampled during communication with respect to the Tau
                           BIF reference rate.  Supported values are 4 and 8
                           which represent 4x and 8x sampling rates
                           respectively.  If this property is not specified,
                           then 4x sampling is assumed.
- qcom,channel-num:       VADC channel number associated PMIC BATT_ID pin.  If
                           no channel is specified, then it will not be
                           possible to measure the slave Rid.
- qcom,pullup-ohms:       Host side pull-up resistance present on BCL in ohms.
                           If no value is specified, then 100000 ohms is
                           assumed.
- qcom,vref-microvolts:   Reference voltage used for BCL divider circuit in
                           microvolts.  If no value is specified, then
                           1800000 uV is assumed.
- qcom,bsi-vadc:	  Corresponding VADC device phandle.

All properties specified within for the BIF framework can also be used. These
properties can be found in bif.txt.

Example:
	qcom,spmi@fc4c0000 {
		#address-cells = <1>;
		#size-cells = <0>;
		interrupt-controller;
		#interrupt-cells = <3>;

		qcom,pm8941@1 {
			spmi-slave-container;
			reg = <0x1>;
			#address-cells = <1>;
			#size-cells = <1>;

			qcom,bsi@1b00 {
				compatible = "qcom,qpnp-bsi";
				reg = <0x1b00 0x100>,
				      <0x1208 0x1>;
				reg-names = "bsi-base", "batt-id-status";
				label = "pm8941-bsi";
				interrupts = <0x0 0x1b 0x0>,
					     <0x0 0x1b 0x1>,
					     <0x0 0x1b 0x2>,
					     <0x0 0x12 0x0>;
				interrupt-names = "err",
						  "rx",
						  "tx",
						  "batt-present";
				qcom,sample-rate = <8>;
				qcom,min-clock-period = <15830>;
				qcom,max-clock-period = <122080>;
				qcom,channel-num = <0x31>;
				qcom,pullup-ohms = <100000>;
				qcom,vref-microvolts = <1800000>;
				qcom,bsi-vadc = <&pm8941_vadc>;
			};
		};
	};
```

## Documentation/devicetree/bindings/bluetooth/bluesleep.txt
```
* Bluetooth Sleep Protocol driver
Bluetooth controller communicates with the Bluetooth Host using HCI Transport layer.
HCI Transport layer can be based on UART or USB serial communication protocol.

Apart from the transport layer, Bluetooth Controller also supports Low Power Mode
using various mechanisms. One of such mechanism is Out-of-Band Sleep. Also known
as 2-wire sleep mechanism.

Out-of-Band Sleep:
It requires two GPIOs to communicate the sleep protocol between Host and Controller.
One of them is called as Host Wake GPIO where as other is known as a External wake
GPIO.
Host Wake GPIO is used for awake the Host from the Sleep Mode. It is controlled by the
Controller. It should be wakeup interruptible source on the Host.
External Wake GPIO is used for awake the Controller from the Sleep Mode. It is controlled
by the Host.

Required Properties:

  - compatible: Should be "qca,ar3002_bluesleep"
  - host-wake-gpio: Specify GPIO for Host wake signal (Controller -> Host).
  - ext-wake-gpio: Specify GPIO for Controller wake signal(Host -> Controller).
  - interrupt-parent: Should be phandle for the interrupt controller
      that services interrupts for this device.
  - interrupts: Should contain host wake interrupt from controller.
  - interrupt-names: indicates interrupts passed to driver
      (via interrupts property) by name. "host_wake" is mandatory.

Optional Properties:
  None

Example:

	bt_sleep {
		compatible = "qca,ar3002_bluesleep";
		host-wake-gpio = <&msmgpio 12 0>;
		ext-wake-gpio = <&msmgpio 13 0>;
		interrupt-parent = <&msmgpio>;
		interrupts = <12 0>;
		interrupt-names = "host_wake";
	};
```

## Documentation/devicetree/bindings/bluetooth/bluetooth_power.txt
```
* Bluetooth Controller
Bluetooth controller communicates with the Bluetooth Host using HCI Transport
layer. HCI Transport layer can be based on UART or USB serial communication
protocol.

Required properties:
	- compatible: Should be set to one of the following:
		qca,ar3002
		qca,qca6174
		qca,wcn3990
                qca,qca6390
		qca,wcn6750
	- qca,bt-reset-gpio: GPIO pin to bring BT Controller out of reset

Optional properties:
	- qca,bt-vdd-pa-supply: Bluetooth VDD PA regulator handle
	- qca,bt-vdd-io-supply: Bluetooth VDD IO regulator handle
	- qca,bt-vdd-ldo-supply: Bluetooth VDD LDO regulator handle. Kept under
		optional parameters as some of the chipsets doesn't require ldo
		or it may use from same vddio.
	- qca,bt-vdd-xtal-supply: Bluetooth VDD XTAL regulator handle
	- qca,bt-vdd-core-supply: Bluetooth VDD CORE regulator handle
	- qca,bt-vdd-asd-supply: Bluetooth VDD regulator handle for antenna switch
    diversity.
	- qca,bt-chip-pwd-supply: Chip power down gpio is required when bluetooth
		module and other modules like wifi co-exist in a singe chip and
		shares a common gpio to bring chip out of reset.
	- qca,bt-vdd-pa-voltage-level: specifies VDD PA voltage levels for supply.
		Should be specified in pairs (min, max), units uV
	- qca,bt-vdd-io-voltage-level: specifies VDD IO voltage levels for supply.
		Should be specified in pairs (min, max), units uV
	- qca,bt-vdd-ldo-voltage-level: specifies VDD LDO voltage levels for supply.
		Should be specified in pairs (min, max), units uV
	- qca,bt-vdd-xtal-voltage-level: specifies VDD XTAL voltage levels for supply.
		Should be specified in pairs (min, max), units uV
	- qca,bt-vdd-core-voltage-level: specifies VDD CORE voltage levels for supply.
	- qca,bt-vdd-asd-voltage-level: specifies VDD  voltage levels for supply for
    antenna switch diversity.  Should be specified in pairs (min, max), units uV
	- qca,bt-vdd-io-current-level: specifies VDD IO current level in microamps
	- qca,bt-vdd-xtal-current-level: specifies VDD XTAL current level in microamps
	- qca,bt-vdd-core-current-level: specifies VDD CORE current level in microamps.
	- qca,bt-vdd-ldo-current-level: specifies VDD LDO current level in microamps.
	- qca,bt-vdd-pa-current-level: specifies VDD PA current level in microamps.
	- qca,bt-chip-pwd-current-level: specifies Chip Power current level in microamps.
	- qca,bt-vdd-asd-current-level: specifies VDD  ASD current level

Example:
	bluetooth: bt_qca6390 {
		compatible = "qca,qca6390";
		pinctrl-names = "default";
		pinctrl-0 = <&bt_en_sleep>;
		qca,bt-reset-gpio = <&tlmm 21 0>; /* BT_EN */
		qca,bt-vdd-aon-supply = <&pm8150_s6>;
		qca,bt-vdd-dig-supply = <&pm8009_s2>;
		qca,bt-vdd-rfa1-supply = <&pm8150_s5>;
		qca,bt-vdd-rfa2-supply = <&pm8150a_s8>;
		qca,bt-vdd-asd-supply = <&pm8150_l16>;

		qca,bt-vdd-aon-voltage-level = <950000 950000>;
		qca,bt-vdd-dig-voltage-level = <950000 952000>;
		qca,bt-vdd-rfa1-voltage-level = <1900000 1900000>;
		qca,bt-vdd-rfa2-voltage-level = <1350000 1350000>;
		qca,bt-vdd-asd-voltage-level = <3024000 3304000>;

		qca,bt-vdd-asd-current-level = <10000>;

		qca,bt-vdd-io-current-level = <1>; /* LPM/PFM */
		qca,bt-vdd-xtal-current-level = <1>; /* LPM/PFM */
		qca,bt-vdd-core-current-level = <1>; /* LPM/PFM */
		qca,bt-vdd-ldo-current-level = <1>; /* LPM/PFM */
		qca,bt-vdd-pa-current-level = <1>; /* LPM/PFM */
	};
```

## Documentation/devicetree/bindings/bluetooth/btfm_slim.txt
```
* BTFM Slimbus Slave Driver
BTFM Slimbus Slave driver configure and initialize slimbus slave device.
Bluetooth SCO and FM Audio data is transferred over slimbus interface.

Required properties:
	- compatible: Should be set to one of the following:
		btfmslim_slave
	- qcom,btfm-slim-ifd: BTFM slimbus slave device entry name

Optional properties:
	- qcom,btfm-slim-ifd-elemental-addr: BTFM slimbus slave device
		enumeration address

Example:
	btfmslim_codec: wcn3990 {
		compatible = "qcom,btfmslim_slave";
		elemental-addr = [00 01 20 02 17 02];
		qcom,btfm-slim-ifd = "btfmslim_slave_ifd";
		qcom,btfm-slim-ifd-elemental-addr = [00 00 20 02 17 02];
	};
```
