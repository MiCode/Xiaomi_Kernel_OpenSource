## Documentation/devicetree/bindings/arm/msm/clock-krait-8974.txt
```
Qualcomm MSM8974 Krait clock tree

clock-krait-8974 is a device that represents the MSM8974 Krait subsystem
clock tree. It lists the various power supplies that need to be scaled when
the clocks are scaled and also other HW specific parameters like fmax tables,
avs settings table, etc.

Required properties:
- compatible:		Must be "qcom,clock-krait-8974"
- reg:			Pairs of physical base addresses and region sizes of
			memory mapped registers.
- reg-names:		Names of the bases for the above registers. Expected
			bases are:
			"hfpll_l2_clk", "hfpll0_clk", ... "hfpllN_clk", "efuse"
- cpuX-supply:		The regulator powering the CPUX.
- l2-dig-supply:	The regulator powering the L2 digital logic.
- hfpll-dig-supply:	The regulator powering the HFPLL digital domains.
- hfpll-analog-supply:	The regulator powering the HFPLL analog domains.
- qcom,l2-fmax:		A table of L2 frequency to voltage mappings that
			represents the max frequency (Hz) possible for each
			supported voltage level (uV).
- qcom,speedX-pvsY-bin-vZ:
			A table of CPU frequency (Hz) to voltage (uV) and
			current (uA) mapping that represents the max
			frequency possible for each supported voltage level
			for a CPU that's binned as speed bin X, PVS bin Y
			based on characterization version Z. Speed and PVS
			bin values can be between [0-7] and the version can
			be between [0-3]

Optional properties:
- qcom,avs-tbl:		A table of frequencies (Hz) and their corresponding
			AVS DSCR register settings (32 bit value) to program
			into the AVS HW. Frequencies with no AVS support do
			not need to be listed in the table. If there is no
			AVS support at all, then the whole property can be
			omitted.
- qcom,hfpll-config-val:
			A 32 bit value to be programmed into the HFPLL
			configuration control register.
- qcom,hfpll-user-vco-mask:
			The mask to be used when programming the VCO selection
			bits in the user control register.

Example:
	qcom,clock-krait@f9016000 {
		compatible = "qcom,clock-krait-8974";
		reg = <0xf9016000 0x20>,
			<0xf908a000 0x20>,
			<0xf909a000 0x20>,
			<0xf90aa000 0x20>,
			<0xf90ba000 0x20>,
			<0xfc4b80b0 0x08>;
		reg-names = "hfpll_l2_clk", "hfpll0_clk",
				"hfpll1_clk", "hfpll2_clk",
				"hfpll3_clk", "efuse";
		cpu0-supply = <&krait0_vreg>;
		cpu1-supply = <&krait1_vreg>;
		cpu2-supply = <&krait2_vreg>;
		cpu3-supply = <&krait3_vreg>;
		l2-dig-supply = <&pm8841_s2_corner_ao>;
		hfpll-dig-supply = <&pm8841_s2_corner_ao>;
		hfpll-analog-supply = <&pm8941_l12_ao>;

		qcom,l2-fmax =
			<  576000000 4 /* svs_soc */	>,
			< 1036800000 5 /* normal */	>,
			< 1728000000 7 /* super_turbo */>;

		qcom,avs-tbl =
			<  300000000 0xfa70054 >,
			< 1574400000 0xfa70100 >;

		qcom,speed0-pvs0-bin-v0 =
			<          0       0   0 >,
			<  300000000  815000  73 >,
				.....
				.....
			< 1958400000 1100000 598 >;

		qcom,speed0-pvs1-bin-v0 =
			<          0       0   0 >,
			<  300000000  800000  73 >,
				.....
				.....
			< 1958400000 1075000 598 >;

				.....
				.....

		qcom,speed2-pvs6-bin-v0 =
			<          0       0   0 >,
			<  300000000  750000  72 >,
				.....
				.....
			< 2265600000  950000 691 >;

	};
```

## Documentation/devicetree/bindings/arm/msm/clock-pm.txt
```
* clock PM

This driver is intended to handle any changes related to power management clocks.
Registers with CPU PM notification call back to handle bimc/apss hardware clock gating.

Required properties

- compatible: "qcom,clock-pm"

Optional properties

- clocks: clock identifers used by clock driver while looking up apss clocks.
- clock-names: name of the clock used by the driver.

[Example dts]

qcom,clock-pm {
	compatible = "qcom,clock-pm";
		clocks = <&clock_gcc clk_apss_axi_clk_sleep>,
				<&clock_gcc clk_bimc_apss_axi_clk_sleep>;
		clock-names = "apss_axi", "bimc_apss_axi";
};
```

## Documentation/devicetree/bindings/arm/msm/cmd-db.txt
```
Command DB
---------

Command DB is a database that provides a mapping between resource key and
the resource address for a system resource managed by RPMh. The data is
stored in a shared memory region and is loaded by the remote processor.

Some of the "Qualcomm Technologies Inc" SOC's have hardware accelerators
for controlling shared resources.  The HW accelerator associated to a given
resource could change between builds when accelerators are added/removed.
To remove dependencies between multiple images in a SoC, Command DB allows
drivers to query resource parameters based on predetermined key strings.

The devicetree representation of the command DB driver should be:

PROPERTIES:
- compatible:
	Usage: required
	Value type: <string>
	Definition: Should be "qcom,cmd-db"

- reg:
	Usage: required
	Value type: <prop-encoded-array>
	Definition: First element is the base address of shared memory
		Second element is the size of the shared memory region
		Points to the dictionary address that houses the command DB
		start address and the size of the command DB region

Example:

qcom,cmd-db@861e0000 {
	compatible = "qcom,cmd-db";
	reg = <0xc3f000c 0x8>;
}
```

## Documentation/devicetree/bindings/arm/msm/core_sleep_status.txt
```
* MSM Sleep status

MSM Sleep status device is used to check the power collapsed status of a
offlined core. The core that initiates the hotplug would wait on the
sleep status device before CPU_DEAD notifications are sent out. Some hardware
devices require that the offlined core is power collapsed before turning off
the resources that are used by the offlined core.

The required properties of core sleep status node are:
- compatible: qcom,cpu-sleep-status

The required properties of sleep status node are:
- reg: physical address of the sleep status register for the cpus
- qcom,cpu-sleep-status-mask - The bit mask within the status register that
	indicates the Core's sleep state.

Example:
	qcom,cpu-sleep-status {
		compatible = "qcom,cpu-sleep-status";
	};

	cpus {
		#address-cells = <2>;
		#size-cells = <0>;

		CPU0: cpu@0 {
			device_type = "cpu";
			compatible = "qcom,kryo";

			qcom,sleep-status = <&cpu0_slp_sts>;
		};

		CPU1: cpu@1 {
			device_type = "cpu";
			compatible = "qcom,kryo";

			qcom,sleep-status = <&cpu1_slp_sts>;
		};
	};

	cpu0_slp_sts: cpu-sleep-status@9981058 {
		reg = <0x9981058 0x100>;
		qcom,sleep-status-mask = <0xc00000>;
	};

	cpu1_slp_sts: cpu-sleep-status@9991058 {
		reg = <0x9991058 0x100>;
		qcom,sleep-status-mask = <0xc00000>;
	}
```
