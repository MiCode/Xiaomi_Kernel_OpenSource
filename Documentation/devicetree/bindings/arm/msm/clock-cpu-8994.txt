## Documentation/devicetree/bindings/arm/msm/cpu-ldo-ret-8994.txt
```
*8994 CPU LDO Retention Voltage Configuration

This device is used to program the appropriate LDO voltage for 8994 target
from the pre-programmed register.

Required properties:
- compatible:
		Must be "qcom,8994-cpu-ldo-vref"
- reg:
		The register holds the base address to LDO_BHS. Use this
		register base to configure the LDO for all the cpus.
- qcom,ldo-vref-ret:
		Value to which the ldo voltage reference needs to be
		programmed.
		Value to be used is encoded. 0x20 = 0.5V and 0x2a = 0x55V

Example:
	ldo0:ldo-vref@f9070000 {
		compatible = "qcom,8994-cpu-ldo-vref";
		reg = <0xf9070000 0x30>,
		qcom,ldo-vref-ret = <0x20>;
	};
```

## Documentation/devicetree/bindings/arm/msm/cpubw.txt
```
MSM CPU bandwidth device

cpubw is a device that represents the CPU subsystem master ports in a MSM SoC
and the related info that is needed to make CPU to DDR bandwidth votes.

Required properties:
- compatible:		Must be "qcom,cpubw"
- qcom,cpu-mem-ports:	A list of tuples where each tuple consists of a bus
			master (CPU subsystem) port number and a bus slave
			(memory) port number.
- qcom,bw-tbl:		A list of meaningful instantaneous bandwidth values
			(in MB/s) that can be requested from the CPU
			subsystem to DDR. The list of values depend on the
			supported DDR frequencies and the bus widths.

Optional properties:
- qcom,ab-tbl:		A list of pre-calculated absolute bandwidth values
			(in MB/s) that can be requested from the CPU subsystem
			to DDR for particular instantaneous bandwidth. The list
			of values could depend on a certain percentage of
			instantaneous bandwidth.

Example:

	qcom,cpubw {
		compatible = "qcom,cpubw";
		qcom,cpu-mem-ports = <1 512>, <2 512>;
		qcom,bw-tbl =
			<  572 /*  75 MHz */ >,
			< 1144 /* 150 MHz */ >,
			< 1525 /* 200 MHz */ >,
			< 2342 /* 307 MHz */ >,
			< 3509 /* 460 MHz */ >,
			< 4684 /* 614 MHz */ >,
			< 6103 /* 800 MHz */ >,
			< 7102 /* 931 MHz */ >;
	};
```

## Documentation/devicetree/bindings/arm/msm/cpuss-8994.txt
```
*CPUSS-8994

CPUSS refers to the CPU sub-system and this node provides the base address to the CPU sub-system
registers like TCSR_HW_SOC_VERSION which contain the CPU SOC VERSION for 8994 and variant chips.

compatible:	Must be "qcom,cpuss-8994"
reg:		Base Address for the CPUSS

Example:
 tss@fd4a8000 {
               compatible = "qcom,cpuss-8994";
               reg = <0xfd4a8000 0x4>;
 };
```

## Documentation/devicetree/bindings/arm/msm/dcvs-core-info.txt
```
DCVS Core Info

This data describes specific DCVS tuning data for a specific core (CPU, GPU,
etc).

Required properties:

- qcom,core-core-type:	indicates whether this core is a CPU(0) or a GPU(1)

- qcom,num-cores:	The number of cores this entry represents
- qcom,sensors:		The vector of sensor ids for the cores

- qcom,algo-disable-pc-threshold:	sets highest frequency at which DCVS
					will allow the CPU to power collapse.
- qcom,algo-em-win-size-min-us:		sets minimum Energy Minimization(EM)
					window size.

- qcom,algo-em-win-size-max-us:		sets maximum EM window size.
- qcom,algo-em-max-util-pct:		sets maximum CPU utilization that will
					not be exceeded by any core when
					MP-decision decides the number of
					online cores.
- qcom,algo-group-id:			specifies a group index of a core.
- qcom,algo-max-freq-chg-time-us:	shows time taken for the most recent
					frequency change.
- qcom,algo-slack-mode-dynamic:	 	specifies if dynamic slack mode is
					enabled or not.
- qcom,algo-slack-weight-thresh-pct:	sets occurrence percentage of CPU
					activity that will make slack timer
					triggered.
- qcom,algo-slack-time-min-us:		specifies the slack time that slack
					timer would be set if the current clock
					frequency is zero.
- qcom,algo-slack-time-max-us:		sets maximum slack timer value to be
					used by slack timer.
- qcom,algo-ss-win-size-min-us:		sets minimum steady state window size.
- qcom,algo-ss-win-size-max-us:		sets maximum steady state window size.
- qcom,algo-ss-util-pct:		sets target CPU utilization during
					steady-state.
- qcom,algo-ss-no-corr-below-freq:	specifies frequency below which DCVS
					will not attempt to correlate busy or
					idle information from different CPUs

- qcom,energy-active-coeff-a:	sets active power equation coefficient a.
- qcom,energy-active-coeff-b:	sets active power equation coefficient b.
- qcom,energy-active-coeff-c:	sets active power equation coefficient c.
- qcom,energy-leakage-coeff-a:	sets leakage power equation coefficient a.
- qcom,energy-leakage-coeff-b:	sets leakage power equation coefficient b.
- qcom,energy-leakage-coeff-c:	sets leakage power equation coefficient c.
- qcom,energy-leakage-coeff-d:	sets leakage power equation coefficient d.

- qcom,power-current-temp:	the current temperature in degCelcius.
- qcom,power-num-freq:		the number of freq this core supports.

A number of frequency levels are represented as sub-nodes:

required properties:
- reg:			The index of the frequency entry
- qcom,freq		The frequency of the DVS entry (in kHZ)
- qcom,is_trans_level	This frequency is transient step for DCVS
- qcom,active-energy-offset:	The active energy cost of the entry
- qcom,leakage-energy-offset: 	The leakage energy cost of the entry

Sample:

qcom,kgsl-3d0@fdb00000 {
	...
		qcom,dcvs-core-info {
			#address-cells = <1>;
			#size-cells = <0>;

			compatible = "qcom,dcvs-core-info";

			qcom,num-cores = <1>;
			qcom,sensors = <0>;

			qcom,core-core-type = <1>;

			qcom,algo-disable-pc-threshold = <0>;
			qcom,algo-em-win-size-min-us = <100000>;
			qcom,algo-em-win-size-max-us = <300000>;
			qcom,algo-em-max-util-pct = <97>;
			qcom,algo-group-id = <95>;
			qcom,algo-max-freq-chg-time-us = <100000>;
			qcom,algo-slack-mode-dynamic = <100000>;
			qcom,algo-slack-weight-thresh-pct = <0>;
			qcom,algo-slack-time-min-us = <39000>;
			qcom,algo-slack-time-max-us = <39000>;
			qcom,algo-ss-win-size-min-us = <1000000>;
			qcom,algo-ss-win-size-max-us = <1000000>;
			qcom,algo-ss-util-pct = <95>;
			qcom,algo-ss-no-corr-below-freq = <0>;

			qcom,energy-active-coeff-a = <2492>;
			qcom,energy-active-coeff-b = <0>;
			qcom,energy-active-coeff-c = <0>;
			qcom,energy-leakage-coeff-a = <11>;
			qcom,energy-leakage-coeff-b = <157150>;
			qcom,energy-leakage-coeff-c = <0>;
			qcom,energy-leakage-coeff-d = <0>;

			qcom,power-current-temp = <25>;
			qcom,power-num-freq = <4>;

			qcom,dcvs-freq@0 {
				reg = <0>;
				qcom,freq = <0>;
				qcom,voltage = <0>;
				qcom,is_trans_level = <0>;
				qcom,active-energy-offset = <100>;
				qcom,leakage-energy-offset = <0>;
			};

			qcom,dcvs-freq@1 {
				reg = <1>;
				qcom,freq = <0>;
				qcom,voltage = <0>;
				qcom,is_trans_level = <0>;
				qcom,active-energy-offset = <100>;
				qcom,leakage-energy-offset = <0>;
			};

			qcom,dcvs-freq@2 {
				reg = <2>;
				qcom,freq = <0>;
				qcom,voltage = <0>;
				qcom,is_trans_level = <0>;
				qcom,active-energy-offset = <100>;
				qcom,leakage-energy-offset = <0>;
			};

			qcom,dcvs-freq@3 {
				reg = <3>;
				qcom,freq = <0>;
				qcom,voltage = <0>;
				qcom,is_trans_level = <0>;
				qcom,active-energy-offset = <844545>;
				qcom,leakage-energy-offset = <0>;
			};
		};
	...
};
```

## Documentation/devicetree/bindings/arm/msm/ddr_stats.txt
```
* DDR Stats

AOP maintains DDR statistics like DDR LPMs and frequency stats. DDR stats
driver gives sysfs interface to display this.

PROPERTIES

- compatible:
	Usage: required
	Value type: <string>
	Definition: Should be "qcom,ddr-stats".

- reg:
	Usage: required
	Value type: <prop-encoded-array>
	Definition: The address on the AOP Message RAM from where the stats
		    are read should be provided as "phys_addr_base".
		    The offset from which the stats are available should be
		    provided as "offset_addr".

- reg-names:
	Usage: required
	Value type: <prop-encoded-array>
	Definition: Provides labels for the reg property.

EXAMPLE:
	qcom,ddr-stats@c300000 {
		compatible = "qcom,ddr-stats";
		reg = <0xc300000 0x1000>, <0xc3f001c 0x4>;
		reg-names = "phys_addr_base", "offset_addr";
	};
```

## Documentation/devicetree/bindings/arm/msm/debug-pc-cntr.txt
```
* MSM PC Debug Counters

MSM PC debug counter reserves 16 registers in the IMEM memory space which
maintains a count on the state of power collapse on each core. This count
will be useful to debug the power collapse state on each core.

The required nodes for MSM PC Debug Counters are:

- compatible: "qcom,pc-cntr"
- reg: physical IMEM address reserved for PC counters

Example:

qcom,pc-cntr@fe800000 {
		compatible = "qcom,pc-cntr";
		reg = <0xfe800664 0x40>;
	};
```

## Documentation/devicetree/bindings/arm/msm/diag.txt
```
Qualcomm Technologies, Inc. Diagnostic Services

Diag is used for generating Diagnostic Packets (F3s, Logs and Events) from the application
processor. It also support sending and receiving commands/responses to/from the target.
Diag will also communicate with MDM through either USB or HSIC bridge. This node will decide
which interface diag need to choose to communicate with MDM. This node will enable USB as the
bridge interface otherwise diag will choose HSIC (MHI) as the default bridge interface.

Required properties:
-compatible: should be "qcom,diag"
-qcom,usb-enabled: this will enable usb as the bridge interface for diag
		   to communicate with remote peripheral.

Example:

	qcom,diag {
		compatible = "qcom,diag";
		qcom,usb-enabled;
	};
```

## Documentation/devicetree/bindings/arm/msm/diag_mhi.txt
```
Qualcomm Technologies, Inc. Diag MHI Driver

Required properties:
-compatible : should be "qcom,diag-mhi".
-qcom,mhi : phandle of MHI Device to connect to.

Example:
	qcom,diag {
		compatible = "qcom,diag-mhi";
		qcom,mhi = <&mhi_wlan>;
	};
```

## Documentation/devicetree/bindings/arm/msm/diagfwd_sdio.txt
```
QTI Diag Forward SDIO Driver

Required properties:
-compatible : should be "qcom,diagfwd-sdio".

Example:
	qcom,diag {
		compatible = "qcom,diagfwd-sdio";
	};
```

## Documentation/devicetree/bindings/arm/msm/diagfwd_usb.txt
```
QTI Diag Forward USB Driver

Required properties:
-compatible : should be "qcom,diagfwd-usb".

Example:
	qcom,diag {
		compatible = "qcom,diagfwd-usb";
	};
```

## Documentation/devicetree/bindings/arm/msm/ext-buck-control.txt
```
* MSM EXT BUCK REGULATOR CONTROL

External buck regulator is used to power up the APC rail.
This buck can be turn-on & turn-off by toggling a gpio
line which is connected to buck enable pin. This driver
control the external regulator behaviour with the help
of RPM by sending the sleep and active sets when APPS
decide to enter into low power state with RPM assisted.

The required properties for EXT BUCK CONTROL are:

- compatible: "qcom,ext-buck-control"

The optional properties are:
- qcom,gpio-num: Indicates the GPIO number which will turn-on and turn-off
		 the external buck.
- qcom,settling-time-us: Indicates the settling time for the external buck to
			 get turn-on or turn-off. Settling time is calculated
			 in terms of QTIMER(19.2MHz) and the value is in us.

Example:
	qcom,ext-buck-control {
		compatible = "qcom,ext-buck-control";
		qcom,gpio-num = <50>;
		qcom,settling-time-us = <2580>;
};
```

## Documentation/devicetree/bindings/arm/msm/ext-buck-support.txt
```
* MSM EXT BUCK SUPPORT

EXT BUCK SUPPORT driver is for supporting the external buck controlled by RPM.
This driver sends active and sleep set votes when handshaking with rpm for
supporting external buck by toggling a gpio to trun-on and turn-off external
buck.

The required properties for EXT BUCK SUPPORT are:

- compatible: "qcom,ext-buck-support"

The optional properties are:
- qcom,gpio-num: Indicates the GPIO number which will turn-on and turn-off
		 the external buck.
- qcom,settling-time: Indicates the settling time for the external buck to
		      get turn-on or turn-off. Settling time is calculated
		      in terms of QTIMER(19.2MHz).

Example:
	qcom,ext-buck-support {
		compatible = "qcom,ext-buck-support";
		qcom,gpio-num = <50>;
		qcom,settling-time = <2580>;
	};
```

## Documentation/devicetree/bindings/arm/msm/glink_bgcom_xprt.txt
```
Qualcomm Technologies, Inc. G-link bgcom Transport

Required properties:
-compatible : should be "qcom,glink-bgcom-xprt".
-label : the name of the subsystem this link connects to.

Optional properties:
-qcom,qos-config: Reference to the qos configuration elements.It depends on
		ramp-time.
-qcom,ramp-time: Worst case time in microseconds to transition to this power
		state. Power states are numbered by array index position.

Example:

	qcom,glink-bgcom-xprt-bg {
		compatible = "qcom,glink-bgcom-xprt";
		label = "bg";
		qcom,qos-config = <&glink_qos_bg>;
		qcom,ramp-time = <0x10>,
				     <0x20>,
				     <0x30>,
				     <0x40>;
	};

	glink_qos_bg: qcom,glink-qos-config-bg {
		compatible = "qcom,glink-qos-config";
		qcom,flow-info = <0x80 0x0>,
				 <0x70 0x1>,
				 <0x60 0x2>,
				 <0x50 0x3>;
		qcom,mtu-size = <0x800>;
		qcom,tput-stats-cycle = <0xa>;
	};
```

## Documentation/devicetree/bindings/arm/msm/glink_config_qos.txt
```
Qualcomm Technologies, Inc. G-link QoS Configuration

Required properties:
-compatible : should be "qcom,glink-qos-config"
-qcom,flow-info : A table of MTU transmission time specific for a power state.
		The total number of entries in the table should be equal to the
		number of supported flows.
-qcom,mtu-size : The MTU size for which the qos elements are configured.
-qcom,tput-stats-cycle: The number of allowable cycles for a packet to be
			transmitted without its priority being re-evaluated.

Example:

	qcom,glink-qos-config-adsp {
		compatible = "qcom,glink-qos-config";
		qcom,flow-info = <0x80 0x0>,
				 <0x70 0x1>,
				 <0x60 0x2>,
				 <0x50 0x3>;
		qcom,mtu-size = <0x800>;
		qcom,tput-stats-cycle = <0xa>;
	};
```

## Documentation/devicetree/bindings/arm/msm/glink_mailbox_xprt.txt
```
Qualcomm Technologies, Inc. G-link Mailbox Transport

Required properties:
-compatible : should be "qcom,glink-mailbox-xprt"
-reg : the mailbox register to store the location of the fifo
	the mailbox register to store the size of the fifo
	the irq register base address for triggering interrupts
	the register to enable sending interrupts
	the register to reset the rx irq line
-reg-names : "mbox-loc-addr" - string to identify the mailbox location reg
		"mbox-loc-size" - string to identify the mailbox size reg
		"irq-reg-base" - string to identify the irq register region
		"irq-rx-reset" - string to identify the rx irq reset register
-qcom,irq-mask : the bitmask to trigger an interrupt
-interrupts : the receiving interrupt line
-label : the name of the subsystem this link connects to
-qcom,tx-ring-size: size of the transmit ring buffer in bytes
-qcom,rx-ring-size: size of the receive ring buffer in bytes

Example:

	qcom,glink-mailbox-xprt-spss@1d05008 {
		compatible = "qcom,glink-mailbox-xprt";
		reg = <0x1d05008 0x8>,
			<0x1d05010 0x4>,
			<0x1d06004 0x4>,
			<0x1d06020 0x4>;
		reg-names = "mbox-loc-addr", "mbox-loc-size", "irq-reg-base",
			"irq-rx-reset";
		qcom,irq-mask = <0x1000>;
		interrupts = <0 25 4>;
		label = "spss";
		qcom,tx-ring-size = <0x400>;
		qcom,rx-ring-size = <0x400>;
	};
```
