## Documentation/devicetree/bindings/arm/msm/clock-cpu-8994.txt
```
Qualcomm MSM8994 CPU clock tree

clock-cpu-8994 is a device that represents the MSM8994 CPU subsystem
clock tree. It lists the various power supplies that need to be scaled when
the clocks are scaled and also other HW specific parameters like fmax tables,
avs settings table, etc.

Required properties:
- compatible:		Must be "qcom,clock-cpu-8994"
- reg:			Pairs of physical base addresses and region sizes of
			memory mapped registers.
- reg-names:		Names of the bases for the above registers. Expected
			bases are:
			"c0_pll", "c1_pll", "cci_pll", "c0_mux",
			"c1_mux", "cci_mux"
- vdd-a53-supply:	The regulator powering the A53 cluster
- vdd-a57-supply:	The regulator powering the A57 cluster
- vdd-cci-supply:	The regulator powering the CCI cluster
- vdd-pll-supply:	The regulator powering the cluster PLLs
- qcom,a5X-speedbinY-vZ:
			A table of CPU frequency (Hz) to voltage (corner)
			mapping that represents the max frequency possible
			for each supported voltage level for a CPU. 'Y' is
			the speed bin into which the device falls into - a
			bin will have unique frequency-voltage relationships.
			'Z' is the characterization version, implying that
			characterization (deciding what speed bin a device
			falls into) methods and/or encoding may change. The
			values 'Y' and 'Z' are read from efuse registers, and
			the right table is picked from multiple possible tables.
			 'X' is 3 or 7 depending on whether the table is for the
			A53 or A57 cluster.
- qcom,cci-speedbinY-vZ:
			Similar to the qcom,a5X-speedbinY-vZ property described
			above, except this frequency to voltage table is applied
			to the clock for the CCI.
Example:
	clock_cpu: qcom,cpu-clock-8994@f9015000 {
		compatible = "qcom,cpu-clock-8994";
		reg = <0xf9015000 0x1000>,
		      <0xf9016000 0x1000>,
		      <0xf9011000 0x1000>,
		      <0xf900d000 0x1000>,
		      <0xf900f000 0x1000>,
		      <0xf9112000 0x1000>;
		reg-names = "c0_pll", "c1_pll", "cci_pll", "c0_mux", "c1_mux", "cci_mux";
		vdd-a53-supply = <&apc0_vreg_corner>;
		vdd-a57-supply = <&apc1_vreg_corner>;
		qcom,a53-speedbin0-v0 =
			<         0 0>,
			< 384000000 1>,
			< 787200000 2>,
			<1286400000 3>;
		qcom,a57-speedbin0-v0 =
			<         0 0>,
			< 384000000 1>,
			< 787200000 2>,
			<1785600000 3>;
		qcom,cci-speedbin0-v0 =
			<         0 0>,
			< 150000000 1>,
			< 300000000 2>,
			< 600000000 3>;
		clock-names = "xo", "aux_clk";
		clocks = <&clock_rpm clk_cxo_clk_src>,
			 <&clock_gcc clk_gpll0_ao>;
		#clock-cells = <1>;
	};
```

## Documentation/devicetree/bindings/arm/msm/clock-cpu-8996.txt
```
Qualcomm MSM 8996 CPU clock tree

clock-cpu-8996 is a device that represents the MSM 8996 CPU subsystem
clock tree. It lists the various power supplies that need to be scaled when
the clocks are scaled and also other HW specific parameters like fmax tables,
PLL FMAXes etc.

Required properties:
- compatible:		Must be either "qcom,cpu-clock-8996" or
			"qcom,cpu-clock-8996-v3"
- reg:			Pairs of physical base addresses and region sizes of
			memory mapped registers.
- reg-names:		Names of the bases for the above registers. Expected
			bases are:
			"pwrcl_pll", "perfcl_pll", "cbf_pll", "pwrcl_mux",
			"perfcl_mux", "cbf_mux", "efuse";
- vdd-perfcl-supply:	The regulator powering the power cluster
- vdd-pwrcl-supply:	The regulator powering the perf cluster
- vdd-cbf-supply:	The regulator powering the CBF interconnect
- vdd-dig-supply:	The regulator powering the cluster PLLs
- qcom,pwrcl-speedbinY-vZ:
			A table of CPU frequency (Hz) to voltage (corner)
			mapping that represents the max frequency possible
			for each supported voltage level for the power cluster.
			'Y' is the speed bin into which the device falls into -
			a bin will have unique frequency-voltage relationships.
			'Z' is the characterization version, implying that
			characterization (deciding what speed bin a device
			falls into) methods and/or encoding may change. The
			values 'Y' and 'Z' are read from efuse registers, and
			the right table is picked from multiple possible tables.
- qcom,perfcl-speedbinY-vZ:
			Similar to the qcom,pwrcl-speedbinY-vZ property above,
			except this frequency to voltage table is applied to the
			clock for the perf cluster.
- qcom,cbf-speedbinY-vZ:
			Similar to the qcom,perfcl-speedbinY-vZ property above,
			except this frequency to voltage table is applied to the
			clock for the CBF.
- cbf-dev:		The CBF cache device to which the OPP table for the
			CBF clock domain will be added.
Example:
	clock_cpu: qcom,cpu-clock-8996@ {
		compatible = "qcom,cpu-clock-8996";
		reg = <0x06400000 0x1000>,
		      <0x06480000 0x1000>,
		      <0x09A20000 0x1000>,
		      <0x06400000 0x1000>,
		      <0x06480000 0x1000>,
		      <0x09A11000 0x1000>,
		      <0x00070130 0x8>;
		reg-names = "pwrcl_pll", "perfcl_pll", "cbf_pll", "pwrcl_mux", "perfcl_mux", "cbf_mux", "efuse";
		vdd-pwrcl-supply = <&apc_vreg_corner>;
		vdd-perfcl-supply = <&apc_vreg_corner>;
		vdd-cbf-supply = <&apc_vreg_corner>;
		vdd-dig-supply = <&pm8994_s1_corner_ao>;
		qcom,pwrcl-speedbin0-v0 =
			<          0  0 >,
			<  300000000  1 >,
			<  345600000  2 >,
			<  422400000  3 >,
			< 1459200000 18 >;
		qcom,perfcl-speedbin0-v0 =
			<          0  0 >,
			<  300000000  1 >,
			<  345600000  2 >,
			<  422400000  3 >,
			< 1593600000 18 >;
		qcom,cbf-speedbin0-v0 =
			<	   0  0 >,
			<  300000000  1 >,
			<  384000000  3 >,
			< 1036800000 18 >;
		clock-names = "xo_ao", "aux_clk";
		clocks = <&clock_gcc clk_cxo_clk_src_ao>,
			 <&clock_gcc clk_gpll0_out_main>;
		#clock-cells = <1>;
	};
```

## Documentation/devicetree/bindings/arm/msm/clock-cpu-rcgwr.txt
```
Qualcomm CPU clock Ramp Controller

The root clock generator could have the ramp controller in built.
Ramp control will allow programming the sequence ID for pulse swallowing,
enable sequence and for linking sequence IDs.

This will use the cpu clock device node.

Required properties:
- reg:			Pairs of physical base addresses and region sizes of
			memory mapped registers.
- reg-names:		Names of the bases for the above registers. Expected
			bases are:
			"rcgwr-cX-base" (X: 0 or 1 based on the number of
			clusters)
- qcom,num-clusters:	Number of clusters which support RCGwR.

Optional Properties:
- qcom,lmh-sid-cX:	List of LMH SID offset and value to be programmed for
			each cluster (X: 0 or 1)
- qcom,link-sid-cX:	List of Link SID offset and value to be programmed for
			each cluster (X: 0 or 1)
- qcom,dfs-sid-cX:	List of DFS SID offset and value to be programmed for
			each cluster (X: 0 or 1)
- qcom,ramp-dis-cX:	Boolean property to disable ramp down for each cluster
			(X: 0 or 1)

Example:
        clock_cpu: qcom,cpu-clock@b016000 {
                compatible = "qcom,cpu-clock";
		qcom,num-clusters = <2>;
		qcom,lmh-sid-c0  = < 0x30 0x077706db>,
				   < 0x34 0x05550249>,
				   < 0x38 0x00000111>;
		qcom,lmh-sid-c1  = < 0x30 0x077706db>,
				   < 0x34 0x05550249>,
				   < 0x38 0x00000111>;
                reg = <0xb114000 0x68>,
		      <0xb014000 0x68>;
                reg-names = "rcgwr-c0-base", "rcgwr-c1-base";
                #clock-cells = <1>;
};
```

## Documentation/devicetree/bindings/arm/msm/clock-cpu-sdm632.txt
```
Qualcomm Technologies, Inc SDM632 CPU clock driver

clock-cpu-sdm632 is a device that represents the SDM632 CPU subystem clock
tree. It lists the various power supplies that need to be scaled when the
clocks are scaled and also other HW specific parameters like fmax tables etc.

The root clock generator could have the ramp controller in built.
Ramp control will allow programming the sequence ID for pulse swallowing,
enable sequence and for linking sequence IDs.

Required properties:
- compatible:		Must be "qcom,clock-cpu-sdm632".

- reg:			Pairs of physical base addresses and region sizes of
			memory mapped registers.
- reg-names:		Names of the bases for the above registers. Expected
			bases are:
			"apcs-c1-pll-base", "apcs-c0-pll-base",
			"apcs-cci-pll-base", "apcs-c1-rcg-base",
			"apcs-c0-rcg-base", "apcs-cci-rcg-base",
			"efuse", "rcgwr-c0-base(optional)",
			"rcgwr-c1-base(optional)".
- clocks:		The clocks sources used by the cluster/cci mux.
- clock-names:		Name of the clocks for the above clocks.
- vdd-mx-supply:	The regulator powering all the PLLs of clusters & cci.
- vdd-c0-supply:	The regulator powering the cluster 0.
- vdd-c1-supply:	The regulator powering the cluster 1.
- vdd-cci-supply:	The regulator powering the CCI cluster.

- qcom,speedX-bin-vY-ZZZ:
			A table of CPU frequency (Hz) to voltage (corner)
			mapping that represents the max frequency possible
			for each supported voltage level for a CPU. 'X' is
			the speed bin into which the device falls into - a
			bin will have unique frequency-voltage relationships.
			'Y' is the characterization version, implying that
			characterization (deciding what speed bin a device
			falls into) methods and/or encoding may change. The
			values 'X' and 'Y' are read from efuse registers, and
			the right table is picked from multiple possible tables.
			'ZZZ' can be cl for(c0 & c1) or cci depending on whether
			the table for the clusters or cci.

Example:
	clock_cpu {
		compatible = "qcom,cpu-clock-sdm632";
		reg =   <0xb114000  0x68>,
			<0xb014000  0x68>,
			<0xb016000  0x8>,
			<0xb116000  0x8>,
			<0xb1d0000  0x8>,
			<0xb011050  0x8>,
			<0xb111050  0x8>,
			<0xb1d1050  0x8>,
			<0x00a412c  0x8>;
		reg-names = "rcgwr-c0-base", "rcgwr-c1-base",
			    "apcs-c1-pll-base", "apcs-c0-pll-base",
			    "apcs-cci-pll-base", "apcs-c1-rcg-base",
			    "apcs-c0-rcg-base", "apcs-cci-rcg-base",
			    "efuse";
		qcom,num-clusters = <2>;
		vdd-mx-supply = <&pm8953_s7_level_ao>;
		vdd-c0-supply = <&apc_vreg_corner>;
		vdd-c1-supply = <&apc_vreg_corner>;
		vdd-cci-supply = <&apc_vreg_corner>;
		clocks = <&clock_gcc clk_xo_a_clk_src>;
		clock-names = "xo_a";
		qcom,speed0-bin-v0-c0 =
			<          0 0>,
			<   614400000 1>,
			<   883200000 2>,
			<  1036200000 3>,
			<  1363200000 4>,
			<  1563000000 5>,
			<  1670400000 6>,
			<  1785600000 7>;
		qcom,speed0-bin-v0-c1 =
			<          0 0>,
			<   633600000 1>,
			<   902400000 2>,
			<  1094400000 3>,
			<  1401600000 4>,
			<  1555200000 5>,
			<  1785600000 6>;
		qcom,speed0-bin-v0-cci =
			<          0 0>,
			<  307200000 1>,
			<  403200000 2>,
			<  499200000 3>,
			<  691200000 4>,
			<  768000000 5>,
			<  787200000 6>;
		#clock-cells = <1>;
	};
```

## Documentation/devicetree/bindings/arm/msm/clock-cpu-titanium.txt
```
Qualcomm MSMTITANIUM CPU clock tree

clock-cpu-titanium is a device that represents the MSMTITANIUM CPU subystem clock
tree. It lists the various power supplies that need to be scaled when the
clocks are scaled and also other HW specific parameters like fmax tables etc.

The root clock generator could have the ramp controller in built.
Ramp control will allow programming the sequence ID for pulse swallowing,
enable sequence and for linking sequence IDs.

Required properties:
- compatible:		Must be "qcom,clock-cpu-titanium".

- reg:			Pairs of physical base addresses and region sizes of
			memory mapped registers.
- reg-names:		Names of the bases for the above registers. Expected
			bases are:
			"c0-pll", "c1-pll", "c0-mux", "c1-mux", "cci-mux",
			"efuse", "perf_base"(optional), "rcgwr-c0-base(optional)",
			"rcgwr-c1-base(optional)".
- clocks:		The clocks sources used by the cluster/cci mux.
- clock-names:		Name of the clocks for the above clocks.
- vdd-mx-supply:	The regulator powering all the PLLs of clusters & cci.
- vdd-cl-supply:	The regulator powering the clusters & cci.
- qcom,speedX-bin-vY-ZZZ:
			A table of CPU frequency (Hz) to voltage (corner)
			mapping that represents the max frequency possible
			for each supported voltage level for a CPU. 'X' is
			the speed bin into which the device falls into - a
			bin will have unique frequency-voltage relationships.
			'Y' is the characterization version, implying that
			characterization (deciding what speed bin a device
			falls into) methods and/or encoding may change. The
			values 'X' and 'Y' are read from efuse registers, and
			the right table is picked from multiple possible tables.
			'ZZZ' can be cl for(c0 & c1) or cci depending on whether
			the table for the clusters or cci.

Optional Properties:
- qcom,pboost-delta:    Array of performance boost frequencies (in MHz). If
			defined, the "safe_l" value column is required to be
			defined along with speedX-bin-vY-cl as indicated in
			below example.
- qcom,enable-vmin:     Boolean property if defined denotes presence of VMin
			reduction available for clusters.
			If defined, the "safe_l" value column is required to be
			defined along with speedX-bin-vY-cl as indicated in
			below example.
- qcom,enable-boost:    Boolean property if defined denotes presence of boost
			available for clusters.
			If defined, the "safe_l" value column is required to be
			defined along with speedX-bin-vY-cl as indicated in
			below example.
- qcom,enable-qos:      Boolean property to indicate the pm qos is required
			during set rate of the cluster clocks, which would not
			allow the cluster cores to go to low power mode.

Example:
	clock_cpu: qcom,cpu-clock-titanium@b116000 {
		compatible = "qcom,cpu-clock-titanium";
		reg =   <0xb114000  0x68>,
			<0xb014000  0x68>,
			<0xb116000  0x400>,
			<0xb111050  0x08>,
			<0xb011050  0x08>,
			<0xb1d1050  0x08>,
			<0x00a412c  0x08>;
		reg-names = "rcgwr-c0-base", "rcgwr-c1-base",
			    "c0-pll", "c0-mux", "c1-mux",
			    "cci-mux", "efuse";
		vdd-mx-supply = <&pmtitanium_s7_level_ao>;
		vdd-cl-supply = <&apc_vreg_corner>;
		clocks = <&clock_gcc clk_xo_a_clk_src>;
		clock-names = "xo_a";
		qcom,num-clusters = <2>;
		qcom,speed0-bin-v0-cl =
			<          0 0>,
			< 2208000000 7>;
		qcom,speed0-bin-v0-cci =
			<          0 0>,
			<  883200000 7>;
		#address-cells = <1>;
		#size-cells = <1>;
	};

In case vmin & boost delta defined.

	clock_cpu: qcom,cpu-clock-titanium@b116000 {
		compatible = "qcom,cpu-clock-titanium";
		reg =   <0xb114000  0x68>,
			<0xb014000  0x68>,
			<0xb116000  0x400>,
			<0xb111050  0x08>,
			<0xb011050  0x08>,
			<0xb1d1050  0x08>,
			<0x00a412c  0x08>;
		reg-names = "rcgwr-c0-base", "rcgwr-c1-base",
			    "c0-pll", "c0-mux", "c1-mux",
			    "cci-mux", "efuse";
		vdd-mx-supply = <&pmtitanium_s7_level_ao>;
		vdd-cl-supply = <&apc_vreg_corner>;
		clocks = <&clock_gcc clk_xo_a_clk_src>;
		clock-names = "xo_a";
		qcom,enable-vmin;
		qcom,num-clusters = <2>;
		qcom,speed0-bin-v0-cl =
			/*            safe_L */
			<          0 0 0>,
			< 652800000  1 (-1)>,
			< 2150400000 6 102 >,
			< 2208000000 7 104 >;
		qcom,speed0-bin-v0-cci =
			<          0 0>,
			<  261120000 1>,
			<  860160000 6>,
			<  883200000 7>;
		qcom,pboost-delta = <0 50 100>;
		#address-cells = <1>;
		#size-cells = <1>;
	};
```
