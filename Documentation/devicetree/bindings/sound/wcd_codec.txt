## Documentation/devicetree/bindings/sound/wsa881x-analog.txt
```
wsa881x Audio CODEC

wsa881x Audio CODEC can support either I2C interface or Soundwire interface.
In Analog mode, this codec will operate as I2C slave device and
interacts with I2C controller for status, control and interrupt management.
The wsa881x device nodes will be represented as child nodes to I2C
master device node in the devicetree. Currently, the below devicetree
bindings are for I2C mode only and does not include soundwire mode.

Required properties:

 - compatible : "qcom,wsa881x-i2c-codec"
 - reg : Unique device ID of I2C slave device.

Optional properties:
- qcom,msm-gpios : Lists down all the gpio sets that are supported.
- qcom,pinctrl-names : Lists all the possible combinations of the gpio sets
mentioned in qcom,msm-gpios. Say we have 2^N combinations for N GPIOs, this
list all 2^N combinations.
- pinctrl-names : The combinations of gpio sets from above that are supported in
the flavor. This can be sometimes same as qcom, pinctrl-names i.e with 2^N
combinations or will have less incase if some combination is not supported.
- pinctrl-# : Pinctrl states as mentioned in pinctrl-names.

* wsa_intc

Required properties:

 - compatible :                            "qcom,wsa-irq"
 - interrupt-controller :                  Mark this device node as an
					   interrupt controller
 - #interrupt-cells :                      Should be 1
 - interrupt-parent :                      Parent interrupt controller
 - interrupts :                            Interrupt number on the parent
                                           interrupt controller
 - interrupt-names :                       Name of interrupt on the parent
                                           interrupt controller
Example:

wsa881x-i2c-codec@0e {
	compatible = "qcom,wsa881x-i2c-codec";
	reg = <0x0e>;
	qcom,msm-gpios = "wsa_clk",
			"wsa_reset";
	qcom,pinctrl-names = "all_off",
				"wsa_clk",
				"wsa_active",
				"wsa_clk_active";
	pinctrl-names = "all_off",
			"wsa_clk",
			"wsa_active",
			"wsa_clk_active";
	pinctrl-0 = <&wsa_clk_off &wsa_suspend>;
	pinctrl-1 = <&wsa_clk_on &wsa_suspend>;
	pinctrl-2 = <&wsa_clk_off &wsa_active>;
	pinctrl-3 = <&wsa_clk_on &wsa_active>;
};

wsa881x-i2c-codec@44 {
	compatible = "qcom,wsa881x-i2c-codec";
	reg = <0x44>;
};

wsa881x-i2c-codec@0f {
	compatible = "qcom,wsa881x-i2c-codec";
	reg = <0x0f>;
	qcom,msm-gpios = "wsa_clk",
			"wsa_reset";
	qcom,pinctrl-names = "all_off",
				"wsa_clk",
				"wsa_active",
				"wsa_clk_active";
	pinctrl-names = "all_off",
			"wsa_active",
			"wsa_clk_active";
	pinctrl-0 = <&wsa_clk_off &wsa_suspend>;
	pinctrl-1 = <&wsa_clk_off &wsa_active>;
	pinctrl-2 = <&wsa_clk_on &wsa_active>;
};

wsa_intc: wsa-irq {
	compatible = "qcom,wsa-irq";
	interrupt-controller;
	#interrupt-cells = <1>;
	interrupt-parent = <&msm_gpio>;
	interrupts = <97 0>;
	interrupt-names = "wsa-int";
};
```

## Documentation/devicetree/bindings/sound/wsa881x.txt
```
wsa881x Audio CODEC

wsa881x Audio CODEC can support either Soundwire interface or I2C interface.
In Soundwire mode, this codec will operate as soundwire slave device and
uses soundwire framework to interact with soundwire master controller.
The wsa881x device nodes will be represented as child nodes to soundwire
master device node in the devicetree. Currently, the below devicetree
bindings are for soundwire mode only and does not include I2C mode.

Required properties:

 - compatible : "qcom,wsa881x"
 - reg : Unique device ID of soundwire slave device(48 bits).
 - qcom,spkr-sd-n-gpio : shutdown gpio pin to keep wsa881x in low power mode.
 - pinctrl-names : Pincntrl entries to configure the PDM gpio lines and
		  cross connection switch gpio accordingly
 - pinctrl-0 : This explains the active state of the shutdown gpio pin
          to keep wsa881x in low power mode
 - pinctrl-1 : This explains the suspend state of the shutdown gpio pin
          to keep wsa881x in low power mode

Optional properties:

Example:

wsa881x@32000 {
	compatible = "qcom,wsa881x";
	reg = <0x00 0x032000>;
	qcom,spkr-sd-n-gpio = <&pmi8994_gpios 2 0>;
	pinctrl-names = "wsa_spkr_sd_act",
		"wsa_spkr_sd_sus";
	pinctrl-0 = <&wsa_spkr_sd_act>;
	pinctrl-1 = <&wsa_spkr_sd_sus>;
};

wsa881x@42000 {
	compatible = "qcom,wsa881x";
	reg = <0x00 0x042000>;
	qcom,spkr-sd-n-gpio = <&pmi8994_gpios 3 0>;
	pinctrl-names = "wsa_spkr_sd_act",
		"wsa_spkr_sd_sus";
	pinctrl-0 = <&wsa_spkr_sd_act>;
	pinctrl-1 = <&wsa_spkr_sd_sus>;

};
```

## Documentation/devicetree/bindings/soundwire/swr-mstr-ctrl.txt
```
Qualcomm Technologies, Inc. SoundWire Master controller

* swr_master

Required properties:

- compatible : should be "qcom,swr-mstr"
- #address-cells: must be 2
- #size-cells: must be 0
- qcom,swr-num-ports: number of ports in the master.
- qcom,swr-port-mapping: contains codec port_type and
	corresponding ch-mask entries for possible port types
	of the master port.

Optional properties:
- qcom,swr-wakeup-required : should be set to 1 if wakeup is required
from LPASS as part of soundwire data-toggle interrupt sequence
for given target.

* wsa881x

Required properties:

- compatible : should be "qcom,wsa881x"
- reg : Unique device ID(48 bits) of Soundwire slave device node.
	In the below example, wsa881x is soundwire slave device for
	which the swr-devid is <0x0 0x032000> where 0x03 represents
	device Unique_ID, 0x20 represents Part_Id1 and 0x00
	represents part_Id2.
Optional properties:
- mipi-sdw-clock-stop-mode0-supported : should be set to 1 if all
	the slaves under the master supports clock stop mode 0

 Example:

swr0: swr_master {
		compatible = "qcom,swr-mstr";
		#address-cells = <2>;
		#size-cells = <0>;

		qcom,swr-num-ports = <8>;
		qcom,swr-wakeup-required = <1>;
		qcom,swr-port-mapping = <1 SPKR_L 0x1>,
		<2 SPKR_L_COMP 0xF>, <3 SPKR_L_BOOST 0x3>,
		<4 SPKR_R 0x1>, <5 SPKR_R_COMP 0xF>,
		<6 SPKR_R_BOOST 0x3>, <7 SPKR_L_VI 0x3>,
		<8 SPKR_R_VI 0x3>;

		wsa881x@32000 {
			compatible = "qcom,wsa881x";
			reg = <0x00 0x032000>;
		};

		wsa881x@42000 {
			compatible = "qcom,wsa881x";
			reg = <0x00 0x042000>;
		};
		mipi-sdw-clock-stop-mode0-supported = <0>;
	};
```

## Documentation/devicetree/bindings/soundwire/swr-wcd-ctrl.txt
```
Qualcomm WCD Codec SoundWire controller

Required properties:

 - compatible : should be "qcom,swr-wcd"
 - reg : Unique device ID(48 bits) of Soundwire slave device node.
	 In the below example, wsa881x is soundwire slave device for
	 which the swr-devid is <0x0 0x032000> where 0x03 represents
	 device Unique_ID, 0x20 represents Part_Id1 and 0x00
	 represents part_Id2.
- #address-cells = <2>;
- #size-cells = <0>;

Optional property:

 Example:
	swr_master {
		compatible = "qcom,swr-wcd";
		#address-cells = <2>;
		#size-cells = <0>;

		wsa881x@32000 {
			compatible = "qcom,wsa881x";
			reg = <0x00 0x032000>;
		};

		wsa881x@42000 {
			compatible = "qcom,wsa881x";
			reg = <0x00 0x042000>;
		};
	};
```

## Documentation/devicetree/bindings/spi/nvidia,spi-tegra114.txt
```
NVIDIA Tegra114 SPI controller.

Required properties:
- compatible : should be "nvidia,tegra114-spi".
- reg: Should contain SPI registers location and length.
- interrupts: Should contain SPI interrupts.
- nvidia,dma-request-selector : The Tegra DMA controller's phandle and
  request selector for this SPI controller.

Recommended properties:
- spi-max-frequency: Definition as per
                     Documentation/devicetree/bindings/spi/spi-bus.txt
Optional properties:
- nvidia,clock-always-on: Enable clock of spi always.

spi-client device controller properties:
- nvidia,enable-hw-based-cs: (Boolean) Use the HW based CS if enabled.
- nvidia,tx-clk-tap-delay: Delays the clock going out to the external device
  with this tap value.
- nvidia,rx-clk-tap-delay: Delays the clock coming in from the external device
  with this tap value.
- nvidia,cs-setup-clk-count: CS setup timing parameter.
- nvidia,cs-hold-clk-count: CS hold timing parameter.

Example:
spi@7000d600 {
	compatible = "nvidia,tegra114-spi";
	reg = <0x7000d600 0x200>;
	interrupts = <0 82 0x04>;
	nvidia,dma-request-selector = <&apbdma 16>;
	spi-max-frequency = <25000000>;
	nvidia,clock-always-on;
	#address-cells = <1>;
	#size-cells = <0>;
	status = "disabled";

	<spi-client>@<bus_num> {
		...
		...
		nvidia,enable-hw-based-cs;
		nvidia,cs-setup-clk-count = <10>;
		nvidia,cs-hold-clk-count = <10>;
		nvidia,rx-clk-tap-delay = <0>;
		nvidia,tx-clk-tap-delay = <16>;
		...
	};
};
```

## Documentation/devicetree/bindings/spi/qcom,spi-geni-qcom.txt
```
GENI based Qualcomm Universal Peripheral (QUP) Serial Peripheral Interface (SPI)

The QUP v3 core is a GENI based AHB slave that provides a common data path
(an output FIFO and an input FIFO) for serial peripheral interface (SPI)
mini-core.

SPI in master mode supports up to 50MHz, up to four chip selects, programmable
data path from 4 bits to 32 bits and numerous protocol variants.

Required properties:
- compatible:	  Should contain "qcom,spi-geni"
- reg:		  Should contain base register location and length
- interrupts:	  Interrupt number used by this controller
- clocks:	  Should contain the core clock and the AHB clock.
- clock-names:	  Should be "core" for the core clock and "iface" for the
		  AHB clock.
- pinctrl-names:  Property should contain "default" and "sleep" for the
		  pin configurations during the usecase and during idle.
- pinctrl-x:	  phandle to the default/sleep pin configurations.
- #address-cells: Number of cells required to define a chip select
		  address on the SPI bus. Should be set to 1.
- #size-cells:	  Should be zero.
- spi-max-frequency: Specifies maximum SPI clock frequency,
		     Units - Hz. Definition as per
		     Documentation/devicetree/bindings/spi/spi-bus.txt
- qcom,wrapper-core: Wrapper QUPv3 core containing this SPI controller.

Optional properties:
- qcom,rt:	Specifies if the framework worker thread for this
		controller device should have "real-time" priority.
- qcom,disable-autosuspend: Specifies to disable runtime PM auto suspend.

SPI slave nodes must be children of the SPI master node and can contain
the following properties.

Required properties:
- compatible:     Should contain:
                  "qcom,spi-msm-codec-slave" for external codec control

- reg:            Chip select address of device.

- spi-max-frequency: Maximum SPI clocking speed of device in Hz.

Optional properties:
- spi-cpha:       Empty property indicating device requires
                  shifted clock phase (CPHA) mode.

- qcom,slv-ctrl : Set this flag to configure QUPV3 as SPI slave controller.

- qcom,disable-dma : Set this flag to ensure only fifo mode is used for
			transfers. FIFO mode does not work when FW of SE
			is configured in GSI mode.

Other optional properties described in
Documentation/devicetree/bindings/spi/spi-bus.txt

Example:

	qupv3_spi10: spi@a84000 {
		compatible = "qcom,spi-geni";
		#address-cells = <1>;
		#size-cells = <0>;
		reg = <0xa84000 0x4000>;
		reg-names = "se_phys";
		clock-names = "se-clk", "m-ahb", "s-ahb";
		clocks = <&clock_gcc GCC_QUPV3_WRAP0_S0_CLK>,
			<&clock_gcc GCC_QUPV3_WRAP_0_M_AHB_CLK>,
			<&clock_gcc GCC_QUPV3_WRAP_0_S_AHB_CLK>;
		pinctrl-names = "default", "sleep";
		pinctrl-0 = <&qup_1_spi_2_active>;
		pinctrl-1 = <&qup_1_spi_2_sleep>;
		interrupts = <GIC_SPI 354 0>;
		spi-max-frequency = <19200000>;
		qcom,wrapper-core = <&qupv3_0>;

		dev@0 {
			compatible = "dummy,slave";
			reg = <0>;
			spi-max-frequency = <9600000>;
		};
	};
```
