## Documentation/devicetree/bindings/spmi/qcom,spmi-glink-debug.txt
```
Qualcomm Technologies, Inc. Glink SPMI Debug Controller

The Qualcomm Technologies, Inc. Glink SPMI debug controller device provides an
interface to read and write PMIC registers over PMIC Glink using a remote
subsytem (e.g. DSP).  This allows for debugging PMIC peripherals that would
typically only be accessible to the charger and fuel gauging firmware running
on the remote subsystem.

Refer to Documentation/devicetree/bindings/soc/qcom/qcom,pmic-glink.txt for
information on "qcom,pmic_glink_log" device which is used in the example below.

See spmi.txt for the generic SPMI controller binding requirements for grandchild
nodes.

Required device node structure:

The Glink SPMI debug controller node must contain at least one child node.  Each
child node corresponds to an SPMI bus accessible from the remote subsystem.

Top Level Node Supported Properties:

- compatible:
	Usage:      required
	Value type: <stringlist>
	Definition: Must be "qcom,spmi-glink-debug".

Child Node Supported Properties:

- reg
	Usage:      required
	Value type: <u32>
	Definition: Bus ID of this SPMI bus.

Example:

&soc {
	qcom,pmic_glink_log {
		qcom,spmi_glink_debug {
			compatible = "qcom,spmi-glink-debug";
			#address-cells = <1>;
			#size-cells = <0>;

			spmi@0 {
				reg = <0>;
			};

			spmi@1 {
				reg = <1>;
			};
		};
	};
};
```

## Documentation/devicetree/bindings/spmi/qcom,spmi-pmic-arb-debug.txt
```
Qualcomm Technologies, Inc. SPMI Debug Controller (PMIC Arbiter)

The SPMI PMIC Arbiter is found on various QTI chips.  It is an SPMI controller
with wrapping arbitration logic to allow for multiple on-chip devices to control
a single SPMI master.

The PMIC Arbiter debug bus is present starting at arbiter version 5.  It has
read and write access to all PMIC peripherals regardless of ownership
configurations.  It cannot be used on production devices because it is disabled
by an eFuse.

See spmi.txt for the generic SPMI controller binding requirements for child
nodes.

Supported Properties:

- compatible
	Usage:      required
	Value type: <string>
	Definition: Must be "qcom,spmi-pmic-arb-debug".

- reg
	Usage:      required
	Value type: <prop-encoded-array>
	Definition: List of address and size pairs.  The address of the PMIC
		    arbiter module is required.  The address of the debug bus
		    disabling fuse is optional.

- reg-names
	Usage:      required
	Value type: <stringlist>
	Definition: Address names. Must include "core" for the PMIC arbiter
		    module and may include "fuse" for the debug bus disabling
		    fuse.  The strings must be specified in the same order as
		    the corresponding addresses are specified in the reg
		    property.

- clocks
	Usage:      optional
	Value type: <prop-encoded-array>
	Definition: Clock tuple consisting of a phandle to a clock controller
		    device and the clock ID number for the SPMI debug controller
		    clock.

- clock-names
	Usage:      required if clocks property is specified
	Value type: <string>
	Definition: Defines the name of the clock defined in the "clocks"
		    property.  This must be "core_clk".

- #address-cells
	Usage:      required
	Value type: <u32>
	Definition: Must be 2.

- #size-cells
	Usage:      required
	Value type: <u32>
	Definition: Must be 0.

- qcom,fuse-disable-bit
	Usage:      required if "fuse" is listed in reg-names property
	Value type: <u32>
	Definition: The bit within the fuse register which is set when the debug
		    bus is not available.  Supported values are 0 to 31.

Example:

qcom,spmi-debug@6b22000 {
	compatible = "qcom,spmi-pmic-arb-debug";
	reg = <0x6b22000 0x60>, <0x7820A8 4>;
	reg-names = "core", "fuse";
	clocks = <&clock_aop QDSS_CLK>;
	clock-names = "core_clk";
	qcom,fuse-disable-bit = <12>;
	#address-cells = <2>;
	#size-cells = <0>;
};
```

## Documentation/devicetree/bindings/spmi/qcom,spmi-sim.txt
```
SPMI Controller Simulator

The SPMI Controller Simulator simulates an SPMI bus with PMIC devices attached
to it.

See spmi.txt for the generic SPMI controller binding requirements for child
nodes.

Supported Properties:

- compatible
	Usage:      required
	Value type: <string>
	Definition: Must be "qcom,spmi-sim".

- reg
	Usage:      required
	Value type: <prop-encoded-array>
	Definition: List of SPMI address and size pairs.  These addresses are
		    the ones to be simulated.

- #address-cells
	Usage:      required
	Value type: <u32>
	Definition: Must be 2.

- #size-cells
	Usage:      required
	Value type: <u32>
	Definition: Must be 0.

- interrupt-controller
	Usage:      required
	Value type: boolean
	Definition: Boolean indicating that the SPMI Controller Simulator is an
		    interrupt controller.

- #interrupt-cells
	Usage:      required
	Value type: <u32>
	Definition: Must be 4.
		    Interrupts are specified as a 4-tuple:
			Cell 1: Slave ID for the requested interrupt (0-15)
			Cell 2: Peripheral ID for requested interrupt (0-255)
			Cell 3: The requested peripheral interrupt (0-7)
			Cell 4: Interrupt flags indicating level-sense
				information, as defined in:
				dt-bindings/interrupt-controller/irq.h

- qcom,reg-defaults
	Usage:      optional
	Value type: <prop-encoded-array>
	Definition: List of SPMI address and value pairs.  These define the
		    default values read back from the simulated registers.  The
		    values must be between 0 and 255.

Simulated PMIC Device Supported Properties:

- qcom,spmi-sim
	Usage:      required
	Value type: <phandle>
	Definition: phandle of the spmi-sim bus device that the simulated PMIC
		    device should be used with.

Example:

spmi_sim: spmi-sim {
	compatible = "qcom,spmi-sim";
	reg = <0x00000 0x20000>,
	      <0x40000 0x20000>;
	#address-cells = <2>;
	#size-cells = <0>;
	interrupt-controller;
	#interrupt-cells = <4>;

	qcom,reg-defaults =
		<0x00104 0x51>,
		<0x00105 0x14>,
		<0x40104 0x51>,
		<0x40105 0x18>;
};

pm8150-sim {
	compatible = "qcom,pm8150-sim";
	qcom,spmi-sim = <&spmi_sim>;
	qcom,sid-offset = <0>;
};
```

## Documentation/devicetree/bindings/spmi/qcom,viospmi-pmic-arb.txt
```
QTI Virtio SPMI controller (Virtio PMIC Arbiter)

The Virtio SPMI PMIC Arbiter is a frontend proxy based on backend virtio device.

Required properties:
- compatible : should be "qcom,viospmi-pmic-arb".
- #address-cells : must be set to 2
- #size-cells : must be set to 0
- interrupt-controller : boolean indicator that the PMIC arbiter is an interrupt controller
- #interrupt-cells :  must be set to 4. Interrupts are specified as a 4-tuple:
    cell 1: slave ID for the requested interrupt (0-15)
    cell 2: peripheral ID for requested interrupt (0-255)
    cell 3: the requested peripheral interrupt (0-7)
    cell 4: interrupt flags indicating level-sense information, as defined in
            dt-bindings/interrupt-controller/irq.h

Example Virtio PMIC-Arbiter:

     spmi_bus: qcom,spmi {
         compatible = "qcom,viospmi-pmic-arb";
         interrupt-names = "periph_irq";
         interrupts = <GIC_SPI 481 IRQ_TYPE_NONE>;
         qcom,ee = <0>;
         #address-cells = <2>;
         #size-cells = <0>;
         interrupt-controller;
         #interrupt-cells = <4>;
         cell-index = <0>;
     };

     viospmi: virtio-spmi@c440000 {
         compatible = "virtio,mmio";
         #address-cells = <1>;
         #size-cells = <1>;
         reg = <0xc440000 0x1100>;
         interrupts = <GIC_SPI 100 IRQ_TYPE_NONE>;
         status = "okay";
     };
```

## Documentation/devicetree/bindings/spmi/qcom,virtspmi-pmic-arb.txt
```
QTI Virtual SPMI controller (Virtual PMIC Arbiter)

The Virtual SPMI PMIC Arbiter is a frontend proxy based on backend virtual device.

Required properties:
- compatible : should be "qcom,virtspmi-pmic-arb".
- reg-names  : must contain:
     "core" - core registers

- reg : address + size pairs describing the Virtual PMIC arb register sets;
        order must correspond with the order of entries in reg-names
- #address-cells : must be set to 2
- #size-cells : must be set to 0

Example Virtual PMIC-Arbiter:

	spmi {
		compatible = "qcom,virtspmi-pmic-arb";
		reg-names = "core";
		reg = <0xfc4cf000 0x1000>;

		#address-cells = <2>;
		#size-cells = <0>;
	};
```

## Documentation/devicetree/bindings/spmi/spmi-mtk-pmif.txt
```
Mediatek SPMI Controller

This document describes the binding for the MediaTek SPMI controller.

On MediaTek SoCs the PMIC is connected via SPMI and the controller allows
for multiple SoCs to control a single SPMI master.

Required properties:
- compatible :
     "mediatek,mt6853-spmi" for MT6853 SoCs
     "mediatek,mt6873-spmi" for MT6873 SoCs
- reg-names  : must contain:
     "pmif" - pmif registers
     "spmimst" - spmi controller registers
- reg: Must contain an entry for each entry in reg-names.
- clock-names: Must include the following entries:
  "pmif_sys_ck": pmif system clock
  "pmif_tmr_ck": pmif timer clock
  "spmimst_clk_mux": spmi master clk mux
- clocks: Must contain an entry for each entry in clock-names.

Example:

	spmi: spmi@10027000 {
		compatible = "mediatek,mt6873-spmi";
		reg = <0 0x10027000 0 0x000e00>,
		      <0 0x10029000 0 0x000100>;
		reg-names = "pmif", "spmimst";
		clocks = <&infracfg CLK_INFRA_PMIC_AP>,
			 <&infracfg CLK_INFRA_PMIC_TMR>,
			 <&topckgen CLK_TOP_SPMI_MST_SEL>;
		clock-names = "pmif_sys_ck",
			      "pmif_tmr_ck",
			      "spmimst_clk_mux";
	};
```

## Documentation/devicetree/bindings/spmi/spmi-pmic-arb.txt
```
Qualcomm SPMI Controller (PMIC Arbiter)

Required properties:
- cell-index : the bus identifier.
- compatible : should be "qcom,spmi-pmic-arb".
- reg-names  : should be "core", "intr", "cnfg"
- reg : offset and length of the PMIC Arbiter Core register map.
- reg : offset and length of the PMIC Arbiter Interrupt controller register map.
- reg : offset and length of the PMIC Arbiter Configuration register map.
- interrupts : the PMIC Arbiter interrupt.
- qcom,pmic-arb-ee : the execution environment (EE) identifier.
- qcom,pmic-arb-channel : the assigned channel number for channel registers.

Optional properties:
- qcom,not-wakeup : boolean property which indicates that SPMI PMIC interrupts
	should not be treated as wakeup sources
- reg-names  : may have "chnls", "obsrvr"
- reg : offset and length of the PMIC Arbiter Core Channels register map.
- reg : offset and length of the PMIC Arbiter Core Observer Channels reg map.
- qcom,pmic-arb-max-peripherals : the max supported peripheral channels on device
- qcom,pmic-arb-max-periph-interrupts : the max supported peripheral channels
					interrupts on device
- qcom,reserved-channel : channel number that this driver should not touch.
			  Used only for v2 hw.

Example:

	qcom,spmi@fc4c0000 {
		cell-index = <0>;
		compatible = "qcom,spmi-pmic-arb";
		reg-names = "core", "chnls", "obsrvr", "intr", "cnfg";
		reg = <0x200f000 0x1000>,
			<0x2400000 0x400000>,
			<0x2c00000 0x400000>,
			<0x3800000 0x200000>,
			<0x200a000 0x2100>;
		interrupts = <0 190 0>;
		qcom,pmic-arb-ee = <0>;
		qcom,pmic-arb-channel = <0>;
	};
```

## Documentation/devicetree/bindings/staging/iio/light/iqs253-ps.txt
```
* IQS253 proximity sensor

Required properties:
- compatible: must be "azoteq,iqs253"
- reg: i2c address of the device. It is one of 0x44-0x47.
- vendor: vendor of the hardware part.
- proximity,max-range: maximum range of this sensor's value in SI units.
- proximity,integration-time: minimum sampling period in nano seconds.
- proximity,power-consumed: rough estimate of this sensor's power consumption in mA.
- rdy-gpio: gpio to be used for i2c handshake with the sensor.
- wake-gpio: gpio to be used for wakeup on stylus insert/removal event.
- sar-gpio: gpio to be used for sending proximity event to SAR sensor.

Example:

	iqs253@44 {
		compatible = "azoteq,iqs253";
		reg = <0x44>;
		vendor = "Azoteq";
		proximity,max-range = "2"; /* 2 cm */;
		proximity,integration-time = "16000000"; /* 16 msec */
		proximity,power-consumed = "1.67"; /* mA */
		rdy-gpio = <&gpio TEGRA_GPIO(PK, 5) 1>;
		wake-gpio = <&gpio TEGRA_GPIO(PW, 3) 1>;
		sar-gpio = <&gpio TEGRA_GPIO(I, 2) 1>;
	};
```

## Documentation/devicetree/bindings/staging/iio/light/max44006-als.txt
```
* MAX44006 ambient light sensor

Required properties:
- compatible: must be "maxim,max44006"
- reg: i2c address of the device. It should be 0x44.
- vcc-supply: regulator supply for the chip

Optional propertied:
- maxim,gain: integer value specifying the gain factor per lsb.
- maxim,als-resolution: conversion factor from sensor raw units to lux.

Example:

	max44006@44 {
		compatible = "maxim,max44006";
		reg = <0x44>;
		vcc-supply = <&palmas_smps8>;
		maxim,gain = <1>;
		maxim,als-resolution = "0.75";
	};
```
