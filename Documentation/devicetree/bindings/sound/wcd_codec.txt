## Documentation/devicetree/bindings/spi/spi_qsd.txt
```
Qualcomm Serial Peripheral Interface (SPI)

Required properties:
- compatible : Should be "qcom,spi-qup-v2".
- reg : Offset and length of the register regions for the device
- reg-names : Register region names referenced in reg above.
	Required register resource entries are:
	"spi_physical" : Physical address of controller register blocks.
- interrupts : Interrupt numbers used by this controller
- interrupt-names : Interrupt resource names referenced in interrupts above.
	Required interrupt resource entries are:
	"spi_irq" : QUP-core interrupt.
- spi-max-frequency : Specifies maximum SPI clock frequency, Units - Hz.

Required alias:
- The desired bus-number is specified via an alias with the following format
	'spi{n}' where n is the bus number.

Optional properties:
- qcom,gpio-mosi : GPIO pin number of the MOSI bus line.
- qcom,gpio-miso : GPIO pin number of the MISO bus line.
- qcom,gpio-clk  : GPIO pin number of the CLK  bus line.
- qcom,gpio-cs0  : GPIO pin number of the chipselect0 bus line.
- qcom,gpio-cs1  : GPIO pin number of the chipselect1 bus line.
- qcom,gpio-cs2  : GPIO pin number of the chipselect2 bus line.
- qcom,gpio-cs3  : GPIO pin number of the chipselect3 bus line.
- qcom,infinite-mode: When missing or set to zero, QUP uses infinite-mode. When
  value is non-zero, the value is the number of words in maximum transfer
  length.
 - qcom,active-only : Vote for core clock when the application processor goes
  to active state and remove that vote when it goes to idle state. This flag may
  improve service time of first spi request at the expense of power consumption.
  When this entry is not present, voting is done by the runtime-pm callbacks.
 - qcom,master-id : Master endpoint number used for voting on clocks using the
  bus-scaling driver.
 - qcom,rt-priority : whether spi message queue is set to run as a realtime task.
  With this spi transaction message pump with high (realtime) priority to reduce
  the transfer latency on the bus by minimising the delay between a transfer request

Optional properties which are required for support of BAM-mode:
- qcom,ver-reg-exists : Boolean. When present, allows driver to verify if HW
  version support latest features (e.g. BAM) and then enable them. Should be
  removed for legacy HW.
- qcom,use-bam : Boolean. When present, enables BAM-mode.
- qcom,use-pinctrl : Boolean. When present, enables pinctrl frame work to configure GPIO's
  instead of existing gpio mux hence gpio entries are no more required if present.
- qcom,bam-consumer-pipe-index : BAM consumer-pipe index.
- qcom,bam-producer-pipe-index : BAM producer-pipe index.
- reg-names : register region names referenced in reg.
	Required register resource for BAM are:
	"spi_bam_physical" : Physical address of BAM for this controller.
- interrupt-names : interrupt resource names referenced in interrupts.
	Required interrupt resource from BAM are:
	"spi_bam_irq" : BAM interrupt used by the controller.

Optional SPI slave nodes must be children of the SPI master node and contain
the following properties.
- reg: (required) chip-select address of the device.
- compatible : (required) Name of SPI device following generic names.
- spi-max-frequency : (required) Maximum SPI clocking speed of device in Hz
- interrupts : (recommended) Should contain the SPI slave interrupt number
  encoded depending on the type of the interrupt controller.
- interrupt-parent : (recommended) The phandle for the interrupt controller
  that services interrupts for this device.
- spi-cpol : (optional) Empty property indicating device requires inverse
  clock polarity (CPOL) mode
- spi-cpha : (optional) Empty property indicating device requires shifted
  clock phase (CPHA) mode
- spi-cs-high : (optional) Empty property indicating device requires
  chip select active high

Example:
	aliases {
		spi0 = &spi_0;
	};

	spi_0: spi@f9923000 {
		compatible = "qcom,spi-qup-v2";

		reg-names = "spi_physical", "spi_bam_physical";
		reg = <0xf9923000 0x1000>,
			<0xf9904000 0x10000>;
		interrupt-names = "spi_irq", "spi_bam_irq";
		interrupts = <0 95 0>, <0 238 0>;

		spi-max-frequency = <19200000>;
		#address-cells = <1>;
		#size-cells = <0>;
		qcom,gpio-mosi = <&msmgpio 0 0>;
		qcom,gpio-miso = <&msmgpio 1 0>;
		qcom,gpio-clk  = <&msmgpio 3 0>;
		qcom,gpio-cs2  = <&msmgpio 9 0>;

		qcom,infinite-mode = <0>;
		qcom,use-bam;
		qcom,use-pinctrl;
		qcom,bam-consumer-pipe-index = <12>;
		qcom,bam-producer-pipe-index = <13>;
		qcom,ver-reg-exists;
		qcom,master-id = <86>;
		qcom,rt-priority;
	};
```

## Documentation/devicetree/bindings/spi/spidev.txt
```
SPIDEV

SPI slave devices using the spidev driver allowing for userspace
control of the SPI devices. Must be children of a SPI master node
and contain the following properties.

Required properties:
- compatible:     Should contain:
                  "nxp,mpc57xx" for external CAN controller
                  "infineon,sli97" for external HSM module

- reg:            Chip select address of device.
- spi-max-frequency: Maximum SPI clocking speed of device in Hz.

Optional properties:
- spi-cpol:       Empty property indicating device requires
                  inverse clock polarity (CPOL) mode.
- spi-cpha:       Empty property indicating device requires
                  shifted clock phase (CPHA) mode.

Other optional properties described in
Documentation/devicetree/bindings/spi/spi-bus.txt

Example:

	spi@0 {
		compatible = "nxp,mpc57xx";
		reg = <0>;
		spi-max-frequency = <19200000>;
	};
```

## Documentation/devicetree/bindings/spm/sleep.txt
```
* Mediatek Secure Power Management

This describes the device tree binding for the Mediatek Secure Power Managermenet
which control low power on/off. such as cpu on/off, pll on/off, and lower voltage
for each power domain.

Required properties:
- compatible:
  - "mediatek,sleep" : For all compatible products support spm
- reg: 1. Address base and range for SPMFW loading.
       2. Address base for device_mpu
- interrupts: IRQ for SPM wake up AP

Example:

	sleep@10a00000 {
		compatible = "mediatek,sleep";
		reg = <0 0x10a00000 0 0x30000>,
		      <0 0x0011bb80 0 0x80>;
		interrupts = <GIC_SPI 196 IRQ_TYPE_LEVEL_LOW>;
	};
```

## Documentation/devicetree/bindings/spmi/msm-spmi.txt
```
* SPMI

The SPMI Device Tree support interprets up to three levels of Device Tree
topology. The first level is required and specifies only a slave address.
The second level is optional and allows for the specification of different
device nodes within the same 16-bit address space underneath a particular
SPMI slave ID. Within the second level, any number of address ranges can be
associated with a particular device within that 16-bit range. An additional
flag allows for the possiblity to specify that all device nodes should
have their resources dedicated to only one spmi_device. This flag can
be specified at the second level, or an optional third level. By default
without this flag, one spmi_device is created for each device_node.

[Root Node]

Recommended properties :
 - interrupt-controller : Used to specify the root node as the
   interrupt controller for SPMI devices.
 - #interrupt-cells : The number of cells used to express one interrupt.

Notes :
 - It is considered an error to include either spmi-container-dev or
 spmi-slave-dev in the Root Node.

[First Level Nodes]

Required properites :

 - reg: SPMI Slave ID (0-15) with no size cell.
 - compatible : "qcom," prefixed string to match against the driver.

Recommended properties :

 - interrupts : <a b c> where a is the slave ID, b is the peripheral ID,
   c is the device interrupt number (0-7). Each device supports any arbitrary
   number of interrupts.
 - interrupt-parent : the phandle for the interrupt controller that
   services interrupts for this device.

[Second Level Nodes]

Required properties :
 - spmi-slave-container: Used by the parser to understand that this is the
   second level of the tree that includes device nodes associated with the
   same slave_id.
 - reg: <a b> where a is < 65536 and b is a size. Each device supports an
   arbitrary number of address ranges.
 - compatible : "qcom," prefixed string to match against the driver.

Recommended properties :

 - interrupts : <a b c> where a is the slave ID, b is the peripheral ID,
   c is the device interrupt number (0-7). Each device supports any arbitrary
   number of interrupts.
 - interrupt-parent : the phandle for the interrupt controller that
   services interrupts for this device.

Optional properties :

 - spmi-dev-container: This specifies that all the device nodes specified for
   this slave_id should have their resources coalesced into only one
   spmi_device.

[Third Level Nodes]

Required properties :

  - spmi-dev-container: This specifies that all the device nodes specified for
   this slave_id should have their resources coalesced into only one
   spmi_device.
  - reg: <a b> where a is < 65536 and b is a size. Each device supports an
   arbitrary number of address ranges.
  - compatible : "qcom," prefixed string to match against the driver.

Recommended properties :

 - interrupts : <a b c> where a is the slave ID, b is the peripheral ID,
   c is the device interrupt number (0-7). Each device supports any arbitrary
   number of interrupts.
 - interrupt-parent : the phandle for the interrupt controller that
   services interrupts for this device.

Notes :
 - It is considered an error to include spmi-slave-dev at this level.

[Example]

/ {
	qpnp: qcom,spmi@fc4c0000 {
		#address-cells = <1>;
		#size-cells = <0>;
		interrupt-controller;
		#interrupt-cells = <3>;

		testint@f {
			interrupt-parent = <&qpnp>;
			compatible = "qcom,qpnp-testint";
			reg = <0xf>;
			interrupts = <0x3 0x15 0x0 0x3 0x15 0x02 0x1 0x47 0x0>;

		};

		pm8941@0 {
			spmi-slave-container;
			reg = <0x0>;
			#address-cells = <1>;
			#size-cells = <1>;

			pm8941_gpios: gpios {
				spmi-dev-container;
				compatible = "qcom,qpnp-gpio";
				gpio-controller;
				#gpio-cells = <1>;
				#address-cells = <1>;
				#size-cells = <1>;

				pm8941_gpio1@0xc000 {
					compatible = "qcom,qpnp-gpio";
					reg = <0xc000 0x100>;
					qcom,qpnp_gpio = <1>;
					interrupt-parent = <&qpnp>;
					interrupts = <0x3 0x15 0x02 0x1 0x47 0x0>;
				};

				pm8941_gpio2@0xc100 {
					compatible = "qcom,qpnp-gpio";
					reg = <0xc100 0x100>;
					qcom,qpnp_gpio = <2>;
					interrupt-parent = <&qpnp>;
					interrupts = <0x3 0x15 0x0>;
				};
			};

			testgpio@0x1000 {
				compatible = "qcom,qpnp-testgpio";
				reg = <0x1000 0x1000>;
				qpnp-gpios = <&pm8941_gpios 0x0>;
			};
		};
		pm8841@2 {
			spmi-slave-container;
			reg = <0x2>;
			#address-cells = <1>;
			#size-cells = <1>;
			spmi-dev-container;
			compatible = "qcom,qpnp-gpio";

			pm8841_gpio1@0xc000 {
				reg = <0xc000 0x100>;
				qcom,qpnp_gpio = <1>;
			};

			pm8841_gpio2@0xc100 {
				reg = <0xc100 0x100>;
				qcom,qpnp_gpio = <2>;
			};
		};

	};
};
```

## Documentation/devicetree/bindings/spmi/mtk,pmif.txt
```
MediaTek Power Management Interface (PMIF) Driver

This document describes the binding for the MediaTek PMIF.

The PMIF is designed on MediaTek's SoC.  It implements arbitration logic
to allow for multiple HW/SW channel to control PMIC by a single SPMI master.

See spmi.txt for the generic SPMI controller binding requirements for child
nodes.

See Documentation/devicetree/bindings/interrupt-controller/interrupts.txt for
generic interrupt controller binding documentation.

Required properties:
- compatible:
	"mediatek,mt6789-pmif" for MT6789 SoCs
- reg : address + size pairs describing the pmif/pmifmpu/spmimst register
  sets. Must contain an entry for each entry in reg-names.
- reg-names: must contain:
     "pmif" - power management interface registers
     "pmifmpu" - pmif memory protection unit registers
     "spmimst" - spmi master registers
- interrupts: IRQ for pmif in SOC
- interrupt-names: IRQ name for pmif in SOC
- swinf_ch_start: indicate the physical channel for pmif driver accessing
- ap_swinf_no: indicate the logical channel for ap sw interface number,
  0: for MD interface
  2: for AP interface
- interrupt-controller: indicator that the pmif is an interrupt controller

Optional properities:

Example:
	spmi_bus: spmi@10027000 {
  		compatible = "mediatek,mt6789-pmif";
		reg = <0 0x10027000 0 0x000E00>,
  		      <0 0x10027F00 0 0x00008C>,
      		      <0 0x10029000 0 0x000100>;
		reg-names = "pmif", "pmifmpu", "spmimst";
		interrupts = <GIC_SPI 190 IRQ_TYPE_LEVEL_HIGH>;
		interrupt-names = "pmif_irq";
		swinf_ch_start = <4>;
		ap_swinf_no = <2>;
		interrupt-controller;
 	};
```

## Documentation/devicetree/bindings/spmi/qcom,pm8150b-sim.txt
```
PM8150B PMIC Simulator

This device simulates the registers found within a Qualcomm Technologies, Inc.
PM8150B PMIC chip.

Supported Properties:

- compatible
	Usage:      required
	Value type: <string>
	Definition: Must be "qcom,pm8150b-sim".

- qcom,sid-offset
	Usage:      required
	Value type: <u32>
	Definition: Global slave ID (SID) offset of PM8150B local SID 0.
		    Supported values: 0 - 14
		    Typical values: 0, 2, or 4

- qcom,spmi-sim
	Usage:      required
	Value type: <phandle>
	Definition: phandle of the spmi-sim bus device that the simulated PMIC
		    device should be used with.

Example:

pm8150b-sim {
	compatible = "qcom,pm8150b-sim";
	qcom,spmi-sim = <&spmi_sim>;
	qcom,sid-offset = <2>;
};
```

## Documentation/devicetree/bindings/spmi/qcom,pm8150l-sim.txt
```
PM8150L PMIC Simulator

This device simulates the registers found within a Qualcomm Technologies, Inc.
PM8150L PMIC chip.

Supported Properties:

- compatible
	Usage:      required
	Value type: <string>
	Definition: Must be "qcom,pm8150l-sim".

- qcom,sid-offset
	Usage:      required
	Value type: <u32>
	Definition: Global slave ID (SID) offset of PM8150L local SID 0.
		    Supported values: 0 - 14
		    Typical values: 0, 2, or 4

- qcom,spmi-sim
	Usage:      required
	Value type: <phandle>
	Definition: phandle of the spmi-sim bus device that the simulated PMIC
		    device should be used with.

Example:

pm8150l-sim {
	compatible = "qcom,pm8150l-sim";
	qcom,spmi-sim = <&spmi_sim>;
	qcom,sid-offset = <4>;
};
```

## Documentation/devicetree/bindings/spmi/qcom,pm855b-sim.txt
```
PM855B PMIC Simulator

This device simulates the registers found within a Qualcomm Technologies, Inc.
PM855B PMIC chip.

Supported Properties:

- compatible
	Usage:      required
	Value type: <string>
	Definition: Must be "qcom,pm855b-sim".

- qcom,sid-offset
	Usage:      required
	Value type: <u32>
	Definition: Global slave ID (SID) offset of PM855B local SID 0.
		    Supported values: 0 - 14
		    Typical values: 0, 2, or 4

- qcom,spmi-sim
	Usage:      required
	Value type: <phandle>
	Definition: phandle of the spmi-sim bus device that the simulated PMIC
		    device should be used with.

Example:

pm855b-sim {
	compatible = "qcom,pm855b-sim";
	qcom,spmi-sim = <&spmi_sim>;
	qcom,sid-offset = <2>;
};
```

## Documentation/devicetree/bindings/spmi/qcom,pm855l-sim.txt
```
PM855L PMIC Simulator

This device simulates the registers found within a Qualcomm Technologies, Inc.
PM855L PMIC chip.

Supported Properties:

- compatible
	Usage:      required
	Value type: <string>
	Definition: Must be "qcom,pm855l-sim".

- qcom,sid-offset
	Usage:      required
	Value type: <u32>
	Definition: Global slave ID (SID) offset of PM855L local SID 0.
		    Supported values: 0 - 14
		    Typical values: 0, 2, or 4

- qcom,spmi-sim
	Usage:      required
	Value type: <phandle>
	Definition: phandle of the spmi-sim bus device that the simulated PMIC
		    device should be used with.

Example:

pm855l-sim {
	compatible = "qcom,pm855l-sim";
	qcom,spmi-sim = <&spmi_sim>;
	qcom,sid-offset = <4>;
};
```
