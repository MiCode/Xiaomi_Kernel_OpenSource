## Documentation/devicetree/bindings/thermal/qcom-lmh-dcvs.txt
```
Limits Management Hardware - DCVS

The LMH-DCVS block is a hardware IP for every CPU cluster, to handle quick
changes in thermal limits. The hardware responds to thermal variation amongst
the CPUs in the cluster by requesting limits on the clock frequency and
voltage on the OSM hardware.

The LMH DCVS driver exports a virtual sensor that can be used to set the
thermal limits on the hardware. LMH DCVS driver can be a platform CPU Cooling
device, which registers with the CPU cooling device interface. All CPU device
nodes should reference the corresponding LMH DCVS hardware in device tree.
CPUs referencing the same LMH DCVS node will be associated with the
corresponding cooling device as related CPUs.

Properties:

- compatible:
	Usage: required
	Value type: <string>
	Definition: shall be "qcom,msm-hw-limits"
- interrupts:
	Usage: required
	Value type: <interrupt_type interrupt_number interrupt_trigger_type>
	Definition: Should specify interrupt information about the debug
			interrupt generated by the LMH DCVSh hardware. LMH
			DCVSh hardware will generate this interrupt whenever
			it makes a new cpu DCVS decision.
- qcom,affinity:
	Usage: Required
	Value type: <u32>
	Definition: Should specify the cluster affinity this hardware
			corresponds to.

- isens_vref_1p8-supply:
- isens_vref_0p8-supply:
	Usage: optional
	Value type: <phandle>
	Definition: Should specify the phandle of the vref regulator used by
			the isens hardware. This active only regulator will be
			enabled by LMH DCVSh. Isens hardware needs 1.8v and
			0.8v supply regulators.

- isens-vref-1p8-settings:
- isens-vref-0p8-settings:
	Usage: optional
	Value type: <u32 array>
	Definition: Should specify the min voltage(uV), max voltage(uV) and
			max load(uA) for the isens vref regulator. This
			property is valid only if there is valid entry for
			isens_vref_1p8-supply and isens_vref_0p8-supply.

- reg:
	Usage: Required
	Value type: <a b>
	Definition: where 'a' is the starting register address of the OSM/LLM
			and 'b' is the size of OSM/LLM address space. The
			register space in index 0 should be LLM and index 1
			should be OSM.

- qcom,plat-mitigation-disable:
	Usage: optional
	Value type: <none>
	Definition: Should define this property if platform based cpu cooling
			device is not required.

Example:

	lmh_dcvs0: qcom,limits-dcvs@18350800 {
		compatible = "qcom,msm-hw-limits";
		interrupts = <GIC_SPI 38 IRQ_TYPE_LEVEL_HIGH>;
		qcom,affinity = <0>;
		isens_vref_1p8-supply = <&pm8998_l1_ao>;
		isens-vref-1p8-settings = <880000 880000 36000>;
		isens_vref_0p8-supply = <&pm8998_l12_ao>;
		isens-vref-0p8-settings = <880000 880000 36000>;
		reg =  <0x18350800 0x1000>, //LLM
			<0x18323000 0x1000>; //OSM
		qcom,plat-mitigation-disable;
	};

	CPU0: cpu@0 {
		device_type = "cpu";
		compatible = "arm,armv8";
		reg = <0x0 0x0>;
		qcom,lmh-dcvs = <&lmh_dcvs0>;;
	};
```

## Documentation/devicetree/bindings/thermal/qcom-pe-sensor.txt
```
Policy Engine(PE) recommendation as sensor.

The QTI Policy Engine sensor device will register the policy engine
recommendation with thermal framework as a sensor. This will enable
to provide configuration to mitigate cooling devices when a recommendation
is sent from Policy Engine hardware. The recommendations are mitigation
levels based on CX operating level.

There can be multiple Policy Engine hardwares for different rails.

Properties:

- compatible:
	Usage: required
	Value type: <string>
	Definition: should be "qcom,policy-engine"

- reg:
    Usage: required
    Value type: <u32>
    Definition: RDPM_PE base address.

- #thermal-sensor-cells:
	Usage: required
	Value type: <integer>
	Definition: Must be 0. See thermal.txt for description.

- interrupts:
    Usage: required
    Value type: <prop-encoded-array>
    Definition: Policy Engine master interrupt.


Example:

cx_rdpm_pe@0x00635000 {
	compatible = "qcom,policy-engine";
	#thermal-sensor-cells = <0>;
	reg = <0x00635000 0x1000>;
	interrupts = <GIC_SPI 243 IRQ_TYPE_EDGE_RISING>;
};
```

## Documentation/devicetree/bindings/thermal/qcom-sdpm.txt
```
Simple Digital Power Meter(SDPM) clock monitoring.

SDPM is used to monitor the operating frequency of different clocks and based
on operating levels of different clients, the Policy Engine will recommend a
new max operating level. The SDPM driver will register with the clock
framework for rate change notification of different clocks. These clock rate
will be updated to SDPM.

Properties:

- compatible:
	Usage: required
	Value type: <string>
	Definition: should be "qcom,sdpm"

- reg:
	Usage: required
	Value type: <u32>
	Definition: RDPM base address.

- clocks:
	Usage: required
	Value type: <prop-encoded-array>
	Definition: A List of phandle and clock specifier pairs as listed
			in clock-names property.

- clock-names:
	Usage: required
	Value type: <stringlist>
	Definition: List of clock names matching the clock order mentioned in
			the clocks property.

- <supply-name>-supply:
	Usage: Optional
	Value type: <regulator phandle>
	Definition: phandle to the regulator device tree node that powers
			this domain.

- cpu:
	Usage: optional
	Value type: <CPU phandle>
	Definition: The CPU for which the clock changes should be monitored.

- csr-id:
	Usage: required
	Value type: <array of u32>
	Definition: Array of CSR ID matching the clock order mentioned in the
			clocks property. The last ID can be the CSR
			corresponding to the CPU that needs to be monitored.

Example:

cx_sdpm@0x00634000 {
	compatible = "qcom,sdpm";
	reg = <0x00634000 0x1000>;
	clock-names = "cam_cc_ipe", "compo_aux";
	clocks = <&clock_camcc CAM_CC_IPE_0_CLK_SRC>,
		<&clk_m_a2_div1 CLK_M_COMPO_AUX>;
	cam_cc_ipe-supply = <&cam_cc_ipe_0_gdsc>;
	cpu = <&CPU7>;
	csr-id = <5 7 4>;
	//CSR 5 <=> cam_cc
	//CSR 7 <=> compo_aux
	//CSR 4 <=> CPU7
};
```

## Documentation/devicetree/bindings/thermal/qcom-spmi-temp-alarm.txt
```
Qualcomm QPNP PMIC Temperature Alarm

QPNP temperature alarm peripherals are found inside of Qualcomm PMIC chips
that utilize the Qualcomm SPMI implementation. These peripherals provide an
interrupt signal and status register to identify high PMIC die temperature.

Required properties:
- compatible:      Should contain "qcom,spmi-temp-alarm".
- reg:             Specifies the SPMI address and length of the controller's
                   registers.
- interrupts:      PMIC temperature alarm interrupt.
- #thermal-sensor-cells: Should be 0. See thermal.txt for a description.

Optional properties:
- io-channels:     Should contain IIO channel specifier for the ADC channel,
                   which report chip die temperature.
- io-channel-names: Should contain "thermal".
- qcom,temperature-threshold-set: Defines the temperature threshold set to
		   configure.  Supported values are 0 to 3.  Each set defines
		   the over-temperature stage 1, 2, and 3 temperature
		   thresholds. If this property is not specified, then set 0
		   will be used by default.
		   Threshold set mapping (TEMP_GEN1, TEMP_GEN2 rev 0):
			0 = {105 C, 125 C, 145 C}
			1 = {110 C, 130 C, 150 C}
			2 = {115 C, 135 C, 155 C}
			3 = {120 C, 140 C, 160 C}
		   Threshold set mapping (TEMP_GEN2 rev 1 and above):
			0 = { 90 C, 110 C, 140 C}
			1 = { 95 C, 115 C, 145 C}
			2 = {100 C, 120 C, 150 C}
			3 = {105 C, 125 C, 155 C}

Example:

	pm8941_temp: thermal-alarm@2400 {
		compatible = "qcom,spmi-temp-alarm";
		reg = <0x2400 0x100>;
		interrupts = <0 0x24 0 IRQ_TYPE_EDGE_RISING>;
		#thermal-sensor-cells = <0>;

		io-channels = <&pm8941_vadc VADC_DIE_TEMP>;
		io-channel-names = "thermal";
	};

	thermal-zones {
		pm8941 {
			polling-delay-passive = <250>;
			polling-delay = <1000>;

			thermal-sensors = <&pm8941_temp>;

			trips {
				passive {
					temperature = <1050000>;
					hysteresis = <2000>;
					type = "passive";
				};
				alert {
					temperature = <125000>;
					hysteresis = <2000>;
					type = "hot";
				};
				crit {
					temperature = <145000>;
					hysteresis = <2000>;
					type = "critical";
				};
			};
		};
	};
```

## Documentation/devicetree/bindings/thermal/qpnp-adc-tm.txt
```
Qualcomm's QPNP PMIC thermal monitor ADC driver (VADC_TM)

QPNP PMIC thermal monitoring (TM) provides interface to thermal clients
to set temperature thresholds and receive notification when the thresholds
are crossed. A 15 bit ADC is used for measurements. The driver is part
of the sysfs thermal framework that provides support to read the trip
points, set threshold for the trip points and enable the trip points.
Seperate kernel api's are provided to usb_id and batt_therm
to set thresholds and receive threshold notifications.

VADC_TM node

Required properties:
- compatible : should be "qcom,qpnp-adc-tm" for thermal ADC driver.
- reg : offset and length of the PMIC Aribter register map.
- address-cells : Must be one.
- size-cells : Must be zero.
- interrupts : The thermal ADC bank peripheral interrupts for eoc, high and low interrupts.
- interrupt-names : Should be "eoc-int-en-set", "high-thr-en-set" and "low-thr-en-set".
- qcom,adc-bit-resolution : Bit resolution of the ADC.
- qcom,adc-vdd-reference : Voltage reference used by the ADC.

Optional properties:
- qcom,thermal-node : If present a thermal node is created and the channel is registered as
		part of the thermal sysfs which allows clients to use the thermal framework
		to set temperature thresholds and receive notification when the temperature
		crosses a set threshold, read temperature and enable/set trip types supported
		by the thermal framework.
- qcom,meas-interval-timer-idx: If present select from the following timer index to choose
		a preset configurable measurement interval timer value. The driver defaults
		to timer 2 with a measurement interval of 1 second if the property is not present.
		0 : Select Timer 1 for a measurement polling interval of 3.9 milliseconds.
		1 : Select Timer 2 for a measurement polling interval of 1 second.
		2 : Select Timer 3 for a measurement polling interval of 4 seconds.
- qcom,adc-tm-recalib-check: Add this property to check if recalibration required due to inaccuracy.

Client required property:
- qcom,<consumer name>-adc_tm : The phandle to the corresponding adc_tm device.
			The consumer name passed to the driver when calling
			qpnp_get_adc_tm() is used to associate the client
			with the corresponding device.

Channel nodes
NOTE: Atleast one Channel node is required.

Required properties:
- label : Channel name used for sysfs entry.
- reg : AMUX channel number.
- qcom,decimation : Sampling rate to use for the individual channel measurement.
		    Select from the following unsigned int.
		    0 : 512
		    1 : 1K
		    2 : 2K
		    3 : 4K
- qcom,pre-div-channel-scaling : Pre-div used for the channel before the signal is being measured.
				 Select from the following unsigned int for the corresponding
				 numerator/denominator pre-div ratio.
				 0 : pre-div ratio of {1, 1}
				 1 : pre-div ratio of {1, 3}
				 2 : pre-div ratio of {1, 4}
				 3 : pre-div ratio of {1, 6}
				 4 : pre-div ratio of {1, 20}
				 5 : pre-div ratio of {1, 8}
				 6 : pre-div ratio of {10, 81}
				 7 : pre-div ratio of {1, 10}
- qcom,calibration-type : Reference voltage to use for channel calibration.
			  Channel calibration is dependendent on the channel.
			  Certain channels like XO_THERM, BATT_THERM use ratiometric
			  calibration. Most other channels fall under absolute calibration.
			  Select from the following strings.
			  "absolute" : Uses the 625mv and 1.25V reference channels.
			  "ratiometric" : Uses the reference Voltage/GND for calibration.
- qcom,scale-function : Reverse scaling fuction used to convert raw ADC code to units specific to
			a given channel.
			Select from the following unsigned int.
			0 : Scaling to convert voltage in uV to raw adc code.
			1 : Scaling to convert decidegC to raw adc code.
			2 : Scaling for converting USB_ID reverse scaling.
			3 : Scaling to convert milldegC to raw ADC code.
			4 : Scaling to convert smb_batt_therm values to raw ADC code.
			5 : Scaling to perform reverse calibration for absolute voltage from uV
			    to raw ADC code.
			6 : Scaling to convert qrd skuh battery decidegC to raw ADC code.
			7 : Scaling to convert qrd skue battery decidegC to raw ADC code.
- qcom,hw-settle-time : Settling period for the channel before ADC read.
			Select from the following unsigned int.
			0 : 0us
			1 : 100us
			2 : 200us
			3 : 300us
			4 : 400us
			5 : 500us
			6 : 600us
			7 : 700us
			8 : 800us
			9 : 900us
			0xa : 1ms
			0xb : 2ms
			0xc : 4ms
			0xd : 6ms
			0xe : 8ms
			0xf : 10ms
- qcom,fast-avg-setup : Average number of samples to be used for measurement. Fast averaging
			provides the option to obtain a single measurement from the ADC that
			is an average of multiple samples. The value selected is 2^(value)
			Select from
			0 : 1
			1 : 2
			2 : 4
			3 : 8
			4 : 16
			5 : 32
			6 : 64
			7 : 128
			8 : 256
- qcom,btm-channel-number : Depending on the PMIC version, a max of upto 8 BTM channels.
			    The BTM channel numbers are statically allocated to the
			    corresponding channel node.
- qcom,adc_tm-vadc : phandle to the corresponding VADC device to read the ADC channels.

Client device example:
/* Add to the clients node that needs the ADC_TM channel A/D */
client_node {
	qcom,client-adc_tm = <&pm8941_adc_tm>;
};

Example:
	/* Main Node */
	qcom,vadc@3400 {
                        compatible = "qcom,qpnp-adc-tm";
                        reg = <0x3400 0x100>;
			#address-cells = <1>;
			#size-cells = <0>;
                        interrupts = <0x0 0x34 0x0>,
					<0x0 0x34 0x3>,
					<0x0 0x34 0x4>;
			interrupt-names = "eoc-int-en-set",
					  "high-thr-en-set",
					  "low-thr-en-set";
                        qcom,adc-bit-resolution = <15>;
                        qcom,adc-vdd-reference = <1800>;
			qcom,adc_tm-vadc = <&pm8941_vadc>;

			/* Channel Node to be registered as part of thermal sysfs */
                        chan@b5 {
                                label = "pa_therm1";
				reg = <0xb5>;
                                qcom,decimation = <0>;
                                qcom,pre-div-channel-scaling = <0>;
                                qcom,calibration-type = "absolute";
                                qcom,scale-function = <2>;
                                qcom,hw-settle-time = <0>;
                                qcom,fast-avg-setup = <0>;
				qcom,btm-channel-number = <0x70>;
				qcom,thermal-node;
                        };

			/* Channel Node */
			chan@6 {
				label = "vbat_sns";
				reg = <6>;
				qcom,decimation = <0>;
				qcom,pre-div-channel-scaling = <1>;
				qcom,calibration-type = "absolute";
				qcom,scale-function = <3>;
				qcom,hw-settle-time = <0>;
				qcom,fast-avg-setup = <0>;
				qcom,btm-channel-number = <0x78>;
			};
	};
```
