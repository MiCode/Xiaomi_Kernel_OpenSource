## Documentation/devicetree/bindings/thermal/qpnp-temp-alarm.txt
```
Qualcomm Technologies, Inc. QPNP Temperature Alarm

QPNP temperature alarm peripherals are found inside of Qualcomm Technologies,
Inc. PMIC chips that utilize the MSM SPMI implementation.  These peripherals
provide an interrupt signal and status register to identify high PMIC die
temperature.

Required properties:
- compatible:      Must be "qcom,qpnp-temp-alarm".
- reg:             Specifies the SPMI address and size for this temperature
		    alarm device.
- interrupts:      PMIC temperature alarm interrupt
- label:           A string used as a descriptive name for this thermal device.
		    This name should be 19 characters or less.
- #thermal-sensor-cells: Must be 0. Please refer to
			 <devicetree/bindings/thermal/thermal.txt> for more
			 details.

Required structure:
- A qcom,qpnp-temp-alarm node must be a child of an SPMI node that has specified
   the spmi-slave-container property
- A top level device tree node named "thermal-zones" must exist. It must
   contain a subnode with a property named "thermal-sensors" which is assigned
   a phandle to the qpnp-temp-alarm device node. See
   <devicetree/bindings/thermal/thermal.txt> for more details.

Optional properties:
- qcom,channel-num:    VADC channel number associated PMIC DIE_TEMP thermistor.
			If no channel is specified, then the die temperature
			must be estimated based on the over temperature stage.
- qcom,threshold-set:  Integer value which specifies which set of threshold
			temperatures to use for the over temperature stages.
			Possible values (x = {stage 1 threshold temperature,
				stage 2 threshold temperature,
				stage 3 threshold temperature}):
			 0 = {105 C, 125 C, 145 C}
			 1 = {110 C, 130 C, 150 C}
			 2 = {115 C, 135 C, 155 C}
			 3 = {120 C, 140 C, 160 C}
- qcom,clock-rate:     Integer value which specifies the temperature monitoring
			clock rate.  This property is only supported on GEN2
			temperature alarm peripherals.
			Supported values:
			 0 = 100 Hz
			 1 = 50 Hz
			 2 = 25 Hz
			 3 = 12.5 Hz
- qcom,default-temp:   Specifies the default temperature in millicelcius to use
			if no ADC channel is present to read the real time
			temperature.
- qcom,temp_alarm-vadc: Corresponding VADC device's phandle.

Note, if a given optional qcom,* binding is not present, then the default
hardware state for that feature will be maintained.

Example:
&spmi_bus {
	#address-cells = <1>;
	#size-cells = <0>;
	interrupt-controller;
	#interrupt-cells = <3>;

	qcom,pm8941@0 {
		spmi-slave-container;
		reg = <0x0>;
		#address-cells = <1>;
		#size-cells = <1>;

		pm8941_tz: qcom,temp-alarm@2400 {
			compatible = "qcom,qpnp-temp-alarm";
			reg = <0x2400 0x100>;
			interrupts = <0x0 0x24 0x0>;
			label = "pm8941_tz";
			qcom,channel-num = <8>;
			qcom,threshold-set = <0>;
			qcom,temp_alarm-vadc = <&pm8941_vadc>;
			#thermal-sensor-cells = <0>;
		};
	};
};

Below is an example thermal zone definition for the temperature alarm
peripheral.
thermal-zones {
	pm8941_tz {
		polling-delay-passive = <0>;
		polling-delay = <0>;
		thermal-governor = "step_wise";
		thermal-sensors = <&pm8941_tz>;

		trips {
			pm8941-trip0 {
				temperature = <105000>;
				hysteresis = <0>;
				type = "passive";
			};
			pm8941-trip1 {
				temperature = <125000>;
				hysteresis = <0>;
				type = "passive";
			};
			pm8941-trip2 {
				temperature = <145000>;
				hysteresis = <0>;
				type = "critical";
			};
		};
	};
};
```

## Documentation/devicetree/bindings/thermal/qti-isense-cdsp.txt
```
===============================================================================
QTI Limits cdsp isense driver:
===============================================================================
Limits cdsp isense driver reads cdsp isense calibration data from shared memory
and enables sysfs file support to access the data read from shared memory.

Required Parameters:
- compatible: must be 'qcom,msm-limits-cdsp' for limits cdsp isense driver.

Optional Parameters:

		lmh_isense_cdsp {
			compatible = "qcom,msm-limits-cdsp";
		};
```

## Documentation/devicetree/bindings/thermal/qti-qmi-cdev.txt
```
QMI thermal mitigation(TMD) cooling devices.

The QMI TMD cooling device, will be used for various mitigations for remote
subsystem including remote processor mitigation, rail voltage restriction etc.
This cooling device uses kernel qti QMI interface to send the message to
remote subsystem.

Each child node of the QMI TMD devicetree node represents each remote
subsystem and each child of this subsystem represents separate cooling
devices. It requires minimum one remote subsystem node and each subsystem
node requires minimum one cooling device node.

Properties:

- compatible:
	Usage: required
	Value type: <string>
	Definition: should be "qcom,qmi_cooling_devices"


Subsystem properties:
- qcom,instance-id:
	Usage: required
	Value type: <integer>
	Definition: Remote subsystem QMI server instance id to be used for
			communicating with QMI.

	Minimum one child node is required. Child node name and its alias are
	used as cooling device name and phandle for that cooling device.

	cooling device node properties:
	-qcom,qmi-dev-name:
		Usage: required
		Value type: <string>
		Definition: Remote subsystem device identifier. Below strings
			are the only acceptable device names,
			"pa" -> for pa cooling device,
			"cpuv_restriction_cold" -> for vdd restriction,
			"cx_vdd_limit" -> for vdd limit,
			"modem" -> for processor passive cooling device,
			"modem_current" -> for current limiting device,
			"modem_bw" ->  for bus bandwidth limiting device,
			"cpr_cold" -> for cpr restriction.

	-#cooling-cells:
		Usage: required
		Value type: <integer>
		Definition: Must be 2. Needed for of_thermal as cooling device
			identifier. Please refer to
			<devicetree/bindings/thermal/thermal.txt> for more
			details.
Example:

	qmi-tmd-devices {
		compatible = "qcom,qmi_cooling_devices";

		modem {
			qcom,instance-id = <0x0>;

			modem_pa: modem_pa {
				qcom,qmi-dev-name = "pa";
				#cooling-cells = <2>;
			};

			modem_proc: modem_proc {
				qcom,qmi-dev-name = "modem";
				#cooling-cells = <2>;
			};

			modem_vdd: modem_vdd {
				qcom,qmi-dev-name = "cpuv_restriction_cold";
				#cooling-cells = <2>;
			};

			modem_current: modem_current {
				qcom,qmi-dev-name = "modem_current";
				#cooling-cells = <2>;
			};

			modem_cpr_cold: modem_cpr_cold {
				qcom,qmi-dev-name = "cpr_cold";
				#cooling-cells = <2>;
			};
		};

		adsp {
			qcom,instance-id = <0x1>;

			adsp_vdd: adsp_vdd {
				qcom,qmi-dev-name = "cpuv_restriction_cold";
				#cooling-cells = <2>;
			};
		};

		cdsp {
			qcom,instance-id = <0x43>;

			cdsp_vdd: cdsp_vdd {
				qcom,qmi-dev-name = "cpuv_restriction_cold";
				#cooling-cells = <2>;
			};
		};

		slpi {
			qcom,instance-id = <0x53>;

			slpi_vdd: slpi_vdd {
				qcom,qmi-dev-name = "cpuv_restriction_cold";
				#cooling-cells = <2>;
			};
		};
	};
```

## Documentation/devicetree/bindings/thermal/qti-qmi-sensor.txt
```
QMI thermal mitigation(TS) sensor.

The QMI TS Sensor driver can list the sensors that are available in the
remote subsystem. This driver can read the temperature, set threshold and
get threshold notification.

Each child node of the QMI TS devicetree node represents a remote
subsystem and it can have more than one remote sensor names.

Properties:

- compatible:
	Usage: required
	Value type: <string>
	Definition: should be "qcom,qmi-sensors"

- #thermal-sensor-cells:
	Usage: required
	Value type: <integer>
	Definition: Must be 1. See thermal.txt for description.

Subsystem properties:
- qcom,instance-id:
	Usage: required
	Value type: <integer>
	Definition: Remote subsystem QMI server instance id to be used for
			communicating with QMI.

- qcom,qmi-sensor-names:
	Usage: required
	Value type: <array of string>
	Definition: Remote sensor names. Below strings
		are the only acceptable sensor names,
		1. pa
		2. pa_1
		3. pa_2
		4. qfe_pa0
		5. qfe_wtr0
		6. modem_tsens
		7. qfe_mmw0
		8. qfe_mmw1
		9. qfe_mmw2
		10. qfe_mmw3
		11. xo_therm
		12. qfe_pa_mdm
		13. qfe_pa_wtr
		14. qfe_mmw_streamer0
		15. qfe_mmw0_mod
		16. qfe_mmw1_mod
		17. qfe_mmw2_mod
		18. qfe_mmw3_mod
		19. qfe_ret_pa0
		20. qfe_wtr_pa0
		21. qfe_wtr_pa1
		22. qfe_wtr_pa2
		23. qfe_wtr_pa3
		24. sys_therm1
		25. sys_therm2
		26. modem_tsens1
		27. BEAMER_W_THERM
		28. BEAMER_N_THERM
		29. BEAMER_E_THERM

Example:

qmi_sensor: qmi-ts-sensors {
	compatible = "qcom,qmi-sensors";
	#thermal-sensor-cells = <1>;

	modem {
		qcom,instance-id = <0x0>;
		qcom,qmi-sensor-names = "pa",
					"pa_1",
					"qfe_pa0",
					"qfe_wtr0";
	};
};
```

## Documentation/devicetree/bindings/thermal/qti-rpmh-reg-cdev.txt
```
RPMh regulator cooling device.

The RPMh regulator cooling device, will be used to place a voltage floor
restriction on a rail. This cooling device will use a QMP AOP mail box to send
the message to apply and clear voltage floor restriction.

The cooling device node should be a child of the regulator devicetree node,
which it is trying to place the floor restriction.

Properties:

- compatible:
	Usage: required
	Value type: <string>
	Definition: shall be "qcom,rpmh-reg-cdev"

- qcom,reg-resource-name:
	Usage: required
	Value type: <string>
	Definition: The regulator resource name to be used for communicating
			with RPMh. This value should be any of the below
			resource name,
			cx -> For CX rail,
			mx -> For MX rail,
			ebi -> For EBI rail.

- mboxes:
	Usage: required
	Value type: <phandle>
	Definition: A phandle to the QMP AOP mail box, that needs to be used
			for sending the floor restriction message.

- #cooling-cells: Must be 2. Please refer to
			<devicetree/bindings/thermal/thermal.txt> for more
			details.

Example:

	vdd_cx: rpmh-cx-regulator-cdev {
		compatible = "qcom,rpmh-reg-cdev";
		mboxes = <&qmp_aop 0>;
		qcom,reg-resource-name = "cx";
		#cooling-cells = <2>;
	};
```

## Documentation/devicetree/bindings/thermal/regulator-cdev.txt
```
Regulator cooling device.

The regulator cooling device, will be used to place a voltage floor
restriction on a rail.

Properties:

- compatible:
	Usage: required
	Value type: <string>
	Definition: shall be "qcom,regulator-cooling-device"

- cdev-supply:
	Usage: required
	Value type: <phandle>
	Definition: phandle to the regulator to which the cooling device will
			place a floor mitigation.

- regulator-levels:
	Usage: required
	Value type: <U32 array>
	Definition: Array of regulator voltages the cooling device should
			use to place a floor restriction. The voltages should
			be specified in descending order.

- #cooling-cells: Must be 2. Please refer to
			<devicetree/bindings/thermal/thermal.txt> for more
			details.

Example:

	mv_cdev: mx-cdev-lvl {
		compatible = "qcom,regulator-cooling-device";
		cdev-supply = <&regulator-cdev-supply>;
		regulator-levels = <RPMH_REGULATOR_LEVEL_NOM
			RPMH_REGULATOR_LEVEL_OFF>;
		#cooling-cells = <2>;
	};
```

## Documentation/devicetree/bindings/thermal/tsens.txt
```
Qualcomm Technologies, Inc. TSENS driver

Temperature sensor (TSENS) driver supports reading temperature from sensors
across the MSM. The driver defaults to support a 12 bit ADC.

The driver uses the Thermal sysfs framework to provide thermal
clients the ability to read from supported on-die temperature sensors,
set temperature thresholds for cool/warm thresholds and receive notification
on temperature threshold events.

TSENS node

Required properties:
- compatible : should be "qcom,msm8996-tsens" for 8996 TSENS driver.
	       should be "qcom,msm8953-tsens" for 8953 TSENS driver.
	       should be "qcom,msm8998-tsens" for 8998 TSENS driver.
	       should be "qcom,msmhamster-tsens" for hamster TSENS driver.
	       should be "qcom,sdm660-tsens" for 660 TSENS driver.
	       should be "qcom,sdm630-tsens" for 630 TSENS driver.
	       should be "qcom,sdm845-tsens" for SDM845 TSENS driver.
	       should be "qcom,tsens24xx" for 2.4 TSENS controller.
	       should be "qcom,msm8937-tsens" for 8937 TSENS driver.
	       should be "qcom,qcs405-tsens" for QCS405 TSENS driver.
	       should be "qcom,sm6150-tsens" for 6150 TSENS driver.
	       should be "qcom,mdm9607-tsens" for 9607 TSENS driver.

	       The compatible property is used to identify the respective controller to use
	       for the corresponding SoC.
- reg : offset and length of the TSENS registers with associated property in reg-names
	as "tsens_srot_physical" for TSENS SROT physical address region. TSENS TM
	physical address region as "tsens_tm_physical", and "tsens_eeprom_physical" for the
	TSENS calibration fuse register region.
- reg-names : resource names used for the physical address of the TSENS
	      registers. Should be "tsens_srot_physical" for physical address of the TSENS
	      SROT region, "tsens_tm_physical" for physical address of the TM region and
		  "tsens_eeprom_physical" for the TSENS calibration fuse register region.
- interrupts : TSENS interrupt to notify Upper/Lower and Critical temperature threshold.
- interrupt-names: Should be "tsens-upper-lower" for temperature threshold.
		   Add "tsens-critical" for Critical temperature threshold notification
		   in addition to "tsens-upper-lower" for 8996 TSENS since
		   8996 supports Upper/Lower and Critical temperature threshold.

Example:

tsens@fc4a8000 {
	compatible = "qcom,msm-tsens";
	reg = <0xfc4a8000 0x10>,
		<0xfc4b8000 0x1ff>;
	reg-names = "tsens_srot_physical",
		    "tsens_tm_physical",
			"tsens_eeprom_physical",
	interrupts = <0 184 0>;
	interrupt-names = "tsens-upper-lower";
};
```

## Documentation/devicetree/bindings/trusty/trusty-fiq-debugger.txt
```
Trusty fiq debugger interface

Provides a single fiq for the fiq debugger.

Required properties:
- compatible: compatible = "android,trusty-fiq-v1-*"; where * is a serial port.

Must be a child of the node that provides fiq support ("android,trusty-fiq-v1").
```

## Documentation/devicetree/bindings/trusty/trusty-fiq.txt
```
Trusty fiq interface

Trusty provides fiq emulation.

Required properties:
- compatible: "android,trusty-fiq-v1"

Must be a child of the node that provides the trusty std/fast call interface.
```

## Documentation/devicetree/bindings/trusty/trusty-hee-irq.txt
```
Trusty virq simulation interface

Trusty is running in secure mode on the same (arm) cpu(s) as the current os.

Required properties:
- compatible: "nbl,hee-irqs"
```
