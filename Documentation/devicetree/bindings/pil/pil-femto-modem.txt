## Documentation/devicetree/bindings/pinctrl/qcom,slpi-pinctrl.txt
```
Qualcomm Technologies, Inc. SLPI Pin controller driver

This DT bindings describes the Pin controller driver
being added for supporting SLPI (Sensor Low Power Island) TLMM
from QTI chipsets.

Following properties are for SLPI Pin controller device main node.
- compatible:
	Usage: required
	Value type: <string>
	Definition: must be "qcom,slpi-pinctrl"

- reg:
	Usage: required
	Value type: <prop-encoded-array>
	Definition: Base address and size of the SLPI TLMM register space.

- qcom,num-pins:
	Usage: required
	Value type: <u32>
	Definition: Number of PINs supported by the SLPI TLMM.

Please refer to pinctrl-bindings.txt in this directory for details of the
common pinctrl bindings used by client devices, including the meaning of the
phrase "pin configuration node".

The pin configuration nodes act as a container for an arbitrary number of
subnodes. Each of these subnodes represents some desired configuration for a
pin or a list of pins. This configuration can include the
mux function to select on those pin(s), and various pin configuration
parameters, as listed below.

SUBNODES:

The name of each subnode is not important; all subnodes should be enumerated
and processed purely based on their content.

Each subnode only affects those parameters that are explicitly listed. In
other words, a subnode that lists a mux function but no pin configuration
parameters implies no information about any pin configuration parameters.
Similarly, a pin subnode that describes a pullup parameter implies no
information about e.g. the mux function.

The following generic properties as defined in pinctrl-bindings.txt are valid
to specify in a pin configuration subnode:

- pins:
	Usage: required
	Value type: <string-array>
	Definition: List of gpio pins affected by the properties specified in
		    this subnode.  Valid pins are: gpio0-gpio31 for LPI.

- function:
	Usage: required
	Value type: <string>
	Definition: Specify the alternative function to be configured for the
		    specified pins. Valid values are:
			"gpio",
			"func1",
			"func2",
			"func3",
			"func4",
			"func5"

- bias-disable:
	Usage: optional
	Value type: <none>
	Definition: The specified pins should be configured as no pull.

- bias-pull-down:
	Usage: optional
	Value type: <none>
	Definition: The specified pins should be configured as pull down.

- bias-bus-hold:
	Usage: optional
	Value type: <none>
	Definition: The specified pins should be configured as bus-keeper mode.

- bias-pull-up:
	Usage: optional
	Value type: <empty>
	Definition: The specified pins should be configured as pull up.

- qcom,drive-strength:
	Usage: optional
	Value type: <u32>
	Definition: Selects the drive strength for the specified pins.

Example:

	slpi_tlmm: slpi_pinctrl@02b40000 {
		compatible = "qcom,slpi-pinctrl";
		qcom,num-pins = <14>;
		reg = <0x02b40000 0x20000>;

		slpi_mclk0_active: slpi_mclk0_active {
			mux {
				pins = "gpio0", "gpio1", "gpio2", "gpio3";
				function = "func2";
			};

			config {
				pins = "gpio0", "gpio1", "gpio2", "gpio3";
				drive-strength = <8>;
				bias-disable;
			};
		};

		slpi_mclk0_sleep: slpi_mclk0_sleep {
			mux {
				pins = "gpio0", "gpio1", "gpio2", "gpio3";
				function = "func2";
			};

			config {
				pins = "gpio0", "gpio1", "gpio2", "gpio3";
				drive-strength = <2>;
				bias-pull-down;
			};
		};

	};
```

## Documentation/devicetree/bindings/pinctrl/qcom,wcd-pinctrl.txt
```
Qualcomm Technologies, Inc. WCD GPIO block

This binding describes the GPIO block found in the WCD934X series of
audio codec's from QTI.

- compatible:
	Usage: required
	Value type: <string>
	Definition: must be "qcom,wcd-pinctrl"

- qcom,num-gpios:
	Usage: required
	Value type: <u32>
	Definition: Number of GPIO's supported by the controller

- gpio-controller:
	Usage: required
	Value type: <none>
	Definition: Mark the device node as a GPIO controller

- #gpio-cells:
	Usage: required
	Value type: <u32>
	Definition: Must be 2;
		    the first cell will be used to define gpio number and the
		    second denotes the flags for this gpio

Please refer to ../gpio/gpio.txt for a general description of GPIO bindings.

Please refer to pinctrl-bindings.txt in this directory for details of the
common pinctrl bindings used by client devices, including the meaning of the
phrase "pin configuration node".

The pin configuration nodes act as a container for an arbitrary number of
subnodes. Each of these subnodes represents some desired configuration for a
pin or a list of pins. This configuration can include the
mux function to select on those pin(s), and various pin configuration
parameters, as listed below.


SUBNODES:

The name of each subnode is not important; all subnodes should be enumerated
and processed purely based on their content.

Each subnode only affects those parameters that are explicitly listed. In
other words, a subnode that lists a mux function but no pin configuration
parameters implies no information about any pin configuration parameters.
Similarly, a pin subnode that describes a pullup parameter implies no
information about e.g. the mux function.

The following generic properties as defined in pinctrl-bindings.txt are valid
to specify in a pin configuration subnode:

- pins:
	Usage: required
	Value type: <string-array>
	Definition: List of gpio pins affected by the properties specified in
		    this subnode.  Valid pins are:
		    gpio1-gpio5 for wcd9360

- bias-disable:
	Usage: optional
	Value type: <none>
	Definition: The specified pins should be configured as no pull.

- bias-pull-down:
	Usage: optional
	Value type: <none>
	Definition: The specified pins should be configured as pull down.

- bias-pull-up:
	Usage: optional
	Value type: <empty>
	Definition: The specified pins should be configured as pull up.

- qcom,pull-up-strength:
	Usage: optional
	Value type: <u32>
	Definition: Specifies the strength to use for pull up, if selected.

- bias-high-impedance:
	Usage: optional
	Value type: <none>
	Definition: The specified pins will put in high-Z mode and disabled.

- input-enable:
	Usage: optional
	Value type: <none>
	Definition: The specified pins are put in input mode.

- output-high:
	Usage: optional
	Value type: <none>
	Definition: The specified pins are configured in output mode, driven
		    high.

- output-low:
	Usage: optional
	Value type: <none>
	Definition: The specified pins are configured in output mode, driven
		    low.

- qcom,drive-strength:
	Usage: optional
	Value type: <u32>
	Definition: Selects the drive strength for the specified pins.

Example:

	wcd: wcd_pinctrl@5 {
		compatible = "qcom,wcd-pinctl";
		qcom,num-gpios = <5>;
		gpio-controller;
		#gpio-cells = <2>;

		spkr_1_wcd_en_active: spkr_1_wcd_en_active {
			mux {
				pins = "gpio2";
			};

			config {
				pins = "gpio2";
				output-high;
			};
		};

		spkr_1_wcd_en_sleep: spkr_1_wcd_en_sleep {
			mux {
				pins = "gpio2";
			};

			config {
				pins = "gpio2";
				input-enable;
			};
		};
	};
```

## Documentation/devicetree/bindings/platform/msm/avtimer.txt
```
* avtimer

Avtimer provides an interface for clients to enable avtimer block
on qdsp6. 64 bit AVtimer exposed by qdsp6 is used for audio and video
stream synchronization during capture and playback usecases.

Required properties:
- reg : physical address and length of avtimer register
- reg-names : AVtimer register name
  Required register resource entries are:
  "avtimer_lsb_addr" : AVtimer lsb physical address
  "avtimer_msb_addr" : AVtimer msb physical address
- compatible : Must be "qcom,avtimer"

Optional properties:
- clk-div : The clk is at 27MHz and hence ticks are to be
 divided by 27 to achive the msec value.

Example:
	qcom,avtimer@90f7000 {
		compatible = "qcom,avtimer";
		reg = <0x90f700c 0x4>,
		      <0x90f7010 0x4>;
		reg-names = "avtimer_lsb_addr", "avtimer_msb_addr";
		qcom,clk-div = <27>;
	};
```

## Documentation/devicetree/bindings/platform/msm/early_domain.txt
```
Early domain core driver.

Early domain in bootloader run multimedia services like display,
camera, audio by reserving cpu(s) and some memory in parallel with
kernel.

These services may need to stop when they decide. Early domain
driver in kernel communicates with early services through a shared
memory block. This block is reserved during kernel boot.

Early services running in bootloader update their status in the
shared memory block. Multimedia drivers in kernel can make use of
apis provided by early domain core driver to get the status of early
services and free reserved memory resource to system
when the early services end.

Required properties
- compatible : 	should be "qcom,early_domain"
- status     : 	should be "disabled" by default.
		status should be made "ok" only
		if earlydomain is active by
		bootloaders.

Example:
	early_domain: early_domain  {
			compatible = "qcom,early_domain";
			status = "disabled";
	};
```

## Documentation/devicetree/bindings/platform/msm/gpio-usbdetect.txt
```
GPIO USB VBUS Detection

Discrete USB VBUS detection circuitry can be connected to the AP or PMICs.
Such circuits can be used to detect the when a USB cable is connected to
an upstream port such as a standard host or a wall charger by detecting
the presence of VBUS voltage. The GPIO can be configured to trigger an
interrupt, and allow the software driver to in turn notify the USB
subsytem using the power_supply framework.

Required Properties:
 - compatible: must be "qcom,gpio-usbdetect"
 - qcom,vbus-det-gpio: GPIO from which VBUS detection can be read from.
 - interrupts: an interrupt triggered by the output of the detection circuit
 - interrupt-names: must be "vbus_det_irq"

Optional Properties:
 - vin-supply: phandle to a regulator that powers this circuit, if needed

Example:

	usb_detect {
		compatible = "qcom,gpio-usbdetect";
		qcom,vbus-det-gpio = <&pm8084 2 0>;
                vin-supply = <&vbus_det_reg>;
	};
```
