## Documentation/devicetree/bindings/pil/pil-femto-modem.txt
```
Qualcomm Femtocell (FSM99XX and FSM90XX) Peripheral Image Loader

pil-femto-modem is a peripheral image loader (PIL) driver. It is used for
loading firmware images on multiple modems resident on the FSM99XX and
FSM90XX platforms.

The top-level device tree entry has the following properties:

Required properties:
- compatible:           Must be "qcom,pil-femto-modem".
- reg:                  Pair of physical base address and region size of the
                        QDSP6[0] control registers.
- reg-names:            "qdsp6_base" is required.
- qcom,firmware-name:   Base name of the MBA firmware image ("mba").
                        Maximum size is 4 characters.
- qcom,max-num-modems:  Number of modem child nodes specified.

Optional properties:
- qcom,q6-freq-row:    Row number from the frequency table.  Must be specified
                       with qcom,q6-freq-col.  Refer to MBA documentation for
                       specifics on frequency table row selection.  Current
                       row maximum is 6.
- qcom,q6-freq-col:    The column numbers from the frequency table.  This must
                       be specified if qcom,q6-freq-row is specified.  The
                       number of column values corresponds to the number of
                       QDSPs available, and each selection corresponds to a
                       desired frequency.  Refer to MBA documentation for
                       specifics on frequency table column selections when
                       paired with a given row.  Current column maximum is 7.

One child node per modem that must be loaded is required.

Required properties:
- compatible:           Must be "qcom,pil-femto-modem-desc".
- reg:                  Pair of physical base address and region size of the
                        Relay Message Buffer (RMB) registers for this modem.
- reg-names:            "rmb_base" is required.
- qcom,firmware-name:   Base filename of the firmware image (e.g. "mdm0").
                        Maximum size is 4 characters.
- qcom,modem-id:        Unique ID of this modem.  This is not a logical
                        index.
- qcom,max-num-images:  The maximum number of images that will be loaded to
                        this modem.

Optional properties:
- qcom,pil-skip-entry-check:
                        Some entry pointers are virtual addresses,
                        which will cause the PIL entry address check
                        to fail.  This parameter will disable the
                        check.

Example:
        qcom,modem-femto@fbc00000 {
                compatible = "qcom,pil-femto-modem";
                #address-cells=<1>;
                #size-cells=<1>;
                ranges;
                reg = <0xfbc00000 0x100>;
                reg-names = "qdsp6_base";
                qcom,firmware-name = "mba";
                qcom,max-num-modems = <5>;
                qcom,q6-freq-row = <0>;
                qcom,q6-freq-col = <2 2 1 1>;

                qcom,modem@fd4a7000 {
                        compatible = "qcom,pil-femto-modem-desc";
                        reg = <0xfd4a7000 0x20>;
                        reg-names = "rmb_base";
                        qcom,firmware-name = "mdm0";
                        qcom,modem-id = <0>;
                        qcom,max-num-images = <1>;
                };

                qcom,modem@fd4a7030 {
                        compatible = "qcom,pil-femto-modem-desc";
                        reg = <0xfd4a7030 0x20>;
                        reg-names = "rmb_base";
                        qcom,firmware-name = "mdm1";
                        qcom,modem-id = <1>;
                        qcom,max-num-images = <1>;
                };

                qcom,modem@fd4a7060 {
                        compatible = "qcom,pil-femto-modem-desc";
                        reg = <0xfd4a7060 0x20>;
                        reg-names = "rmb_base";
                        qcom,firmware-name = "mdm2";
                        qcom,modem-id = <2>;
                        qcom,max-num-images = <1>;
                };

                qcom,modem@fd4a7090 {
                        compatible = "qcom,pil-femto-modem-desc";
                        reg = <0xfd4a7090 0x20>;
                        reg-names = "rmb_base";
                        qcom,firmware-name = "mdm3";
                        qcom,modem-id = <3>;
                        qcom,max-num-images = <1>;
                };

                qcom,modem@fd4a70c0 {
                        compatible = "qcom,pil-femto-modem-desc";
                        reg = <0xfd4a70c0 0x20>;
                        reg-names = "rmb_base";
                        qcom,firmware-name = "mdm4";
                        qcom,modem-id = <4>;
                        qcom,max-num-images = <8>;
                        qcom,pil-skip-entry-check;
                };
        };
```

## Documentation/devicetree/bindings/pil/pil-mba.txt
```
Qualcomm Modem Boot Authenticator Peripheral Image Loader

pil-mba is a peripheral image loader (PIL) driver. It is used for loading
modem images using the self-authenticating hardware and software features
of the Modem Boot Authenticator.

Required properties:
- compatible:	      Must be "qcom,pil-mba"
- reg:		      Two pairs of physical base addresses and sizes. The
		      first corresponds to the Relay Message Buffer (RMB)
		      register base. The second specifies the address at which
		      the primary modem image metadata should be stored.
- qcom,firmware-name: Base name of the firmware image. Ex. "modem"

Optional properties:
- qcom,depends-on:    firmware-name of a prerequisite image that must already
		      be running.

Example:
	qcom,mba@fc820000 {
		compatible = "qcom,pil-mba";
		reg = <0xfc820000 0x0020>,
		      <0x0d1f0000 0x4000>;

		qcom,firmware-name = "modem";
		qcom,depends-on    = "mba";
	};
```

## Documentation/devicetree/bindings/pil/pil-pronto.txt
```
* Qualcomm WCNSS Pronto Peripheral Image Loader

pil-pronto is a peripheral image loading (PIL) driver. It is used for loading
Pronto firmware images for wireless connectivity subsystems into memory and
preparing the subsystem's processor to execute code. It is also used for
shutting down the processor when it's not needed.

Required properties:
- compatible: "pil-pronto"
- reg: offset and length of the register set for the device.
- reg-names: names of the bases for the above registers. "pmu_base", "clk_base",
             and "halt_base" are expected.
- interrupts: WCNSS to Apps watchdog bite interrupt
- vdd_pronto_pll-supply: regulator to supply pronto pll.
- qcom,firmware-name: Base name of the firmware image. Ex. "wcnss"

Optional properties:
- qcom,gpio-err-fatal: GPIO used by the wcnss to indicate error fatal to the Apps.
- qcom,gpio-err-ready: GPIO used by the wcnss to indicate error ready to the Apps.
- qcom,gpio-proxy-unvote: GPIO used by the wcnss to trigger proxy unvoting in
  the Apps
- qcom,gpio-stop-ack: GPIO used by wcnss to ack force stop or a graceful stop
  to Apps.
- qcom,gpio-force-stop: GPIO used by the Apps to force the wcnss to shutdown.
- qcom,restart-group: List of subsystems that will need to restart together.

Example:
	qcom,pronto@fb21b000 {
		compatible = "qcom,pil-pronto";
		reg = <0xfb21b000 0x3000>,
		      <0xfc401700 0x4>,
		      <0xfd485300 0xc>;
		reg-names = "pmu_base", "clk_base", "halt_base";
		vdd_pronto_pll-supply = <&pm8941_l12>;
		interrupts = <0 231 1>;

		qcom,firmware-name = "wcnss";

		/* GPIO input from wcnss */
		qcom,gpio-err-fatal = <&smp2pgpio_ssr_smp2p_4_in 0 0>;
		qcom,gpio-err-ready = <&smp2pgpio_ssr_smp2p_4_in 1 0>;
		qcom,proxy-unvote = <&smp2pgpio_ssr_smp2p_4_in 2 0>;
		qcom,gpio-stop-ack = <&smp2pgpio_ssr_smp2p_4_in 3 0>;

		/* GPIO output to wcnss */
		qcom,gpio-force-stop = <&smp2pgpio_ssr_smp2p_4_out 0 0>;
	};
```

## Documentation/devicetree/bindings/pil/pil-q6v5-lpass.txt
```
Qualcomm LPASS QDSP6v5 Peripheral Image Loader

pil-qdsp6v5-lpass is a peripheral image loader (PIL) driver. It is used for
loading QDSP6v5 (Hexagon) firmware images for Low Power Audio Subsystems
into memory and preparing the subsystem's processor to execute code. It's
also responsible for shutting down the processor when it's not needed.

Required properties:
- compatible:	      Must be "qcom,pil-q6v5-lpass"
- reg:		      Two pairs of physical base addresses and region sizes
		      of memory mapped registers. The first region corresponds
		      to QDSP6SS_PUB, and the second to LPASS_HALTREQ.
- qcom,firmware-name: Base name of the firmware image. Ex. "lpass"

Example:
	qcom,lpass@fe200000 {
	        compatible = "qcom,pil-q6v5-lpass";
	        reg = <0xfe200000 0x00100>,
	              <0xfd485100 0x00010>;

	        qcom,firmware-name = "lpass";
	};
```

## Documentation/devicetree/bindings/pil/pil-q6v5-mss.txt
```
Qualcomm MSS QDSP6v5 Peripheral Image Loader

pil-qdsp6v5-mss is a peripheral image loader (PIL) driver. It is used for
loading QDSP6v5 (Hexagon) firmware images for modem subsystems into memory and
preparing the subsystem's processor to execute code. It's also responsible for
shutting down the processor when it's not needed.

Required properties:
- compatible:	      Must be "qcom,pil-q6v5-mss" or "qcom,pil-q6v55-mss" or
			"pil-q6v56-mss".
- reg:		      Pairs of physical base addresses and region sizes of
		      memory mapped registers.
- reg-names:	      Names of the bases for the above registers. "qdsp6_base",
		      "rmb_base", "restart_reg" or "restart_reg_sec"(optional
		      for secure mode) are expected.
		      If "halt_base" is in same 4K pages this register then
		      this will be defined else "halt_q6", "halt_modem",
		      "halt_nc" is required.
- interrupts:         The modem watchdog interrupt
- vdd_cx-supply:      Reference to the regulator that supplies the vdd_cx domain.
- vdd_mx-supply:      Reference to the regulator that supplies the memory rail.
- vdd_mx-uV:          Voltage setting for the mx rail.
- qcom,firmware-name: Base name of the firmware image. Ex. "mdsp"

Optional properties:
- vdd_mss-supply:     Reference to the regulator that supplies the processor.
		      This may be a shared regulator that is already voted
		      on in the PIL proxy voting code (and also managed by the
		      modem on its own), hence we mark it as as optional.
- vdd_pll-supply:     Reference to the regulator that supplies the PLL's rail.
- qcom,vdd_pll:       Voltage to be set for the PLL's rail.
- reg-names:          "cxrail_bhs_reg" - control register for modem power
		      domain.
- clocks:	      Array of <clock_controller_phandle clock_reference> listing
		      all the clocks that are accesed by this subsystem.
- qcom,proxy-clock-names:  Names of the clocks that need to be turned on/off during
			   proxy voting/unvoting.
- qcom,active-clock-names: Names of the clocks that need to be turned on for the
			   subsystem to run. Turned off when the subsystem is shutdown.
- clock-names:		   Names of all the clocks that are accessed by the subsystem.
- qcom,is-not-loadable: Boolean- Present if the image does not need to
			be loaded.
- qcom,pil-self-auth: Boolean- True if authentication is required.
- qcom,gpio-err-fatal: GPIO used by the modem to indicate error fatal to the apps.
- qcom,gpio-err-ready: GPIO used by the modem to indicate error ready to the apps.
- qcom,gpio-proxy-unvote: GPIO used by the modem to trigger proxy unvoting in
  the apps.
- qcom,gpio-force-stop: GPIO used by the apps to force the modem to shutdown.
- qcom,gpio-stop-ack: GPIO used by the modem to ack force stop or a graceful stop
		      to the apps.
- qcom,gpio-ramdump-disable: GPIO used by the modem to inform the apps that ramdump
			     collection should be disabled.
- qcom,restart-group: List of subsystems that will need to restart together.
- qcom,mba-image-is-not-elf:	Boolean- Present if MBA image doesnt use the ELF
				format.
- qcom,ssctl-instance-id: Instance id used by the subsystem to connect with the SSCTL
			  service.
- qcom,sysmon-id:	platform device id that sysmon is probed with for the subsystem.
- qcom,override-acc: Boolean- Present if we need to override the default ACC settings
- qcom,ahb-clk-vote: Boolean- Present if we need to remove the vote for the mss_cfg_ahb
		     clock after the modem boots up
- qcom,qdsp6v56-1-3: Boolean- Present if the qdsp version is v56 1.3
One child node to represent the MBA image may be specified, when the MBA
image needs to be loaded in a specifically carved out memory region.

Required properties:
- compatible:              Must be "qcom,pil-mba-mem"
- linux,contiguous-region: A phandle that points to a memory heap where the MBA
                          image will be loaded

Example:
	qcom,mss@fc880000 {
		compatible = "qcom,pil-q6v5-mss";
		reg = <0xfc880000 0x100>,
		      <0xfd485000 0x400>,
		      <0xfc820000 0x020>,
		      <0xfc401680 0x004>;
		reg-names = "qdsp6_base", "halt_base", "rmb_base",
			    "restart_reg";
		interrupts = <0 24 1>;
		vdd_mss-supply = <&pm8841_s3>;
		vdd_cx-supply = <&pm8841_s2>;
		vdd_mx-supply = <&pm8841_s1>;
		vdd_mx-uV = <105000>;

		clocks = <&clock_rpm clk_xo_pil_mss_clk>,
			 <&clock_gcc clk_gcc_mss_cfg_ahb_clk>,
			 <&clock_gcc clk_gcc_mss_q6_bimc_axi_clk>,
			 <&clock_gcc clk_gcc_boot_rom_ahb_clk>;
		clock-names = "xo", "iface_clk", "bus_clk", "mem_clk";
		qcom,proxy-clock-names = "xo";
		qcom,active-clock-names = "iface_clk", "bus_clk", "mem_clk";

		qcom,is-not-loadable;
		qcom,firmware-name = "mba";
		qcom,pil-self-auth;
		qcom,mba-image-is-not-elf;
		qcom,override-acc;

		/* GPIO inputs from mss */
		qcom,gpio-err-fatal = <&smp2pgpio_ssr_smp2p_1_in 0 0>;
		qcom,gpio-err-ready = <&smp2pgpio_ssr_smp2p_1_in 1 0>;
		qcom,gpio-proxy-unvote = <&smp2pgpio_ssr_smp2p_1_in 2 0>;

		/* GPIO output to mss */
		qcom,gpio-force-stop = <&smp2pgpio_ssr_smp2p_1_out 0 0>;
		qcom,ssctl-instance-id = <12>;
		qcom,sysmon-id = <0>;

		qcom,mba-mem@0 {
			compatible = "qcom,pil-mba-mem";
			linux,contiguous-region = <&mba_mem>;
		};
	};
```

## Documentation/devicetree/bindings/pil/pil-venus.txt
```
* Qualcomm Venus Video Subsystem Peripheral Image Loader

pil-venus is a peripheral image loading (PIL) driver. It is used for loading
venus firmware images for video codec into memory and preparing the subsystem's
processor to execute code. It is also used for shutting down the processor when
it's not needed.

Required properties:
- compatible: "pil-venus"
- reg: offset and length of the register set for the device. The first pair
       corresponds to VENUS_WRAPPER, the second pair corresponds to VENUS_VBIF.
- vdd-supply: regulator to supply venus.
- qcom,firmware-name: Base name of the firmware image. Ex. "venus"
- qcom,firmware-min-paddr: The lowest addr boundary for firmware image in DDR
- qcom,firmware-max-paddr: The highest addr boundary for firmware image in DDR

Example:
        qcom,venus@fdce0000 {
                compatible = "qcom,pil-venus";
                reg = <0xfdce0000 0x4000>,
                      <0xfdc80208 0x8>;
                vdd-supply = <&gdsc_venus>;

                qcom,firmware-name = "venus";
                qcom,firmware-min-paddr = <0xF500000>;
                qcom,firmware-max-paddr = <0xFA00000>;

        };
```
