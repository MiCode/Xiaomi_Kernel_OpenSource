## Documentation/devicetree/bindings/media/video/msm-ispif.txt
```
* Qualcomm MSM ISPIF

Required properties:
- cell-index: ispif hardware core index
- compatible :
    - "qcom,ispif"
    - "qcom,ispif-v3.0"
- reg : offset and length of the register set for the device
    for the ispif operating in compatible mode.
- reg-names : should specify relevant names to each reg property defined.
- interrupts : should contain the ispif interrupt.
- interrupt-names : should specify relevant names to each interrupts
  property defined.
- vfe0-vdd-supply: phandle to vfe0 regulator.
- vfe1-vdd-supply: phandle to vfe1 regulator.
- clocks: list of phandles to the clock controller device and coresponding
  clock names.
- clock-names: name of the clocks required for the device used by the consumer.
- qcom,clock-rates: clock rate in Hz.

Optional properties:
- qcom,num-isps: The number of ISPs the ISPIF module is connected to. If not set
  the default value used is 1

Example:

	qcom,ispif@fda0a000 {
		cell-index = <0>;
		compatible = "qcom,ispif";
		reg = <0xfda0a000 0x300>;
		reg-names = "ispif";
		interrupts = <0 55 0>;
		interrupt-names = "ispif";
		vfe0-vdd-supply = <&gdsc_vfe>;
		vfe1-vdd-supply = <&gdsc_vfe1>;
		clocks = <&clock_mmss clk_camss_ispif_ahb_clk>,
			<&clock_mmss clk_csi0_clk_src>,
			<&clock_mmss clk_camss_csi0_clk>,
			<&clock_mmss clk_camss_csi0rdi_clk>,
			<&clock_mmss clk_camss_csi0pix_clk>,
			<&clock_mmss clk_csi1_clk_src>,
			<&clock_mmss clk_camss_csi1_clk>,
			<&clock_mmss clk_camss_csi1rdi_clk>,
			<&clock_mmss clk_camss_csi1pix_clk>,
			<&clock_mmss clk_csi2_clk_src>,
			<&clock_mmss clk_camss_csi2_clk>,
			<&clock_mmss clk_camss_csi2rdi_clk>,
			<&clock_mmss clk_camss_csi2pix_clk>,
			<&clock_mmss clk_csi3_clk_src>,
			<&clock_mmss clk_camss_csi3_clk>,
			<&clock_mmss clk_camss_csi3rdi_clk>,
			<&clock_mmss clk_camss_csi3pix_clk>,
			<&clock_mmss clk_vfe0_clk_src>,
			<&clock_mmss clk_camss_vfe0_clk>,
			<&clock_mmss clk_camss_csi_vfe0_clk>,
			<&clock_mmss clk_vfe1_clk_src>,
			<&clock_mmss clk_camss_vfe1_clk>,
			<&clock_mmss clk_camss_csi_vfe1_clk>;
		clock-names = "ispif_ahb_clk",
			"csi0_src_clk", "csi0_clk",
			"csi0_pix_clk", "csi0_rdi_clk",
			"csi1_src_clk", "csi1_clk",
			"csi1_pix_clk", "csi1_rdi_clk",
			"csi2_src_clk", "csi2_clk",
			"csi2_pix_clk", "csi2_rdi_clk",
			"csi3_src_clk", "csi3_clk",
			"csi3_pix_clk", "csi3_rdi_clk",
			"vfe0_clk_src", "camss_vfe_vfe0_clk", "camss_csi_vfe0_clk",
			"vfe1_clk_src", "camss_vfe_vfe1_clk", "camss_csi_vfe1_clk";
		qcom,clock-rates = "0",
			"200000000", "0", "0", "0",
			"200000000", "0", "0", "0",
			"200000000", "0", "0", "0",
			"200000000", "0", "0", "0",
			"0", "0", "0",
			"0", "0", "0";
	};


or

   qcom,ispif@fda0a000 {
       cell-index = <0>;
       compatible = "qcom,ispif-v3.0", "qcom,ispif";
       reg = <0xfda0a000 0x300>;
       reg-names = "ispif";
       interrupts = <0 55 0>;
       interrupt-names = "ispif";
       qcom,num-isps = <2>
   };
```

## Documentation/devicetree/bindings/media/video/msm-jpeg.txt
```
* Qualcomm Technologies, Inc. MSM JPEG

Required properties:
- cell-index: jpeg hardware core index
- compatible :
    - "qcom,jpeg"
    - "qcom,jpeg_dma"
- reg : offset and length of the register set of jpeg device and vbif device
    for the jpeg operating in compatible mode.
- reg-names : should specify relevant names to each reg property defined.
- interrupts : should contain the jpeg interrupt.
- interrupt-names : should specify relevant names to each interrupts
  property defined.
- clock-names : names of clocks required for the device.
- clocks : clocks required for the device.
- qcom, clock-rates: rates of the required clocks.
- vdd-supply: phandle to GDSC regulator controlling JPEG core.
- mmagic-vdd-supply: phandle to GDSC regulator controlling mmagic.
- camss-vdd-supply: phandle to GDSC regulator controlling camss.

Optional properties:
- qcom,vbif-reg-settings: relative address offsets and value pairs for VBIF registers.
- qcom,qos-reg-settings: relative address offsets and value pairs for QoS registers.
- qcom,prefetch-reg-settings: relative address offsets and value pairs for
  MMU prefetch registers.

Example:

	qcom,jpeg@a1c000 {
		cell-index = <0>;
		compatible = "qcom,jpeg";
		reg = <0xa1c000 0x4000>,
			<0xa60000 0x3000>;
		reg-names = "jpeg";
		interrupts = <0 316 0>;
		interrupt-names = "jpeg";
                mmagic-vdd-supply = <&gdsc_mmagic_camss>;
                camss-vdd-supply = <&gdsc_camss_top>;
                vdd-supply = <&gdsc_jpeg>;
                qcom,vdd-names = "mmagic-vdd", "camss-vdd", "vdd";
		clock-names =  "core_clk", "iface_clk", "bus_clk0",
			       "camss_top_ahb_clk", "camss_ahb_clk", "smmu_jpeg_axi_clk",
                               "mmss_mmagic_ahb_clk", "mmssnoc_axi_clk",
                               "mmagic_camss_axi_clk";
		clocks = <&clock_mmss clk_camss_jpeg0_clk>,
			<&clock_mmss clk_camss_jpeg_ahb_clk>,
			<&clock_mmss clk_camss_jpeg_axi_clk>,
			<&clock_mmss clk_camss_top_ahb_clk>,
			<&clock_mmss clk_camss_ahb_clk>,
			<&clock_mmss clk_smmu_jpeg_axi_clk>,
                        <&clock_mmss clk_mmss_mmagic_ahb_clk>,
                        <&clock_gcc  clk_mmssnoc_axi_clk>,
                        <&clock_mmss clk_mmagic_camss_axi_clk>;
		qcom,clock-rates = <320000000 0 0 0 0 0 0 0 0>;
		qcom,vbif-reg-settings = <0x4 0x1>,
			<0xb0 0x00100010>,
			<0xc0 0x10001000>;
		qcom,qos-reg-settings = <0x28 0x00000008>;
		qcom,prefetch-reg-settings = <0x30c 0x1111>,
			<0x318 0x31>,
			<0x324 0x31>,
			<0x330 0x31>,
			<0x33c 0x0>;
		status = "ok";
	};

	qcom,jpeg@a24000 {
		cell-index = <2>;
		compatible = "qcom,jpeg";
		reg = <0xa24000 0x4000>,
			<0xa60000 0x3000>;
		reg-names = "jpeg";
		interrupts = <0 318 0>;
		interrupt-names = "jpeg";
                mmagic-vdd-supply = <&gdsc_mmagic_camss>;
                camss-vdd-supply = <&gdsc_camss_top>;
                vdd-supply = <&gdsc_jpeg>;
                qcom,vdd-names = "mmagic-vdd", "camss-vdd", "vdd";
		clock-names =  "core_clk", "iface_clk", "bus_clk0",
                               "camss_top_ahb_clk", "camss_ahb_clk", "smmu_jpeg_axi_clk",
                               "mmss_mmagic_ahb_clk", "mmssnoc_axi_clk",
                               "mmagic_camss_axi_clk";
		clocks = <&clock_mmss clk_camss_jpeg2_clk>,
		       <&clock_mmss clk_camss_jpeg_ahb_clk>,
		       <&clock_mmss clk_camss_jpeg_axi_clk>,
		       <&clock_mmss clk_camss_top_ahb_clk>,
		       <&clock_mmss clk_camss_ahb_clk>,
		       <&clock_mmss clk_smmu_jpeg_axi_clk>,
                       <&clock_mmss clk_mmss_mmagic_ahb_clk>,
                       <&clock_gcc  clk_mmssnoc_axi_clk>,
                       <&clock_mmss clk_mmagic_camss_axi_clk>;
		qcom,clock-rates = <266670000 0 0 0 0 0 0 0 0>;
		qcom,vbif-reg-settings = <0x4 0x1>,
			<0xb0 0x00100010>,
			<0xc0 0x10001000>;
		qcom,qos-reg-settings = <0x28 0x00000008>;
		qcom,prefetch-reg-settings = <0x30c 0x1111>,
			<0x318 0x0>,
			<0x324 0x31>,
			<0x330 0x31>,
			<0x33c 0x31>;
		status = "ok";
	};

	qcom,jpeg@aa0000 {
		cell-index = <3>;
		compatible = "qcom,jpeg_dma";
		reg = <0xaa0000 0x4000>,
			<0xa60000 0x3000>;
		reg-names = "jpeg";
		interrupts = <0 304 0>;
		interrupt-names = "jpeg";
                mmagic-vdd-supply = <&gdsc_mmagic_camss>;
                camss-vdd-supply = <&gdsc_camss_top>;
                vdd-supply = <&gdsc_jpeg>;
                qcom,vdd-names = "mmagic-vdd", "camss-vdd", "vdd";
		clock-names =  "core_clk", "iface_clk", "bus_clk0",
                               "camss_top_ahb_clk", "camss_ahb_clk", "smmu_jpeg_axi_clk",
                               "mmss_mmagic_ahb_clk", "mmssnoc_axi_clk",
                               "mmagic_camss_axi_clk";
		clocks = <&clock_mmss clk_camss_jpeg_dma_clk>,
			<&clock_mmss clk_camss_jpeg_ahb_clk>,
			<&clock_mmss clk_camss_jpeg_axi_clk>,
			<&clock_mmss clk_camss_top_ahb_clk>,
			<&clock_mmss clk_camss_ahb_clk>,
			<&clock_mmss clk_smmu_jpeg_axi_clk>,
                        <&clock_mmss clk_mmss_mmagic_ahb_clk>,
                        <&clock_gcc  clk_mmssnoc_axi_clk>,
                        <&clock_mmss clk_mmagic_camss_axi_clk>;
		qcom,clock-rates = <266670000 0 0 0 0 0 0 0 0>;
		qcom,vbif-reg-settings = <0x4 0x1>,
			<0xb0 0x00100010>,
			<0xc0 0x10001000>;
		qcom,qos-reg-settings = <0x28 0x00000008>;
		qcom,prefetch-reg-settings = <0x18c 0x11>,
			<0x1a0 0x31>,
			<0x1b0 0x31>;
		status = "ok";
	};
```

## Documentation/devicetree/bindings/media/video/msm-jpegdma.txt
```
* Qualcomm Technologies, Inc. MSM JPEG DMA

Jpeg dma hardware block.

Jpeg dma can replicate and downscale yuv frames.
Supported formats: Monochrome, NV12 and NV21.

Required properties:
- compatible : "qcom,jpegdma".
- reg : offset and length of the register set of jpeg dma device and
    vbif device for the jpeg dma operating in compatible mode.
- reg-names : should specify relevant names to each reg property defined.
- interrupts : should contain the jpeg interrupt.
- interrupt-names : should specify relevant names to each interrupts
  property defined.
- mmagic-vdd-supply: phandle to GDSC regulator controlling mmagic.
- camss-vdd-supply: phandle to GDSC regulator controlling camss.
- clock-names : names of clocks required for the device.
- clocks : clocks required for the device.
- qcom,clock-rates: should specify clock rates in Hz to each clocks
    property defined.
- qcom,max-ds-factor: should specify the max dma downscale factor,
    supported by HW.
- Refer to "Documentation/devicetree/bindings/arm/msm/msm_bus.txt" for
	below optional properties:
	- qcom,msm-bus,name
	- qcom,msm-bus,num-cases
	- qcom,msm-bus,num-paths
	- qcom,msm-bus,vectors-KBps

Optional properties:
- qcom,vbif-reg-settings: relative address offsets and value pairs for VBIF registers.
- qcom,qos-reg-settings: relative address offsets and value pairs for QoS registers.
- qcom,prefetch-reg-settings: relative address offsets and value pairs for
  MMU prefetch registers.

Example:
	qcom,jpegdma@aa0000 {
		compatible = "qcom,jpegdma";
		reg = <0xaa0000 0x4000>,
			<0xa60000 0x3000>;
		reg-names = "jpegdma_core", "jpeg_vbif";
		interrupts = <0 304 0>;
		interrupt-names = "jpeg";
		mmagic-vdd-supply = <&gdsc_mmagic_camss>;
		camss-vdd-supply = <&gdsc_camss_top>;
		vdd-supply = <&gdsc_jpeg>;
		qcom,vdd-names = "mmagic-vdd", "camss-vdd", "vdd";
		clock-names =  "core_clk", "iface_clk", "bus_clk0",
				"camss_top_ahb_clk", "camss_ahb_clk", "smmu_jpeg_axi_clk",
				"mmss_mmagic_ahb_clk", "mmssnoc_axi_clk",
				"mmagic_camss_axi_clk";
		clocks = <&clock_mmss clk_camss_jpeg_dma_clk>,
			<&clock_mmss clk_camss_jpeg_ahb_clk>,
			<&clock_mmss clk_camss_jpeg_axi_clk>,
			<&clock_mmss clk_camss_top_ahb_clk>,
			<&clock_mmss clk_camss_ahb_clk>,
			<&clock_mmss clk_smmu_jpeg_axi_clk>,
			<&clock_mmss clk_mmss_mmagic_ahb_clk>,
			<&clock_gcc  clk_mmssnoc_axi_clk>,
			<&clock_mmss clk_mmagic_camss_axi_clk>;
		qcom,clock-rates = <266670000 0 0 0 0 0 0 0 0>,
		qcom,vbif-reg-settings = <0x4 0x1>;
		qcom,prefetch-reg-settings = <0x18c 0x11>,
			<0x1a0 0x31>,
			<0x1b0 0x31>;
		qcom,msm-bus,name = "msm_camera_jpeg_dma";
		qcom,msm-bus,num-cases = <2>;
		qcom,msm-bus,num-paths = <1>;
		qcom,msm-bus,vectors-KBps = <62 512 0 0>,
			<62 512 666675 666675>;
		qcom,max-ds-factor = <128>;
		status = "ok";
	};
```
