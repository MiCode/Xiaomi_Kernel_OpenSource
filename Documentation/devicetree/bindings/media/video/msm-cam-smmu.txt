## Documentation/devicetree/bindings/media/video/msm-cam-smmu.txt
```
* Qualcomm Technologies, Inc. MSM Camera SMMU

[Root level node]
The complete set of context banks for camera are encapsulated under this
root node. Each second level node encapsulates the information related to
the corresponding context bank. During the kernel initialization all
the devices are probed recursively and a device pointer is created for
each context bank keeping track of the virtual address mapping information.

Required properties:
- compatible :
    - "qcom,msm-cam-smmu"

[Second level nodes]
Required properties:
- compatible : one of:
    - "qcom,msm-cam-smmu-cb" : For arm smmu iommu type.
    - "qcom,qsmmu-cam-cb" : For qsmmu iommu type.
- iommus : Handle parsed by smmu driver. Number of entries will vary
  across targets.
- label - string describing iommu domain usage.

Optional properties:
- qcom,scratch-buf-support : Enables iommu scratch buffer support in
  that context bank.
- qcom,secure-context : boolean type, to set the context domain type as secure.

Example:
  qcom,cam_smmu@0 {
    compatible = "qcom,msm-cam-smmu";
    msm_cam_smmu_cb1: msm_cam_smmu_cb1 {
      compatible = "qcom,msm-cam-smmu-cb";
      iommus = <&vfe_iommu 0>;
      label = "vfe";
      qcom,scratch-buf-support;
    }
  }
```

## Documentation/devicetree/bindings/media/video/msm-cam-soc.txt
```
* Qualcomm Technologies, Inc. MSM Camera SOC

The below set of properties need to be defined by all the camera
modules in their respective dtsi to adapt to SOC layer

Required properties:
  - clock-names: name of the clocks required for the device
  - qcom,clock-rates: clock rate in Hz
    - 0 if appropriate clock is required but doesn't have to apply the rate
  - qcom,vdd-names: names of all the regulators for the device
  - Refer to "Documentation/devicetree/bindings/arm/msm/msm_bus.txt" for
    below optional properties:
      - qcom,msm-bus,name
      - qcom,msm-bus,num-cases
      - qcom,msm-bus,num-paths
      - qcom,msm-bus,vectors-KBps
  - qcom,msm-bus-vector-dyn-vote: indicated dynamic or static voting
  - qcom,clock-cntl-support: indicates if further control supported for clocks
  - Refer to "Documentation/devicetree/bindings/media/video/msm-ispif.txt" for
    below optional property:
      - qcom,clock-control

Example:

   cpp: qcom,cpp@a04000 {
       mmagic-vdd-supply = <&gdsc_mmagic_camss>;
       camss-vdd-supply = <&gdsc_camss_top>;
       vdd-supply = <&gdsc_cpp>;
       qcom,vdd-names = "mmagic-vdd", "camss-vdd", "vdd";
       clock-names = "camss_top_ahb_clk",
                "ispif_ahb_clk", "csiphy_timer_src_clk",
                "csiphy_timer_clk";
       qcom,clock-rates = <0 0 200000000 0>;
       qcom,msm-bus,name = "msm_camera_cpp";
       qcom,msm-bus,num-cases = <2>;
       qcom,msm-bus,num-paths = <1>;
       qcom,msm-bus,vectors-KBps =
               <106 512 0 0>,
               <106 512 0 0>;
       qcom,msm-bus-vector-dyn-vote;
   };
```

## Documentation/devicetree/bindings/media/video/msm-cam-vfe.txt
```
* Qualcomm Technologies, Inc. MSM Camera VFE

Camera VFE device provides the definitions for enabling
the VFE hardware. It also provides the functions for the client
to control the VFE hardware.

=======================
Required Node Structure
=======================
The VFE device is described in one level of the device node.

======================================
First Level Node - CAM VFE device
======================================
Required properties:
- compatible
  Usage: required
  Value type: <string>
  Definition: Should specify the compatibility string for matching the
	driver. e.g. "qcom,vfe175", "qcom,vfe170", "qcom,vfe-lite175", "qcom,vfe-lite170".

- cell-index
  Usage: required
  Value type: <u32>
  Definition: Should specify the hardware index id.

- reg-names
  Usage: required
  Value type: <string>
  Definition: Should specify the name of the register block.

- reg
  Usage: required
  Value type: <u32>
  Definition: Register values.

- interrupt-names
  Usage: Required
  Value type: <string>
  Definition: Name of the interrupt.

- interrupts
  Usage: Required
  Value type: <u32>
  Definition: Interrupt associated with VFE HW.

- regulator-names
  Usage: required
  Value type: <string>
  Definition: Name of the regulator resources for VFE HW.

- xxxx-supply
  Usage: required
  Value type: <phandle>
  Definition: Regulator reference corresponding to the names listed in
	"regulator-names".

- clock-names
  Usage: required
  Value type: <string>
  Definition: List of clock names required for VFE HW.

- clocks
  Usage: required
  Value type: <phandle>
  Definition: List of clocks used for VFE HW.

- clock-rates
  Usage: required
  Value type: <u32>
  Definition: List of clocks rates.

- src-clock-name
  Usage: required
  Value type: <string>
  Definition: Source clock name.

Optional properties:
- clock-names-option
  Usage: optional
  Value type: <string>
  Definition: Optional clock names.

- clocks-option
  Usage: required if clock-names-option defined
  Value type: <phandle>
  Definition: List of optinal clocks used for VFE HW.

- clock-rates-option
  Usage: required if clock-names-option defined
  Value type: <u32>
  Definition: List of clocks rates for optional clocks.

- clock-control-debugfs
  Usage: optional
  Value type: <string>
  Definition: Enable/Disable clk rate control.

Example:
	qcom,vfe0@acaf000 {
		cell-index = <0>;
		compatible = "qcom,vfe170";
		reg-names = "ife";
		reg = <0xacaf000 0x4000>;
		interrupts = <0 465 0>;
		interrupt-names = "ife";
		vdd-names = "camss-vdd", "ife0-vdd";
		camss-vdd-supply = <&titan_top_gdsc>;
		ife0-vdd-supply = <&ife_0_gdsc>;
		clock-names = "soc_ahb_clk",
			"cpas_ahb_clk",
			"slow_ahb_clk_src",
			"ife_clk",
			"ife_clk_src",
			"ife_csid_clk",
			"ife_csid_clk_src",
			"camnoc_axi_clk",
			"ife_axi_clk",
		clocks = <&clock_camcc CAM_CC_SOC_AHB_CLK>,
			<&clock_camcc CAM_CC_CPAS_AHB_CLK>,
			<&clock_camcc CAM_CC_SLOW_AHB_CLK_SRC>,
			<&clock_camcc CAM_CC_IFE_0_CLK>,
			<&clock_camcc CAM_CC_IFE_0_CLK_SRC>,
			<&clock_camcc CAM_CC_IFE_0_CSID_CLK>,
			<&clock_camcc CAM_CC_IFE_0_CSID_CLK_SRC>,
			<&clock_camcc CAM_CC_CAMNOC_AXI_CLK>,
			<&clock_camcc CAM_CC_IFE_0_AXI_CLK>,
		clock-rates = <0 0 80000000 0 320000000 0 384000000 0 0 0>;
		src-clock-name = "ife_clk_src";
		clock-names-option = "ife_dsp_clk";
		clocks-option = <&clock_camcc CAM_CC_IFE_0_DSP_CLK>;
		clock-rates-option = <600000000>;
		status = "ok";
	};
```

## Documentation/devicetree/bindings/media/video/msm-cam.txt
```
* Qualcomm Technologies, Inc. MSM Camera

Required properties:
- compatible :
    - "qcom,msm-cam"
- reg : offset and length of msm camera device registers.
- reg-names : should specify relevant names for each reg property defined.

Optional properties:
- qcom,gpu-limit : valid kgsl frequency.

Example:

   qcom,msm-cam@fd8c0000 {
       compatible = "qcom,msm-cam";
       reg = <0xfd8C0000 0x10000>;
       reg-names = "msm-cam";
       qcom,gpu-limit = <700000000>;
   };
```

## Documentation/devicetree/bindings/media/video/msm-camera-flash.txt
```
* Qualcomm MSM CAMERA FLASH

Required properties:
- cell-index : Should contain flash source index to diffentiate
    between different flash devices. These indexes represent flash devices
    for multiple flashes.
    - 0, 1, 2, 3
- compatible :
    - "qcom,camera-led-flash"
- reg : offset and length of the register set for the device.
    for the flash operating in compatible mode.
- gpios : should contain phandle to gpio controller node and array of
    #gpio-cells specifying specific gpio (controller specific)
- qcom,gpio-req-tbl-num : should contain index to gpios specific to this flash
- qcom,gpio-req-tbl-flags : should contain direction of gpios present in
    qcom,gpio-req-tbl-num property (in the same order)
- qcom,gpio-req-tbl-label : should contain name of gpios present in
    qcom,gpio-req-tbl-num property (in the same order)
- qcom,gpio-flash-en : should contain index to gpio used by flash's "flash enable" pin.
- qcom,gpio-flash-now : should contain index to gpio used by flash's "flash now" pin.
- label : should contain unique flash name to differentiate from other flash
    - "adp1660"
- qcom,flash-type : Should contain type flash device
    - 1 for LED flash
    - 2 for strobe flash
    - 3 for simple led flash controlled by one gpio
      This is a low cost led used for camera flash, the led is driven by
      system power, and use a transistor controlled by external pin to
      gate its on/off state.
- qcom,cci-master : should contain i2c master id to be used for this flash.
    - 0 -> MASTER 0
    - 1 -> MASTER 1
- qcom,flash-source : Should contain array of phandles to flash source nodes.
    - pm8941_flash0 pm8941_flash1

Optional properties:
-qcom,torch-source : Should contain phandle to torch source node.
    -pm8941_torch
- qcom,slave-id : should contain i2c slave address, device id address
    and expected id read value.

Example:

qcom,led-flash@60 {
		reg = <0x60>;
		cell-index = <0>;
		qcom,slave-id = <0x60 0x00 0x0011>;
		compatible = "qcom,led-flash";
		label = "adp1660";
		qcom,flash-type = <1>;
		qcom,cci-master = <0>;
		gpios = <&msmgpio 23 0>,
			<&msmgpio 24 0>;
		qcom,gpio-flash-en = <0>;
		qcom,gpio-flash-now = <1>;
		qcom,gpio-req-tbl-num = <0 1>;
		qcom,gpio-req-tbl-flags = <0 0>;
		qcom,gpio-req-tbl-label = "FLASH_EN",
			"FLASH_NOW";
	};
```
