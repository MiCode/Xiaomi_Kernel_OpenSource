## Documentation/devicetree/bindings/media/video/msm-csi-phy.txt
```
* Qualcomm MSM CSI Phy

Required properties:
- cell-index: csi phy hardware core index
- compatible :
    - "qcom,csiphy"
    - "qcom,csiphy-v2.0"
    - "qcom,csiphy-v2.2"
    - "qcom,csiphy-v3.0"
    - "qcom,csiphy-v3.1"
    - "qcom,csiphy-v3.1.1"
    - "qcom,csiphy-v3.2"
- reg : offset and length of the register set for the device
    for the csiphy operating in compatible mode.
- reg-names : should specify relevant names to each reg property defined.
- interrupts : should contain the csiphy interrupt.
- interrupt-names : should specify relevant names to each interrupts
  property defined.
- clock-names: name of the clocks required for the device
- qcom,clock-rates: clock rate in Hz
	- 0 if appropriate clock is required but doesn't have to apply the rate

Example:

   qcom,csiphy@fda0ac00 {
       cell-index = <0>;
       compatible = "qcom,csiphy-v2.0", "qcom,csiphy";
       reg = <0xfda0ac00 0x200>;
       reg-names = "csiphy";
       interrupts = <0 78 0>;
       interrupt-names = "csiphy";
       clock-names = "camss_top_ahb_clk",
                "ispif_ahb_clk", "csiphy_timer_src_clk",
                "csiphy_timer_clk";
       qcom,clock-rates = <0 0 200000000 0>;
   };
```

## Documentation/devicetree/bindings/media/video/msm-csid.txt
```
* Qualcomm MSM CSID

Required properties:
- cell-index: csid hardware core index
- compatible :
    - "qcom,csid"
    - "qcom,csid-v2.0"
    - "qcom,csid-v2.2"
    - "qcom,csid-v3.0"
    - "qcom,csid-v3.1"
    - "qcom,csid-v3.2"
    - "qcom,csid-v3.5"
    - "qcom,csid-v4.0"
    - "qcom,csid-v3.4.2"
- reg : offset and length of the register set for the device
    for the csid operating in compatible mode.
- reg-names : should specify relevant names to each reg property defined.
- interrupts : should contain the csid interrupt.
- interrupt-names : should specify relevant names to each interrupts
  property defined.
- qcom,csi-vdd-voltage : should specify voltage level
    for mipi csi in uV.
- qcom,mipi-csi-vdd-supply : should contain regulator to be used for
    this csid core
- clock-names: name of the clocks required for the device
- qcom,clock-rates: clock rate in Hz
	- 0 if appropriate clock is required but doesn't have to apply the rate

Optional properties:
- qcom,cam-vreg-name : name of the voltage regulators required for the device.
- gdscr-supply : should contain regulator used for csid clocks.
- mmagic-supply : should contain mmagic regulator used for mmagic clocks.

Example:

   qcom,csid@fda08000 {
       cell-index = <0>;
       compatible = "qcom,csid-v2.0", "qcom,csid";
       reg = <0xfda08000 0x200>;
       reg-names = "csid";
       interrupts = <0 51 0>;
       interrupt-names = "csiphy";
       qcom,csi-vdd-voltage = <1800000>;
       qcom,mipi-csi-vdd-supply = <&pm8941_l12>;
       clock-names = "camss_top_ahb_clk", "ispif_ahb_clk",
                "csi_ahb_clk", "csi_src_clk", "csi_clk",
                "csi_phy_clk", "csi_pix_clk", "csi_rdi_clk";
       qcom,clock-rates = <0 0 0 200000000 0 0 0 0>;
   };
```

## Documentation/devicetree/bindings/media/video/msm-eeprom.txt
```
* Qualcomm MSM EEPROM

EEPROM is an one time programmed(OTP) device that stores the calibration data
use for camera sensor. It may either be integrated in the sensor module or in
the sensor itself. As a result, the power, clock and GPIOs may be the same as
the camera sensor. The following describes the page block map, power supply,
clock, GPIO and power on sequence properties of the EEPROM device.

Required properties:
- cell-index: eeprom hardware core index
- compatible :
    - "qcom,eeprom"
- reg : offset of eeprom device registers.
- qcom,cci-master : should specify the cci core index that eeprom use.
- cam_vio-supply : should contain regulator to be used for the IO vdd.
- qcom,cam-vreg-name : should specify the regulator name to be used for
    this eeprom.
- qcom,cam-vreg-type : should specify the regulator type to be used for
    this eeprom.
- qcom,cam-vreg-min-voltage : should specify minimum voltage level
    for eeprom in uV.
- qcom,cam-vreg-max-voltage : should specify maximum voltage level
    for eeprom in uV.
- qcom,cam-vreg-op-mode : should specify current level for eeprom in uA.
- qcom,gpio-no-mux : should specify the gpio mux type.
- gpios : should specify the gpios to be used for the eeprom.
- qcom,gpio-reset : should specify the reset gpio index.
- qcom,gpio-standby : should specify the standby gpio index.
- qcom,gpio-req-tbl-num : should specify the gpio table index.
- qcom,gpio-req-tbl-flags : should specify the gpio functions.
- qcom,gpio-req-tbl-label : should specify the gpio labels.
- qcom,cam-power-seq-type : should specify the power on sequence types.
- qcom,cam-power-seq-val : should specify the power on sequence values.
- qcom,cam-power-seq-cfg-val : should specify the power on sequence config
    values.
- qcom,cam-power-seq-delay : should specify the power on sequence delay
    time in ms.

Optional properties:
- cam_vdig-supply : should contain regulator to be used for the digital vdd.

Example:

    eeprom0: qcom,eeprom@60 {
        cell-index = <0>;
        reg = <0x60 0x0>;
        compatible = "qcom,eeprom";
        qcom,cci-master = <0>;
        cam_vdig-supply = <&pm8226_l5>;
        cam_vio-supply = <&pm8226_lvs1>;
        qcom,cam-vreg-name = "cam_vdig", "cam_vio";
        qcom,cam-vreg-type = <0 1>;
        qcom,cam-vreg-min-voltage = <1200000 0>;
        qcom,cam-vreg-max-voltage = <1200000 0>;
        qcom,cam-vreg-op-mode = <200000 0>;
        qcom,gpio-no-mux = <0>;
        gpios = <&msmgpio 26 0>,
            <&msmgpio 37 0>,
            <&msmgpio 36 0>;
        qcom,gpio-reset = <1>;
        qcom,gpio-standby = <2>;
        qcom,gpio-req-tbl-num = <0 1 2>;
        qcom,gpio-req-tbl-flags = <1 0 0>;
        qcom,gpio-req-tbl-label = "CAMIF_MCLK",
            "CAM_RESET1",
            "CAM_STANDBY";
        qcom,cam-power-seq-type = "sensor_vreg",
            "sensor_vreg", "sensor_clk",
            "sensor_gpio", "sensor_gpio";
        qcom,cam-power-seq-val = "cam_vdig",
            "cam_vio", "sensor_cam_mclk",
            "sensor_gpio_reset",
            "sensor_gpio_standby";
        qcom,cam-power-seq-cfg-val = <1 1 24000000 1 1>;
        qcom,cam-power-seq-delay = <1 1 5 5 10>;
    };
```

## Documentation/devicetree/bindings/media/video/msm-fd.txt
```
* Qualcomm MSM FD

Face detection hardware block.
The Face Detection Hardware Block will offload processing
on the host and also reduce power consumption.
Supports:
Front and back camera face detection concurrently.
Sizes: QVGA, VGA, WQVGA, WVGA at 20 pix minimum face size.

Required properties:

- compatible:
    - "qcom,face-detection"
- reg: offset and length of the register set for the device.
- reg-names: should specify relevant names to each reg property defined.
    - "fd_core" - FD CORE hardware register set.
    - "fd_misc" - FD MISC hardware register set.
    - "fd_vbif" - FD VBIF hardware register set.
- interrupts: should contain the fd interrupts. From fd cores with
  revisions 0x10010000 and higher, power collapse sequence is required.
  Face detection misc irq is needed to perform power collapse.
- interrupt-names: should specify relevant names to each interrupts
  property defined.
- vdd-supply: phandle to GDSC regulator controlling face detection hw.
- clocks: list of entries each of which contains:
    - phandle to the clock controller.
    - macro containing clock's name in hardware.
- clock-names: should specify relevant names to each clocks
  property defined.

Optional properties:

- clock-rates: should specify clock rates in Hz to each clocks
  property defined.
  If we want to have different operating clock frequencies we can define
  rate levels. They should be defined in incremental order.
- qcom,bus-bandwidth-vectors: Specifies instant and average bus bandwidth
  vectors per clock rate.
  Each of entries contains:
  - ab. Average bus bandwidth (Bps).
  - ib. Instantaneous bus bandwidth (Bps).
- mmagic-vdd-supply: phandle to GDSC regulator controlling mmagic.
- camss-vdd-supply: phandle to GDSC regulator controlling camss.
- qcom,fd-core-reg-settings: relative address offsets and value pairs for
  FD CORE registers and bit mask.
  Format: <reg_addr_offset reg_value reg_mask>
- qcom,fd-misc-reg-settings: relative address offsets and value pairs for
  FD MISC registers and bit mask.
  Format: <reg_addr_offset reg_value reg_mask>
- qcom,fd-vbif-reg-settings: relative address offsets and value pairs for
  FD VBIF registers and bit mask.
  Format: <reg_addr_offset reg_value reg_mask>

Example:

    qcom,fd@fd878000 {
        compatible = "qcom,face-detection";
        reg = <0xfd878000 0x800>,
              <0xfd87c000 0x800>,
              <0xfd860000 0x1000>;
        reg-names = "fd_core", "fd_misc", "fd_vbif";
        interrupts = <0 316 0>;
        interrupt-names = "fd";
        mmagic-vdd-supply = <&gdsc_mmagic_camss>;
        camss-vdd-supply = <&gdsc_camss_top>;
        vdd-supply = <&gdsc_fd>;
        qcom,vdd-names = "mmagic-vdd", "camss-vdd", "vdd";
        clocks = <&clock_mmss clk_mmss_mmagic_ahb_clk>,
                <&clock_gcc  clk_mmssnoc_axi_clk>,
                <&clock_mmss clk_mmagic_camss_axi_clk>,
                <&clock_mmss clk_camss_top_ahb_clk>,
                <&clock_mmss clk_fd_core_clk_src>,
                <&clock_mmss clk_fd_core_clk>,
                <&clock_mmss clk_fd_core_uar_clk>,
                <&clock_mmss clk_fd_ahb_clk>,
                <&clock_mmss clk_smmu_cpp_axi_clk>,
                <&clock_mmss clk_camss_ahb_clk>,
                <&clock_mmss clk_camss_cpp_axi_clk>,
                <&clock_mmss clk_camss_cpp_vbif_ahb_clk>,
                <&clock_mmss clk_smmu_cpp_ahb_clk>;
        clock-names = "mmss_mmagic_ahb_clk", "mmssnoc_axi_clk" ,
                        "mmagic_camss_axi_clk", "camss_top_ahb_clk",
                        "fd_core_clk_src", "fd_core_clk",
                        "fd_core_uar_clk", "fd_ahb_clk",
                        "smmu_cpp_axi_clk", "camss_ahb_clk",
                        "camss_cpp_axi_clk", "cpp_vbif_ahb_clk",
                         "smmu_cpp_ahb_clk";
        clock-rates = <0 0 0 0 400000000 400000000 400000000 80000000 0 0 0 0 0>;
        qcom,bus-bandwidth-vectors = <13000000 13000000>,
            <45000000 45000000>,
            <90000000 90000000>;
        qcom,fd-vbif-reg-settings = <0x20 0x10000000 0x30000000>,
            <0x24 0x10000000 0x30000000>,
            <0x28 0x10000000 0x30000000>,
            <0x2c 0x10000000 0x30000000>;
        qcom,fd-misc-reg-settings = <0x20 0x2 0x3>,
            <0x24 0x2 0x3>;
        qcom,fd-core-reg-settings = <0x8 0x20 0xffffffff>;
    };
```

## Documentation/devicetree/bindings/media/video/msm-ir-cut.txt
```
* QTI MSM IR CUT

Required properties:
- cell-index : ir cut filter hardware core index
- compatible :
    - "qcom,ir-cut"

Optional properties:
- gpios : should specify the gpios to be used for the ir cut filter.
- qcom,gpio-req-tbl-num : should contain index to gpios specific to ir cut filter
- qcom,gpio-req-tbl-flags : should contain direction of gpios present in
    qcom,gpio-req-tbl-num property (in the same order)
- qcom,gpio-req-tbl-label : should contain name of gpios present in
    qcom,gpio-req-tbl-num property (in the same order)
- label : should contain unique ir cut filter name
Example:

qcom,ir-cut@60 {
		cell-index = <0>;
		compatible = "qcom,ir-cut";
		label = "led-ir-label";
		gpios = <&tlmm 60 0>;
		qcom,gpio-req-tbl-num = <0>;
		qcom,gpio-req-tbl-flags = <0>;
		qcom,gpio-req-tbl-label = "LED_IR_EN";
	};
```

## Documentation/devicetree/bindings/media/video/msm-ir-led.txt
```
* QTI MSM IR LED

Required properties:
- cell-index : ir led hardware core index
- compatible :
    - "qcom,ir-led"

Optional properties:
- gpios : should specify the gpios to be used for the ir led.
- qcom,gpio-req-tbl-num : should contain index to gpios specific to ir led
- qcom,gpio-req-tbl-flags : should contain direction of gpios present in
    qcom,gpio-req-tbl-num property (in the same order)
- qcom,gpio-req-tbl-label : should contain name of gpios present in
    qcom,gpio-req-tbl-num property (in the same order)
- label : should contain unique ir led name
Example:

qcom,ir-led {
		cell-index = <0>;
		compatible = "qcom,ir-led";
		label = "led-ir-label";
		gpios = <&tlmm 60 0>;
		qcom,gpio-req-tbl-num = <0>;
		qcom,gpio-req-tbl-flags = <0>;
		qcom,gpio-req-tbl-label = "LED_IR_EN";
	};
```

## Documentation/devicetree/bindings/media/video/msm-irqrouter.txt
```
* Qualcomm Technologies, Inc. MSM IRQ Router

Required properties:
- cell-index: irq router hardware core index
- compatible :
    - "qcom,irqrouter"
- reg : offset and length of the register set for the device
    for the irqrouter operating in compatible mode.
- reg-names : should specify relevant names to each reg property defined.

Example:

   qcom,irqrouter@0xfda0c000 {
       cell-index = <0>;
       compatible = "qcom,irqrouter";
       reg = <0xfda00000 0x100>;
       reg-names = "irqrouter";
   };
```
