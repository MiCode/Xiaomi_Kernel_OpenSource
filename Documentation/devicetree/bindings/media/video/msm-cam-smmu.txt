## Documentation/devicetree/bindings/media/video/msm-vfe.txt
```
* Qualcomm MSM VFE

Required properties for parent node:
- compatible :
    - "qcom,vfe"
- #address-cells : Number of address related values in the reg field
- #size-cells : Number of size related values in the reg field
- ranges: How the register offsets for child translate to parent.

Required properties for child node:
- cell-index: vfe hardware core index
- compatible :
    - "qcom,vfe32"
    - "qcom,vfe40"
    - "qcom,vfe44"
    - "qcom,vfe46"
    - "qcom,vfe47"
    - "qcom,vfe48"
- reg : offset and length of the register set for the device
    for the vfe operating in compatible mode. For parent node, add union of
    all registers for both vfe.
- reg-names : should specify relevant names to each reg property defined.
    Only needed for child node.
    - "vfe" - Required.
    - "vfe_vbif" - Optional for "vfe32". Required for "vfe40".
- interrupts : should contain the vfe interrupt.
- interrupt-names : should specify relevant names to each interrupts
  property defined.
    - "vfe" - Required.
- vdd-supply: phandle to GDSC regulator controlling VFE core.
- qos-entries: number of QoS registers to program
- qos-regs: relative address offsets of QoS registers
- qos-settings: QoS values to be written to QoS registers
- vbif-entries - number of VBIF registers to program (optional)
- vbif-regs: relative address offsets of VBIF registers (optional)
- vbif-settings: VBIF values to be written to VBIF registers (optional)
- ds-entries: number danger/safe registers to program (optional)
- ds-regs: relative address offsets of danger/safe registers (optional)
- ds-settings: danger/safe values to be written to registers (optional)
  NOTE: For all qos*, vbif*, ds* parameters, same SoC can have different
  hardware versions with different entries/registers/settings. They can be
  specified by adding version to the string e.g. qos-v2-settings. Also
  different SoC can have same hardware version and still different QOS, VBIF,
  and DS parameters. In this case they are exported if separate SoC version
  specific dts files.
- max-svs-clk: svs rate of the VFE clock in Hertz.
- max-nominal-clk: nominal rate of the VFE clock in Hertz.
- max-turbo-clk: turbo/high rate of the VFE clock in Hertz.

Example:

vfe0: qcom,vfe0@fda10000 {
	cell-index = <0>;
	compatible = "qcom,vfe44";
	reg = <0xfda10000 0x1000>;
		<0xfda40000 0x200>;
	reg-names = "vfe", "vfe_vbif";
	interrupts = <0 57 0>;
	interrupt-names = "vfe";
	vdd-supply = <&gdsc_vfe>;
	qos-entries = <8>;
	qos-regs = <0x2c4 0x2c8 0x2cc 0x2d0 0x2d4 0x2d8
		0x2dc 0x2e0>;
	qos-settings = <0xaaaaaaaa 0xaaaaaaaa 0xaaaaaaaa
		0xaaaaaaaa 0xaaaaaaaa 0xaaaaaaaa
		0xaaaaaaaa 0x0002aaaa>;
	qos-v2-settings = <0xaaa9aaa9 0xaaa9aaa9 0xaaa9aaa9
		0xaaa9aaa9 0xaaa9aaa9 0xaaa9aaa9
		0xaaa9aaa9 0x0001aaa9>;
	qos-v3-settings = <0xaaa9aaa9 0xaaa9aaa9 0xaaa9aaa9
		0xaaa9aaa9 0xaaa9aaa9 0xaaa9aaa9
		0xaaa9aaa9 0x0001aaa9>;
	vbif-entries = <17>;
	vbif-regs = <0x4 0xb0 0xb4 0xb8 0xc0 0xc4 0xc8 0xd0
		0xd4 0xd8 0xdc 0xf0 0x178 0x17c 0x124 0x160
		0x164>;
	vbif-settings = <0x1 0x01010101 0x01010101 0x10010110
		0x10101010 0x10101010 0x10101010 0x00001010
		0x00001010 0x00000707 0x00000707 0x00000030
		0x00000fff 0x0fff0fff 0x00000001 0x22222222
		0x00002222>;
	vbif-v2-entries = <16>;
	vbif-v2-regs = <0x4 0xb0 0xb4 0xb8 0xc0 0xc4 0xc8 0xd0
		0xd4 0xd8 0xf0 0x178 0x17c 0x124 0x160
		0x164>;
	vbif-v2-settings = <0x1 0x10101010 0x10101010 0x10101010
		0x10101010 0x10101010 0x10101010 0x00000010
		0x00000010 0x00000707 0x00000010 0x00000fff
		0x0fff0fff 0x00000003 0x22222222 0x00002222>;
	ds-entries = <17>;
	ds-regs = <0x988 0x98c 0x990 0x994 0x998
		0x99c 0x9a0 0x9a4 0x9a8 0x9ac 0x9b0
		0x9b4 0x9b8 0x9bc 0x9c0 0x9c4 0x9c8>;
	ds-settings = <0x44441111 0x44441111 0x44441111
		0x44441111 0x44441111 0x44441111
		0x44441111 0x44441111 0x44441111
		0x44441111 0x44441111 0x44441111
		0x44441111 0x44441111 0x44441111
		0x44441111 0x00000103>;
	max-clk-svs = <300000000>;
	max-clk-nominal = <465000000>;
	max-clk-turbo = <600000000>;
};

vfe1: qcom,vfe1@fda14000 {
	cell-index = <1>;
	compatible = "qcom,vfe44";
	reg = <0xfda14000 0x1000>;
		<0xfda40000 0x200>;
	reg-names = "vfe", "vfe_vbif";
	interrupts = <0 58 0>;
	interrupt-names = "vfe";
	vdd-supply = <&gdsc_vfe>;
	qos-entries = <8>;
	qos-regs = <0x2c4 0x2c8 0x2cc 0x2d0 0x2d4 0x2d8
		0x2dc 0x2e0>;
	qos-settings = <0xaaaaaaaa 0xaaaaaaaa 0xaaaaaaaa
		0xaaaaaaaa 0xaaaaaaaa 0xaaaaaaaa
		0xaaaaaaaa 0x0002aaaa>;
	qos-v2-settings = <0xaaa9aaa9 0xaaa9aaa9 0xaaa9aaa9
		0xaaa9aaa9 0xaaa9aaa9 0xaaa9aaa9
		0xaaa9aaa9 0x0001aaa9>;
	qos-v3-settings = <0xaaa9aaa9 0xaaa9aaa9 0xaaa9aaa9
		0xaaa9aaa9 0xaaa9aaa9 0xaaa9aaa9
		0xaaa9aaa9 0x0001aaa9>;
	vbif-entries = <17>;
	vbif-regs = <0x4 0xb0 0xb4 0xb8 0xc0 0xc4 0xc8 0xd0
		0xd4 0xd8 0xdc 0xf0 0x178 0x17c 0x124 0x160
		0x164>;
	vbif-settings = <0x1 0x01010101 0x01010101 0x10010110
		0x10101010 0x10101010 0x10101010 0x00001010
		0x00001010 0x00000707 0x00000707 0x00000030
		0x00000fff 0x0fff0fff 0x00000001 0x22222222
		0x00002222>;
	vbif-v2-entries = <16>;
	vbif-v2-regs = <0x4 0xb0 0xb4 0xb8 0xc0 0xc4 0xc8 0xd0
		0xd4 0xd8 0xf0 0x178 0x17c 0x124 0x160
		0x164>;
	vbif-v2-settings = <0x1 0x10101010 0x10101010 0x10101010
		0x10101010 0x10101010 0x10101010 0x00000010
		0x00000010 0x00000707 0x00000010 0x00000fff
		0x0fff0fff 0x00000003 0x22222222 0x00002222>;
	ds-entries = <17>;
	ds-regs = <0x988 0x98c 0x990 0x994 0x998
		0x99c 0x9a0 0x9a4 0x9a8 0x9ac 0x9b0
		0x9b4 0x9b8 0x9bc 0x9c0 0x9c4 0x9c8>;
	ds-settings = <0x44441111 0x44441111 0x44441111
		0x44441111 0x44441111 0x44441111
		0x44441111 0x44441111 0x44441111
		0x44441111 0x44441111 0x44441111
		0x44441111 0x44441111 0x44441111
		0x44441111 0x00000103>;
	max-clk-svs = <300000000>;
	max-clk-nominal = <465000000>;
	max-clk-turbo = <600000000>;
};

qcom,vfe {
	compatible = "qcom,vfe";
	num_child = <2>;
};

In version specific file one needs to move only entries that differ between
SoC versions with same VFE HW version:

	&vfe0 {
		qos-entries = <8>;
		qos-regs = <0x378 0x37C 0x380 0x384 0x388 0x38C
				0x390 0x394>;
		qos-settings = <0xAAA9AAA9
			0xAAA9AAA9
			0xAAA9AAA9
			0xAAA9AAA9
			0xAAA9AAA9
			0xAAA9AAA9
			0xAAA9AAA9
			0x0001AAA9>;
		vbif-entries = <1>;
		vbif-regs = <0x124>;
		vbif-settings = <0x3>;
		ds-entries = <17>;
		ds-regs = <0xBD8 0xBDC 0xBE0 0xBE4 0xBE8
			0xBEC 0xBF0 0xBF4 0xBF8 0xBFC 0xC00
			0xC04 0xC08 0xC0C 0xC10 0xC14 0xC18>;
		ds-settings = <0x44441111
			0x44441111
			0x44441111
			0x44441111
			0x44441111
			0x44441111
			0x44441111
			0x44441111
			0x44441111
			0x44441111
			0x44441111
			0x44441111
			0x44441111
			0x44441111
			0x44441111
			0x44441111
			0x00000103>;
		max-clk-svs = <300000000>;
		max-clk-nominal = <465000000>;
		max-clk-turbo = <600000000>;
	};
```

## Documentation/devicetree/bindings/media/video/msm-vidc-bus.txt
```
* Qualcomm Technologies Inc MSM VIDC BUS

Required properties:
- compatible : "qcom,msm-vidc,governor,table"
- name : name of the governor.
- qcom,bus-table : node containing individual domain nodes, each with:
  - qcom,codec-mask: a bitmap of supported codec types, every two bits
    represents a codec type.
  - qcom,load-busfreq-tbl: load (in macroblocks/sec) and the corresponding
    bus frequency (in KBps) table.

Optional properties:
- qcom,low-power-mode: a boolean which indicates whether bus profile need
  to be used when client enables low-power mode.
- qcom,ubwc-mode: a boolean which indicates whether the bus profile need
  to be used when client enables UBWC mode.

Example:

venus-bus-gov {
	compatible = "qcom,msm-vidc,governor,table";
	name = "qcom,venus-gov";
	qcom,bus-freq-table {
		qcom,profile-dec {
			qcom,codec-mask = <0xffffffff>;
			qcom,ubwc-mode;
			qcom,load-busfreq-tbl =
				<489600 1205248>,  /* 1080p60D   */
				<244800 618496>,   /* 1080p30D   */
				<216000 618496>,   /* 720p60D    */
				<108000 314368>,   /* 720p30D    */
				<72000  233472>,   /* VGA60D     */
				<36000  118784>,   /* VGA30D     */
				<0      0>;
		};
		qcom,profile-enc {
			qcom,codec-mask = <0x55555555>;
			qcom,low-power-mode;
			qcom,load-busfreq-tbl =
				<244800 787456>,   /* 1080p30E   */
				<216000 350208>,   /* 720p60E    */
				<108000 350208>,   /* 720p30E    */
				<72000  350208>,   /* VGA60E     */
				<36000  136806>,   /* VGA30E     */
				<0      0>;
		};
	};
};
```

## Documentation/devicetree/bindings/media/video/msm-vidc-vmem.txt
```
* Qualcomm Technologies Inc MSM VIDC VMEM

Required properties:
- compatible : "qcom,msm-vmem"
- interrupts : Contains the interrupt that maps to the VMEM module
- reg : A set of 2 start address and size pairs that describe the hardware
register address space and mappable memory address space.
- reg-names : Strings that describe the pairs in "reg".  The register address
space should be called "reg-base" and the memory space should be called "mem-base".
- clocks : A set of clocks that correspond to the AHB and MAXI clocks that the
hardware uses.
- clock-names : A string that describes the "clocks" property.  The AHB clock
should be named "ahb" and the MAXI clock should be named "maxi".
- qcom,bank-size : The size of each memory bank, in bytes.
- vdd-supply: phandle to a regulator that is considered to be the footswitch for vmem.
- qcom,msm-bus,(name|num-cases,num-paths,vectors-KBps) - Bus to be voted for prior to
  issuing any IO transactions to vmem.  Refer to Documentation/devicetree/bindings/arm/\
  msm/msm_bus_adhoc.txt for further details.

Example:

qcom,vmem@880000 {
	compatible = "qcom,msm-vmem";
	interrupts = <0 429 0>;
	reg = <0x880000 0x800>,
	    <0x6800000 0x100000>;
	reg-names = "reg-base", "mem-base";

	vdd-supply = <&gdsc_mmagic_video>;
	clocks = <&clock_mmss clk_vmem_ahb_clk>,
	       <&clock_mmss clk_vmem_maxi_clk>;
	clock-names = "ahb", "maxi";

	qcom,bank-size = <131072>;

	qcom,msm-bus,name = "vmem";
	qcom,msm-bus,num-cases = <2>;
	qcom,msm-bus,num-paths = <1>;
	qcom,msm-bus,vectors-KBps =
	        <MSM_BUS_MASTER_AMPSS_M0 MSM_BUS_SLAVE_VMEM_CFG   0   0>,
	        <MSM_BUS_MASTER_AMPSS_M0 MSM_BUS_SLAVE_VMEM_CFG 500 800>;
};
```
