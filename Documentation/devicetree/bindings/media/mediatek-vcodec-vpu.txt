## Documentation/devicetree/bindings/media/video/msm-cam-diag.txt
```
* Qualcomm Technologies, Inc. MSM Camera diag

[Root level node]
==================
Required properties:
- compatible: Must be "qcom,diag-cam".

[Subnode]
==========
Required properties:
- mmagic-supply: should contain mmagic regulator used for mmagic clocks.
- gdscr-supply: should contain gdsr regulator used for cci clocks.
- vfe0-vdd-supply: phandle to vfe0 regulator.
- qcom,cam-vreg-name: name of the voltage regulators required for the device.
- clocks: List of clock handles. The parent clocks of the input clocks to the
        devices in this power domain are set to oscclk before power gating
        and restored back after powering on a domain. This is required for
        all domains which are powered on and off and not required for unused
        domains.
- clock-names: name of the clock used by the driver.
- qcom,clock-rates: clock rate in Hz.
- qcom,clock-control: The valid fields are "NO_SET_RATE", "INIT_RATE" and
  "SET_RATE". "NO_SET_RATE" the corresponding clock is enabled without setting
  the rate assuming some other driver has already set it to appropriate rate.
  "INIT_RATE" clock rate is not queried assuming some other driver has set
  the clock rate and ispif will set the the clock to this rate.
  "SET_RATE" clock is enabled and the rate is set to the value specified
  in the property qcom,clock-rates.

Example:

	qcom,diag-cam {
			cell-index = <0>;
			compatible = "qcom,diag-cam";
			status = "ok";
			mmagic-supply = <&gdsc_mmagic_camss>;
			gdscr-supply = <&gdsc_camss_top>;
			vfe0-vdd-supply = <&gdsc_vfe0>;
			vfe1-vdd-supply = <&gdsc_vfe1>;
			qcom,cam-vreg-name = "mmagic", "gdscr",
					"vfe0-vdd", "vfe1-vdd";
			clocks = <&clock_mmss clk_mmss_mmagic_ahb_clk>,
				<&clock_mmss clk_camss_top_ahb_clk>,
				<&clock_mmss clk_camss_ispif_ahb_clk>,
				<&clock_mmss clk_csi0phytimer_clk_src>,
				<&clock_mmss clk_camss_csi0phytimer_clk>,
				<&clock_mmss clk_camss_ahb_clk>,
				<&clock_mmss clk_csi1phytimer_clk_src>,
				<&clock_mmss clk_camss_csi1phytimer_clk>,
				<&clock_mmss clk_csi2phytimer_clk_src>,
				<&clock_mmss clk_camss_csi2phytimer_clk>,
				<&clock_mmss clk_csi0_clk_src>,
				<&clock_mmss clk_camss_csi0_clk>,
				<&clock_mmss clk_camss_csi0phy_clk>,
				<&clock_mmss clk_camss_csi0_ahb_clk>,
				<&clock_mmss clk_camss_csi0rdi_clk>,
				<&clock_mmss clk_camss_csi0pix_clk>,
				<&clock_mmss clk_csi1_clk_src>,
				<&clock_mmss clk_camss_csi1_clk>,
				<&clock_mmss clk_camss_csi1phy_clk>,
				<&clock_mmss clk_camss_csi1_ahb_clk>,
				<&clock_mmss clk_camss_csi1rdi_clk>,
				<&clock_mmss clk_camss_csi1pix_clk>,
				<&clock_mmss clk_csi2_clk_src>,
				<&clock_mmss clk_camss_csi2_clk>,
				<&clock_mmss clk_camss_csi2phy_clk>,
				<&clock_mmss clk_camss_csi2_ahb_clk>,
				<&clock_mmss clk_camss_csi2rdi_clk>,
				<&clock_mmss clk_camss_csi2pix_clk>,
				<&clock_mmss clk_csi3_clk_src>,
				<&clock_mmss clk_camss_csi3_clk>,
				<&clock_mmss clk_camss_csi3phy_clk>,
				<&clock_mmss clk_camss_csi3_ahb_clk>,
				<&clock_mmss clk_camss_csi3rdi_clk>,
				<&clock_mmss clk_camss_csi3pix_clk>,
				<&clock_mmss clk_vfe0_clk_src>,
				<&clock_mmss clk_camss_vfe0_clk>,
				<&clock_mmss clk_camss_csi_vfe0_clk>,
				<&clock_mmss clk_vfe1_clk_src>,
				<&clock_mmss clk_camss_vfe1_clk>,
				<&clock_mmss clk_camss_csi_vfe1_clk>,
				<&clock_mmss clk_mmagic_camss_axi_clk>,
				<&clock_mmss clk_camss_vfe_ahb_clk>,
				<&clock_mmss clk_camss_vfe0_ahb_clk>,
				<&clock_mmss clk_camss_vfe_axi_clk>,
				<&clock_mmss clk_camss_vfe0_stream_clk>,
				<&clock_mmss clk_smmu_vfe_axi_clk>,
				<&clock_mmss clk_camss_vfe1_ahb_clk>,
				<&clock_mmss clk_camss_vfe1_stream_clk>;
			clock-names =
				"clk_mmss_mmagic_ahb_clk",
				"clk_camss_top_ahb_clk",
				"clk_camss_ispif_ahb_clk",
				"clk_csi0phytimer_clk_src",
				"clk_camss_csi0phytimer_clk",
				"clk_camss_ahb_clk",
				"clk_csi1phytimer_clk_src",
				"clk_camss_csi1phytimer_clk",
				"clk_csi2phytimer_clk_src",
				"clk_camss_csi2phytimer_clk",
				"clk_csi0_clk_src",
				"clk_camss_csi0_clk",
				"clk_camss_csi0phy_clk",
				"clk_camss_csi0_ahb_clk",
				"clk_camss_csi0rdi_clk",
				"clk_camss_csi0pix_clk",
				"clk_csi1_clk_src",
				"clk_camss_csi1_clk",
				"clk_camss_csi1phy_clk",
				"clk_camss_csi1_ahb_clk",
				"clk_camss_csi1rdi_clk",
				"clk_camss_csi1pix_clk",
				"clk_csi2_clk_src",
				"clk_camss_csi2_clk",
				"clk_camss_csi2phy_clk",
				"clk_camss_csi2_ahb_clk",
				"clk_camss_csi2rdi_clk",
				"clk_camss_csi2pix_clk",
				"clk_csi3_clk_src",
				"clk_camss_csi3_clk",
				"clk_camss_csi3phy_clk",
				"clk_camss_csi3_ahb_clk",
				"clk_camss_csi3rdi_clk",
				"clk_camss_csi3pix_clk",
				"clk_vfe0_clk_src",
				"clk_camss_vfe0_clk",
				"clk_camss_csi_vfe0_clk",
				"clk_vfe1_clk_src",
				"clk_camss_vfe1_clk",
				"clk_camss_csi_vfe1_clk",
				"clk_mmagic_camss_axi_clk",
				"clk_camss_vfe_ahb_clk",
				"clk_camss_vfe0_ahb_clk",
				"clk_camss_vfe_axi_clk",
				"clk_camss_vfe0_stream_clk",
				"clk_smmu_vfe_axi_clk",
				"clk_camss_vfe1_ahb_clk",
				"clk_camss_vfe1_stream_clk";
			qcom,clock-rates = <0 0 0 0 0 0 0 0
				0 0 0 0 0 0 0 0 0 0
				0 0 0 0 0 0 0 0 0 0
				0 0 0 0 0 0 0 0 0 0
				0 0 0 0 0 0 0 0 0 0
				>;
			qcom,clock-cntl-support;
			qcom,clock-control = "NO_SET_RATE",
				"NO_SET_RATE","NO_SET_RATE",
				"INIT_RATE","NO_SET_RATE","NO_SET_RATE",
				"INIT_RATE","NO_SET_RATE","INIT_RATE",
				"NO_SET_RATE","NO_SET_RATE","NO_SET_RATE",
				"NO_SET_RATE","NO_SET_RATE","NO_SET_RATE",
				"NO_SET_RATE","NO_SET_RATE","NO_SET_RATE",
				"NO_SET_RATE","NO_SET_RATE","NO_SET_RATE",
				"NO_SET_RATE","NO_SET_RATE","NO_SET_RATE",
				"NO_SET_RATE","NO_SET_RATE","NO_SET_RATE",
				"NO_SET_RATE","NO_SET_RATE","NO_SET_RATE",
				"NO_SET_RATE","NO_SET_RATE","NO_SET_RATE",
				"NO_SET_RATE","NO_SET_RATE","NO_SET_RATE",
				"NO_SET_RATE","NO_SET_RATE","NO_SET_RATE",
				"NO_SET_RATE","NO_SET_RATE","NO_SET_RATE",
				"NO_SET_RATE","NO_SET_RATE","NO_SET_RATE",
				"NO_SET_RATE","NO_SET_RATE","NO_SET_RATE";
	};
```

## Documentation/devicetree/bindings/media/video/msm-cam-fd.txt
```
* Qualcomm Technologies, Inc. MSM Camera FD

The MSM camera Face Detection device provides dependency definitions
for enabling Camera FD HW. MSM camera FD is implemented in multiple
device nodes. The root FD device node has properties defined to hint
the driver about the FD HW nodes available during the probe sequence.
Each node has multiple properties defined for interrupts, clocks and
regulators.

=======================
Required Node Structure
=======================
FD root interface node takes care of the handling Face Detection high level
driver handling and controls underlying FD hardware present.

- compatible
  Usage: required
  Value type: <string>
  Definition: Should be "qcom,cam-fd".

- compat-hw-name
  Usage: required
  Value type: <string>
  Definition: Should be "qcom,fd".

- num-fd
  Usage: required
  Value type: <u32>
  Definition: Number of supported FD HW blocks.

Example:
	qcom,cam-fd {
		compatible = "qcom,cam-fd";
		compat-hw-name = "qcom,fd";
		num-fd = <1>;
	};

=======================
Required Node Structure
=======================
FD Node provides interface for Face Detection hardware driver
about the device register map, interrupt map, clocks, regulators.

- cell-index
  Usage: required
  Value type: <u32>
  Definition: Node instance number.

- compatible
  Usage: required
  Value type: <string>
  Definition: Should be "qcom,fd41".

- reg-names
  Usage: optional
  Value type: <string>
  Definition: Name of the register resources.

- reg
  Usage: optional
  Value type: <u32>
  Definition: Register values.

- reg-cam-base
  Usage: optional
  Value type: <u32>
  Definition: Offset of the register space compared to
              to Camera base register space.

- interrupt-names
  Usage: optional
  Value type: <string>
  Definition: Name of the interrupt.

- interrupts
  Usage: optional
  Value type: <u32>
  Definition: Interrupt line associated with FD HW.

- regulator-names
  Usage: required
  Value type: <string>
  Definition: Name of the regulator resources for FD HW.

- camss-vdd-supply
  Usage: required
  Value type: <phandle>
  Definition: Regulator reference corresponding to the names listed
              in "regulator-names".

- clock-names
  Usage: required
  Value type: <string>
  Definition: List of clock names required for FD HW.

- clocks
  Usage: required
  Value type: <phandle>
  Definition: List of clocks required for FD HW.

- clock-rates
  Usage: required
  Value type: <u32>
  Definition: List of clocks rates.

- src-clock-name
  Usage: required
  Value type: <string>
  Definition: Source clock name.

- clock-cntl-level
  Usage: required
  Value type: <string>
  Definition: List of strings corresponds clock-rates levels.
  Supported strings: minsvs, lowsvs, svs, svs_l1, nominal, turbo.

Examples:
	cam_fd: qcom,fd@ac5a000 {
		cell-index = <0>;
		compatible = "qcom,fd41";
		reg-names = "fd_core", "fd_wrapper";
		reg = <0xac5a000 0x1000>,
			<0xac5b000 0x400>;
		reg-cam-base = <0x5a000 0x5b000>;
		interrupt-names = "fd";
		interrupts = <0 462 0>;
		regulator-names = "camss-vdd";
		camss-vdd-supply = <&titan_top_gdsc>;
		clock-names = "gcc_ahb_clk",
			"gcc_axi_clk",
			"soc_ahb_clk",
			"cpas_ahb_clk",
			"camnoc_axi_clk",
			"fd_core_clk_src",
			"fd_core_clk",
			"fd_core_uar_clk";
		clocks = <&clock_gcc GCC_CAMERA_AHB_CLK>,
			<&clock_gcc GCC_CAMERA_AXI_CLK>,
			<&clock_camcc CAM_CC_SOC_AHB_CLK>,
			<&clock_camcc CAM_CC_CPAS_AHB_CLK>,
			<&clock_camcc CAM_CC_CAMNOC_AXI_CLK>,
			<&clock_camcc CAM_CC_FD_CORE_CLK_SRC>,
			<&clock_camcc CAM_CC_FD_CORE_CLK>,
			<&clock_camcc CAM_CC_FD_CORE_UAR_CLK>;
		src-clock-name = "fd_core_clk_src";
		clock-cntl-level = "svs";
		clock-rates = <0 0 0 0 0 400000000 0 0>;
	};
```
