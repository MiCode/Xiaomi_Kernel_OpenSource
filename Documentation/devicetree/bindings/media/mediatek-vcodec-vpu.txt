## Documentation/devicetree/bindings/media/mediatek-vcodec-vpu.txt
```
* Mediatek Video Process Unit

Video Processor Unit is a hw video controller. It can accepts commands from
Application Processor.

Required properties:
  - compatible: "mediatek,mt2701-vpu"

Example:
	vpu: vpu@10020000 {
		compatible = "mediatek,mt2701-vpu";
		iommus = <&iommu M4U_PORT_VENC_RCPU>;
	};
```

## Documentation/devicetree/bindings/media/mediatek-vcodec.txt
```
Mediatek Video Codec

Mediatek Video Codec is the video codec hw  present in Mediatek SoCs whcih
supports high resolution decoding and encoding functionalities.
The Mediatek Video Codec device driver is a v4l2 driver which can encode/
decode video raw/elementary streams and has support for all popular video
codecs.

Required properties:
- compatible : "mediatek,mt2701-vcodec-dec", "mediatek,mt2701-vcodec-enc",
- reg : (1) VDEC_SYS register base and size
	(2) VDEC_MISC register base and size
	(3) VDEC_VLD register base and size
	(4) VDEC_VLD_TOP register base and size
	(5) VDEC_MC register base and size
	(6) VDEC_AVC_VLD register base and size
	(7) VDEC_AVC_MV register base and size
	(8) VDEC_PP register base and size
	(9) VDEC_VP8_VLD register base and size
	(10) VDEC_VP6_VD register base and size
	(11) VDEC_VP8_VLD2 register base and size
	(12) VDEC_VP9_VLD register base and size
- interrupts : interrupt number to the cpu.
- larb : must contain the larbes of current platform
- clocks : 	(1) clock name of top video decoder sel from clock manager
		(2) clock name of top video decoder pll from clock manager
- clock-names:  (1) "vdec_sel" for top video decoder sel clock
		(2) "vdecpll" for top video decoder pll clock
- iommus : Mediatek IOMMU H/W has designed the fixed associations with
        the multimedia H/W. and there is only one multimedia iommu domain.
        "iommus = <&iommu portid>" the "portid" is from
        dt-bindings\iommu\mt2701-iommu-port.h, it means that this portid will
        enable iommu. The portid default is disable iommu if "<&iommu portid>"
        didn't be added.
		(1) porid for VDEC MC
		(2) porid for VDEC PP
		(3) porid for VDEC AVC_MV
		(4) porid for VDEC PRED_RD
		(5) porid for VDEC PRED_WR
		(6) porid for VDEC VLD
		(7) porid for VDEC VLD2
		(8) porid for VDEC TILE

- vpu : Mediatek Codec need to download vpu firmware if there is any codec ctx created

Example:
	vdec:v4l2codec@16000000 {
		compatible = "mediatek,mt2701-vcodec-dec";
		reg = <0 0x16000000 0 0x100>,		/* VDEC_SYS */
		      <0 0x16020000 0 0x1000>,		/* VDEC_MISC */
		      <0 0x16021000 0 0x800>,		/* VDEC_LD */
		      <0 0x16021800 0 0x800>,		/* VDEC_TOP */
		      <0 0x16022000 0 0x1000>,		/* VDEC_CM */
		      <0 0x16023000 0 0x1000>,		/* VDEC_AD */
		      <0 0x16024000 0 0x1000>,		/* VDEC_AV */
		      <0 0x16025000 0 0x1000>,		/* VDEC_PP */
		      <0 0x16026800 0 0x800>,		/* VP8_VD */
		      <0 0x16027000 0 0x800>,		/* VP6_VD */
		      <0 0x16027800 0 0x800>,		/* VP8_VL */
		      <0 0x16028400 0 0x400>;		/* VP9_VD */
		interrupts = <GIC_SPI 139 IRQ_TYPE_LEVEL_LOW>;
		larb = <&larb1>;
		iommus = <&iommu M4U_PORT_VDEC_MC_EXT>,
			 <&iommu M4U_PORT_VDEC_PP_EXT>,
			 <&iommu M4U_PORT_VDEC_AVC_MV_EXT>,
			 <&iommu M4U_PORT_VDEC_PRED_RD_EXT>,
			 <&iommu M4U_PORT_VDEC_PRED_WR_EXT>,
			 <&iommu M4U_PORT_VDEC_VLD_EXT>,
			 <&iommu M4U_PORT_VDEC_VLD2_EXT>,
			 <&iommu M4U_PORT_VDEC_TILE_EXT>;
		vpu = <&vpu>;
		power-domains = <&scpsys MT2701_POWER_DOMAIN_VDEC>;
		clocks = <&topckgen CLK_TOP_VDEC_SEL>,
			 <&topckgen CLK_TOP_VDECPLL>;
		clock-names = "vdec_sel",
			      "vdecpll";
	};
```

## Documentation/devicetree/bindings/media/mediatek-videocodec.txt
```
* Mediatek Video Codec Driver

This document describes the binding for the mediatek video codec.

Required properties:
- compatible:
   - "mediatek,mt6735-vdec_gcon", "mediatek,mt6735-vdec", for video decoder,
   - "mediatek,mt6735-venc_gcon", "mediatek,mt6735-venc", for video encoder,
   - "mediatek,mt6735-vencsys", "mediatek,mt6735-vdecsys", for video clock management,
   for MT6735 SoCs
- interrupts: IRQ for video codec in SOC
- reg: The base address of the video codec register
- clocks: device clocks
- clock-name: Should be the names of the clocks
   - "MT_CG_DISP0_SMI_COMMON" for Display SMI
   - "MT_CG_VDEC0_VDEC" for Video Decoder
   - "MT_CG_VDEC1_LARB" for Video Decoder Larb
   - "MT_CG_VENC_VENC" for Video Encoder
   - "MT_CG_VENC_LARB" for Video Encoder Larb
   - "MT_CG_TOP_MUX_VDEC" for Video Decoder Mux for MMDVFS
   - "MT_CG_TOP_SYSPLL1_D2" for MMDVFS higher frequency
   - "MT_CG_TOP_SYSPLL1_D4" for MMDVFS lower frequency
   - "MT_SCP_SYS_VDE" for Video Decoder MTCMOS
   - "MT_SCP_SYS_VEN" for Video Encoder MTCMOS
   - "MT_SCP_SYS_DIS" for Display MTCMOS

Example:

		vdecsys: vdecsys@0x16000000 {
			compatible = "mediatek,mt6735-vdecsys";
			reg = <0x16000000 0x1000>;
			interrupts = <GIC_SPI 179 IRQ_TYPE_LEVEL_LOW>;
			#clock-cells = <1>;
		};

		vencsys: vencsys@0x17000000 {
			compatible = "mediatek,mt6735-vencsys";
			reg = <0x17000000 0x1000>;
			interrupts = <GIC_SPI 180 IRQ_TYPE_LEVEL_LOW>;
			#clock-cells = <1>;
		};

		vdec_gcon: vdec_gcon@16000000 {
			compatible = "mediatek,mt6735-vdec_gcon";
			reg = <0x16000000 0x1000>;
			interrupts = <GIC_SPI 179 IRQ_TYPE_LEVEL_LOW>;
			clocks =
			<&mmsys MM_DISP0_SMI_COMMON>,
			<&vdecsys VDEC0_VDEC>,
			<&vdecsys VDEC1_LARB>,
			<&vencsys VENC_VENC>,
			<&vencsys VENC_LARB>,
			<&topckgen TOP_MUX_VDEC>,
			<&topckgen TOP_SYSPLL1_D2>,
			<&topckgen TOP_SYSPLL1_D4>,
			<&scpsys SCP_SYS_VDE>,
			<&scpsys SCP_SYS_VEN>,
			<&scpsys SCP_SYS_DIS>;
			clock-names =
			"MT_CG_DISP0_SMI_COMMON",
			"MT_CG_VDEC0_VDEC",
			"MT_CG_VDEC1_LARB",
			"MT_CG_VENC_VENC",
			"MT_CG_VENC_LARB",
			"MT_CG_TOP_MUX_VDEC",
			"MT_CG_TOP_SYSPLL1_D2",
			"MT_CG_TOP_SYSPLL1_D4",
			"MT_SCP_SYS_VDE",
			"MT_SCP_SYS_VEN",
			"MT_SCP_SYS_DIS";
		};

		vdec: vdec@16020000 {
			compatible = "mediatek,mt6735-vdec";
			reg = <0x16020000 0x10000>;
			interrupts = <GIC_SPI 179 IRQ_TYPE_LEVEL_LOW>;
		};

		venc_gcon: venc_gcon@17000000 {
			compatible = "mediatek,mt6735-venc_gcon";
			reg = <0x17000000 0x1000>;
			interrupts = <GIC_SPI 180 IRQ_TYPE_LEVEL_LOW>;
		};

		venc: venc@17002000 {
			compatible = "mediatek,mt6735-venc";
			reg = <0x17002000 0x1000>;
			interrupts = <GIC_SPI 180 IRQ_TYPE_LEVEL_LOW>;
		};
\ No newline at end of file
```

## Documentation/devicetree/bindings/media/msm-cvp.txt
```
* Qualcomm Technologies, Inc. MSM CVP

[Root level node]
cvp
=====
Required properties:
- compatible : one of:
	- "qcom,msm-cvp"
	- "qcom,shima-cvp" : Invokes driver specific data for shima.
	- "qcom,lahaina-cvp" : Invokes driver specific data for Lahaina.
	- "qcom,kona-cvp" : Invokes driver specific data for kona.

Optional properties:
- reg : offset and length of the CSR register set for the device.
- interrupts : should contain the cvp interrupt.
- qcom,reg-presets : list of offset-value pairs for registers to be written.
  The offsets are from the base offset specified in 'reg'. This is mainly
  used for QoS, VBIF, etc. presets for video.
- qcom,qdss-presets : list of physical address and memory allocation size pairs.
  when fw_debug_mode is set as HFI_DEBUG_MODE_QDSS, all firmware messages will be
  written to QDSS memory.
- *-supply: A phandle pointing to the appropriate regulator. Number of
  regulators vary across targets.
- clock-names: an array of clocks that the driver is supposed to be
  manipulating. The clocks names here correspond to the clock names used in
  clk_get(<name>).
- qcom,clock-configs = an array of bitmaps of clocks' configurations. The index
  of the bitmap corresponds to the clock at the same index in qcom,clock-names.
  The bitmaps describes the actions that the device needs to take regarding the
  clock (i.e. scale it based on load).

  The bitmap is defined as:
  scalable = 0x1 (if the driver should vary the clock's frequency based on load)
- qcom,allowed-clock-rates = an array of supported clock rates by the chipset.
- qcom,use-non-secure-pil = A bool indicating which type of pil to use to load
  the fw.
- qcom,fw-bias = The address at which cvp fw is loaded (manually).

[Second level nodes]
Context Banks
=============
Required properties:
- compatible : one of:
	- "qcom,msm-cvp,context-bank"
- iommus : A phandle parsed by smmu driver. Number of entries will vary
  across targets.

Optional properties:
- label - string describing iommu domain usage.
- buffer-types : bitmap of buffer types that can be mapped into the current
	IOMMU domain.
        - Buffer types are defined as the following:
          input = 0x1
          output = 0x2
          output2 = 0x4
          extradata input = 0x8
          extradata output = 0x10
          extradata output2 = 0x20
          internal scratch = 0x40
          internal scratch1 = 0x80
          internal scratch2 = 0x100
          internal persist = 0x200
          internal persist1 = 0x400
          internal cmd queue = 0x800
- virtual-addr-pool : offset and length of virtual address pool.
- qcom,fw-context-bank : bool indicating firmware context bank.
- qcom,secure-context-bank : bool indicating secure context bank.

Buses
=====
Required properties:
- compatible : one of:
	- "qcom,msm-cvp,bus"
- label : an arbitrary name
- qcom,bus-master : an integer descriptor of the bus master. Refer to arch/arm/\
  boot/dts/include/dt-bindings/msm/msm-bus-ids.h for list of acceptable masters
- qcom,bus-slave : an integer descriptor of the bus slave. Refer to arch/arm/\
  boot/dts/include/dt-bindings/msm/msm-bus-ids.h for list of acceptable slaves

Optional properties:
- qcom,bus-governor : governor to use when scaling bus, generally any commonly
  found devfreq governor might be used.  In addition to those governors, the
  custom Venus governors, "msm-vidc-ddr" or "msm-vidc-llcc" are also
  acceptable values.
  In the absence of this property the "performance" governor is used.
- qcom,bus-rage-kbps : an array of two items (<min max>) that indicate the
  minimum and maximum acceptable votes for the bus.
  In the absence of this property <0 INT_MAX> is used.
- qcom,ubwc-10bit : UBWC 10 bit content has different bus requirements,
  this tag will be used to pick the appropriate bus as per the session profile
  as shown below in example.

Memory Heaps
============
Required properties:
- compatible : one of:
	- "qcom,msm-vidc,mem-cdsp"
- memory-region : phandle to the memory heap/region.

Example:
	msm_cvp: qcom,cvp@ab00000 {
		 compatible = "qcom,msm-cvp", "qcom,Lahaina-cvp";
		 status = "ok";
		 reg = <0xab00000 0x100000>;
		 interrupts = <GIC_SPI 234 IRQ_TYPE_LEVEL_HIGH>;

		 /* FIXME: LLCC Info */
		 /* cache-slice-names = "vidsc0", "vidsc1"; */
		 /* cache-slices = <&llcc 2>, <&llcc 3>; */

		 /* Supply */
		 cvp-supply = <&mvs1_gdsc>;

		 /* Clocks */
		 clock-names =  "gcc_video_axi0",
			 "gcc_video_axi1", "cvp_clk";
		 clocks = <&clock_gcc GCC_VIDEO_AXI0_CLK>,
			<&clock_gcc GCC_VIDEO_AXI1_CLK>,
			<&clock_videocc VIDEO_CC_MVS1_CLK>;
		 qcom,proxy-clock-names = "gcc_video_axi0", "gcc_video_axi1",
			 "cvp_clk";

		 qcom,clock-configs = <0x0 0x0 0x1>;
		 qcom,allowed-clock-rates = <403000000 520000000
			 549000000 666000000 800000000>;

		 /* Buses */
		 bus_cnoc {
			 compatible = "qcom,msm-cvp,bus";
			 label = "cnoc";
			 qcom,bus-master = <MSM_BUS_MASTER_AMPSS_M0>;
			 qcom,bus-slave = <MSM_BUS_SLAVE_VENUS_CFG>;
			 qcom,bus-governor = "performance";
			 qcom,bus-range-kbps = <1000 1000>;
		 };

		 /* MMUs */
		 non_secure_cb {
			 compatible = "qcom,msm-cvp,context-bank";
			 label = "cvp_hlos";
			 iommus =
				 <&apps_smmu 0x2120 0x400>;
			 qcom,iommu-dma = "disabled";
			 buffer-types = <0xfff>;
			 virtual-addr-pool = <0x4b000000 0xe0000000>;
		 };

		 /* Memory Heaps */
		 qcom,msm-cvp,mem_cdsp {
			 compatible = "qcom,msm-cvp,mem-cdsp";
			 memory-region = <&cdsp_mem>;
		 };
	};
```

## Documentation/devicetree/bindings/media/msm-geni-ir.txt
```
MSM Generic Serial Interface Infrared (GENI-IR) Controller

Required properties:
- compatible : Should be "qcom,msm-geni-ir"
- reg : Offset and length of the register region for the device
- reg-names : Register region name referenced in 'reg' above
	The only required register resource entry is:
	"base"       : GENI-IR controller register block
- interrupts : Interrupt numbers used by this controller
- interrupt-names : Interrupt resource names referenced in 'interrupts' above
	Required interrupt resource entries are:
	"geni-ir-core-irq"   : GENI-IR core interrupt
	"geni-ir-wakeup-irq" : GENI-IR wakeup interrupt
- qcom,geni-ir-gpio-tx  : GPIO pin number of the GENI-IR transmit line
- qcom,geni-ir-gpio-rx  : GPIO pin number of the GENI-IR receive line

Aliases :
Aliases may be optionally used for GENI-IR devices on a target.
The alias will have the following format:
	'geni_ir{n}' where n is the instance number.

GENI-IR device is the child device of the SPSS device.

Example:
	aliases {
		geni_ir1 = &geni_ir_1;
	};

	qcom,msm-spss@fc5c3000 {

		...

		geni_ir_1: qcom,msm-geni-ir@fc5c1000 {
			compatible = "qcom,msm-geni-ir";
			reg-names = "base";
			reg = <0xfc5c1000 0x1000>;
			interrupts = <0 284 0>, <0 285 0>;
			interrupt-names = "geni-ir-core-irq",
					  "geni-ir-wakeup-irq";
			qcom,geni-ir-gpio-tx = <&msmgpio 8 0>;
			qcom,geni-ir-gpio-rx = <&msmgpio 9 0>;
		};
	};
```
