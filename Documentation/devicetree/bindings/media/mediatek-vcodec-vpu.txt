## Documentation/devicetree/bindings/media/msm-npu-pwrlevels.txt
```
Qualcomm Technologies, Inc. NPU powerlevels

Powerlevels are defined in sets by qcom,npu-pwrlevels. Each powerlevel defines
a series of clock frequencies. These frequencies are for the corresponding
clocks in the clocks property of the msm_npu device.

qcom,npu-pwrlevels bindings:

Required Properties:
- #address-cells: Should be set to 1
- #size-cells: Should be set to 0
- compatible: Must be qcom,npu-pwrlevels
- initial-pwrlevel: NPU initial wakeup power level, this is the index of the
	child node.

qcom,npu-pwrlevel: This is a child node defining power levels.
qcom,npu-pwrlevels must contain at least one power level node. Each child node
has the following properties:

Required Properties:
- reg: Index of the powerlevel (0 = lowest performance)
- clk-freq: List of clock frequencies (in Hz) of each clock for the current
	powerlevel. List of clocks and order described in:
	Documentation/devicetree/bindings/media/msm-npu.txt

Example:
	qcom,npu-pwrlevels {
		#address-cells = <1>;
		#size-cells = <0>;
		compatible = "qcom,npu-pwrlevels";
		initial-pwrlevel = <4>;
		qcom,npu-pwrlevel@0 {
			reg = <0>;
			clk-freq = <9600000
					9600000
					19200000
					19200000
					19200000
					19200000
					9600000
					60000000
					19200000
					19200000
					30000000
					19200000
					19200000
					19200000
					19200000
					19200000
					9600000
					19200000
					0>;
		};
		qcom,npu-pwrlevel@1 {
			reg = <1>;
			clk-freq = <300000000
					300000000
					19200000
					100000000
					19200000
					19200000
					300000000
					150000000
					19200000
					19200000
					60000000
					100000000
					100000000
					37500000
					100000000
					19200000
					300000000
					19200000
					0>;
		};
		qcom,npu-pwrlevel@2 {
			reg = <2>;
			clk-freq = <350000000
					350000000
					19200000
					150000000
					19200000
					19200000
					350000000
					200000000
					37500000
					19200000
					120000000
					150000000
					150000000
					75000000
					150000000
					19200000
					350000000
					19200000
					0>;
		};
		qcom,npu-pwrlevel@3 {
			reg = <3>;
			clk-freq = <400000000
					400000000
					19200000
					200000000
					19200000
					19200000
					400000000
					300000000
					37500000
					19200000
					120000000
					200000000
					200000000
					75000000
					200000000
					19200000
					400000000
					19200000
					0>;
		};
		qcom,npu-pwrlevel@4 {
			reg = <4>;
			clk-freq = <600000000
					600000000
					19200000
					300000000
					19200000
					19200000
					600000000
					403000000
					75000000
					19200000
					240000000
					300000000
					300000000
					150000000
					300000000
					19200000
					600000000
					19200000
					0>;
		};
		qcom,npu-pwrlevel@5 {
			reg = <5>;
			clk-freq = <715000000
					715000000
					19200000
					350000000
					19200000
					19200000
					715000000
					533000000
					75000000
					19200000
					240000000
					350000000
					350000000
					150000000
					350000000
					19200000
					715000000
					19200000
					0>;
		};
	};
```

## Documentation/devicetree/bindings/media/msm-npu.txt
```
* Qualcomm Technologies, Inc. MSM NPU

NPU (Neural Network Processing Unit) applies neural network processing

Required properties:
- compatible: Must be "qcom,msm-npu"
- reg: Specify offset and length of the device register sets.
- reg-names: Names corresponding to the defined register sets.
	- "npu_base": npu base registers
- interrupts: Specify the npu interrupts.
- interrupt-names: should specify relevant names to each interrupts
	property defined.
- cache-slice-names: A set of names that identify the usecase names of a
	client that uses cache slice. These strings are used to look up the
	cache slice entries by name
- cache-slices: The tuple has phandle to llcc device as the first argument
	and the second argument is the usecase id of the client
- clocks: clocks required for the device.
- clock-names: names of clocks required for the device.
- vdd-supply: Phandle for vdd regulator device node
- vdd_'reg'-supply: Reference to the regulator that supplies the corresponding
	'reg' domain, e.g. vdd_cx-supply.
- qcom,proxy-reg-names: Names of the regulators that need to be turned on/off
	during proxy voting/unvoting.
- qcom,vdd_'reg'-uV-uA: Voltage and current values for the 'reg' regulator,
	e.g. qcom,vdd_cx-uV-uA.
- mboxes: Phandle array for mailbox controllers to be used for IPC
- mbox-names: names of each mailboxes
- #cooling-cells: Should be set to 2
- qcom,npubw-dev: a phandle to a device representing bus bandwidth requirements
	(see devbw.txt)
- qcom,npu-pwrlevels: Container for NPU power levels
	(see msm-npu-pwrlevels.txt)
Example:
	msm_npu: qcom,msm_npu@9800000 {
		compatible = "qcom,msm-npu";
		status = "ok";
		reg = <0x9800000 0x800000>;
		reg-names = "npu_base";
		interrupts = <GIC_SPI 368 IRQ_TYPE_EDGE_RISING>;
		iommus = <&apps_smmu 0x1461 0x0>, <&apps_smmu 0x2061 0x0>;
		cache-slice-names = "npu";
		cache-slices = <&llcc 23>;
		clocks = <&clock_npucc NPU_CC_CAL_DP_CLK>,
				<&clock_npucc NPU_CC_CAL_DP_CLK_SRC>,
				<&clock_npucc NPU_CC_XO_CLK>,
				<&clock_npucc NPU_CC_ARMWIC_CORE_CLK>,
				<&clock_npucc NPU_CC_BTO_CORE_CLK>,
				<&clock_npucc NPU_CC_BWMON_CLK>,
				<&clock_npucc NPU_CC_CAL_DP_CDC_CLK>,
				<&clock_npucc NPU_CC_COMP_NOC_AXI_CLK>,
				<&clock_npucc NPU_CC_CONF_NOC_AHB_CLK>,
				<&clock_npucc NPU_CC_NPU_CORE_APB_CLK>,
				<&clock_npucc NPU_CC_NPU_CORE_ATB_CLK>,
				<&clock_npucc NPU_CC_NPU_CORE_CLK>,
				<&clock_npucc NPU_CC_NPU_CORE_CLK_SRC>,
				<&clock_npucc NPU_CC_NPU_CORE_CTI_CLK>,
				<&clock_npucc NPU_CC_NPU_CPC_CLK>,
				<&clock_npucc NPU_CC_NPU_CPC_TIMER_CLK>,
				<&clock_npucc NPU_CC_PERF_CNT_CLK>,
				<&clock_npucc NPU_CC_QTIMER_CORE_CLK>,
				<&clock_npucc NPU_CC_SLEEP_CLK>;
		clock-names = "cal_dp_clk",
				"cal_dp_clk_src",
				"xo_clk",
				"armwic_core_clk",
				"bto_core_clk",
				"bwmon_clk",
				"cal_dp_cdc_clk",
				"comp_noc_axi_clk",
				"conf_noc_ahb_clk",
				"npu_core_apb_clk",
				"npu_core_atb_clk",
				"npu_core_clk",
				"npu_core_clk_src",
				"npu_core_cti_clk",
				"npu_cpc_clk",
				"npu_cpc_timer_clk",
				"perf_cnt_clk",
				"qtimer_core_clk",
				"sleep_clk";
		vdd-supply = <&npu_core_gdsc>;
		vdd_cx-supply = <&pm8150l_s6_level>;
		qcom,proxy-reg-names ="vdd", "vdd_cx";
		qcom,vdd_cx-uV-uA = <RPMH_REGULATOR_LEVEL_TURBO 100000>;
		mboxes = <&qmp_npu0 0>, <&qmp_npu1 0>;
		mbox-names = "npu_low", "npu_high";
		#cooling-cells = <2>;
		qcom,npubw-dev = <&npu_npu_ddr_bw>;
		qcom,npu-pwrlevels {
			#address-cells = <1>;
			#size-cells = <0>;
			compatible = "qcom,npu-pwrlevels";
			initial-pwrlevel = <4>;
			qcom,npu-pwrlevel@0 {
				reg = <0>;
				clk-freq = <9600000
						9600000
						19200000
						19200000
						19200000
						19200000
						9600000
						60000000
						19200000
						19200000
						30000000
						19200000
						19200000
						19200000
						19200000
						19200000
						9600000
						19200000
						0>;
			};
			qcom,npu-pwrlevel@1 {
				reg = <1>;
				clk-freq = <300000000
						300000000
						19200000
						100000000
						19200000
						19200000
						300000000
						150000000
						19200000
						19200000
						60000000
						100000000
						100000000
						37500000
						100000000
						19200000
						300000000
						19200000
						0>;
			};
			qcom,npu-pwrlevel@2 {
				reg = <2>;
				clk-freq = <350000000
						350000000
						19200000
						150000000
						19200000
						19200000
						350000000
						200000000
						37500000
						19200000
						120000000
						150000000
						150000000
						75000000
						150000000
						19200000
						350000000
						19200000
						0>;
			};
			qcom,npu-pwrlevel@3 {
				reg = <3>;
				clk-freq = <400000000
						400000000
						19200000
						200000000
						19200000
						19200000
						400000000
						300000000
						37500000
						19200000
						120000000
						200000000
						200000000
						75000000
						200000000
						19200000
						400000000
						19200000
						0>;
			};
			qcom,npu-pwrlevel@4 {
				reg = <4>;
				clk-freq = <600000000
						600000000
						19200000
						300000000
						19200000
						19200000
						600000000
						403000000
						75000000
						19200000
						240000000
						300000000
						300000000
						150000000
						300000000
						19200000
						600000000
						19200000
						0>;
			};
			qcom,npu-pwrlevel@5 {
				reg = <5>;
				clk-freq = <715000000
						715000000
						19200000
						350000000
						19200000
						19200000
						715000000
						533000000
						75000000
						19200000
						240000000
						350000000
						350000000
						150000000
						350000000
						19200000
						715000000
						19200000
						0>;
			};
		};
	};
```

## Documentation/devicetree/bindings/media/qca402x.txt
```
* Qualcomm Technologies, Inc. MSM QCA402x

Required properties for parent node:
- compatible :
    - "qcom,qca402"

Optional properties
- endpoints : Number of endpoints used for communication with the QCA402x
               device
Example:
qcom,qca402x {
	compatible = "qcom,qca402";
	endpoints = <1>;
};
```

## Documentation/devicetree/bindings/media/spi-ir.txt
```
Device tree bindings for IR LED connected through SPI bus which is used as
remote controller.

The IR LED switch is connected to the MOSI line of the SPI device and the data
are delivered thourgh that.

Required properties:
	- compatible: should be "ir-spi"

Optional properties:
	- irled,switch: specifies the gpio switch which enables the irled

Example:

	irled@0 {
		compatible = "ir-spi";
		reg = <0x0>;
		spi-max-frequency = <5000000>;
		irled,switch = <&gpr3 3 0>;

		controller-data {
			samsung,spi-feedback-delay = <0>;
		};
	};
```

## Documentation/devicetree/bindings/media/video/cam-hyp-intf.txt
```
* Qualcomm Technologies, Inc. MSM Camera Hypervisor interface

The MSM camera hypervisor driver provides interface to communicate with resource
manager within hypervisor to get secure handle for ion buffer handle.

=======================
Required Node Structure
=======================
The hypervisor is described in one level of device node.

==================================
First Level Node
==================================
- compatible
  Usage: required
  Value type: <string>
  Definition: Should be "qcom,resource-manager-scbuf".
- reg
  Usage: required
  Value type: <int>
  Definition: Should have transmit and receive pipe handle of resource manager

Example:

	scbuf@18 {
		compatible = "qcom,resource-manager-scbuf";
		status = "ok";
		reg = <0x15 0x11>;
	};
```

## Documentation/devicetree/bindings/media/video/laser-sensor.txt
```
Laser Sensor Device Tree Bindings.
========================================

Boards with the Laser Sensor connected to CCI shall have the following
properties:

Required node properties:
	- cell-index: cci hardware core index
    - compatible:
		- "st,stmvl53l0" : STMiecroelectronics VL53L0 Laser sensor.
	- reg : offset and length of the register set for the device
	- qcom, cci-master: cci master the sensor connected to
	- cam_cci-supply : cci voltage regulator used
	- cam_laser-supply: laser sensor voltage regulator
	- qcom,cam-vreg-name: voltage regulators name
	- qcom, cam-vreg-min-voltage: specify minimum voltage level for
		regulators used
	- qcom, cam-vreg-max-voltage: specify maximum voltage level for
		regulators used
	- pinctrl-names : should specify the pin control groups followed by
		the definition of each group
		stm,irq-gpio : irq gpio which is to provide interrupts to host.
	- gpios : should contain phandle to gpio controller node and array of
		#gpio-cells specifying specific gpio (controller specific)
	- qcom,gpio-req-tbl-num : contains index to gpios specific to the sensor
	- qcom,gpio-req-tbl-flags : should contain direction of gpios present in
		qcom,gpio-req-tbl-num property (in the same order)
	- qcom,gpio-req-tbl-label : should contain name of gpios present in
		qcom,gpio-req-tbl-num property (in the same order)
```

## Documentation/devicetree/bindings/media/video/msm-ais-ife.txt
```
* Qualcomm Technologies, Inc. MSM Camera ISP

The MSM AIS IFE driver provides the definitions for enabling
the Camera IFE hadware for Automotive usecase. It provides the
functions for the Client to control the IFE hardware.

=======================
Required Node Structure
=======================
The Camera AIS IFE device is described in one level of device node.

==================================
First Level Node - AIS IFE device
==================================
- compatible
  Usage: required
  Value type: <string>
  Definition: Should be "qcom,ais-ife".

- arch-compat
  Usage: required
  Value type: <string>
  Definition: Should be "ife".

- cell-index
  Usage: required
  Value type: <u32>
  Definition: Should specify the hardware index id.

Example:

	qcom,ais-ife0 {
		compatible = "qcom,ais-ife";
		cell-index = <0>;
		status = "ok";
	};
```

## Documentation/devicetree/bindings/media/video/msm-ba.txt
```
* Qualcomm Technologies Inc MSM BA

[Root level node]
==================
Required properties:
- compatible: Must be "qcom,msm-ba".

[Subnode]
==========
- qcom,ba-input-profile-#: Defines child nodes for the profiles supported
              by BA driver. Each profile should have properties "qcom,type",
              "qcom,name", "qcom,ba-input", "qcom,ba-output", "qcom,sd-name",
              "qcom,ba-node" and "qcom,user-type".
Required properties:
- qcom,type: Input type such as CVBS(0), HDMI(4) etc as defined in BA driver.
             This property is of type u32.
- qcom,name: Name of the input type. This property is of type string.
- qcom,ba-input: BA input id supported by a bridge chip for this profile.
             This property is of type u32.
- qcom,ba-output: BA output id for the profile. This property is of type u32.
- qcom,sd-name: Name of the sub-device driver associated with this profile.
              This property is of type string.
- qcom,ba-node: Defines the ba node id. This is the avdevice node used by camera
                for this profile. This property is of type u32.
- qcom,user-type: This property defines how the profile is being used. If this
             profile is used by kernel it is set to 0 and if used by userspace
             it is set to 1. This property is of type u32.
Example:

	qcom,msm-ba {
		compatible = "qcom,msm-ba";
		qcom,ba-input-profile-0 {
			qcom,type = <4>;          /* input type   */
			qcom,name = "HDMI-1";     /* input name   */
			qcom,ba-input = <13>;     /* ba input id  */
			qcom,ba-output = <0>;     /* ba output id */
			qcom,sd-name = "adv7481"; /* sd name      */
			qcom,ba-node = <0>;       /* ba node      */
			qcom,user-type = <1>;     /* user type    */
		};
	};
```
