## sound/soc/msm/Kconfig
```kconfig
menu "MSM SoC Audio support"

config SND_SOC_MSM_HOSTLESS_PCM
	tristate

config SND_SOC_MSM_QDSP6V2_INTF
	bool "SoC Q6 audio driver for APQ8084"
	help
	 To add support for SoC audio on APQ8084.
	 This will enable all the platform specific
	 interactions towards DSP. It includes asm,
	 adm and afe interfaces on the DSP.

config SND_SOC_QDSP6V2
	tristate "SoC ALSA audio driver for QDSP6V2"
	select SND_SOC_MSM_QDSP6V2_INTF
	help
	 To add support for MSM QDSP6V2 Soc Audio.
	 This will enable sound soc platform specific
	 audio drivers. This includes q6asm, q6adm,
	 q6afe interfaces to DSP using apr.

config SND_SOC_QDSP6V2_VM
	tristate "SoC ALSA audio driver for QDSP6V2 virtualization"
	depends on MSM_QDSP6_APRV2_VM
	help
	 To add support for MSM QDSP6V2 virtualization
	 Soc Audio.
	 This will enable sound soc platform specific
	 audio drivers. This includes q6asm, q6adm,
	 q6afe interfaces to DSP using virtualized apr.

config SND_SOC_QDSP_DEBUG
	bool "QDSP Audio Driver Debug Feature"
	help
	 Configuration to enable debugging utilities for
	 QDSP6 based audio drivers. One debugging utility
	 is inducing kernel panic upon encountering critical
	 errors from DSP audio modules

config DOLBY_DAP
	bool "Enable Dolby DAP"
	depends on SND_SOC_MSM_QDSP6V2_INTF
	help
	 To add support for dolby DAP post processing.
	 This support is to configure the post processing parameters
	 to DSP. The configuration includes sending the end point
	 device, end point dependent post processing parameters and
	 the various posrt processing parameters

config DOLBY_DS2
	bool "Enable Dolby DS2"
	depends on SND_SOC_MSM_QDSP6V2_INTF
	help
	 To add support for dolby DAP post processing.
	 This support is to configure the post processing parameters
	 to DSP. The configuration includes sending the end point
	 device, end point dependent post processing parameters and
	 the various posrt processing parameters

config DTS_EAGLE
	bool "Enable DTS Eagle Support"
	depends on SND_SOC_MSM_QDSP6V2_INTF
	select SND_HWDEP
	help
	 To add DTS Eagle support on QDSP6 targets.
	 Eagle is a DTS pre/post processing
	 package that includes HeadphoneX. The configuration
	 includes sending tuning parameters of various modules.

config DTS_SRS_TM
	bool "Enable DTS SRS"
	depends on SND_SOC_MSM_QDSP6V2_INTF
	help
	 To add support for DTS SRS post processing.
	 This support is to configure the post processing
	 parameters to DSP. The configuration includes sending
	 tuning parameters of various modules.

config QTI_PP
	bool "Enable QTI PP"
	depends on SND_SOC_MSM_QDSP6V2_INTF || SND_SOC_QDSP6V2_VM
	help
	 To add support for default QTI post processing.
	 This support is to configure the post processing
	 parameters to DSP. The configuration includes sending
	 tuning parameters of various modules such as equalizer,
	 customized mixing.

config SND_SOC_CPE
	tristate "CPE drivers"
	depends on SND_SOC_WCD_CPE
	help
	 To add support for Codec Processing Engine. This support
	 is to enable CPE block on the codec and this config needs
	 to be added to codecs that contain the CPE hardware block.
	 The configuration includes the cpe lsm driver to enable
	 listen on codec.

config SND_SOC_APQ8084
	tristate "SoC Machine driver for APQ8084 boards"
	depends on ARCH_APQ8084
	select SND_SOC_QDSP6V2
	select SND_SOC_MSM_STUB
	select SND_SOC_MSM_HOSTLESS_PCM
	select SND_SOC_WCD9330
	select SND_SOC_WCD9320
	select SND_DYNAMIC_MINORS
	select DOLBY_DAP
	select DTS_SRS_TM
	select QTI_PP
	select SND_SOC_CPE
	select DOLBY_DS2
	select SND_HWDEP
	help
	 To add support for SoC audio on APQ8084.
	 This will enable sound soc drivers which
	 interfaces with DSP, also it will enable
	 the machine drivers and the corresponding
	 DAI-links.

config SND_SOC_MSM8994
	tristate "SoC Machine driver for MSM8994 boards"
	depends on ARCH_MSM8994
	select SND_SOC_QDSP6V2
	select SND_SOC_MSM_STUB
	select SND_SOC_MSM_HOSTLESS_PCM
	select SND_DYNAMIC_MINORS
	select MSM_QDSP6_APRV2
	select MSM_QDSP6V2_CODECS
	select SND_SOC_WCD9330
	select SND_SOC_MSM_HDMI_CODEC_RX
	select QTI_PP
	select DTS_SRS_TM
	select SND_SOC_CPE
	select MSM_ULTRASOUND
	select DOLBY_DS2
	select SND_HWDEP
        select DTS_EAGLE
	help
	 To add support for SoC audio on MSM8994.
	 This will enable sound soc drivers which
	 interfaces with DSP, also it will enable
	 the machine drivers and the corresponding
	 DAI-links.

config SND_SOC_MSM8996
	tristate "SoC Machine driver for MSM8996 boards"
	depends on ARCH_MSM8996
	select SND_SOC_QDSP6V2
	select SND_SOC_MSM_STUB
	select SND_SOC_MSM_HOSTLESS_PCM
	select SND_DYNAMIC_MINORS
	select MSM_QDSP6_APRV2
	select MSM_QDSP6V2_CODECS
	select SND_SOC_WCD9330
	select SND_SOC_WCD9335
	select SND_SOC_WSA881X
	select SND_SOC_MSM_HDMI_CODEC_RX
	select DTS_SRS_TM
	select QTI_PP
	select SND_SOC_CPE
	select MSM_ULTRASOUND
	select DOLBY_DS2
	select SND_HWDEP
        select DTS_EAGLE
	help
	 To add support for SoC audio on MSM8996.
	 This will enable sound soc drivers which
	 interfaces with DSP, also it will enable
	 the machine driver and the corresponding
	 DAI-links

config SND_SOC_MSM8996_VM
	tristate "SoC Machine driver for MSM8996 virtualization"
	select SND_SOC_QDSP6V2_VM
	select SND_SOC_MSM_STUB
	select SND_SOC_MSM_HOSTLESS_PCM
	select SND_DYNAMIC_MINORS
	select MSM_QDSP6_APRV2_VM
	select MSM_QDSP6V2_CODECS
	select QTI_PP
	help
	 To add support for SoC audio on MSM8996
	 virtualization platform.
	 This will enable sound soc drivers which
	 interfaces with DSP using virtualized apr,
	 also it will enable the machine driver and
	 the corresponding DAI-links

config SND_SOC_MSM8X16
	tristate "SoC Machine driver for MSM8916"
	depends on ARCH_MSM8953 || ARCH_MSM8937
	select SND_SOC_QDSP6V2
	select SND_SOC_MSM_STUB
	select SND_SOC_MSM_HOSTLESS_PCM
	select SND_DYNAMIC_MINORS
	select MSM_QDSP6_APRV2
	select MSM_QDSP6V2_CODECS
	select SND_SOC_WCD9330
	select SND_SOC_WCD9335
	select SND_SOC_MSM8X16_WCD
	select SND_SOC_WSA881X_ANALOG
	select SND_SOC_WSA881X
	select MFD_CORE
	select QTI_PP
	select DTS_SRS_TM
	select DOLBY_DAP
	select DOLBY_DS2
	select SND_SOC_CPE
	select SND_SOC_WCD_CPE
	select SND_SOC_MSM_HDMI_DBA_CODEC_RX
	select SND_HWDEP
        select DTS_EAGLE
	help
	 To add support for SoC audio on MSM8996.
	 This will enable sound soc drivers which
	 interfaces with DSP, also it will enable
	 the machine driver and the corresponding
	 DAI-links

config SND_SOC_MDM9650
        tristate "SoC Machine driver for MDM9650 or SDX20 boards"
        depends on ARCH_MDM9650 || ARCH_SDX20
        select SND_SOC_QDSP6V2
        select SND_SOC_MSM_STUB
        select SND_SOC_MSM_HOSTLESS_PCM
        select SND_DYNAMIC_MINORS
        select MSM_QDSP6_APRV3_GLINK
        select MSM_QDSP6V2_CODECS
        select SND_SOC_WCD9335
        select SND_SOC_WSA881X
        select SND_SOC_TLV320AIC3X
        select SND_HWDEP
        help
         To add support for SoC audio on MDM9650 or SDX20.
         This will enable sound soc drivers which
         interfaces with DSP, also it will enable
         the machine driver and the corresponding
         DAI-links

config SND_SOC_MDM9607
	tristate "SoC Machine driver for MDM9607 boards"
	depends on ARCH_MDM9607
	select SND_SOC_QDSP6V2
	select SND_SOC_MSM_STUB
	select SND_SOC_WCD9330
	select SND_SOC_WCD9306
	select SND_SOC_MSM_HOSTLESS_PCM
	select SND_DYNAMIC_MINORS
	select MSM_QDSP6_APRV3
	select MSM_QDSP6V2_CODECS
	select SND_HWDEP
	help
	 To add support for SoC audio on MDM9607 boards.
	 This will enable sound soc drivers which
	 interfaces with DSP, also it will enable
	 the machine drivers and the corresponding
	 DAI-links.

config SND_SOC_MSM8909
	tristate "SoC Machine driver for MSM8909 boards"
	depends on ARCH_MSM8909
	select SND_SOC_QDSP6V2
	select SND_SOC_MSM_STUB
	select SND_SOC_MSM_HOSTLESS_PCM
	select SND_DYNAMIC_MINORS
	select MSM_QDSP6_APRV3
	select MSM_QDSP6V2_CODECS
	select SND_SOC_MSM8X16_WCD
	select SND_SOC_DIGITAL_CDC
	select SND_SOC_WSA881X_ANALOG
	select SND_SOC_WSA881X
	select SND_SOC_WCD9335
        select SND_SOC_CPE
	select SND_HWDEP
	select MSM_BG_GLINK
	select MSM_BG_CODEC
	select QTI_PP
	help
	 To add support for SoC audio on MSM8909 boards.
	 This will enable sound soc drivers which
	 interfaces with DSP, also it will enable
	 the machine drivers and the corresponding
	 DAI-links.

config SND_SOC_MDM9640
	tristate "SoC Machine driver for MDM9640 boards"
	depends on ARCH_MDM9640
	select SND_SOC_QDSP6V2
	select SND_SOC_MSM_STUB
	select SND_SOC_WCD9330
	select SND_SOC_MSM_HOSTLESS_PCM
	select SND_DYNAMIC_MINORS
	select MSM_QDSP6_APRV3
	select MSM_QDSP6V2_CODECS
	select SND_HWDEP
        help
	 To add support for SoC audio on MDM9640 boards.
	 This will enable sound soc drivers which
	 interfaces with DSP, also it will enable
	 the machine drivers and the corresponding
	 DAI-links.

endmenu
```

## sound/soc/tegra-alt/Kconfig
```kconfig
config SND_SOC_TEGRA_ALT
	tristate "Alternative DAPM-based SoC audio support for the Tegra System-on-Chip"
	depends on ARCH_TEGRA && TEGRA20_APB_DMA
	select REGMAP_MMIO
	select SND_SOC_DMAENGINE_PCM if TEGRA20_APB_DMA
	help
	  Say Y or M here if you want support for SoC audio on Tegra, using the
	  alternative driver that exposes to user-space the full routing capabilities
	  of the AHUB (Audio HUB) hardware module.

config SND_SOC_TEGRA_ALT_30_OR_LATER
	def_bool y
	depends on SND_SOC_TEGRA_ALT
	depends on ARCH_TEGRA_3x_SOC || ARCH_TEGRA_11x_SOC || ARCH_TEGRA_12x_SOC

config SND_SOC_TEGRA_ALT_114_OR_LATER
	def_bool y
	depends on SND_SOC_TEGRA_ALT
	depends on ARCH_TEGRA_11x_SOC || ARCH_TEGRA_12x_SOC

config SND_SOC_TEGRA30_XBAR_ALT
	tristate "Tegra30 XBAR driver"
	depends on SND_SOC_TEGRA_ALT && SND_SOC_TEGRA_ALT_30_OR_LATER
	help
	  Say Y or M if you want to add support for Tegra30 XBAR module.

config SND_SOC_TEGRA30_APBIF_ALT
	tristate "Tegra30 APBIF driver"
	depends on SND_SOC_TEGRA30_XBAR_ALT && SND_SOC_TEGRA_ALT_30_OR_LATER
	help
	  Say Y or M if you want to add support for Tegra30 APBIF module.

config SND_SOC_TEGRA30_I2S_ALT
	tristate "Tegra30 I2S driver"
	depends on SND_SOC_TEGRA_ALT && SND_SOC_TEGRA_ALT_30_OR_LATER
	help
	  Say Y or M if you want to add support for Tegra30 I2S module.

config SND_SOC_TEGRA30_SPDIF_ALT
	tristate "Tegra30 SPDIF driver"
	depends on SND_SOC_TEGRA_ALT && SND_SOC_TEGRA_ALT_30_OR_LATER
	help
	  Say Y or M if you want to add support for Tegra30 SPDIF module.

config SND_SOC_TEGRA114_AMX_ALT
	tristate "Tegra114 AMX driver"
	depends on SND_SOC_TEGRA_ALT && SND_SOC_TEGRA_ALT_114_OR_LATER
	help
	  Say Y or M if you want to add support for Tegra114 AMX module.

config SND_SOC_TEGRA114_ADX_ALT
	tristate "Tegra114 ADX driver"
	depends on SND_SOC_TEGRA_ALT && SND_SOC_TEGRA_ALT_114_OR_LATER
	help
	  Say Y or M if you want to add support for Tegra114 ADX module.

config SND_SOC_TEGRA_VCM30T124_ALT
	tristate "SoC Audio support for VCM30_T124"
	depends on SND_SOC_TEGRA_ALT
	depends on MACH_VCM30_T124
	select SND_SOC_TEGRA30_XBAR_ALT
	select SND_SOC_TEGRA30_APBIF_ALT
	select SND_SOC_TEGRA30_I2S_ALT
	select SND_SOC_TEGRA114_AMX_ALT
	select SND_SOC_TEGRA114_ADX_ALT
	select SND_SOC_AD193X
	select SND_SOC_WM8731
	select SND_SOC_SPDIF
	help
	  Say Y or M here if you want to add support for SoC audio on the
	  TEGRA VCM30_T124 using wm8731 and ad1937 codecs.
```
