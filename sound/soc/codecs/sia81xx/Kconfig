## sound/soc/codecs/sia81xx/Kconfig
```kconfig
config SND_SOC_SIA8150
	tristate "SoC Audio for si-in SIA8150 PA"
	depends on I2C
	help
	  This option enables support for SIA8150 PA.
```

## sound/soc/codecs/sipa/Kconfig
```kconfig
config SND_SOC_SIA8152S
	tristate "SoC Audio for awinic SIA8152S Smart K PA"
	depends on I2C
	help
	  This option enables support for SIA8152S Smart K PA.
```

## sound/soc/codecs/tas2557/Kconfig
```kconfig
menuconfig SND_SOC_TAS2557_STEREO
	tristate "Texas Instruments TAS2557 SmartAmp(R)"

if SND_SOC_TAS2557_STEREO
config TAS2557_REGMAP_STEREO
	bool "Use of RegMap API"

config TAS2557_CODEC_STEREO
	bool "Codec Driver support"

config TAS2557_MISC_STEREO
	bool "Misc Driver support"

endif # SND_SOC_TAS2557_STEREO
```

## sound/soc/codecs/tas2563/Kconfig
```kconfig
if SND_SOC_TAS2563
config TAS2563_REGMAP
    bool "Use of RegMap API"
    default y

config TAS2563_CODEC
    bool "Codec Driver support"
    default y

config TAS2563_MISC
    bool "Misc Driver support"
    default y
	
endif # SND_SOC_TAS2563
```

## sound/soc/codecs/tfa98xx/Kconfig
```kconfig
config SND_SOC_TFA9874
       tristate
       depends on I2C
       help
       This option enables support for TFA9874 PA
```

## sound/soc/et7480/Kconfig
```kconfig
#
# et7480 type-c switch device configuration
#
config USB_SWITCH_ET7480
	tristate "TYPE-C switch for MediaTek MT6338 ACCDET driver"
	depends on I2C
	help
	  TYPE-C switch for ACCDET means Accessory Detection technology,
	  MediaTek develop it for ASoC codec soc-jack
	  detection mechanism. Select N if you don't
	  have jack on board.
```

## sound/soc/hda/Kconfig
```kconfig
config SND_SOC_HDA_BUS
	tristate "SOC HDA bus driver"
	help
	 This adds support the generic SOC HDA Bus Core library
```

## sound/soc/intel/Kconfig
```kconfig
config SND_SOC_INTEL_MRD7
	tristate "SOC Machine Audio driver for Intel(R) MRD7 device"
	depends on X86
	select SND_SOC_RT5640
	select SND_SST_PLATFORM
	select SND_SST_MACHINE
	select SND_INTEL_SST
	select SND_HWDEP
	default n

	help
	  This adds support for ASoC machine driver for Intel(R) MRD7 device
          based on the BYT-CR platform and RT5640 codec.
          Say Y if you have such a device
          If unsure select "N".

config SND_SOC_INTEL_ANCHOR8
	tristate "SOC Machine Audio driver for Intel(R) Anchor8 device"
	depends on X86
	select SND_SOC_RT5651
	select SND_SST_PLATFORM
	select SND_SST_MACHINE
	select SND_INTEL_SST
	select SND_HWDEP
	default n

	help
	  This adds support for ASoC machine driver for Intel(R) Anchor8 device
          based on the BYT-CR platform and RT5651 codec.
          Say Y if you have such a device
          If unsure select "N".

config SND_SOC_INTEL_CHT_T
	tristate "SOC Machine Audio driver for Intel(R) CHT-T device"
	depends on X86
	select SND_SOC_RT5672
	select SND_SST_PLATFORM
	select SND_SST_MACHINE
	select SND_INTEL_SST
	select SND_HWDEP
	default n

	help
	  This adds support for ASoC machine driver for Intel(R) CHT-T device
          based on the CHT-T platform and RT5672 codec.
          Say Y if you have such a device
          If unsure select "N".

config SND_INTEL_SST
       tristate

config SND_SST_PLATFORM
	tristate

config SND_SOC_COMMS_SSP
	depends on SND_INTEL_MID_I2S
	tristate "Use ASOC framework to drive AudioComms SSP BT and Modem"
	help
	  Sound SOC cards usually used for BT VOIP and MODEM MIXING use cases.
	  This will add devices for these uses cases in the list of alsa cards.
	  Say Y if you need these sound cards (BT chipset or Modem present).
	  Requires to enable the INTEL_MID_I2S low level SSP I2S driver.

config SST_DPCM
	bool "Use DPCM based Machine Audio driver"
	default n
	help
	  This adds an option to enable the DPCM based machine driver

config SND_SST_MACHINE
	tristate

config SND_SST_SW_CODECS
	depends on SND_INTEL_SST
	bool "Disable HW codecs"
	default n

	help
		This disables HW codecs support and falls back on
		SW decoding. This is useful when HW codec firmwares
		are still at alpha quality.
```
