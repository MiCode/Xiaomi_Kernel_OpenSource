## kernel/sched/extension/Kconfig
```kconfig
menu "MTK scheduler extension"

config MTK_SCHED_EXTENSION
	bool "mtk scheduler extension"
	help
	  MTK scheduler extension,
	  1. include MTK scheduler enhancement.
	  2. All MTK scheduler sub-feature config should depend on
	     this config.
	  Say Y to enable MTK scheduler extension. If unsure, say N.

config MTK_IDLE_BALANCE_ENHANCEMENT
	bool "mtk load balance enhancement"
	depends on MTK_SCHED_EXTENSION && SMP && ENERGY_MODEL && CPU_FREQ_GOV_SCHEDUTIL
	help
	  Mediatek aggressive idle balance, include
	  1. for runnable tasks with idle prefer attributes
	  2. for runnable and running tasks with min_cap(dynamic floor)
	  3. migrate runnable task directly and
		use stop machine to migrate running task

config MTK_SCHED_INTEROP
	bool "mtk scheduling interopation enhancement"
	depends on MTK_SCHED_EXTENSION
	help
	   Original Linux Design, RT & CFS do load balance seperatedly,
	   and let would result in unload balance.
	   that is, one CPU has more than 2 tasks, however, one CPU is IDLE
	   We make RT & CFS to check each other and make load more balance.

config MTK_SCHED_LB_ENHANCEMENT
	bool "mtk enhancement for load balance"
	depends on MTK_SCHED_EXTENSION && ENERGY_MODEL && CPU_FREQ_GOV_SCHEDUTIL
	help
	   mtk enhancement for load balance
	   system overutilization,
	   intra-cluster load balance,
	   and so on.

config MTK_SCHED_TRACERS
	bool "mtk scheduling trace, output mtk schedule trace into FTRACE"
	depends on MTK_SCHED_EXTENSION
	help
	  Mediatek scheduling trace, output mtk schedule trace into FTRACE,
	  Mediatek enhancements to vanilla linux kernel. Export scheduling
	  trace in sched_switch events.
	  Say Y to enable mtk scheduling trace.If unsure, say N

config MTK_SCHED_CPU_PREFER
	bool "mtk scheduling boost enhancement"
	depends on MTK_SCHED_EXTENSION && ENERGY_MODEL && CPU_FREQ_GOV_SCHEDUTIL
	help
	   task level to prefer to put the task
	   on big core or little core.
	   If the preferred type CPU has IDLE CPU,
	   put on the task on the idle CPU.
	   If there are no IDLE CPU on preferred type CPU,
	   the task placement will follow original policy.

config MTK_SCHED_BIG_TASK_MIGRATE
	bool "mtk scheduling big task migrate"
	depends on MTK_SCHED_EXTENSION && SMP
	help
	   Migrate misfit task more efficient in scheduler tick.
	   1. Big task migration: migrate misfit task in scheduler tick
	      To reduce boosted task push to big core latency.
	      Migrate current task to big core if it is misfit.
	   2. Big task rotation: swap two misfit task between big cores and
	      little core, equally distributed runtime for each misfit task.
endmenu
```

## lib/Kconfig.kasan
```kconfig
config HAVE_ARCH_KASAN
	bool

if HAVE_ARCH_KASAN

config KASAN
	bool "KASan: runtime memory debugger"
	depends on (SLUB && SYSFS) || (SLAB && !DEBUG_SLAB)
	select SLUB_DEBUG if SLUB
	select CONSTRUCTORS
	select STACKDEPOT
	help
	  Enables kernel address sanitizer - runtime memory debugger,
	  designed to find out-of-bounds accesses and use-after-free bugs.
	  This is strictly a debugging feature and it requires a gcc version
	  of 4.9.2 or later. Detection of out of bounds accesses to stack or
	  global variables requires gcc 5.0 or later.
	  This feature consumes about 1/8 of available memory and brings about
	  ~x3 performance slowdown.
	  For better error detection enable CONFIG_STACKTRACE.
	  Currently CONFIG_KASAN doesn't work with CONFIG_DEBUG_SLAB
	  (the resulting kernel does not boot).


choice
	prompt "Instrumentation type"
	depends on KASAN
	default KASAN_OUTLINE

config KASAN_OUTLINE
	bool "Outline instrumentation"
	help
	  Before every memory access compiler insert function call
	  __asan_load*/__asan_store*. These functions performs check
	  of shadow memory. This is slower than inline instrumentation,
	  however it doesn't bloat size of kernel's .text section so
	  much as inline does.

config KASAN_INLINE
	bool "Inline instrumentation"
	help
	  Compiler directly inserts code checking shadow memory before
	  memory accesses. This is faster than outline (in some workloads
	  it gives about x2 boost over outline instrumentation), but
	  make kernel's .text size much bigger.
	  This requires a gcc version of 5.0 or later.

endchoice

config KASAN_STACK_ENABLE
	bool "Enable stack instrumentation (unsafe)" if CC_IS_CLANG && !COMPILE_TEST
	default !(CLANG_VERSION < 90000)
	depends on KASAN
	help
	  The LLVM stack address sanitizer has a know problem that
	  causes excessive stack usage in a lot of functions, see
	  https://bugs.llvm.org/show_bug.cgi?id=38809
	  Disabling asan-stack makes it safe to run kernels build
	  with clang-8 with KASAN enabled, though it loses some of
	  the functionality.
	  This feature is always disabled when compile-testing with clang-8
	  or earlier to avoid cluttering the output in stack overflow
	  warnings, but clang-8 users can still enable it for builds without
	  CONFIG_COMPILE_TEST.  On gcc and later clang versions it is
	  assumed to always be safe to use and enabled by default.

config KASAN_STACK
	int
	default 1 if KASAN_STACK_ENABLE || CC_IS_GCC
	default 0

config TEST_KASAN
	tristate "Module for testing kasan for bug detection"
	depends on m && KASAN
	help
	  This is a test module doing various nasty things like
	  out of bounds accesses, use after free. It is useful for testing
	  kernel debugging features like kernel address sanitizer.

endif
```

## lib/crypto/Kconfig
```kconfig
# SPDX-License-Identifier: GPL-2.0

comment "Crypto library routines"

config CRYPTO_LIB_AES
	tristate

config CRYPTO_LIB_ARC4
	tristate

config CRYPTO_ARCH_HAVE_LIB_BLAKE2S
	tristate
	help
	  Declares whether the architecture provides an arch-specific
	  accelerated implementation of the Blake2s library interface,
	  either builtin or as a module.

config CRYPTO_LIB_BLAKE2S_GENERIC
	tristate
	help
	  This symbol can be depended upon by arch implementations of the
	  Blake2s library interface that require the generic code as a
	  fallback, e.g., for SIMD implementations. If no arch specific
	  implementation is enabled, this implementation serves the users
	  of CRYPTO_LIB_BLAKE2S.

config CRYPTO_LIB_BLAKE2S
	tristate "BLAKE2s hash function library"
	depends on CRYPTO_ARCH_HAVE_LIB_BLAKE2S || !CRYPTO_ARCH_HAVE_LIB_BLAKE2S
	select CRYPTO_LIB_BLAKE2S_GENERIC if CRYPTO_ARCH_HAVE_LIB_BLAKE2S=n
	help
	  Enable the Blake2s library interface. This interface may be fulfilled
	  by either the generic implementation or an arch-specific one, if one
	  is available and enabled.

config CRYPTO_LIB_DES
	tristate

config CRYPTO_LIB_SHA256
	tristate
```

## linux/drivers/iio/proximity/inv_ch101/Kconfig
```kconfig
#
# ch101 drivers for Invensense CH-101 device
#
# To include ch101 to kernel build add next line to drivers/iio/proximity/Kconfig
# source "drivers/iio/proximity/inv_ch101/Kconfig"
#

config CH101
	tristate
	select IIO_BUFFER
	select IIO_TRIGGERED_BUFFER

config CH101_I2C
	tristate "Invensense CH-101 devices (I2C)"
	depends on I2C_MUX
	select CH101
	select REGMAP_I2C
	help
	  This driver supports the Invensense CH-101 ultra-low power
	  ultrasonic Time-of-Flight (ToF) range sensor over I2C.
	  This driver can be built as a module. The module will be called
	  ch101-i2c
```

## mm/Kconfig.debug
```kconfig
config DEBUG_PAGEALLOC
	bool "Debug page memory allocations"
	depends on DEBUG_KERNEL
	depends on !HIBERNATION || ARCH_SUPPORTS_DEBUG_PAGEALLOC && !PPC && !SPARC
	depends on !KMEMCHECK
	select PAGE_POISONING if !ARCH_SUPPORTS_DEBUG_PAGEALLOC
	select PAGE_GUARD if ARCH_SUPPORTS_DEBUG_PAGEALLOC
	---help---
	  Unmap pages from the kernel linear mapping after free_pages().
	  This results in a large slowdown, but helps to find certain types
	  of memory corruption.

	  For architectures which don't enable ARCH_SUPPORTS_DEBUG_PAGEALLOC,
	  fill the pages with poison patterns after free_pages() and verify
	  the patterns before alloc_pages().  Additionally,
	  this option cannot be enabled in combination with hibernation as
	  that would result in incorrect warnings of memory corruption after
	  a resume because free pages are not saved to the suspend image.

config SLUB_DEBUG_PANIC_ON
	bool "Enable to Panic on SLUB corruption detection"
	depends on SLUB_DEBUG
	help
	  SLUB has a resiliency feature enabled which restores bytes in
	  order for production environments to continue to operate. IN
	  debug options this may not be desirable as it prevents from
	  investigating the root cause which may be rooted within cache
	  or memory.

config WANT_PAGE_DEBUG_FLAGS
	bool

config PAGE_POISONING
	bool
	select WANT_PAGE_DEBUG_FLAGS

config PAGE_GUARD
	bool
	select WANT_PAGE_DEBUG_FLAGS
```

## net/ipc_router/Kconfig
```kconfig
#
# IPC_ROUTER Configuration
#

menuconfig IPC_ROUTER
	bool "IPC Router support"
	help
	  IPC Router provides a connectionless message routing service
	  between multiple modules within a System-on-Chip(SoC). The
	  communicating entities can run either in the same processor or
	  in a different processor within the SoC. The IPC Router has been
	  designed to route messages of any types and support a broader
	  network of processors.

	  If in doubt, say N.

config IPC_ROUTER_SECURITY
	depends on IPC_ROUTER
	bool "IPC Router Security support"
	help
	  This feature of IPC Router will enforce security rules
	  configured by a security script from the user-space. IPC Router
	  once configured with the security rules will ensure that the
	  sender of the message to a service belongs to the relevant
	  Linux group as configured by the security script.

config IPC_ROUTER_NODE_ID
	depends on IPC_ROUTER
	int "IPC router local NODE ID"
	default 1
	help
	  This option allows to configure the IPC Router NODE ID dynamically.
	  The NODE defined here is used as the local NODE ID by IPC Router
	  core and publish the same NODE ID to other NODES present in the
	  network.

config IPC_ROUTER_FIFO_XPRT
	depends on IPC_ROUTER
	bool "IPC Router FIFO Transport"
	help
	  FIFO Transport Layer that enables IPC Router communication between
	  two virtual machines. When the Shared FIFO becomes available, this
	  layer registers the transport with IPC Router and enable message
	  exchange.
```

## net/mhi/Kconfig
```kconfig
#
# MHI protocol family and drivers
#

config MHI
	bool "Modem-Host Interface"
	default n
	help
	  The Modem-Host Interface (MHI) is a packet-oriented transport protocol
	  developed by Renesas Mobile for use with their modems.

	  If unsure, say N.


if MHI

config MHI_L2MUX
	tristate "L2 MUX Protocol Layer for MHI"
	default y
	help
	  L2 MUX is a protocol layer in the MHI stack. It is required
	  by the MHI L3 components.

	  To compile this driver as a module, choose M here: the module
	  will be called l2mux. If unsure, say Y.

config MHI_L3MHI
	tristate "L3 MHI Protocol Family (AF_MHI)"
	select MHI_L2MUX
	default y
	help
	  AF_MHI provides datagram access to L2 channels in MHI,
	  developed by Renesas Mobile for use with their modems.

	  To compile this driver as a module, choose M here: the modules
	  will be called l3mhi and af_mhi. If unsure, say Y.

config MHI_L3PHONET
	tristate "L3 PHONET Protocol bridge (AF_PHONET)"
	select MHI_L2MUX
	select PHONET
	default y
	help
	  L3 PHONET protocol for MHI protocol family,
	  developed by Renesas Mobile for use with their modems.

	  This driver is a bridge between MHI L3 Phonet and Phonet Protocol Family.

	  To compile this driver as a module, choose M here: the module
	  will be called l3phonet. If unsure, say Y.

config MHI_L3MHDP
	tristate "L3 MHDP IP Tunneling Protocol"
	select MHI_L2MUX
	select INET_TUNNEL
	default y
	help
	  Tunneling means encapsulating data of one protocol type within
	  another protocol and sending it over a channel that understands the
	  encapsulating protocol. This particular tunneling driver implements
	  encapsulation of IP within MHDP (Modem Host Data Protocol), which
	  is used for communication between the APE and the Modem.

	  To compile this driver as a module, choose M here: the module
	  will be called l3mhdp. If unsure, say Y.


config MHI_DEBUG
	bool "MHI Debugging"
	default n
	help
	  Generate lots of debugging messages in the MHI stack.
	  This option is useful when developing MHI.
	  Otherwise it should be off.

	  If unsure, say N.

config MHI_DUMP_FRAMES
	bool "Dump MHI frames on L2 layer"
	default n
	help
	  Print out every frame passed through L2MUX into kernel log.
	  This option is useful when developing MHI. Otherwise it should be off.

	  If unsure, say N.

config MHDP_BONDING_SUPPORT
	bool "use mhdp as a bonding slave"
	default n
endif
```

## net/neuron/Kconfig
```kconfig
# SPDX-License-Identifier: GPL-2.0-only
menu "Neuron Device-sharing Framework"

config NEURON
	tristate "Support for Neuron device-sharing framework"
	help
	  This option enables the Neuron device-sharing framework. It is used
	  by guests of the gunyah hypervisors to serve or access shared I/O
	  devices and other inter-VM services. The Neuron framework is composed
	  of three buses that represent different layers in the framework
	  (channel, protocol, application).

config NEURON_SERVICE
	tristate "Static configuration of services from the device tree"
	depends on OF
	select NEURON
	help
	  This option enables a platform driver that can construct a Neuron
	  service stack from a description in a device tree. The device tree
	  node should contain a channel, application and protocol subnode.
	  Multiple services can run on a system.

source "net/neuron/channel/Kconfig"
source "net/neuron/protocol/Kconfig"

endmenu
```

## net/neuron/channel/Kconfig
```kconfig
# SPDX-License-Identifier: GPL-2.0-only
config NEURON_CH_GUNYAH
	tristate "Shared memory channel drivers for Gunyah guests"
	depends on OF && GUNYAH_DRIVERS
	help
	  This option enables receive and send Neuron channel drivers that use
	  a shared memory buffer and a pair of notification objects to
	  communicate with another VM. This is the Gunyah version.

	  If unsure, say Y.
```

## net/neuron/protocol/Kconfig
```kconfig
# SPDX-License-Identifier: GPL-2.0-only
config NEURON_PROT_BLOCK_CLIENT
	tristate "Protocol block client driver"
	help
	  This option enables a Neuron block protocol client driver. It
	  contains the commands to virtualize a block device. This driver
	  will read from a block device being virtualized by a server.

	  If unsure, say N.

config NEURON_PROT_BLOCK_SERVER
	tristate "Protocol block server driver"
	help
	  This option enables a Neuron block protocol server driver. It
	  contains the commands to virtualize a block device. This driver
	  will send commands to virtualize a block device owned by this
	  virtual machine.

	  If unsure, say N.
```
