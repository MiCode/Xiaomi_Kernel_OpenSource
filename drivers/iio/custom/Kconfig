## drivers/iio/custom/Kconfig
```kconfig
#
# Custom drivers
#
menu "Custom"

config HID_SENSOR_CUSTOM
	depends on HID_SENSOR_HUB
	select IIO_BUFFER
	select IIO_TRIGGERED_BUFFER
	select HID_SENSOR_IIO_COMMON
	select HID_SENSOR_IIO_TRIGGER
	tristate "HID Custom Sensor"
	help
	  Say yes here to build support for HID
	  Custom sensor.

endmenu
```

## drivers/iio/goodix_health/Kconfig
```kconfig
config HEALTH_GOODIX
	tristate "goodix health sensor"
	default m
	depends on MODULES
	help
	  Say Y here to enable support for retrieving self-test reports.
	  If unsure, say N.
	  To compile this driver as a module, choose M here.
```

## drivers/iio/humidity/Kconfig
```kconfig
#
# Humidity sensor drivers
#
menu "Humidity sensors"

config HID_SENSOR_HUMIDITY
	depends on HID_SENSOR_HUB
	select IIO_BUFFER
	select IIO_TRIGGERED_BUFFER
	select HID_SENSOR_IIO_COMMON
	select HID_SENSOR_IIO_TRIGGER
	tristate "HID Humidity"
	help
	  Say yes here to build support for the HID Sensor
	  Humidity.

endmenu
```

## drivers/iio/imu/bmi160/Kconfig
```kconfig
#
# IIO imu drivers configuration
#
menu "Inertial measurement units"

#
# Bosch BMI160 IMU drivers configuration
#

config SENSORS_BMI160_IIO
        tristate "BMI160 IMU IIO Driver"
        depends on I2C 
        help
	  If you say yes here you get support for Bosch Sensortec's
	  IMU drivers of BMI16x.

config SENSORS_BMI160_IIO_RING
        tristate "BMI160 IIO Ring Buffer Support"
        depends on SENSORS_BMI160_IIO
        select IIO_TRIGGERED_BUFFER if IIO_BUFFER
        help
         BMI160 IMU Driver support ring buffer operations.

config ENABLE_ACC_GYRO_BUFFERING
	bool "Enable accel & gyro  boot time sensor sample buffering"
	depends on SENSORS_BMI160_IIO
	help
	 Say Y here if you want to buffer boot time sensor
         samples for BMI160 accelerometer and gyroscoper

endmenu
```

## drivers/iio/imu/garnet/Kconfig
```kconfig
#
# inv-mpu-iio driver for Invensense MPU
#

config INV_MPU_IIO
	tristate "Invensense MPU devices"
	depends on I2C && SYSFS && IIO
	select IIO_BUFFER
	select IIO_TRIGGERED_BUFFER
	default n
	help
	  This driver supports the Invensense mpu devices.
	  This driver can be built as a module. The module will be called
	  inv-mpu-iio.
```

## drivers/iio/imu/inv_icm20602/Kconfig
```kconfig
#
# inv-icm20602 drivers for Invensense MPU devices and combos
#
config INV_ICM20602_IIO
	tristate "Invensense ICM20602 devices"
	depends on I2C && SYSFS
	select IIO_BUFFER
	select IIO_BUFFER_CB
	select IIO_TRIGGERED_BUFFER
	help
	  This driver supports the Invensense ICM20602 devices.
	  It is a gyroscope/accelerometer combo device.
	  This driver can be built as a module. The module will be called
	  inv-icm20602.
```

## drivers/iio/imu/inv_icm20689/Kconfig
```kconfig
#
# inv-icm20689 drivers for Invensense MPU devices and combos
#

config INV_ICM20689_IIO
	tristate "Invensense ICM20689 devices"
	depends on SPI && SYSFS && CONFIG_MSM_SMD
	select IIO_BUFFER
	select IIO_TRIGGERED_BUFFER
	help
	  This driver supports the Invensense ICM20689 devices.
	  It is a gyroscope/accelerometer combo device.
	  This driver can be built as a module. The module will be called
	  inv-icm20689.
```

## drivers/iio/imu/inv_mpu/Kconfig
```kconfig
#
# inv-mpu-iio driver for Invensense MPU devices
#

config INV_MPU_IIO
	tristate
	select IIO_BUFFER
	select IIO_KFIFO_BUF
	select IIO_TRIGGER
	select CRC32

choice
	prompt "Chip name"
	depends on INV_MPU_IIO

config INV_MPU_IIO_ICM20648
	bool "ICM20648/ICM20948"
	help
	  Select this if you are using a ICM20648/ICM20948 chip.

config INV_MPU_IIO_ICM20608D
	bool "ICM20608D/ICM20609/ICM20689"
	help
	  Select this if you are using a ICM20608D/ICM20609/ICM20689 chip.

config INV_MPU_IIO_ICM20602
	bool "ICM20602"
	help
	  Select this if you are using a ICM20602 chip.

config INV_MPU_IIO_ICM20690
	bool "ICM20690"
	help
	  Select this if you are using a ICM20690 chip.

config INV_MPU_IIO_IAM20680
	bool "IAM20680"
	help
	  Select this if you are using a IAM20680 chip.

endchoice

config INV_MPU_IIO_I2C
	tristate "Invensense ICM20xxx devices (I2C)"
	depends on I2C && !INV_MPU6050_IIO
	select INV_MPU_IIO
	default n
	help
	  This driver supports Invensense ICM20xxx devices over I2C.
	  This driver can be built as a module. The module will be called
	  inv-mpu-iio-i2c.

config INV_MPU_IIO_SPI
	tristate "Invensense ICM20xxx devices (SPI)"
	depends on SPI_MASTER && !INV_MPU6050_IIO
	select INV_MPU_IIO
	default n
	help
	  This driver supports Invensense ICM20xxx devices over SPI.
	  This driver can be built as a module. The module will be called
	  inv-mpu-iio-spi.

source "drivers/iio/imu/inv_mpu/inv_test/Kconfig"
```

## drivers/iio/imu/inv_mpu/inv_compass/Kconfig
```kconfig
#
# Kconfig for Invensense IIO compass drivers of 3rd party compass devices.
#

# Yamaha YAS530/YAS532/YAS533
config INV_YAS53X_IIO
	tristate "Invensense IIO driver for Yamaha YAS530/YAS532/YAS533 compass"
	depends on I2C && SYSFS && IIO && IIO_KFIFO_BUF
	default n
	help
	  This driver supports the Yamaha YAS530/YAS532/YAS533. It is the Invensense
	  implementation of YAS53x series compass devices.
	  This driver can be built as a module. The module will be called
	  inv_yas53x_iio.

# Aichi AMI306
config INV_AMI306_IIO
	tristate "Invensense IIO driver for Aichi AMI306 compass"
	depends on I2C && SYSFS && IIO && IIO_KFIFO_BUF
	default n
	help
	  This driver supports the Aichi AMI306 compass. It is the Invensense
	  IIO implementation for the AMI306 compass device.
	  This driver can be built as a module. The module will be called
	  inv-ami306-iio.

# Asahi Kasei AK8975/AK8972/AK8963
config INV_AK89XX_IIO
	tristate "Invensense IIO driver for Asahi Kasei AK8975/AK8972/AK8963 compass"
	depends on I2C && SYSFS && IIO && IIO_KFIFO_BUF
	default n
	help
	  This driver supports the Asahi Kasei AK8975/AK8972/AK8963 compasses. It is the Invensense
	  IIO implementation of AK89xx series compass devices.
	  This driver can be built as a module. The module will be called
	  inv-ak89xx-iio.
```

## drivers/iio/imu/inv_mpu/inv_test/Kconfig
```kconfig
#
# Kconfig for Invensense IIO testing hooks
#

config INV_TESTING
	boolean "Invensense IIO testing hooks"
	depends on INV_MPU_IIO || INV_AMI306_IIO || INV_YAS530 || INV_HUB_IIO
	default n
	help
	  This flag enables display of additional testing information from the
	  Invensense IIO drivers
	  It also enables the I2C counters facility to perform IO profiling.
	  Some additional sysfs entries will appear when this flag is enabled.
```

## drivers/iio/imu/inv_mpu9250/Kconfig
```kconfig
#
# inv_mpu9250 drivers for Invensense MPU devices and combos
#

config INV_MPU9250_IIO
	tristate "Invensense MPU9250 devices"
	depends on SPI && SYSFS
	select IIO_BUFFER
	select IIO_BUFFER_CB
        select IIO_TRIGGERED_BUFFER
	help
	  This driver supports the Invensense MPU9250 devices.
	  It is a gyroscope/accelerometer combo device.
	  This driver can be built as a module. The module will be called
	  inv-mpu9250.
```

## drivers/iio/imu/st_asm330lhh/Kconfig
```kconfig
config IIO_ST_ASM330LHH
	tristate "STMicroelectronics ASM330LHH sensor"
	depends on (I2C || SPI)
	select IIO_BUFFER
	select IIO_KFIFO_BUF
	select IIO_ST_ASM330LHH_I2C if (I2C)
	select IIO_ST_ASM330LHH_SPI if (SPI_MASTER)
	help
	  Say yes here to build support for STMicroelectronics ASM330LHH imu
	  sensor.

	  To compile this driver as a module, choose M here: the module
	  will be called st_asm330lhh.

config IIO_ST_ASM330LHH_I2C
	tristate
	depends on IIO_ST_ASM330LHH

config IIO_ST_ASM330LHH_SPI
	tristate
	depends on IIO_ST_ASM330LHH
```

## drivers/iio/imu/st_asm330lhhx/Kconfig
```kconfig
# SPDX-License-Identifier: GPL-2.0-only

config IIO_ST_ASM330LHHX
	tristate "STMicroelectronics ASM330LHHX sensor"
	depends on (I2C || SPI)
	select IIO_BUFFER
	select IIO_KFIFO_BUF
	select IIO_ST_ASM330LHHX_I2C if (I2C)
	select IIO_ST_ASM330LHHX_SPI if (SPI_MASTER)
	help
	  Say yes here to build support for STMicroelectronics ASM330LHHX imu
	  sensor.

	  To compile this driver as a module, choose M here: the module
	  will be called st_asm330lhhx.

config IIO_ST_ASM330LHHX_I2C
	tristate
	depends on IIO_ST_ASM330LHHX

config IIO_ST_ASM330LHHX_SPI
	tristate
	depends on IIO_ST_ASM330LHHX

config IIO_ST_ASM330LHHX_MLC
	bool "Enable machine learning core"
	depends on IIO_ST_ASM330LHHX
	help
	  Enable loading MLC binary internal for hw machine learning core

config IIO_ST_ASM330LHHX_MLC_PRELOAD
	bool "Preload some examples on MLC/FSM core"
	depends on IIO_ST_ASM330LHHX_MLC
	help
	  Preload some examples on machine learning core and finite state machine
	  The examples code are hardcoded in to the driver.

config IIO_ST_ASM330LHHX_MAY_WAKEUP
	bool "Enable wake-up irq"
	depends on IIO_ST_ASM330LHHX
	help
	  Enable wake-up irq on interrupt line
```

## drivers/iio/imu/st_sensor_hub/Kconfig
```kconfig
#
# STMicroelectronics sensor-hub core driver
#

menuconfig IIO_ST_HUB_DRIVERS
	tristate "STMicroelectronics sensor-hub Driver"
	depends on I2C && SYSFS
	select IIO_BUFFER
	select IIO_BUFFER_CB
	select IIO_TRIGGERED_BUFFER
	help
	  Say yes here to build support for STMicroelectronics sensor-hub
	  sensors: LIS331EB, LSM6DB0.

	  This driver can also be built as a module. If so, will be created
	  these modules:
	  - st_sensor_hub_core;
	  - st_hub_ymodem;
	  - st_hub_accel;
	  - st_hub_magn;
	  - st_hub_magn_uncalib;
	  - st_hub_gyro;
	  - st_hub_gyro_uncalib;
	  - st_hub_sign_motion;
	  - st_hub_quaternion;
	  - st_hub_step_detector;
	  - st_hub_step_counter;
	  - st_hub_euler;
	  - st_hub_linear;
	  - st_hub_gravity;

if IIO_ST_HUB_DRIVERS
config IIO_ST_HUB_RESET_GPIO
	bool "Reset pin control"
	help
	  Say yes here to use reset GPIO pin control.

	  If this feature is enabled, drivers needs a GPIO to reset the sensor
	  at boot-time.
	  To use Ram loaded this parameter is needed.

config IIO_ST_HUB_RAM_LOADER
	bool "RAM loader"
	select IIO_ST_HUB_RESET_GPIO
	help
	  Say yes here to support Ram Loader feature.

	  If this feature is enabled, the firmware will be download every time
	  at boot-time.

endif
```

## drivers/iio/orientation/Kconfig
```kconfig
#
# Orientation sensors
#
menu "Orientation sensors"

config HID_SENSOR_ORIENTATION
	depends on HID_SENSOR_HUB
	select IIO_BUFFER
	select IIO_TRIGGERED_BUFFER
	select HID_SENSOR_IIO_COMMON
	select HID_SENSOR_IIO_TRIGGER
	tristate "HID Orientation"
	help
	  Say yes here to build support for the HID SENSOR
	  Orientation.

config HID_SENSOR_DISTANCE
	depends on HID_SENSOR_HUB
	select IIO_BUFFER
	select IIO_TRIGGERED_BUFFER
	select HID_SENSOR_IIO_COMMON
	select HID_SENSOR_IIO_TRIGGER
	tristate "HID Distance"
	help
	  Say yes here to build support for the HID Sensor
	  Distance.

endmenu
```

## drivers/iio/pressure/Kconfig
```kconfig
#
# Pressure drivers
#
menu "Pressure Sensors"

config HID_SENSOR_PRESSURE
	depends on HID_SENSOR_HUB
	select IIO_BUFFER
	select IIO_TRIGGERED_BUFFER
	select HID_SENSOR_IIO_COMMON
	select HID_SENSOR_IIO_TRIGGER
	tristate "HID Pressure"
	help
	  Say yes here to build support for the HID Sensor
	  Pressure.

config IIO_ST_PRESS
	tristate "STMicroelectronics pressures Driver"
	depends on (I2C || SPI_MASTER) && SYSFS
	select IIO_ST_SENSORS_CORE
	select IIO_ST_PRESS_I2C if (I2C)
	select IIO_ST_PRESS_SPI if (SPI_MASTER)
	select IIO_TRIGGERED_BUFFER if (IIO_BUFFER)
	help
	  Say yes here to build support for STMicroelectronics pressures:
	  LPS331AP.

	  This driver can also be built as a module. If so, will be created
	  these modules:
	  - st_pressure (core functions for the driver [it is mandatory]);
	  - st_pressure_i2c (necessary for the I2C devices [optional*]);
	  - st_pressure_spi (necessary for the SPI devices [optional*]);

	  (*) one of these is necessary to do something.

config IIO_ST_PRESS_I2C
	tristate
	depends on IIO_ST_PRESS
	depends on IIO_ST_SENSORS_I2C

config IIO_ST_PRESS_SPI
	tristate
	depends on IIO_ST_PRESS
	depends on IIO_ST_SENSORS_SPI

config BMP280
	tristate "BMP280 digital pressure sensor"
	depends on (I2C || SPI_MASTER) && SYSFS
	help
	  If you say yes here you get support for Bosch Sensortec
	  digital pressure sensors BMP280.

	  To compile this driver as a module, choose M here: the
	  module will be called bmp280-core.

config BMP280_I2C
	tristate "support I2C bus communication"
	depends on BMP280 && I2C
	help
	  Say Y here if you want to support Bosch Sensortec digital pressure
	  sensor hooked to an I2C bus.

	  To compile this driver as a module, choose M here: the
	  module will be called bmp280-i2c.

config BMP280_SPI
	tristate "support SPI bus communication"
	depends on BMP280 && SPI_MASTER
	help
	  Say Y here if you want to support Bosch Sensortec digital pressure
	  sensor hooked to an SPI bus.

	  To compile this driver as a module, choose M here: the
	  module will be called bmp280-spi.


endmenu
```

## drivers/iio/proximity/inv_ch101/Kconfig
```kconfig
# SPDX-License-Identifier: GPL-2.0-only

config CH101
	tristate
	select IIO_BUFFER
	select IIO_TRIGGERED_BUFFER

config CH101_I2C
	tristate "Invensense CH-101 devices (I2C)"
	depends on I2C_MUX
	select CH101
	select REGMAP_I2C
	help
	  This driver supports the Invensense CH-101 ultra-low power
	  ultrasonic Time-of-Flight (ToF) range sensor over I2C.
	  This driver can be built as a module. The module will be called
	  ch101-i2c
```

## drivers/iio/sprd_hub/Kconfig
```kconfig
#
# SPRD Sensor Hub drivers configuration
#

menu "Spreadtrum Sensor Hub"

config SPRD_SENSOR_HUB
	tristate "Spreadtrum Sensor Hub"
	select IIO_BUFFER
	select IIO_KFIFO_BUF
	select IIO_TRIGGER
	depends on SPRD_SYSTIMER
	depends on UNISOC_SIPC
	help
	  Support Sensor hub Feature
	  Provide power saving solution for integrating and
	  processing sensor data.

	  Say Y here to build support for sensor hub.
	  To compile this driver as a module, choose M here

endmenu
```

## drivers/iio/temperature/Kconfig
```kconfig
#
# Temperature sensor drivers
#
menu "Temperature sensors"

config HID_SENSOR_TEMPERATURE
	depends on HID_SENSOR_HUB
	select IIO_BUFFER
	select IIO_TRIGGERED_BUFFER
	select HID_SENSOR_IIO_COMMON
	select HID_SENSOR_IIO_TRIGGER
	tristate "HID Temperature"
	help
	  Say yes here to build support for the HID Sensor
	  Temperature.

endmenu
```

## drivers/infrared/Kconfig
```kconfig
config IR_PWM
	tristate "PWM IR remote control"
	depends on RC_CORE
	help
	    Say Y if you want to use PWM based IR.

	    To compile this driver as a module, choose M here: the module will
	    be called pwm-ir.
```

## drivers/input/af3018/Kconfig
```kconfig
#
# nextinput driver configuration
#
menuconfig INPUT_PRESS_NEXTINPUT
	bool "nextinput"
	help
	  Say Y here, and a list of supported fingerprints will be displayed.
	  This option doesn't affect the kernel.

	  If unsure, say Y.
```

## drivers/input/fingerprint/fpc/Kconfig
```kconfig
config FPC_FINGERPRINT
	tristate "FingerPrint Cards fingerprint drvier support"
	depends on MTK_FINGERPRINT_SUPPORT
	help
	  Say Y here to enable fpc fingerprint driver support!
```

## drivers/input/fingerprint/fpc1020_ta/Kconfig
```kconfig
config FINGERPRINT_FPC1020_TA
	tristate "Finger print card FPC"
	depends on INPUT_FINGERPRINT
	help
	  Say Y here to enable support for retrieving self-test reports.

	  If unsure, say N.

	  To compile this driver as a module, choose M here.
```

## drivers/input/fingerprint/fpc1268_tee/Kconfig
```kconfig
config FINGERPRINT_FPC1268_TEE
	tristate "Finger print card fpc1268"
	depends on INPUT_FINGERPRINT
	help
	  Say Y here to enable support for retrieving self-test reports.

	  If unsure, say N.

	  To compile this driver as a module, choose M here.
```

## drivers/input/fingerprint/fpc1542/Kconfig
```kconfig
#
#Fingerprint
#

config INPUT_FINGERPRINT_FPC1542
	bool "Mediatek Fingerprint"
	help
	  Fingerprint mtk driver enable/disable
	  in the kernel.Say Y here if you want to
	  use mediatek fingerprint driver,fingerprint
	  driver will support fingerprint function
```
