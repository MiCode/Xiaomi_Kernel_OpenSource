## drivers/input/fingerprint/fpc_1540/Kconfig
```kconfig
#
# FPC sensors
#

config FINGERPRINT_FPC_1540
	tristate "FPC1020 fingerprint sensor IRQ support"
	depends on INPUT_FINGERPRINT
	help
		If you say yes here you get IRQ support for the FPC1020 family
		of fingerprint sensors from Fingerprint Cards (FPC).
```

## drivers/input/fingerprint/fpc_1555/Kconfig
```kconfig
config FINGERPRINT_FPC_1555
	tristate "Finger print card fpc"
	default m
	depends on MODULES
	help
	  Say Y here to enable support for retrieving self-test reports.
	  If unsure, say N.
	  To compile this driver as a module, choose M here.
config HAVE_MULTI_SCREEN
	bool "Have multi screen"
	default n
	help
		Enable register two screen in driver
```

## drivers/input/fingerprint/fpc_c6lite/Kconfig
```kconfig
config FINGERPRINT_FPC1020_C6LITE
	tristate "FingerPrint Cards fingerprint drvier support"
	depends on INPUT_FINGERPRINT
	help
	  Say Y here to enable goodix fingerprint driver support!
```

## drivers/input/fingerprint/fpc_d2/Kconfig
```kconfig
config FINGERPRINT_FPC1020_d2
	tristate "FingerPrint Cards fingerprint drvier support"
	depends on INPUT_FINGERPRINT
	help
	  Say Y here to enable goodix fingerprint driver support!
```

## drivers/input/fingerprint/fpc_fod/Kconfig
```kconfig
config FINGERPRINT_FPC_FOD
	tristate "Fingerprint Card FOD"
	depends on INPUT_FINGERPRINT
	help
	  Say Y here to enable support for retrieving self-test reports.
	  If unsure, say N.
	  To compile this driver as a module, choose M here.
```

## drivers/input/fingerprint/fpc_tee/Kconfig
```kconfig
config FINGERPRINT_FPC_TEE
	tristate "Finger print card fpc"
	depends on INPUT_FINGERPRINT
	help
	  Say Y here to enable support for retrieving self-test reports.

	  If unsure, say N.

	  To compile this driver as a module, choose M here.

config FINGERPRINT_FPC_SCREEN_NOTIFY
	bool "fingerprint get screen status and notify"
	default n
	depends on FINGERPRINT_FPC_TEE
	---help---
	  Say Y here to enable notify screen on/off status.
```

## drivers/input/fingerprint/fpc_ugg/Kconfig
```kconfig
config FINGERPRINT_FPC1020_UGG
    tristate "fpc fingerprint "
    help
        say y enable fpc
```

## drivers/input/fingerprint/fpc_vayu/Kconfig
```kconfig
config FINGERPRINT_FPC_VAYU
	tristate "Finger print card fpc"
	depends on INPUT_FINGERPRINT
	help
	  Say Y here to enable support for retrieving self-test reports.

	  If unsure, say N.

	  To compile this driver as a module, choose M here.
```

## drivers/input/fingerprint/fs_tee/Kconfig
```kconfig
config FINGERPRINT_FS_TEE
	tristate "FortSense Fingerprint"
	default y
	help
	  If you say Y to this option, support will be included for 
	  the FortSense's fingerprint sensor. This driver supports 
	  both REE and TEE. If in REE, CONFIG_SPI_SPIDEV must be set 
	  to use the standard 'spidev' driver.
	
	  This driver can also be built as a module. If so, the module
	  will be called 'fortsense_driver_all_in_one'.
```

## drivers/input/fingerprint/gf3208/Kconfig
```kconfig
config FINGERPRINT_GF3208
    tristate "goodix fingerprint gf3208"
    help 
        say y enable  gf3208 goodix
```

## drivers/input/fingerprint/gf3258/Kconfig
```kconfig
config FINGERPRINT_GF3258
    tristate "goodix fingerprint gf3258"
    help
        say y enable  gf3258 goodix
```

## drivers/input/fingerprint/goodix/Kconfig
```kconfig
config GOODIX_FINGERPRINT
	tristate "Finger print card goodix fod"
	depends on MTK_FINGERPRINT_SUPPORT
	help
	  Say Y here to enable support for retrieving self-test reports.

	  If unsure, say N.

	  To compile this driver as a module, choose M here.
```

## drivers/input/fingerprint/goodix_d2/Kconfig
```kconfig
config FINGERPRINT_GOODIX_GF3208_d2
				tristate "Goodix GF3208 fingerprint drvier support"
				depends on INPUT_FINGERPRINT
				help
				  Say Y here to enable goodix fingerprint driver support!
```

## drivers/input/fingerprint/goodix_ta/Kconfig
```kconfig
config FINGERPRINT_GOODIX_TA
	tristate "Finger print card goodix"
	depends on INPUT_FINGERPRINT
	help
	  Say Y here to enable support for retrieving self-test reports.

	  If unsure, say N.

	  To compile this driver as a module, choose M here.
```

## drivers/input/fingerprint/silead/Kconfig
```kconfig
#
# Silead Fingerprint driver configuration
#

config SILEAD_FP
	tristate "Silead Fingerprint driver support"
	help
	  This supports Silead Fingerprint drivers.

config SILEAD_FP_SPI
	tristate "Silead spi Fingerprint driver support"
	select SILEAD_FP
	help
	  This supports Silead spi Fingerprint drivers.

config SILEAD_FP_PLATFORM
	tristate "Silead platformm Fingerprint driver support"
	select SILEAD_FP
	help
	  This supports Silead platform Fingerprint drivers.
```

## drivers/input/fingerprint/sunwave_fp_tee/Kconfig
```kconfig
config MTK_FINGERPRINT_SUNWAVECORP
	tristate "Sunwave Fingerprint"
	default n
	help
	  SUNWAVECORP Fingerprint
```

## drivers/input/fingerprint/synaptics/Kconfig
```kconfig
config FINGERPRINT_SYNAPTICS4302
	tristate "SYNAPTICS OEM fingerprint SYNAPTICS4302 support"
	help
	  Say Y here to enable synaptics fingerprint driver support!
```

## drivers/input/fingerprint_C3J/Kconfig
```kconfig
#
#Fingerprint
#
menu "Fingerprint support"
	depends on INPUT

config MTK_FINGERPRINT_SUPPORT_C3J
	bool "Mediatek Fingerprint"
	default n
	help
	  Fingerprint mtk driver enable/disable
	  in the kernel.Say Y here if you want to
	  use mediatek fingerprint driver,fingerprint
	  driver will support fingerprint function

if MTK_FINGERPRINT_SUPPORT_C3J
config MTK_FINGERPRINT_SELECT
	string "sensor type"
	default "GF3208"


config FPC_FINGERPRINT_C3J
	bool "FPC Fingerprint"
	default y
	help
	  FPC fingerprint FPC's 102x/104x device.

config GOODIX_FINGERPRINT_C3J
	bool "Goodix Fingerprint"
	default y
	help
	  Goodix Fingerprint chip GF316M/GF3208/
	  GF3118M/GF518M/GF5118M/GF516M/GF816M/
	  GF3208/GF3206/GF3266/GF3288/GF5206/
	  GF5216/GF5208 TEE driver

if MTK_FINGERPRINT_SELECT = "GF3208" ||  MTK_FINGERPRINT_SELECT = "GF5216"

config GOODIX_SENSOR_TYPE
	string "SENSOR_TYPE"
	default "GF5216"
	help
	  Must input sensor type, or default is
	  GF316M GF3208 GF3118M GF518M GF5118M
	  GF516M GF816M GF3208 GF3206 GF3266
	  GF3288 GF5206 GF5216 GF5208
endif
endif
endmenu
```

## drivers/input/keyboard/mediatek/Kconfig
```kconfig
config KEYBOARD_MTK
	tristate "MediaTek Keypad Support"
	---help---
	  Say Y here if you want to use the keypad.
	  If unuse, say N.
	  To compile this driver as a module, choose M here: the
	  module will be called mtk-kpd.

config ONEKEY_REBOOT_NORMAL_MODE
	bool "Long press reboot by Powerkey only on normal mode"
	default n
	---help---
	  Say Y here if you want to use one key reboot normal mode.

	  If unuse, say N.

	  To compile this driver as a module, choose M here: the
	  module will be called long_press_reboot_function_setting.

config TWOKEY_REBOOT_NORMAL_MODE
	bool "Long press reboot by Powerkey + other key on normal mode"
	default n
	---help---
	  Say Y here if you want to use two key reboot noraml mode.

	  If unuse, say N.

	  To compile this driver as a module, choose M here: the
	  module will be called long_press_reboot_function_setting.

config ONEKEY_REBOOT_OTHER_MODE
	bool "Long press reboot by Powerkey only on other mode"
	default n
	---help---
	  Say Y here if you want to use one key reboot other mode.

	  If unuse, say N.

	  To compile this driver as a module, choose M here: the
	  module will be called long_press_reboot_function_setting.

config TWOKEY_REBOOT_OTHER_MODE
	bool "Long press reboot by Powerkey + other key on other mode"
	default n
	---help---
	  Say Y here if you want to use two key reboot other mode.

	  If unuse, say N.

	  To compile this driver as a module, choose M here: the
	  module will be called long_press_reboot_function_setting.

config KPD_PMIC_LPRST_TD
	int "Long press reboot timeout period"
	depends on ONEKEY_REBOOT_NORMAL_MODE || TWOKEY_REBOOT_NORMAL_MODE
	range 0 3
	default "0"
	---help---
	  0->8s, 1->11s, 2->14s, 3->5s

config KPD_PWRKEY_USE_PMIC
	bool "power key use pmic key"
	default n
	---help---
	  Say Y here if you want to use pmic key as power key.

	  If unuse, say N.

	  To compile this driver as a module, choose M here: the
	  module will be called kpd_pmic_pwrkey_hal.


config MTK_MRDUMP_KEY
	bool "MediaTek mrdump reset key support"
	default n
	help
	  Say Y if you want to enable mrdump key SMT item support.

	  If you don't know what to do here, say N.

	  The memory dump key is implemented via eint-rst-key,
	  and used for debug purpose. The circuit layout must
	  have phyiscal eint-rst-key key on the main board.


config LONG_PRESS_MODE_EN
	bool "MediaTek dump reset key support"
	default n
	help
	  Say Y if you want to enable mrdump key SMT item support.

	  If you don't know what to do here, say N.

	  The memory dump key includes power key,homerst key and
	  volume down key,and used for debug purpose.
```

## drivers/input/keyboard/nanosic_driver/Kconfig
```kconfig
config KEYBOARD_NANO_8030
	tristate "Nanosic 8030 Keyboard"
	depends on I2C
	help
	  Say Y here if you have Nanosic 8030 I2C Keyboard.

	  If unsure, say N.

	  To compile this driver as a module, choose M here: the
```

## drivers/input/keyboard/nanosic_driver_v2/Kconfig
```kconfig
config KEYBOARD_NANO_8030_V2
	tristate "Nanosic 8030 Keyboard for M82"
	depends on I2C
	help
	  Say Y here if you have Nanosic 8030 I2C Keyboard.

	  If unsure, say N.

	  To compile this driver as a module, choose M here: the
```
