## drivers/input/misc/aw8622x_haptic/Kconfig
```kconfig
config INPUT_AW862XX_HAPTIC
	tristate "Awinic AW862XX haptic driver"
	depends on I2C
	help
	  Say Y here if you have Awinic AW862XX haptic controller
	  chip in your system.
	  If unsure, say N.
	  To compile this driver as a module, choose M here: the
	  module will be called aw862xx haptic driver.
```

## drivers/input/misc/aw8624_haptic/Kconfig
```kconfig
config INPUT_AW8624_HAPTIC
	tristate "Awinic AW8624 haptic driver"
	depends on I2C
	help
	  Say Y here if you have Awinic AW8624 haptic controller
	  chip in your system.

	  If unsure, say N.

	  To compile this driver as a module, choose M here.
```

## drivers/input/misc/aw8624_haptic_xm/Kconfig
```kconfig
#
# Mediatek AW9233 Driver
#

config AW8624_XM_HAPTIC
	tristate "Freescale AW8624 Touchkey"
	depends on I2C
	help
	  Say Y here if you have Freescale AW8624 touchkey controller
	  chip in your system.

	  If unsure, say N.

	  To compile this driver as a module, choose M here: the
	  module will be called mpr121_touchkey.
```
