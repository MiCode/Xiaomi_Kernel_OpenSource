/*
 * Copyright (C) 2010 - 2017 Novatek, Inc.
 *
 * $Revision: 19589 $
 * $Date: 2017-11-28 21:26:00 +0800 (周二, 28 十一月 2017) $
 *
 * This program is free software; you can redistribute it and/or modify
 * it under the terms of the GNU General Public License as published by
 * the Free Software Foundation; either version 2 of the License, or
 * (at your option) any later version.
 *
 * This program is distributed in the hope that it will be useful, but WITHOUT
 * ANY WARRANTY; without even the implied warranty of MERCHANTABILITY or
 * FITNESS FOR A PARTICULAR PURPOSE.  See the GNU General Public License for
 * more details.
 *
 */

&i2c4 {

	/* Novatek device tree node */
	cap_touch@62 {
		compatible = "mediatek,cap_touch";	//Use MTK default touch
		reg = <0x62>;
		status = "ok";

		/* MP */
		//novatek,mp-support-dt;

		novatek-mp-criteria-nvtpid@0 {
			#address-cells = <1>;
			#size-cells = <0>;
			compatible = "novatek-mp-criteria-nvtpid";

			/* MP Config */
			IC_X_CFG_SIZE = <18>;
			IC_Y_CFG_SIZE = <32>;
			IC_KEY_CFG_SIZE = <4>;
			X_Channel = <18>;
			Y_Channel = <32>;
			AIN_X = <17 16 15 14 13 12 11 10 9 8 7 6 5 4 3 2 1 0>;
			AIN_Y = <31 30 29 28 27 26 25 24 23 22 21 20 19 18 17 16 15
								14 13 12 11 10 9 8 7 6 5 4 3 2 1 0>;
			AIN_KEY = <0 1 2 0xFF>;

			/* MP Criteria */
			PS_Config_Lmt_Short_Rawdata_P = <
				20000 20000 20000 20000 20000 20000 20000 20000 20000 20000 20000 20000 20000 20000 20000 20000 20000 20000
				20000 20000 20000 20000 20000 20000 20000 20000 20000 20000 20000 20000 20000 20000 20000 20000 20000 20000
				20000 20000 20000 20000 20000 20000 20000 20000 20000 20000 20000 20000 20000 20000 20000 20000 20000 20000
				20000 20000 20000 20000 20000 20000 20000 20000 20000 20000 20000 20000 20000 20000 20000 20000 20000 20000
				20000 20000 20000 20000 20000 20000 20000 20000 20000 20000 20000 20000 20000 20000 20000 20000 20000 20000
				20000 20000 20000 20000 20000 20000 20000 20000 20000 20000 20000 20000 20000 20000 20000 20000 20000 20000
				20000 20000 20000 20000 20000 20000 20000 20000 20000 20000 20000 20000 20000 20000 20000 20000 20000 20000
				20000 20000 20000 20000 20000 20000 20000 20000 20000 20000 20000 20000 20000 20000 20000 20000 20000 20000
				20000 20000 20000 20000 20000 20000 20000 20000 20000 20000 20000 20000 20000 20000 20000 20000 20000 20000
				20000 20000 20000 20000 20000 20000 20000 20000 20000 20000 20000 20000 20000 20000 20000 20000 20000 20000
				20000 20000 20000 20000 20000 20000 20000 20000 20000 20000 20000 20000 20000 20000 20000 20000 20000 20000
				20000 20000 20000 20000 20000 20000 20000 20000 20000 20000 20000 20000 20000 20000 20000 20000 20000 20000
				20000 20000 20000 20000 20000 20000 20000 20000 20000 20000 20000 20000 20000 20000 20000 20000 20000 20000
				20000 20000 20000 20000 20000 20000 20000 20000 20000 20000 20000 20000 20000 20000 20000 20000 20000 20000
				20000 20000 20000 20000 20000 20000 20000 20000 20000 20000 20000 20000 20000 20000 20000 20000 20000 20000
				20000 20000 20000 20000 20000 20000 20000 20000 20000 20000 20000 20000 20000 20000 20000 20000 20000 20000
				20000 20000 20000 20000 20000 20000 20000 20000 20000 20000 20000 20000 20000 20000 20000 20000 20000 20000
				20000 20000 20000 20000 20000 20000 20000 20000 20000 20000 20000 20000 20000 20000 20000 20000 20000 20000
				20000 20000 20000 20000 20000 20000 20000 20000 20000 20000 20000 20000 20000 20000 20000 20000 20000 20000
				20000 20000 20000 20000 20000 20000 20000 20000 20000 20000 20000 20000 20000 20000 20000 20000 20000 20000
				20000 20000 20000 20000 20000 20000 20000 20000 20000 20000 20000 20000 20000 20000 20000 20000 20000 20000
				20000 20000 20000 20000 20000 20000 20000 20000 20000 20000 20000 20000 20000 20000 20000 20000 20000 20000
				20000 20000 20000 20000 20000 20000 20000 20000 20000 20000 20000 20000 20000 20000 20000 20000 20000 20000
				20000 20000 20000 20000 20000 20000 20000 20000 20000 20000 20000 20000 20000 20000 20000 20000 20000 20000
				20000 20000 20000 20000 20000 20000 20000 20000 20000 20000 20000 20000 20000 20000 20000 20000 20000 20000
				20000 20000 20000 20000 20000 20000 20000 20000 20000 20000 20000 20000 20000 20000 20000 20000 20000 20000
				20000 20000 20000 20000 20000 20000 20000 20000 20000 20000 20000 20000 20000 20000 20000 20000 20000 20000
				20000 20000 20000 20000 20000 20000 20000 20000 20000 20000 20000 20000 20000 20000 20000 20000 20000 20000
				20000 20000 20000 20000 20000 20000 20000 20000 20000 20000 20000 20000 20000 20000 20000 20000 20000 20000
				20000 20000 20000 20000 20000 20000 20000 20000 20000 20000 20000 20000 20000 20000 20000 20000 20000 20000
				20000 20000 20000 20000 20000 20000 20000 20000 20000 20000 20000 20000 20000 20000 20000 20000 20000 20000
				20000 20000 20000 20000 20000 20000 20000 20000 20000 20000 20000 20000 20000 20000 20000 20000 20000 20000
				20000 20000 20000>;

			PS_Config_Lmt_Short_Rawdata_N = <
				11550 11550 11550 11550 11550 11550 11550 11550 11550 11550 11550 11550 11550 11550 11550 11550 11550 11550
				11550 11550 11550 11550 11550 11550 11550 11550 11550 11550 11550 11550 11550 11550 11550 11550 11550 11550
				11550 11550 11550 11550 11550 11550 11550 11550 11550 11550 11550 11550 11550 11550 11550 11550 11550 11550
				11550 11550 11550 11550 11550 11550 11550 11550 11550 11550 11550 11550 11550 11550 11550 11550 11550 11550
				11550 11550 11550 11550 11550 11550 11550 11550 11550 11550 11550 11550 11550 11550 11550 11550 11550 11550
				11550 11550 11550 11550 11550 11550 11550 11550 11550 11550 11550 11550 11550 11550 11550 11550 11550 11550
				11550 11550 11550 11550 11550 11550 11550 11550 11550 11550 11550 11550 11550 11550 11550 11550 11550 11550
				11550 11550 11550 11550 11550 11550 11550 11550 11550 11550 11550 11550 11550 11550 11550 11550 11550 11550
				11550 11550 11550 11550 11550 11550 11550 11550 11550 11550 11550 11550 11550 11550 11550 11550 11550 11550
				11550 11550 11550 11550 11550 11550 11550 11550 11550 11550 11550 11550 11550 11550 11550 11550 11550 11550
				11550 11550 11550 11550 11550 11550 11550 11550 11550 11550 11550 11550 11550 11550 11550 11550 11550 11550
				11550 11550 11550 11550 11550 11550 11550 11550 11550 11550 11550 11550 11550 11550 11550 11550 11550 11550
				11550 11550 11550 11550 11550 11550 11550 11550 11550 11550 11550 11550 11550 11550 11550 11550 11550 11550
				11550 11550 11550 11550 11550 11550 11550 11550 11550 11550 11550 11550 11550 11550 11550 11550 11550 11550
				11550 11550 11550 11550 11550 11550 11550 11550 11550 11550 11550 11550 11550 11550 11550 11550 11550 11550
				11550 11550 11550 11550 11550 11550 11550 11550 11550 11550 11550 11550 11550 11550 11550 11550 11550 11550
				11550 11550 11550 11550 11550 11550 11550 11550 11550 11550 11550 11550 11550 11550 11550 11550 11550 11550
				11550 11550 11550 11550 11550 11550 11550 11550 11550 11550 11550 11550 11550 11550 11550 11550 11550 11550
				11550 11550 11550 11550 11550 11550 11550 11550 11550 11550 11550 11550 11550 11550 11550 11550 11550 11550
				11550 11550 11550 11550 11550 11550 11550 11550 11550 11550 11550 11550 11550 11550 11550 11550 11550 11550
				11550 11550 11550 11550 11550 11550 11550 11550 11550 11550 11550 11550 11550 11550 11550 11550 11550 11550
				11550 11550 11550 11550 11550 11550 11550 11550 11550 11550 11550 11550 11550 11550 11550 11550 11550 11550
				11550 11550 11550 11550 11550 11550 11550 11550 11550 11550 11550 11550 11550 11550 11550 11550 11550 11550
				11550 11550 11550 11550 11550 11550 11550 11550 11550 11550 11550 11550 11550 11550 11550 11550 11550 11550
				11550 11550 11550 11550 11550 11550 11550 11550 11550 11550 11550 11550 11550 11550 11550 11550 11550 11550
				11550 11550 11550 11550 11550 11550 11550 11550 11550 11550 11550 11550 11550 11550 11550 11550 11550 11550
				11550 11550 11550 11550 11550 11550 11550 11550 11550 11550 11550 11550 11550 11550 11550 11550 11550 11550
				11550 11550 11550 11550 11550 11550 11550 11550 11550 11550 11550 11550 11550 11550 11550 11550 11550 11550
				11550 11550 11550 11550 11550 11550 11550 11550 11550 11550 11550 11550 11550 11550 11550 11550 11550 11550
				11550 11550 11550 11550 11550 11550 11550 11550 11550 11550 11550 11550 11550 11550 11550 11550 11550 11550
				11550 11550 11550 11550 11550 11550 11550 11550 11550 11550 11550 11550 11550 11550 11550 11550 11550 11550
				11550 11550 11550 11550 11550 11550 11550 11550 11550 11550 11550 11550 11550 11550 11550 11550 11550 11550
				11550 11550 11550>;

			PS_Config_Lmt_Short_Diff_P = <
				6300 6300 6300 6300 6300 6300 6300 6300 6300 6300 6300 6300 6300 6300 6300 6300 6300 6300
				6300 6300 6300 6300 6300 6300 6300 6300 6300 6300 6300 6300 6300 6300 6300 6300 6300 6300
				6300 6300 6300 6300 6300 6300 6300 6300 6300 6300 6300 6300 6300 6300 6300 6300 6300 6300
				6300 6300 6300 6300 6300 6300 6300 6300 6300 6300 6300 6300 6300 6300 6300 6300 6300 6300
				6300 6300 6300 6300 6300 6300 6300 6300 6300 6300 6300 6300 6300 6300 6300 6300 6300 6300
				6300 6300 6300 6300 6300 6300 6300 6300 6300 6300 6300 6300 6300 6300 6300 6300 6300 6300
				6300 6300 6300 6300 6300 6300 6300 6300 6300 6300 6300 6300 6300 6300 6300 6300 6300 6300
				6300 6300 6300 6300 6300 6300 6300 6300 6300 6300 6300 6300 6300 6300 6300 6300 6300 6300
				6300 6300 6300 6300 6300 6300 6300 6300 6300 6300 6300 6300 6300 6300 6300 6300 6300 6300
				6300 6300 6300 6300 6300 6300 6300 6300 6300 6300 6300 6300 6300 6300 6300 6300 6300 6300
				6300 6300 6300 6300 6300 6300 6300 6300 6300 6300 6300 6300 6300 6300 6300 6300 6300 6300
				6300 6300 6300 6300 6300 6300 6300 6300 6300 6300 6300 6300 6300 6300 6300 6300 6300 6300
				6300 6300 6300 6300 6300 6300 6300 6300 6300 6300 6300 6300 6300 6300 6300 6300 6300 6300
				6300 6300 6300 6300 6300 6300 6300 6300 6300 6300 6300 6300 6300 6300 6300 6300 6300 6300
				6300 6300 6300 6300 6300 6300 6300 6300 6300 6300 6300 6300 6300 6300 6300 6300 6300 6300
				6300 6300 6300 6300 6300 6300 6300 6300 6300 6300 6300 6300 6300 6300 6300 6300 6300 6300
				6300 6300 6300 6300 6300 6300 6300 6300 6300 6300 6300 6300 6300 6300 6300 6300 6300 6300
				6300 6300 6300 6300 6300 6300 6300 6300 6300 6300 6300 6300 6300 6300 6300 6300 6300 6300
				6300 6300 6300 6300 6300 6300 6300 6300 6300 6300 6300 6300 6300 6300 6300 6300 6300 6300
				6300 6300 6300 6300 6300 6300 6300 6300 6300 6300 6300 6300 6300 6300 6300 6300 6300 6300
				6300 6300 6300 6300 6300 6300 6300 6300 6300 6300 6300 6300 6300 6300 6300 6300 6300 6300
				6300 6300 6300 6300 6300 6300 6300 6300 6300 6300 6300 6300 6300 6300 6300 6300 6300 6300
				6300 6300 6300 6300 6300 6300 6300 6300 6300 6300 6300 6300 6300 6300 6300 6300 6300 6300
				6300 6300 6300 6300 6300 6300 6300 6300 6300 6300 6300 6300 6300 6300 6300 6300 6300 6300
				6300 6300 6300 6300 6300 6300 6300 6300 6300 6300 6300 6300 6300 6300 6300 6300 6300 6300
				6300 6300 6300 6300 6300 6300 6300 6300 6300 6300 6300 6300 6300 6300 6300 6300 6300 6300
				6300 6300 6300 6300 6300 6300 6300 6300 6300 6300 6300 6300 6300 6300 6300 6300 6300 6300
				6300 6300 6300 6300 6300 6300 6300 6300 6300 6300 6300 6300 6300 6300 6300 6300 6300 6300
				6300 6300 6300 6300 6300 6300 6300 6300 6300 6300 6300 6300 6300 6300 6300 6300 6300 6300
				6300 6300 6300 6300 6300 6300 6300 6300 6300 6300 6300 6300 6300 6300 6300 6300 6300 6300
				6300 6300 6300 6300 6300 6300 6300 6300 6300 6300 6300 6300 6300 6300 6300 6300 6300 6300
				6300 6300 6300 6300 6300 6300 6300 6300 6300 6300 6300 6300 6300 6300 6300 6300 6300 6300
				6300 6300 6300>;

			PS_Config_Lmt_Short_Diff_N = <
				0 0 0 0 0 0 0 0 0 0 0 0 0 0 0 0 0 0
				0 0 0 0 0 0 0 0 0 0 0 0 0 0 0 0 0 0
				0 0 0 0 0 0 0 0 0 0 0 0 0 0 0 0 0 0
				0 0 0 0 0 0 0 0 0 0 0 0 0 0 0 0 0 0
				0 0 0 0 0 0 0 0 0 0 0 0 0 0 0 0 0 0
				0 0 0 0 0 0 0 0 0 0 0 0 0 0 0 0 0 0
				0 0 0 0 0 0 0 0 0 0 0 0 0 0 0 0 0 0
				0 0 0 0 0 0 0 0 0 0 0 0 0 0 0 0 0 0
				0 0 0 0 0 0 0 0 0 0 0 0 0 0 0 0 0 0
				0 0 0 0 0 0 0 0 0 0 0 0 0 0 0 0 0 0
				0 0 0 0 0 0 0 0 0 0 0 0 0 0 0 0 0 0
				0 0 0 0 0 0 0 0 0 0 0 0 0 0 0 0 0 0
				0 0 0 0 0 0 0 0 0 0 0 0 0 0 0 0 0 0
				0 0 0 0 0 0 0 0 0 0 0 0 0 0 0 0 0 0
				0 0 0 0 0 0 0 0 0 0 0 0 0 0 0 0 0 0
				0 0 0 0 0 0 0 0 0 0 0 0 0 0 0 0 0 0
				0 0 0 0 0 0 0 0 0 0 0 0 0 0 0 0 0 0
				0 0 0 0 0 0 0 0 0 0 0 0 0 0 0 0 0 0
				0 0 0 0 0 0 0 0 0 0 0 0 0 0 0 0 0 0
				0 0 0 0 0 0 0 0 0 0 0 0 0 0 0 0 0 0
				0 0 0 0 0 0 0 0 0 0 0 0 0 0 0 0 0 0
				0 0 0 0 0 0 0 0 0 0 0 0 0 0 0 0 0 0
				0 0 0 0 0 0 0 0 0 0 0 0 0 0 0 0 0 0
				0 0 0 0 0 0 0 0 0 0 0 0 0 0 0 0 0 0
				0 0 0 0 0 0 0 0 0 0 0 0 0 0 0 0 0 0
				0 0 0 0 0 0 0 0 0 0 0 0 0 0 0 0 0 0
				0 0 0 0 0 0 0 0 0 0 0 0 0 0 0 0 0 0
				0 0 0 0 0 0 0 0 0 0 0 0 0 0 0 0 0 0
				0 0 0 0 0 0 0 0 0 0 0 0 0 0 0 0 0 0
				0 0 0 0 0 0 0 0 0 0 0 0 0 0 0 0 0 0
				0 0 0 0 0 0 0 0 0 0 0 0 0 0 0 0 0 0
				0 0 0 0 0 0 0 0 0 0 0 0 0 0 0 0 0 0
				0 0 0>;

			PS_Config_Lmt_Short_Base_P = <
				2000 2000 2000 2000 2000 2000 2000 2000 2000 2000 2000 2000 2000 2000 2000 2000 2000 2000
				2000 2000 2000 2000 2000 2000 2000 2000 2000 2000 2000 2000 2000 2000 2000 2000 2000 2000
				2000 2000 2000 2000 2000 2000 2000 2000 2000 2000 2000 2000 2000 2000 2000 2000 2000 2000
				2000 2000 2000 2000 2000 2000 2000 2000 2000 2000 2000 2000 2000 2000 2000 2000 2000 2000
				2000 2000 2000 2000 2000 2000 2000 2000 2000 2000 2000 2000 2000 2000 2000 2000 2000 2000
				2000 2000 2000 2000 2000 2000 2000 2000 2000 2000 2000 2000 2000 2000 2000 2000 2000 2000
				2000 2000 2000 2000 2000 2000 2000 2000 2000 2000 2000 2000 2000 2000 2000 2000 2000 2000
				2000 2000 2000 2000 2000 2000 2000 2000 2000 2000 2000 2000 2000 2000 2000 2000 2000 2000
				2000 2000 2000 2000 2000 2000 2000 2000 2000 2000 2000 2000 2000 2000 2000 2000 2000 2000
				2000 2000 2000 2000 2000 2000 2000 2000 2000 2000 2000 2000 2000 2000 2000 2000 2000 2000
				2000 2000 2000 2000 2000 2000 2000 2000 2000 2000 2000 2000 2000 2000 2000 2000 2000 2000
				2000 2000 2000 2000 2000 2000 2000 2000 2000 2000 2000 2000 2000 2000 2000 2000 2000 2000
				2000 2000 2000 2000 2000 2000 2000 2000 2000 2000 2000 2000 2000 2000 2000 2000 2000 2000
				2000 2000 2000 2000 2000 2000 2000 2000 2000 2000 2000 2000 2000 2000 2000 2000 2000 2000
				2000 2000 2000 2000 2000 2000 2000 2000 2000 2000 2000 2000 2000 2000 2000 2000 2000 2000
				2000 2000 2000 2000 2000 2000 2000 2000 2000 2000 2000 2000 2000 2000 2000 2000 2000 2000
				2000 2000 2000 2000 2000 2000 2000 2000 2000 2000 2000 2000 2000 2000 2000 2000 2000 2000
				2000 2000 2000 2000 2000 2000 2000 2000 2000 2000 2000 2000 2000 2000 2000 2000 2000 2000
				2000 2000 2000 2000 2000 2000 2000 2000 2000 2000 2000 2000 2000 2000 2000 2000 2000 2000
				2000 2000 2000 2000 2000 2000 2000 2000 2000 2000 2000 2000 2000 2000 2000 2000 2000 2000
				2000 2000 2000 2000 2000 2000 2000 2000 2000 2000 2000 2000 2000 2000 2000 2000 2000 2000
				2000 2000 2000 2000 2000 2000 2000 2000 2000 2000 2000 2000 2000 2000 2000 2000 2000 2000
				2000 2000 2000 2000 2000 2000 2000 2000 2000 2000 2000 2000 2000 2000 2000 2000 2000 2000
				2000 2000 2000 2000 2000 2000 2000 2000 2000 2000 2000 2000 2000 2000 2000 2000 2000 2000
				2000 2000 2000 2000 2000 2000 2000 2000 2000 2000 2000 2000 2000 2000 2000 2000 2000 2000
				2000 2000 2000 2000 2000 2000 2000 2000 2000 2000 2000 2000 2000 2000 2000 2000 2000 2000
				2000 2000 2000 2000 2000 2000 2000 2000 2000 2000 2000 2000 2000 2000 2000 2000 2000 2000
				2000 2000 2000 2000 2000 2000 2000 2000 2000 2000 2000 2000 2000 2000 2000 2000 2000 2000
				2000 2000 2000 2000 2000 2000 2000 2000 2000 2000 2000 2000 2000 2000 2000 2000 2000 2000
				2000 2000 2000 2000 2000 2000 2000 2000 2000 2000 2000 2000 2000 2000 2000 2000 2000 2000
				2000 2000 2000 2000 2000 2000 2000 2000 2000 2000 2000 2000 2000 2000 2000 2000 2000 2000
				2000 2000 2000 2000 2000 2000 2000 2000 2000 2000 2000 2000 2000 2000 2000 2000 2000 2000
				2000 2000 2000>;

			PS_Config_Lmt_Short_Base_N = <
				(-2000) (-2000) (-2000) (-2000) (-2000) (-2000) (-2000) (-2000) (-2000) (-2000) (-2000) (-2000) (-2000) (-2000) (-2000) (-2000) (-2000) (-2000)
				(-2000) (-2000) (-2000) (-2000) (-2000) (-2000) (-2000) (-2000) (-2000) (-2000) (-2000) (-2000) (-2000) (-2000) (-2000) (-2000) (-2000) (-2000)
				(-2000) (-2000) (-2000) (-2000) (-2000) (-2000) (-2000) (-2000) (-2000) (-2000) (-2000) (-2000) (-2000) (-2000) (-2000) (-2000) (-2000) (-2000)
				(-2000) (-2000) (-2000) (-2000) (-2000) (-2000) (-2000) (-2000) (-2000) (-2000) (-2000) (-2000) (-2000) (-2000) (-2000) (-2000) (-2000) (-2000)
				(-2000) (-2000) (-2000) (-2000) (-2000) (-2000) (-2000) (-2000) (-2000) (-2000) (-2000) (-2000) (-2000) (-2000) (-2000) (-2000) (-2000) (-2000)
				(-2000) (-2000) (-2000) (-2000) (-2000) (-2000) (-2000) (-2000) (-2000) (-2000) (-2000) (-2000) (-2000) (-2000) (-2000) (-2000) (-2000) (-2000)
				(-2000) (-2000) (-2000) (-2000) (-2000) (-2000) (-2000) (-2000) (-2000) (-2000) (-2000) (-2000) (-2000) (-2000) (-2000) (-2000) (-2000) (-2000)
				(-2000) (-2000) (-2000) (-2000) (-2000) (-2000) (-2000) (-2000) (-2000) (-2000) (-2000) (-2000) (-2000) (-2000) (-2000) (-2000) (-2000) (-2000)
				(-2000) (-2000) (-2000) (-2000) (-2000) (-2000) (-2000) (-2000) (-2000) (-2000) (-2000) (-2000) (-2000) (-2000) (-2000) (-2000) (-2000) (-2000)
				(-2000) (-2000) (-2000) (-2000) (-2000) (-2000) (-2000) (-2000) (-2000) (-2000) (-2000) (-2000) (-2000) (-2000) (-2000) (-2000) (-2000) (-2000)
				(-2000) (-2000) (-2000) (-2000) (-2000) (-2000) (-2000) (-2000) (-2000) (-2000) (-2000) (-2000) (-2000) (-2000) (-2000) (-2000) (-2000) (-2000)
				(-2000) (-2000) (-2000) (-2000) (-2000) (-2000) (-2000) (-2000) (-2000) (-2000) (-2000) (-2000) (-2000) (-2000) (-2000) (-2000) (-2000) (-2000)
				(-2000) (-2000) (-2000) (-2000) (-2000) (-2000) (-2000) (-2000) (-2000) (-2000) (-2000) (-2000) (-2000) (-2000) (-2000) (-2000) (-2000) (-2000)
				(-2000) (-2000) (-2000) (-2000) (-2000) (-2000) (-2000) (-2000) (-2000) (-2000) (-2000) (-2000) (-2000) (-2000) (-2000) (-2000) (-2000) (-2000)
				(-2000) (-2000) (-2000) (-2000) (-2000) (-2000) (-2000) (-2000) (-2000) (-2000) (-2000) (-2000) (-2000) (-2000) (-2000) (-2000) (-2000) (-2000)
				(-2000) (-2000) (-2000) (-2000) (-2000) (-2000) (-2000) (-2000) (-2000) (-2000) (-2000) (-2000) (-2000) (-2000) (-2000) (-2000) (-2000) (-2000)
				(-2000) (-2000) (-2000) (-2000) (-2000) (-2000) (-2000) (-2000) (-2000) (-2000) (-2000) (-2000) (-2000) (-2000) (-2000) (-2000) (-2000) (-2000)
				(-2000) (-2000) (-2000) (-2000) (-2000) (-2000) (-2000) (-2000) (-2000) (-2000) (-2000) (-2000) (-2000) (-2000) (-2000) (-2000) (-2000) (-2000)
				(-2000) (-2000) (-2000) (-2000) (-2000) (-2000) (-2000) (-2000) (-2000) (-2000) (-2000) (-2000) (-2000) (-2000) (-2000) (-2000) (-2000) (-2000)
				(-2000) (-2000) (-2000) (-2000) (-2000) (-2000) (-2000) (-2000) (-2000) (-2000) (-2000) (-2000) (-2000) (-2000) (-2000) (-2000) (-2000) (-2000)
				(-2000) (-2000) (-2000) (-2000) (-2000) (-2000) (-2000) (-2000) (-2000) (-2000) (-2000) (-2000) (-2000) (-2000) (-2000) (-2000) (-2000) (-2000)
				(-2000) (-2000) (-2000) (-2000) (-2000) (-2000) (-2000) (-2000) (-2000) (-2000) (-2000) (-2000) (-2000) (-2000) (-2000) (-2000) (-2000) (-2000)
				(-2000) (-2000) (-2000) (-2000) (-2000) (-2000) (-2000) (-2000) (-2000) (-2000) (-2000) (-2000) (-2000) (-2000) (-2000) (-2000) (-2000) (-2000)
				(-2000) (-2000) (-2000) (-2000) (-2000) (-2000) (-2000) (-2000) (-2000) (-2000) (-2000) (-2000) (-2000) (-2000) (-2000) (-2000) (-2000) (-2000)
				(-2000) (-2000) (-2000) (-2000) (-2000) (-2000) (-2000) (-2000) (-2000) (-2000) (-2000) (-2000) (-2000) (-2000) (-2000) (-2000) (-2000) (-2000)
				(-2000) (-2000) (-2000) (-2000) (-2000) (-2000) (-2000) (-2000) (-2000) (-2000) (-2000) (-2000) (-2000) (-2000) (-2000) (-2000) (-2000) (-2000)
				(-2000) (-2000) (-2000) (-2000) (-2000) (-2000) (-2000) (-2000) (-2000) (-2000) (-2000) (-2000) (-2000) (-2000) (-2000) (-2000) (-2000) (-2000)
				(-2000) (-2000) (-2000) (-2000) (-2000) (-2000) (-2000) (-2000) (-2000) (-2000) (-2000) (-2000) (-2000) (-2000) (-2000) (-2000) (-2000) (-2000)
				(-2000) (-2000) (-2000) (-2000) (-2000) (-2000) (-2000) (-2000) (-2000) (-2000) (-2000) (-2000) (-2000) (-2000) (-2000) (-2000) (-2000) (-2000)
				(-2000) (-2000) (-2000) (-2000) (-2000) (-2000) (-2000) (-2000) (-2000) (-2000) (-2000) (-2000) (-2000) (-2000) (-2000) (-2000) (-2000) (-2000)
				(-2000) (-2000) (-2000) (-2000) (-2000) (-2000) (-2000) (-2000) (-2000) (-2000) (-2000) (-2000) (-2000) (-2000) (-2000) (-2000) (-2000) (-2000)
				(-2000) (-2000) (-2000) (-2000) (-2000) (-2000) (-2000) (-2000) (-2000) (-2000) (-2000) (-2000) (-2000) (-2000) (-2000) (-2000) (-2000) (-2000)
				(-2000) (-2000) (-2000)>;

			PS_Config_Lmt_Open_Rawdata_P = <
				13000 13000 13000 13000 13000 13000 13000 13000 13000 13000 13000 13000 13000 13000 13000 13000 13000 13000
				13000 13000 13000 13000 13000 13000 13000 13000 13000 13000 13000 13000 13000 13000 13000 13000 13000 13000
				13000 13000 13000 13000 13000 13000 13000 13000 13000 13000 13000 13000 13000 13000 13000 13000 13000 13000
				13000 13000 13000 13000 13000 13000 13000 13000 13000 13000 13000 13000 13000 13000 13000 13000 13000 13000
				13000 13000 13000 13000 13000 13000 13000 13000 13000 13000 13000 13000 13000 13000 13000 13000 13000 13000
				13000 13000 13000 13000 13000 13000 13000 13000 13000 13000 13000 13000 13000 13000 13000 13000 13000 13000
				13000 13000 13000 13000 13000 13000 13000 13000 13000 13000 13000 13000 13000 13000 13000 13000 13000 13000
				13000 13000 13000 13000 13000 13000 13000 13000 13000 13000 13000 13000 13000 13000 13000 13000 13000 13000
				13000 13000 13000 13000 13000 13000 13000 13000 13000 13000 13000 13000 13000 13000 13000 13000 13000 13000
				13000 13000 13000 13000 13000 13000 13000 13000 13000 13000 13000 13000 13000 13000 13000 13000 13000 13000
				13000 13000 13000 13000 13000 13000 13000 13000 13000 13000 13000 13000 13000 13000 13000 13000 13000 13000
				13000 13000 13000 13000 13000 13000 13000 13000 13000 13000 13000 13000 13000 13000 13000 13000 13000 13000
				13000 13000 13000 13000 13000 13000 13000 13000 13000 13000 13000 13000 13000 13000 13000 13000 13000 13000
				13000 13000 13000 13000 13000 13000 13000 13000 13000 13000 13000 13000 13000 13000 13000 13000 13000 13000
				13000 13000 13000 13000 13000 13000 13000 13000 13000 13000 13000 13000 13000 13000 13000 13000 13000 13000
				13000 13000 13000 13000 13000 13000 13000 13000 13000 13000 13000 13000 13000 13000 13000 13000 13000 13000
				13000 13000 13000 13000 13000 13000 13000 13000 13000 13000 13000 13000 13000 13000 13000 13000 13000 13000
				13000 13000 13000 13000 13000 13000 13000 13000 13000 13000 13000 13000 13000 13000 13000 13000 13000 13000
				13000 13000 13000 13000 13000 13000 13000 13000 13000 13000 13000 13000 13000 13000 13000 13000 13000 13000
				13000 13000 13000 13000 13000 13000 13000 13000 13000 13000 13000 13000 13000 13000 13000 13000 13000 13000
				13000 13000 13000 13000 13000 13000 13000 13000 13000 13000 13000 13000 13000 13000 13000 13000 13000 13000
				13000 13000 13000 13000 13000 13000 13000 13000 13000 13000 13000 13000 13000 13000 13000 13000 13000 13000
				13000 13000 13000 13000 13000 13000 13000 13000 13000 13000 13000 13000 13000 13000 13000 13000 13000 13000
				13000 13000 13000 13000 13000 13000 13000 13000 13000 13000 13000 13000 13000 13000 13000 13000 13000 13000
				13000 13000 13000 13000 13000 13000 13000 13000 13000 13000 13000 13000 13000 13000 13000 13000 13000 13000
				13000 13000 13000 13000 13000 13000 13000 13000 13000 13000 13000 13000 13000 13000 13000 13000 13000 13000
				13000 13000 13000 13000 13000 13000 13000 13000 13000 13000 13000 13000 13000 13000 13000 13000 13000 13000
				13000 13000 13000 13000 13000 13000 13000 13000 13000 13000 13000 13000 13000 13000 13000 13000 13000 13000
				13000 13000 13000 13000 13000 13000 13000 13000 13000 13000 13000 13000 13000 13000 13000 13000 13000 13000
				13000 13000 13000 13000 13000 13000 13000 13000 13000 13000 13000 13000 13000 13000 13000 13000 13000 13000
				13000 13000 13000 13000 13000 13000 13000 13000 13000 13000 13000 13000 13000 13000 13000 13000 13000 13000
				13000 13000 13000 13000 13000 13000 13000 13000 13000 13000 13000 13000 13000 13000 13000 13000 13000 13000
				13000 13000 13000>;

			PS_Config_Lmt_Open_Rawdata_N = <
				6500 6500 6500 6500 6500 6500 6500 6500 6500 6500 6500 6500 6500 6500 6500 6500 6500 6500
				6500 6500 6500 6500 6500 6500 6500 6500 6500 6500 6500 6500 6500 6500 6500 6500 6500 6500
				6500 6500 6500 6500 6500 6500 6500 6500 6500 6500 6500 6500 6500 6500 6500 6500 6500 6500
				6500 6500 6500 6500 6500 6500 6500 6500 6500 6500 6500 6500 6500 6500 6500 6500 6500 6500
				6500 6500 6500 6500 6500 6500 6500 6500 6500 6500 6500 6500 6500 6500 6500 6500 6500 6500
				6500 6500 6500 6500 6500 6500 6500 6500 6500 6500 6500 6500 6500 6500 6500 6500 6500 6500
				6500 6500 6500 6500 6500 6500 6500 6500 6500 6500 6500 6500 6500 6500 6500 6500 6500 6500
				6500 6500 6500 6500 6500 6500 6500 6500 6500 6500 6500 6500 6500 6500 6500 6500 6500 6500
				6500 6500 6500 6500 6500 6500 6500 6500 6500 6500 6500 6500 6500 6500 6500 6500 6500 6500
				6500 6500 6500 6500 6500 6500 6500 6500 6500 6500 6500 6500 6500 6500 6500 6500 6500 6500
				6500 6500 6500 6500 6500 6500 6500 6500 6500 6500 6500 6500 6500 6500 6500 6500 6500 6500
				6500 6500 6500 6500 6500 6500 6500 6500 6500 6500 6500 6500 6500 6500 6500 6500 6500 6500
				6500 6500 6500 6500 6500 6500 6500 6500 6500 6500 6500 6500 6500 6500 6500 6500 6500 6500
				6500 6500 6500 6500 6500 6500 6500 6500 6500 6500 6500 6500 6500 6500 6500 6500 6500 6500
				6500 6500 6500 6500 6500 6500 6500 6500 6500 6500 6500 6500 6500 6500 6500 6500 6500 6500
				6500 6500 6500 6500 6500 6500 6500 6500 6500 6500 6500 6500 6500 6500 6500 6500 6500 6500
				6500 6500 6500 6500 6500 6500 6500 6500 6500 6500 6500 6500 6500 6500 6500 6500 6500 6500
				6500 6500 6500 6500 6500 6500 6500 6500 6500 6500 6500 6500 6500 6500 6500 6500 6500 6500
				6500 6500 6500 6500 6500 6500 6500 6500 6500 6500 6500 6500 6500 6500 6500 6500 6500 6500
				6500 6500 6500 6500 6500 6500 6500 6500 6500 6500 6500 6500 6500 6500 6500 6500 6500 6500
				6500 6500 6500 6500 6500 6500 6500 6500 6500 6500 6500 6500 6500 6500 6500 6500 6500 6500
				6500 6500 6500 6500 6500 6500 6500 6500 6500 6500 6500 6500 6500 6500 6500 6500 6500 6500
				6500 6500 6500 6500 6500 6500 6500 6500 6500 6500 6500 6500 6500 6500 6500 6500 6500 6500
				6500 6500 6500 6500 6500 6500 6500 6500 6500 6500 6500 6500 6500 6500 6500 6500 6500 6500
				6500 6500 6500 6500 6500 6500 6500 6500 6500 6500 6500 6500 6500 6500 6500 6500 6500 6500
				6500 6500 6500 6500 6500 6500 6500 6500 6500 6500 6500 6500 6500 6500 6500 6500 6500 6500
				6500 6500 6500 6500 6500 6500 6500 6500 6500 6500 6500 6500 6500 6500 6500 6500 6500 6500
				6500 6500 6500 6500 6500 6500 6500 6500 6500 6500 6500 6500 6500 6500 6500 6500 6500 6500
				6500 6500 6500 6500 6500 6500 6500 6500 6500 6500 6500 6500 6500 6500 6500 6500 6500 6500
				6500 6500 6500 6500 6500 6500 6500 6500 6500 6500 6500 6500 6500 6500 6500 6500 6500 6500
				6500 6500 6500 6500 6500 6500 6500 6500 6500 6500 6500 6500 6500 6500 6500 6500 6500 6500
				6500 6500 6500 6500 6500 6500 6500 6500 6500 6500 6500 6500 6500 6500 6500 6500 6500 6500
				6500 6500 6500>;

			PS_Config_Lmt_FW_Rawdata_P = <
				2000 2000 2000 2000 2000 2000 2000 2000 2000 2000 2000 2000 2000 2000 2000 2000 2000 2000
				2000 2000 2000 2000 2000 2000 2000 2000 2000 2000 2000 2000 2000 2000 2000 2000 2000 2000
				2000 2000 2000 2000 2000 2000 2000 2000 2000 2000 2000 2000 2000 2000 2000 2000 2000 2000
				2000 2000 2000 2000 2000 2000 2000 2000 2000 2000 2000 2000 2000 2000 2000 2000 2000 2000
				2000 2000 2000 2000 2000 2000 2000 2000 2000 2000 2000 2000 2000 2000 2000 2000 2000 2000
				2000 2000 2000 2000 2000 2000 2000 2000 2000 2000 2000 2000 2000 2000 2000 2000 2000 2000
				2000 2000 2000 2000 2000 2000 2000 2000 2000 2000 2000 2000 2000 2000 2000 2000 2000 2000
				2000 2000 2000 2000 2000 2000 2000 2000 2000 2000 2000 2000 2000 2000 2000 2000 2000 2000
				2000 2000 2000 2000 2000 2000 2000 2000 2000 2000 2000 2000 2000 2000 2000 2000 2000 2000
				2000 2000 2000 2000 2000 2000 2000 2000 2000 2000 2000 2000 2000 2000 2000 2000 2000 2000
				2000 2000 2000 2000 2000 2000 2000 2000 2000 2000 2000 2000 2000 2000 2000 2000 2000 2000
				2000 2000 2000 2000 2000 2000 2000 2000 2000 2000 2000 2000 2000 2000 2000 2000 2000 2000
				2000 2000 2000 2000 2000 2000 2000 2000 2000 2000 2000 2000 2000 2000 2000 2000 2000 2000
				2000 2000 2000 2000 2000 2000 2000 2000 2000 2000 2000 2000 2000 2000 2000 2000 2000 2000
				2000 2000 2000 2000 2000 2000 2000 2000 2000 2000 2000 2000 2000 2000 2000 2000 2000 2000
				2000 2000 2000 2000 2000 2000 2000 2000 2000 2000 2000 2000 2000 2000 2000 2000 2000 2000
				2000 2000 2000 2000 2000 2000 2000 2000 2000 2000 2000 2000 2000 2000 2000 2000 2000 2000
				2000 2000 2000 2000 2000 2000 2000 2000 2000 2000 2000 2000 2000 2000 2000 2000 2000 2000
				2000 2000 2000 2000 2000 2000 2000 2000 2000 2000 2000 2000 2000 2000 2000 2000 2000 2000
				2000 2000 2000 2000 2000 2000 2000 2000 2000 2000 2000 2000 2000 2000 2000 2000 2000 2000
				2000 2000 2000 2000 2000 2000 2000 2000 2000 2000 2000 2000 2000 2000 2000 2000 2000 2000
				2000 2000 2000 2000 2000 2000 2000 2000 2000 2000 2000 2000 2000 2000 2000 2000 2000 2000
				2000 2000 2000 2000 2000 2000 2000 2000 2000 2000 2000 2000 2000 2000 2000 2000 2000 2000
				2000 2000 2000 2000 2000 2000 2000 2000 2000 2000 2000 2000 2000 2000 2000 2000 2000 2000
				2000 2000 2000 2000 2000 2000 2000 2000 2000 2000 2000 2000 2000 2000 2000 2000 2000 2000
				2000 2000 2000 2000 2000 2000 2000 2000 2000 2000 2000 2000 2000 2000 2000 2000 2000 2000
				2000 2000 2000 2000 2000 2000 2000 2000 2000 2000 2000 2000 2000 2000 2000 2000 2000 2000
				2000 2000 2000 2000 2000 2000 2000 2000 2000 2000 2000 2000 2000 2000 2000 2000 2000 2000
				2000 2000 2000 2000 2000 2000 2000 2000 2000 2000 2000 2000 2000 2000 2000 2000 2000 2000
				2000 2000 2000 2000 2000 2000 2000 2000 2000 2000 2000 2000 2000 2000 2000 2000 2000 2000
				2000 2000 2000 2000 2000 2000 2000 2000 2000 2000 2000 2000 2000 2000 2000 2000 2000 2000
				2000 2000 2000 2000 2000 2000 2000 2000 2000 2000 2000 2000 2000 2000 2000 2000 2000 2000
				2000 2000 2000>;

			PS_Config_Lmt_FW_Rawdata_N = <
				400 400 400 400 400 400 400 400 400 400 400 400 400 400 400 400 400 400
				400 400 400 400 400 400 400 400 400 400 400 400 400 400 400 400 400 400
				400 400 400 400 400 400 400 400 400 400 400 400 400 400 400 400 400 400
				400 400 400 400 400 400 400 400 400 400 400 400 400 400 400 400 400 400
				400 400 400 400 400 400 400 400 400 400 400 400 400 400 400 400 400 400
				400 400 400 400 400 400 400 400 400 400 400 400 400 400 400 400 400 400
				400 400 400 400 400 400 400 400 400 400 400 400 400 400 400 400 400 400
				400 400 400 400 400 400 400 400 400 400 400 400 400 400 400 400 400 400
				400 400 400 400 400 400 400 400 400 400 400 400 400 400 400 400 400 400
				400 400 400 400 400 400 400 400 400 400 400 400 400 400 400 400 400 400
				400 400 400 400 400 400 400 400 400 400 400 400 400 400 400 400 400 400
				400 400 400 400 400 400 400 400 400 400 400 400 400 400 400 400 400 400
				400 400 400 400 400 400 400 400 400 400 400 400 400 400 400 400 400 400
				400 400 400 400 400 400 400 400 400 400 400 400 400 400 400 400 400 400
				400 400 400 400 400 400 400 400 400 400 400 400 400 400 400 400 400 400
				400 400 400 400 400 400 400 400 400 400 400 400 400 400 400 400 400 400
				400 400 400 400 400 400 400 400 400 400 400 400 400 400 400 400 400 400
				400 400 400 400 400 400 400 400 400 400 400 400 400 400 400 400 400 400
				400 400 400 400 400 400 400 400 400 400 400 400 400 400 400 400 400 400
				400 400 400 400 400 400 400 400 400 400 400 400 400 400 400 400 400 400
				400 400 400 400 400 400 400 400 400 400 400 400 400 400 400 400 400 400
				400 400 400 400 400 400 400 400 400 400 400 400 400 400 400 400 400 400
				400 400 400 400 400 400 400 400 400 400 400 400 400 400 400 400 400 400
				400 400 400 400 400 400 400 400 400 400 400 400 400 400 400 400 400 400
				400 400 400 400 400 400 400 400 400 400 400 400 400 400 400 400 400 400
				400 400 400 400 400 400 400 400 400 400 400 400 400 400 400 400 400 400
				400 400 400 400 400 400 400 400 400 400 400 400 400 400 400 400 400 400
				400 400 400 400 400 400 400 400 400 400 400 400 400 400 400 400 400 400
				400 400 400 400 400 400 400 400 400 400 400 400 400 400 400 400 400 400
				400 400 400 400 400 400 400 400 400 400 400 400 400 400 400 400 400 400
				400 400 400 400 400 400 400 400 400 400 400 400 400 400 400 400 400 400
				400 400 400 400 400 400 400 400 400 400 400 400 400 400 400 400 400 400
				400 400 400>;

			PS_Config_Lmt_FW_CC_P = <
				38 38 38 38 38 38 38 38 38 38 38 38 38 38 38 38 38 38
				38 38 38 38 38 38 38 38 38 38 38 38 38 38 38 38 38 38
				38 38 38 38 38 38 38 38 38 38 38 38 38 38 38 38 38 38
				38 38 38 38 38 38 38 38 38 38 38 38 38 38 38 38 38 38
				38 38 38 38 38 38 38 38 38 38 38 38 38 38 38 38 38 38
				38 38 38 38 38 38 38 38 38 38 38 38 38 38 38 38 38 38
				38 38 38 38 38 38 38 38 38 38 38 38 38 38 38 38 38 38
				38 38 38 38 38 38 38 38 38 38 38 38 38 38 38 38 38 38
				38 38 38 38 38 38 38 38 38 38 38 38 38 38 38 38 38 38
				38 38 38 38 38 38 38 38 38 38 38 38 38 38 38 38 38 38
				38 38 38 38 38 38 38 38 38 38 38 38 38 38 38 38 38 38
				38 38 38 38 38 38 38 38 38 38 38 38 38 38 38 38 38 38
				38 38 38 38 38 38 38 38 38 38 38 38 38 38 38 38 38 38
				38 38 38 38 38 38 38 38 38 38 38 38 38 38 38 38 38 38
				38 38 38 38 38 38 38 38 38 38 38 38 38 38 38 38 38 38
				38 38 38 38 38 38 38 38 38 38 38 38 38 38 38 38 38 38
				38 38 38 38 38 38 38 38 38 38 38 38 38 38 38 38 38 38
				38 38 38 38 38 38 38 38 38 38 38 38 38 38 38 38 38 38
				38 38 38 38 38 38 38 38 38 38 38 38 38 38 38 38 38 38
				38 38 38 38 38 38 38 38 38 38 38 38 38 38 38 38 38 38
				38 38 38 38 38 38 38 38 38 38 38 38 38 38 38 38 38 38
				38 38 38 38 38 38 38 38 38 38 38 38 38 38 38 38 38 38
				38 38 38 38 38 38 38 38 38 38 38 38 38 38 38 38 38 38
				38 38 38 38 38 38 38 38 38 38 38 38 38 38 38 38 38 38
				38 38 38 38 38 38 38 38 38 38 38 38 38 38 38 38 38 38
				38 38 38 38 38 38 38 38 38 38 38 38 38 38 38 38 38 38
				38 38 38 38 38 38 38 38 38 38 38 38 38 38 38 38 38 38
				38 38 38 38 38 38 38 38 38 38 38 38 38 38 38 38 38 38
				38 38 38 38 38 38 38 38 38 38 38 38 38 38 38 38 38 38
				38 38 38 38 38 38 38 38 38 38 38 38 38 38 38 38 38 38
				38 38 38 38 38 38 38 38 38 38 38 38 38 38 38 38 38 38
				38 38 38 38 38 38 38 38 38 38 38 38 38 38 38 38 38 38
				38 38 38>;

			PS_Config_Lmt_FW_CC_N = <
				9 9 9 9 9 9 9 9 9 9 9 9 9 9 9 9 9 9
				9 9 9 9 9 9 9 9 9 9 9 9 9 9 9 9 9 9
				9 9 9 9 9 9 9 9 9 9 9 9 9 9 9 9 9 9
				9 9 9 9 9 9 9 9 9 9 9 9 9 9 9 9 9 9
				9 9 9 9 9 9 9 9 9 9 9 9 9 9 9 9 9 9
				9 9 9 9 9 9 9 9 9 9 9 9 9 9 9 9 9 9
				9 9 9 9 9 9 9 9 9 9 9 9 9 9 9 9 9 9
				9 9 9 9 9 9 9 9 9 9 9 9 9 9 9 9 9 9
				9 9 9 9 9 9 9 9 9 9 9 9 9 9 9 9 9 9
				9 9 9 9 9 9 9 9 9 9 9 9 9 9 9 9 9 9
				9 9 9 9 9 9 9 9 9 9 9 9 9 9 9 9 9 9
				9 9 9 9 9 9 9 9 9 9 9 9 9 9 9 9 9 9
				9 9 9 9 9 9 9 9 9 9 9 9 9 9 9 9 9 9
				9 9 9 9 9 9 9 9 9 9 9 9 9 9 9 9 9 9
				9 9 9 9 9 9 9 9 9 9 9 9 9 9 9 9 9 9
				9 9 9 9 9 9 9 9 9 9 9 9 9 9 9 9 9 9
				9 9 9 9 9 9 9 9 9 9 9 9 9 9 9 9 9 9
				9 9 9 9 9 9 9 9 9 9 9 9 9 9 9 9 9 9
				9 9 9 9 9 9 9 9 9 9 9 9 9 9 9 9 9 9
				9 9 9 9 9 9 9 9 9 9 9 9 9 9 9 9 9 9
				9 9 9 9 9 9 9 9 9 9 9 9 9 9 9 9 9 9
				9 9 9 9 9 9 9 9 9 9 9 9 9 9 9 9 9 9
				9 9 9 9 9 9 9 9 9 9 9 9 9 9 9 9 9 9
				9 9 9 9 9 9 9 9 9 9 9 9 9 9 9 9 9 9
				9 9 9 9 9 9 9 9 9 9 9 9 9 9 9 9 9 9
				9 9 9 9 9 9 9 9 9 9 9 9 9 9 9 9 9 9
				9 9 9 9 9 9 9 9 9 9 9 9 9 9 9 9 9 9
				9 9 9 9 9 9 9 9 9 9 9 9 9 9 9 9 9 9
				9 9 9 9 9 9 9 9 9 9 9 9 9 9 9 9 9 9
				9 9 9 9 9 9 9 9 9 9 9 9 9 9 9 9 9 9
				9 9 9 9 9 9 9 9 9 9 9 9 9 9 9 9 9 9
				9 9 9 9 9 9 9 9 9 9 9 9 9 9 9 9 9 9
				9 9 9>;

			PS_Config_Lmt_FW_CC_I_P = <
				25 25 25 25 25 25 25 25 25 25 25 25 25 25 25 25 25 25
				25 25 25 25 25 25 25 25 25 25 25 25 25 25 25 25 25 25
				25 25 25 25 25 25 25 25 25 25 25 25 25 25 25 25 25 25
				25 25 25 25 25 25 25 25 25 25 25 25 25 25 25 25 25 25
				25 25 25 25 25 25 25 25 25 25 25 25 25 25 25 25 25 25
				25 25 25 25 25 25 25 25 25 25 25 25 25 25 25 25 25 25
				25 25 25 25 25 25 25 25 25 25 25 25 25 25 25 25 25 25
				25 25 25 25 25 25 25 25 25 25 25 25 25 25 25 25 25 25
				25 25 25 25 25 25 25 25 25 25 25 25 25 25 25 25 25 25
				25 25 25 25 25 25 25 25 25 25 25 25 25 25 25 25 25 25
				25 25 25 25 25 25 25 25 25 25 25 25 25 25 25 25 25 25
				25 25 25 25 25 25 25 25 25 25 25 25 25 25 25 25 25 25
				25 25 25 25 25 25 25 25 25 25 25 25 25 25 25 25 25 25
				25 25 25 25 25 25 25 25 25 25 25 25 25 25 25 25 25 25
				25 25 25 25 25 25 25 25 25 25 25 25 25 25 25 25 25 25
				25 25 25 25 25 25 25 25 25 25 25 25 25 25 25 25 25 25
				25 25 25 25 25 25 25 25 25 25 25 25 25 25 25 25 25 25
				25 25 25 25 25 25 25 25 25 25 25 25 25 25 25 25 25 25
				25 25 25 25 25 25 25 25 25 25 25 25 25 25 25 25 25 25
				25 25 25 25 25 25 25 25 25 25 25 25 25 25 25 25 25 25
				25 25 25 25 25 25 25 25 25 25 25 25 25 25 25 25 25 25
				25 25 25 25 25 25 25 25 25 25 25 25 25 25 25 25 25 25
				25 25 25 25 25 25 25 25 25 25 25 25 25 25 25 25 25 25
				25 25 25 25 25 25 25 25 25 25 25 25 25 25 25 25 25 25
				25 25 25 25 25 25 25 25 25 25 25 25 25 25 25 25 25 25
				25 25 25 25 25 25 25 25 25 25 25 25 25 25 25 25 25 25
				25 25 25 25 25 25 25 25 25 25 25 25 25 25 25 25 25 25
				25 25 25 25 25 25 25 25 25 25 25 25 25 25 25 25 25 25
				25 25 25 25 25 25 25 25 25 25 25 25 25 25 25 25 25 25
				25 25 25 25 25 25 25 25 25 25 25 25 25 25 25 25 25 25
				25 25 25 25 25 25 25 25 25 25 25 25 25 25 25 25 25 25
				25 25 25 25 25 25 25 25 25 25 25 25 25 25 25 25 25 25
				25 25 25>;

			PS_Config_Lmt_FW_CC_I_N = <
				0 0 0 0 0 0 0 0 0 0 0 0 0 0 0 0 0 0
				0 0 0 0 0 0 0 0 0 0 0 0 0 0 0 0 0 0
				0 0 0 0 0 0 0 0 0 0 0 0 0 0 0 0 0 0
				0 0 0 0 0 0 0 0 0 0 0 0 0 0 0 0 0 0
				0 0 0 0 0 0 0 0 0 0 0 0 0 0 0 0 0 0
				0 0 0 0 0 0 0 0 0 0 0 0 0 0 0 0 0 0
				0 0 0 0 0 0 0 0 0 0 0 0 0 0 0 0 0 0
				0 0 0 0 0 0 0 0 0 0 0 0 0 0 0 0 0 0
				0 0 0 0 0 0 0 0 0 0 0 0 0 0 0 0 0 0
				0 0 0 0 0 0 0 0 0 0 0 0 0 0 0 0 0 0
				0 0 0 0 0 0 0 0 0 0 0 0 0 0 0 0 0 0
				0 0 0 0 0 0 0 0 0 0 0 0 0 0 0 0 0 0
				0 0 0 0 0 0 0 0 0 0 0 0 0 0 0 0 0 0
				0 0 0 0 0 0 0 0 0 0 0 0 0 0 0 0 0 0
				0 0 0 0 0 0 0 0 0 0 0 0 0 0 0 0 0 0
				0 0 0 0 0 0 0 0 0 0 0 0 0 0 0 0 0 0
				0 0 0 0 0 0 0 0 0 0 0 0 0 0 0 0 0 0
				0 0 0 0 0 0 0 0 0 0 0 0 0 0 0 0 0 0
				0 0 0 0 0 0 0 0 0 0 0 0 0 0 0 0 0 0
				0 0 0 0 0 0 0 0 0 0 0 0 0 0 0 0 0 0
				0 0 0 0 0 0 0 0 0 0 0 0 0 0 0 0 0 0
				0 0 0 0 0 0 0 0 0 0 0 0 0 0 0 0 0 0
				0 0 0 0 0 0 0 0 0 0 0 0 0 0 0 0 0 0
				0 0 0 0 0 0 0 0 0 0 0 0 0 0 0 0 0 0
				0 0 0 0 0 0 0 0 0 0 0 0 0 0 0 0 0 0
				0 0 0 0 0 0 0 0 0 0 0 0 0 0 0 0 0 0
				0 0 0 0 0 0 0 0 0 0 0 0 0 0 0 0 0 0
				0 0 0 0 0 0 0 0 0 0 0 0 0 0 0 0 0 0
				0 0 0 0 0 0 0 0 0 0 0 0 0 0 0 0 0 0
				0 0 0 0 0 0 0 0 0 0 0 0 0 0 0 0 0 0
				0 0 0 0 0 0 0 0 0 0 0 0 0 0 0 0 0 0
				0 0 0 0 0 0 0 0 0 0 0 0 0 0 0 0 0 0
				0 0 0>;

			PS_Config_Lmt_FW_CC_Q_P = <
				25 25 25 25 25 25 25 25 25 25 25 25 25 25 25 25 25 25
				25 25 25 25 25 25 25 25 25 25 25 25 25 25 25 25 25 25
				25 25 25 25 25 25 25 25 25 25 25 25 25 25 25 25 25 25
				25 25 25 25 25 25 25 25 25 25 25 25 25 25 25 25 25 25
				25 25 25 25 25 25 25 25 25 25 25 25 25 25 25 25 25 25
				25 25 25 25 25 25 25 25 25 25 25 25 25 25 25 25 25 25
				25 25 25 25 25 25 25 25 25 25 25 25 25 25 25 25 25 25
				25 25 25 25 25 25 25 25 25 25 25 25 25 25 25 25 25 25
				25 25 25 25 25 25 25 25 25 25 25 25 25 25 25 25 25 25
				25 25 25 25 25 25 25 25 25 25 25 25 25 25 25 25 25 25
				25 25 25 25 25 25 25 25 25 25 25 25 25 25 25 25 25 25
				25 25 25 25 25 25 25 25 25 25 25 25 25 25 25 25 25 25
				25 25 25 25 25 25 25 25 25 25 25 25 25 25 25 25 25 25
				25 25 25 25 25 25 25 25 25 25 25 25 25 25 25 25 25 25
				25 25 25 25 25 25 25 25 25 25 25 25 25 25 25 25 25 25
				25 25 25 25 25 25 25 25 25 25 25 25 25 25 25 25 25 25
				25 25 25 25 25 25 25 25 25 25 25 25 25 25 25 25 25 25
				25 25 25 25 25 25 25 25 25 25 25 25 25 25 25 25 25 25
				25 25 25 25 25 25 25 25 25 25 25 25 25 25 25 25 25 25
				25 25 25 25 25 25 25 25 25 25 25 25 25 25 25 25 25 25
				25 25 25 25 25 25 25 25 25 25 25 25 25 25 25 25 25 25
				25 25 25 25 25 25 25 25 25 25 25 25 25 25 25 25 25 25
				25 25 25 25 25 25 25 25 25 25 25 25 25 25 25 25 25 25
				25 25 25 25 25 25 25 25 25 25 25 25 25 25 25 25 25 25
				25 25 25 25 25 25 25 25 25 25 25 25 25 25 25 25 25 25
				25 25 25 25 25 25 25 25 25 25 25 25 25 25 25 25 25 25
				25 25 25 25 25 25 25 25 25 25 25 25 25 25 25 25 25 25
				25 25 25 25 25 25 25 25 25 25 25 25 25 25 25 25 25 25
				25 25 25 25 25 25 25 25 25 25 25 25 25 25 25 25 25 25
				25 25 25 25 25 25 25 25 25 25 25 25 25 25 25 25 25 25
				25 25 25 25 25 25 25 25 25 25 25 25 25 25 25 25 25 25
				25 25 25 25 25 25 25 25 25 25 25 25 25 25 25 25 25 25
				25 25 25>;

			PS_Config_Lmt_FW_CC_Q_N = <
				0 0 0 0 0 0 0 0 0 0 0 0 0 0 0 0 0 0
				0 0 0 0 0 0 0 0 0 0 0 0 0 0 0 0 0 0
				0 0 0 0 0 0 0 0 0 0 0 0 0 0 0 0 0 0
				0 0 0 0 0 0 0 0 0 0 0 0 0 0 0 0 0 0
				0 0 0 0 0 0 0 0 0 0 0 0 0 0 0 0 0 0
				0 0 0 0 0 0 0 0 0 0 0 0 0 0 0 0 0 0
				0 0 0 0 0 0 0 0 0 0 0 0 0 0 0 0 0 0
				0 0 0 0 0 0 0 0 0 0 0 0 0 0 0 0 0 0
				0 0 0 0 0 0 0 0 0 0 0 0 0 0 0 0 0 0
				0 0 0 0 0 0 0 0 0 0 0 0 0 0 0 0 0 0
				0 0 0 0 0 0 0 0 0 0 0 0 0 0 0 0 0 0
				0 0 0 0 0 0 0 0 0 0 0 0 0 0 0 0 0 0
				0 0 0 0 0 0 0 0 0 0 0 0 0 0 0 0 0 0
				0 0 0 0 0 0 0 0 0 0 0 0 0 0 0 0 0 0
				0 0 0 0 0 0 0 0 0 0 0 0 0 0 0 0 0 0
				0 0 0 0 0 0 0 0 0 0 0 0 0 0 0 0 0 0
				0 0 0 0 0 0 0 0 0 0 0 0 0 0 0 0 0 0
				0 0 0 0 0 0 0 0 0 0 0 0 0 0 0 0 0 0
				0 0 0 0 0 0 0 0 0 0 0 0 0 0 0 0 0 0
				0 0 0 0 0 0 0 0 0 0 0 0 0 0 0 0 0 0
				0 0 0 0 0 0 0 0 0 0 0 0 0 0 0 0 0 0
				0 0 0 0 0 0 0 0 0 0 0 0 0 0 0 0 0 0
				0 0 0 0 0 0 0 0 0 0 0 0 0 0 0 0 0 0
				0 0 0 0 0 0 0 0 0 0 0 0 0 0 0 0 0 0
				0 0 0 0 0 0 0 0 0 0 0 0 0 0 0 0 0 0
				0 0 0 0 0 0 0 0 0 0 0 0 0 0 0 0 0 0
				0 0 0 0 0 0 0 0 0 0 0 0 0 0 0 0 0 0
				0 0 0 0 0 0 0 0 0 0 0 0 0 0 0 0 0 0
				0 0 0 0 0 0 0 0 0 0 0 0 0 0 0 0 0 0
				0 0 0 0 0 0 0 0 0 0 0 0 0 0 0 0 0 0
				0 0 0 0 0 0 0 0 0 0 0 0 0 0 0 0 0 0
				0 0 0 0 0 0 0 0 0 0 0 0 0 0 0 0 0 0
				0 0 0>;

			PS_Config_Lmt_FW_Diff_P = <
				35 35 35 35 35 35 35 35 35 35 35 35 35 35 35 35 35 35
				35 35 35 35 35 35 35 35 35 35 35 35 35 35 35 35 35 35
				35 35 35 35 35 35 35 35 35 35 35 35 35 35 35 35 35 35
				35 35 35 35 35 35 35 35 35 35 35 35 35 35 35 35 35 35
				35 35 35 35 35 35 35 35 35 35 35 35 35 35 35 35 35 35
				35 35 35 35 35 35 35 35 35 35 35 35 35 35 35 35 35 35
				35 35 35 35 35 35 35 35 35 35 35 35 35 35 35 35 35 35
				35 35 35 35 35 35 35 35 35 35 35 35 35 35 35 35 35 35
				35 35 35 35 35 35 35 35 35 35 35 35 35 35 35 35 35 35
				35 35 35 35 35 35 35 35 35 35 35 35 35 35 35 35 35 35
				35 35 35 35 35 35 35 35 35 35 35 35 35 35 35 35 35 35
				35 35 35 35 35 35 35 35 35 35 35 35 35 35 35 35 35 35
				35 35 35 35 35 35 35 35 35 35 35 35 35 35 35 35 35 35
				35 35 35 35 35 35 35 35 35 35 35 35 35 35 35 35 35 35
				35 35 35 35 35 35 35 35 35 35 35 35 35 35 35 35 35 35
				35 35 35 35 35 35 35 35 35 35 35 35 35 35 35 35 35 35
				35 35 35 35 35 35 35 35 35 35 35 35 35 35 35 35 35 35
				35 35 35 35 35 35 35 35 35 35 35 35 35 35 35 35 35 35
				35 35 35 35 35 35 35 35 35 35 35 35 35 35 35 35 35 35
				35 35 35 35 35 35 35 35 35 35 35 35 35 35 35 35 35 35
				35 35 35 35 35 35 35 35 35 35 35 35 35 35 35 35 35 35
				35 35 35 35 35 35 35 35 35 35 35 35 35 35 35 35 35 35
				35 35 35 35 35 35 35 35 35 35 35 35 35 35 35 35 35 35
				35 35 35 35 35 35 35 35 35 35 35 35 35 35 35 35 35 35
				35 35 35 35 35 35 35 35 35 35 35 35 35 35 35 35 35 35
				35 35 35 35 35 35 35 35 35 35 35 35 35 35 35 35 35 35
				35 35 35 35 35 35 35 35 35 35 35 35 35 35 35 35 35 35
				35 35 35 35 35 35 35 35 35 35 35 35 35 35 35 35 35 35
				35 35 35 35 35 35 35 35 35 35 35 35 35 35 35 35 35 35
				35 35 35 35 35 35 35 35 35 35 35 35 35 35 35 35 35 35
				35 35 35 35 35 35 35 35 35 35 35 35 35 35 35 35 35 35
				35 35 35 35 35 35 35 35 35 35 35 35 35 35 35 35 35 35
				35 35 35>;

			PS_Config_Lmt_FW_Diff_N = <
				(-35) (-35) (-35) (-35) (-35) (-35) (-35) (-35) (-35) (-35) (-35) (-35) (-35) (-35) (-35) (-35) (-35) (-35)
				(-35) (-35) (-35) (-35) (-35) (-35) (-35) (-35) (-35) (-35) (-35) (-35) (-35) (-35) (-35) (-35) (-35) (-35)
				(-35) (-35) (-35) (-35) (-35) (-35) (-35) (-35) (-35) (-35) (-35) (-35) (-35) (-35) (-35) (-35) (-35) (-35)
				(-35) (-35) (-35) (-35) (-35) (-35) (-35) (-35) (-35) (-35) (-35) (-35) (-35) (-35) (-35) (-35) (-35) (-35)
				(-35) (-35) (-35) (-35) (-35) (-35) (-35) (-35) (-35) (-35) (-35) (-35) (-35) (-35) (-35) (-35) (-35) (-35)
				(-35) (-35) (-35) (-35) (-35) (-35) (-35) (-35) (-35) (-35) (-35) (-35) (-35) (-35) (-35) (-35) (-35) (-35)
				(-35) (-35) (-35) (-35) (-35) (-35) (-35) (-35) (-35) (-35) (-35) (-35) (-35) (-35) (-35) (-35) (-35) (-35)
				(-35) (-35) (-35) (-35) (-35) (-35) (-35) (-35) (-35) (-35) (-35) (-35) (-35) (-35) (-35) (-35) (-35) (-35)
				(-35) (-35) (-35) (-35) (-35) (-35) (-35) (-35) (-35) (-35) (-35) (-35) (-35) (-35) (-35) (-35) (-35) (-35)
				(-35) (-35) (-35) (-35) (-35) (-35) (-35) (-35) (-35) (-35) (-35) (-35) (-35) (-35) (-35) (-35) (-35) (-35)
				(-35) (-35) (-35) (-35) (-35) (-35) (-35) (-35) (-35) (-35) (-35) (-35) (-35) (-35) (-35) (-35) (-35) (-35)
				(-35) (-35) (-35) (-35) (-35) (-35) (-35) (-35) (-35) (-35) (-35) (-35) (-35) (-35) (-35) (-35) (-35) (-35)
				(-35) (-35) (-35) (-35) (-35) (-35) (-35) (-35) (-35) (-35) (-35) (-35) (-35) (-35) (-35) (-35) (-35) (-35)
				(-35) (-35) (-35) (-35) (-35) (-35) (-35) (-35) (-35) (-35) (-35) (-35) (-35) (-35) (-35) (-35) (-35) (-35)
				(-35) (-35) (-35) (-35) (-35) (-35) (-35) (-35) (-35) (-35) (-35) (-35) (-35) (-35) (-35) (-35) (-35) (-35)
				(-35) (-35) (-35) (-35) (-35) (-35) (-35) (-35) (-35) (-35) (-35) (-35) (-35) (-35) (-35) (-35) (-35) (-35)
				(-35) (-35) (-35) (-35) (-35) (-35) (-35) (-35) (-35) (-35) (-35) (-35) (-35) (-35) (-35) (-35) (-35) (-35)
				(-35) (-35) (-35) (-35) (-35) (-35) (-35) (-35) (-35) (-35) (-35) (-35) (-35) (-35) (-35) (-35) (-35) (-35)
				(-35) (-35) (-35) (-35) (-35) (-35) (-35) (-35) (-35) (-35) (-35) (-35) (-35) (-35) (-35) (-35) (-35) (-35)
				(-35) (-35) (-35) (-35) (-35) (-35) (-35) (-35) (-35) (-35) (-35) (-35) (-35) (-35) (-35) (-35) (-35) (-35)
				(-35) (-35) (-35) (-35) (-35) (-35) (-35) (-35) (-35) (-35) (-35) (-35) (-35) (-35) (-35) (-35) (-35) (-35)
				(-35) (-35) (-35) (-35) (-35) (-35) (-35) (-35) (-35) (-35) (-35) (-35) (-35) (-35) (-35) (-35) (-35) (-35)
				(-35) (-35) (-35) (-35) (-35) (-35) (-35) (-35) (-35) (-35) (-35) (-35) (-35) (-35) (-35) (-35) (-35) (-35)
				(-35) (-35) (-35) (-35) (-35) (-35) (-35) (-35) (-35) (-35) (-35) (-35) (-35) (-35) (-35) (-35) (-35) (-35)
				(-35) (-35) (-35) (-35) (-35) (-35) (-35) (-35) (-35) (-35) (-35) (-35) (-35) (-35) (-35) (-35) (-35) (-35)
				(-35) (-35) (-35) (-35) (-35) (-35) (-35) (-35) (-35) (-35) (-35) (-35) (-35) (-35) (-35) (-35) (-35) (-35)
				(-35) (-35) (-35) (-35) (-35) (-35) (-35) (-35) (-35) (-35) (-35) (-35) (-35) (-35) (-35) (-35) (-35) (-35)
				(-35) (-35) (-35) (-35) (-35) (-35) (-35) (-35) (-35) (-35) (-35) (-35) (-35) (-35) (-35) (-35) (-35) (-35)
				(-35) (-35) (-35) (-35) (-35) (-35) (-35) (-35) (-35) (-35) (-35) (-35) (-35) (-35) (-35) (-35) (-35) (-35)
				(-35) (-35) (-35) (-35) (-35) (-35) (-35) (-35) (-35) (-35) (-35) (-35) (-35) (-35) (-35) (-35) (-35) (-35)
				(-35) (-35) (-35) (-35) (-35) (-35) (-35) (-35) (-35) (-35) (-35) (-35) (-35) (-35) (-35) (-35) (-35) (-35)
				(-35) (-35) (-35) (-35) (-35) (-35) (-35) (-35) (-35) (-35) (-35) (-35) (-35) (-35) (-35) (-35) (-35) (-35)
				(-35) (-35) (-35)>;

			PS_Config_Diff_Test_Frame = <50>;
		};
	};
};
