## drivers/input/touchscreen/synaptics_dsx_2.6/Kconfig
```kconfig
#
# Synaptics DSX v2.6 touchscreen driver configuration
#
menuconfig TOUCHSCREEN_SYNAPTICS_DSX_v26
	bool "Synaptics DSX v2.6 touchscreen"
	default y
	help
	  Say Y here if you have a Synaptics DSX touchscreen connected
	  to your system.

	  If unsure, say N.

if TOUCHSCREEN_SYNAPTICS_DSX_v26

choice
	default TOUCHSCREEN_SYNAPTICS_DSX_I2C_v26
	prompt "Synaptics DSX v2.6 bus interface"
config TOUCHSCREEN_SYNAPTICS_DSX_I2C_v26
	bool "RMI over I2C"
	depends on I2C
config TOUCHSCREEN_SYNAPTICS_DSX_SPI_v26
	bool "RMI over SPI"
	depends on SPI_MASTER
config TOUCHSCREEN_SYNAPTICS_DSX_RMI_HID_I2C_v26
	bool "HID over I2C"
	depends on I2C
endchoice

config TOUCHSCREEN_SYNAPTICS_DSX_CORE_v26
	tristate "Synaptics DSX v2.6 core driver module"
	depends on I2C || SPI_MASTER
	help
	  Say Y here to enable basic touch reporting functionality.

	  If unsure, say N.

	  To compile this driver as a module, choose M here: the
	  module will be called synaptics_dsx_core.

config TOUCHSCREEN_SYNAPTICS_DSX_RMI_DEV_v26
	tristate "Synaptics DSX v2.6 RMI device module"
	depends on TOUCHSCREEN_SYNAPTICS_DSX_CORE_v26
	help
	  Say Y here to enable support for direct RMI register access.

	  If unsure, say N.

	  To compile this driver as a module, choose M here: the
	  module will be called synaptics_dsx_rmi_dev.

config TOUCHSCREEN_SYNAPTICS_DSX_FW_UPDATE_v26
	tristate "Synaptics DSX v2.6 firmware update module"
	depends on TOUCHSCREEN_SYNAPTICS_DSX_CORE_v26
	help
	  Say Y here to enable support for doing firmware update.

	  If unsure, say N.

	  To compile this driver as a module, choose M here: the
	  module will be called synaptics_dsx_fw_update.

config TOUCHSCREEN_SYNAPTICS_DSX_TEST_REPORTING_v26
	tristate "Synaptics DSX v2.6 test reporting module"
	depends on TOUCHSCREEN_SYNAPTICS_DSX_CORE_v26
	help
	  Say Y here to enable support for retrieving production test reports.

	  If unsure, say N.

	  To compile this driver as a module, choose M here: the
	  module will be called synaptics_dsx_test_reporting.

config TOUCHSCREEN_SYNAPTICS_DSX_PROXIMITY_v26
	tristate "Synaptics DSX v2.6 proximity module"
	depends on TOUCHSCREEN_SYNAPTICS_DSX_CORE_v26
	help
	  Say Y here to enable support for proximity functionality.

	  If unsure, say N.

	  To compile this driver as a module, choose M here: the
	  module will be called synaptics_dsx_proximity.

config TOUCHSCREEN_SYNAPTICS_DSX_ACTIVE_PEN_v26
	tristate "Synaptics DSX v2.6 active pen module"
	depends on TOUCHSCREEN_SYNAPTICS_DSX_CORE_v26
	help
	  Say Y here to enable support for active pen functionality.

	  If unsure, say N.

	  To compile this driver as a module, choose M here: the
	  module will be called synaptics_dsx_active_pen.

config TOUCHSCREEN_SYNAPTICS_DSX_GESTURE_v26
	tristate "Synaptics DSX v2.6 user defined gesture module"
	depends on TOUCHSCREEN_SYNAPTICS_DSX_CORE_v26
	help
	  Say Y here to enable support for user defined gesture functionality.

	  If unsure, say N.

	  To compile this driver as a module, choose M here: the
	  module will be called synaptics_dsx_gesture.

config TOUCHSCREEN_SYNAPTICS_DSX_VIDEO_v26
	tristate "Synaptics DSX v2.6 video module"
	depends on TOUCHSCREEN_SYNAPTICS_DSX_CORE_v26
	help
	  Say Y here to enable support for video communication functionality.

	  If unsure, say N.

	  To compile this driver as a module, choose M here: the
	  module will be called synaptics_dsx_video.

config SECURE_TOUCH_SYNAPTICS_DSX_V26
	bool "Secure Touch support for Synaptics V2.6 Touchscreen"
	depends on TOUCHSCREEN_SYNAPTICS_DSX_I2C_v26
	help
	  Say Y here
	  -Synaptics DSX V2.6 touch driver is connected
	  -To enable secure touch for Synaptics DSX V2.6 touch driver

	  If unsure, say N.

endif
```

## drivers/input/touchscreen/synaptics_dsx_e7s/Kconfig
```kconfig
#
# Synaptics DSX touchscreen driver configuration
#
config TOUCHSCREEN_SYNAPTICS_DSX_E7S
	bool "Synaptics DSX touchscreen"
	default y
	help
	  Say Y here if you have a Synaptics DSX touchscreen connected
	  to your system.

	  If unsure, say N.



config TOUCHSCREEN_SYNAPTICS_DSX_E7S_I2C
	bool "I2C"
	help
	  Say Y here if you have a Synaptics DSX touchscreen interfaced
	  to the host processor over I2C

	  If unsure, say N.

	  This module uses the services of DSX CORE

config TOUCHSCREEN_SYNAPTICS_DSX_E7S_SPI
	bool "SPI"
	help
	  Say Y here if you have a Synaptics DSX touchscreen interfaced
	  to the host processor over SPI

	  If unsure, say N.

	  This module uses the services of DSX CORE

config TOUCHSCREEN_SYNAPTICS_DSX_E7S_CORE
	tristate "Synaptics DSX core driver module"
	depends on TOUCHSCREEN_SYNAPTICS_DSX_E7S_I2C || TOUCHSCREEN_SYNAPTICS_DSX_E7S_SPI
	help
	  Say Y here to enable basic touch reporting functionalities.

	  If unsure, say N.

	  To compile this driver as a module, choose M here: the
	  module will be called synaptics_dsx_core.

config TOUCHSCREEN_SYNAPTICS_DSX_E7S_RMI_DEV
	tristate "Synaptics DSX touchscreen RMI device module"
	depends on TOUCHSCREEN_SYNAPTICS_DSX_E7S_CORE
	help
	  Say Y here to enable support for direct RMI register access.

	  If unsure, say N.

	  To compile this driver as a module, choose M here: the
	  module will be called synaptics_dsx_rmi_dev.

config TOUCHSCREEN_SYNAPTICS_DSX_E7S_FW_UPDATE
	tristate "Synaptics DSX touchscreen firmware update module"
	depends on TOUCHSCREEN_SYNAPTICS_DSX_E7S_CORE
	help
	  Say Y here to enable support for carrying out firmware update.

	  If unsure, say N.

	  To compile this driver as a module, choose M here: the
	  module will be called synaptics_dsx_fw_update.

config TOUCHSCREEN_SYNAPTICS_DSX_E7S_GESTURE
	tristate "Synaptics DSX v2.6 user defined gesture module"
	depends on TOUCHSCREEN_SYNAPTICS_DSX_E7S_CORE
	help
	  Say Y here to enable support for user defined gesture functionality.

	  If unsure, say N.

	  To compile this driver as a module, choose M here: the
	  module will be called synaptics_dsx_gesture.



config TOUCHSCREEN_SYNAPTICS_DSX_E7S_PROXIMITY
	tristate "Synaptics DSX touchscreen proximity module"
	depends on TOUCHSCREEN_SYNAPTICS_DSX_E7S_CORE
	help
	  Say Y here to enable support for proximity functionalities.

	  If unsure, say N.

	  To compile this driver as a module, choose M here: the
	  module will be called synaptics_dsx_proximity.




config TOUCHSCREEN_SYNAPTICS_DSX_E7S_TEST_REPORTING
	tristate "Synaptics DSX touchscreen selftest module"
	depends on TOUCHSCREEN_SYNAPTICS_DSX_E7S_CORE
	help
	  Say Y here to enable support for proximity functionalities.

	  If unsure, say N.

	  To compile this driver as a module, choose M here: the
	  module will be called synaptics_dsx_test_reporting.
```

## drivers/input/touchscreen/synaptics_dsx_td4322/Kconfig
```kconfig
#
# Synaptics DSX touchscreen driver configuration
#
menuconfig TOUCHSCREEN_SYNAPTICS_DSX_TD4322
	bool "Synaptics DSX touchscreen"
	default n
	help
	  Say Y here if you have a Synaptics DSX I2C touchscreen
	  connected to your system

	  if unsure, say N.

if TOUCHSCREEN_SYNAPTICS_DSX_TD4322

config TOUCHSCREEN_SYNAPTICS_DSX_I2C
	tristate "Synaptics DSX core driver module"
	depends on I2C
	help
	  Say Y here if you have a Synaptics DSX I2C touchscreen
	  connected to your system

	  If unsure, say N.

	  To compile this driver as a module, choose M here: the
	  module will be called synaptics_dsx_i2c.

config TOUCHSCREEN_SYNAPTICS_DSX_RMI_DEV
	tristate "Synaptics DSX RMI device module"
	depends on TOUCHSCREEN_SYNAPTICS_DSX_I2C
	help
	  Say Y here to enable support for direct RMI register access.

	  If unsure, say N.

	  To compile this driver as a module, choose M here: the
	  module will be called synaptics_dsx_rmi_dev.

config TOUCHSCREEN_SYNAPTICS_DSX_FW_UPDATE
	tristate "Synaptics DSX firmware update module"
	depends on TOUCHSCREEN_SYNAPTICS_DSX_I2C
	help
	  Say Y here to enable support for doing firmware update.

	  If unsure, say N.

	  To compile this driver as a module, choose M here: the
	  module will be called synaptics_dsx_fw_update.

config TOUCHSCREEN_SYNAPTICS_DSX_TEST_REPORTING
	tristate "Synaptics DSX test reporting module"
	depends on TOUCHSCREEN_SYNAPTICS_DSX_I2C
	help
	  Say Y here to enable support for retrieving production test reports.

	  If unsure, say N.

	  To compile this driver as a module, choose M here: the
	  module will be called synaptics_dsx_test_reporting.

endif
```

## drivers/input/touchscreen/synaptics_i2c_rmi4/Kconfig
```kconfig
#
# Touchscreen driver configuration
#
if TOUCHSCREEN_MTK_SYNAPTICS_I2C_RMI4

config SYNA_RMI4_FIRMWARE
	string "Synaptics I2C touchscreen for Mediatek firmware"

config TOUCHSCREEN_MTK_SYNAPTICS_DSX_RMI4_DEV
	tristate "Synaptics I2C touchscreen char device"
	depends on TOUCHSCREEN_MTK_SYNAPTICS_I2C_RMI4
	help
	  This enables support for character device channel for Synaptics RMI
	  touchscreens.
	  If unsure, say N.
	  To compile this driver as a module, choose M

config SYNA_RMI4_WARP_X_ON
	bool "Synaptics I2C touchscreen for Mediatek package"
	default n
	help
	  Say Y here if you have Synaptics I2C touchscreen touch panel SYNA_RMI4_WARP_X_ON.

	  If unsure, say N.

	  To compile this dirver as a module, choose M here: the
	  module will be called.

config SYNA_RMI4_WARP_Y_ON
	bool "Synaptics I2C touchscreen for Mediatek package"
	default n
	help
	  Say Y here if you have Synaptics I2C touchscreen touch panel SYNA_RMI4_WARP_Y_ON.

	  If unsure, say N.

	  To compile this dirver as a module, choose M here: the
	  module will be called.

config TOUCHSCREEN_MTK_SYNAPTICS_DSX_RMI4_FW_UPDATE
	tristate "Synaptics I2C touchscreen firmware update"
	depends on TOUCHSCREEN_MTK_SYNAPTICS_I2C_RMI4
	help
	  This enables support for firmware update for Synaptics RMI
	  touchscreens.
	  If unsure, say N.
	  To compile this driver as a module, choose M

config SYNA_RMI4_AUTO_UPDATE
	bool "Synaptics I2C touchscreen for Mediatek package"
	default n
	help
	  Say Y here if you have Synaptics touch panel SYNA_RMI4_AUTO_UPDATE.

	  If unsure, say N.

	  To compile this dirver as a module, choose M here: the
	  module will be called.
endif
```

## drivers/input/touchscreen/synaptics_l9/Kconfig
```kconfig
#
# Synaptics TCM touchscreen driver configuration
#
config TOUCHSCREEN_SYNAPTICS_TCM_S3908P_L9
	tristate "synaptics s3908 Touchscreen"
	default n
	depends on SPI_MASTER
	help
	  Say Y here if you have synaptics series SPI touchscreen.

	  If unsure, say N.

	  To compile this driver as a module, choose M here.


config TOUCHSCREEN_SYNAPTICS_TCM_SPI
	tristate "synaptics spi support"
	default n
	depends on TOUCHSCREEN_SYNAPTICS_TCM_S3908P_L9
	help
	  Say Y here to enable debug tools

	  If unsure, say N.

	  To compile this driver as a module, choose M here.

config TOUCHSCREEN_SYNAPTICS_TCM_CORE
	tristate "Synaptics TCM core module"
	depends on TOUCHSCREEN_SYNAPTICS_TCM_S3908P_L9
	help
	  Say Y here to enable core functionality.

	  If unsure, say N.

	  To compile this driver as a module, choose M here: the
	  module will be called synaptics_tcm_core.

config TOUCHSCREEN_SYNAPTICS_TCM_REFLASH
	tristate "Synaptics reflash tools support"
	default n
	depends on TOUCHSCREEN_SYNAPTICS_TCM_S3908P_L9
	help
	  Say Y here to enable debug tools

	  If unsure, say N.

	  To compile this driver as a module, choose M here.

config TOUCHSCREEN_SYNAPTICS_TCM_TESTING
	tristate "Synaptics test tools support"
	default n
	depends on TOUCHSCREEN_SYNAPTICS_TCM_S3908P_L9
	help
	  Say Y here to enable debug tools

	  If unsure, say N.

	  To compile this driver as a module, choose M here.

config TOUCHSCREEN_SYNAPTICS_TCM_DEVICE
	tristate "Synaptics device support"
	default n
	depends on TOUCHSCREEN_SYNAPTICS_TCM_S3908P_L9
	help
	  Say Y here to enable debug tools

	  If unsure, say N.

	  To compile this driver as a module, choose M here.

config TOUCHSCREEN_SYNAPTICS_TCM_DIAGNOSTIC
	tristate "Synaptics diagnostic tools support"
	default n
	depends on TOUCHSCREEN_SYNAPTICS_TCM_S3908P_L9
	help
	  Say Y here to enable debug tools

	  If unsure, say N.

	  To compile this driver as a module, choose M here.
```

## drivers/input/touchscreen/synaptics_tcm/Kconfig
```kconfig
#
# Synaptics TCM touchscreen driver configuration
#
menuconfig TOUCHSCREEN_SYNAPTICS_TCM
	bool "Synaptics TCM touchscreen"
	help
	  Say Y here if you have a Synaptics TCM touchscreen connected
	  to your system.

	  If unsure, say N.

if TOUCHSCREEN_SYNAPTICS_TCM

choice
	default TOUCHSCREEN_SYNAPTICS_TCM_I2C
	prompt "Synaptics TCM bus module"
config TOUCHSCREEN_SYNAPTICS_TCM_I2C
	bool "I2C"
	depends on I2C
	help
	  Say Y here to use I2C bus for communication.

	  Else, say N.

	  This will configure I2C bus for communicating
	  with touch controller.

config TOUCHSCREEN_SYNAPTICS_TCM_SPI
	bool "SPI"
	depends on SPI_MASTER
	help
	  Say Y here to use SPI bus for communication.

	  Else, say N.

	  This will configure SPI bus for communicating
	  with touch controller.

endchoice

config TOUCHSCREEN_SYNAPTICS_TCM_CORE
	tristate "Synaptics TCM core module"
	depends on I2C || SPI_MASTER
	help
	  Say Y here to enable core functionality.

	  If unsure, say N.

	  To compile this driver as a module, choose M here: the
	  module will be called synaptics_tcm_core.

config TOUCHSCREEN_SYNAPTICS_TCM_TOUCH
	tristate "Synaptics TCM touch module"
	depends on TOUCHSCREEN_SYNAPTICS_TCM_CORE
	help
	  Say Y here to enable support for touch reporting.

	  If unsure, say N.

	  To compile this driver as a module, choose M here: the
	  module will be called synaptics_tcm_touch.

config TOUCHSCREEN_SYNAPTICS_TCM_DEVICE
	tristate "Synaptics TCM device module"
	depends on TOUCHSCREEN_SYNAPTICS_TCM_CORE
	help
	  Say Y here to enable support for TCM device functionality.

	  If unsure, say N.

	  To compile this driver as a module, choose M here: the
	  module will be called synaptics_tcm_device.

config TOUCHSCREEN_SYNAPTICS_TCM_TESTING
	tristate "Synaptics TCM testing module"
	depends on TOUCHSCREEN_SYNAPTICS_TCM_CORE
	help
	  Say Y here to enable support for testing functionality.

	  If unsure, say N.

	  To compile this driver as a module, choose M here: the
	  module will be called synaptics_tcm_testing.

config TOUCHSCREEN_SYNAPTICS_TCM_REFLASH
	tristate "Synaptics TCM reflash module"
	depends on TOUCHSCREEN_SYNAPTICS_TCM_CORE
	help
	  Say Y here to enable support for reflash functionality.

	  If unsure, say N.

	  To compile this driver as a module, choose M here: the
	  module will be called synaptics_tcm_reflash.

config TOUCHSCREEN_SYNAPTICS_TCM_RECOVERY
	tristate "Synaptics TCM recovery module"
	depends on TOUCHSCREEN_SYNAPTICS_TCM_CORE
	help
	  Say Y here to enable support for recovery functionality.

	  If unsure, say N.

	  To compile this driver as a module, choose M here: the
	  module will be called synaptics_tcm_recovery.

config TOUCHSCREEN_SYNAPTICS_TCM_ZEROFLASH
	tristate "Synaptics TCM zeroflash module"
	depends on TOUCHSCREEN_SYNAPTICS_TCM_CORE
	help
	  Say Y here to enable support for ZeroFlash functionality.

	  If unsure, say N.

	  To compile this driver as a module, choose M here: the
	  module will be called synaptics_tcm_zeroflash.

config TOUCHSCREEN_SYNAPTICS_TCM_DIAGNOSTICS
	tristate "Synaptics TCM diagnostics module"
	depends on TOUCHSCREEN_SYNAPTICS_TCM_CORE
	help
	  Say Y here to enable support for diagnostics functionality.

	  If unsure, say N.

	  To compile this driver as a module, choose M here: the
	  module will be called synaptics_tcm_diagnostics.
endif
```

## drivers/input/touchscreen/tpd_notify/Kconfig
```kconfig
# N19A code for HQ-359934 by p-huangyunbiao at 2023/12/19 start
config TOUCHSCREEN_TPD_NOTIFY
	tristate "touchscreen tpd notify"
	default n
	help
	  Say Y here if you enable touchscreen tpd notify.

	  If unsure, say N.

	  To compile this driver as a module, choose M here:
# N19A code for HQ-359934 by p-huangyunbiao at 2023/12/19 end
```
