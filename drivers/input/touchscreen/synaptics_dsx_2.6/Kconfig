## drivers/input/touchscreen/xiaomi-spi-tp/Kconfig
```kconfig
config XIAOMI_SPI_TOUCH
	bool
	default y if TOUCHSCREEN_NT36xxx_HOSTDL_SPI=y || TOUCHSCREEN_NT36xxx_HOSTDL_SPI_G7=y
	help
	  Say Y if want use xiaomi touch panel.
```

## drivers/input/touchscreen/xiaomi/Kconfig
```kconfig
config TOUCHSCREEN_XIAOMI_TOUCHFEATURE
	tristate "Xiaomi Touch Feature"
	depends on INPUT_TOUCHSCREEN
	help
	  Say Y here if you enable xiaomi touch feature.

	  If unsure, say N.

	  To compile this driver as a module, choose M here:
```

## drivers/input/touchscreen/xiaomi_touch/Kconfig
```kconfig
#
# Xiaomi touch driver configuration
#

config TOUCHSCREEN_XIAOMI_TOUCHFEATURE
	tristate "Xiaomi touch driver"
	default m
	help
	  Say Y here if you use xiaomi touch driver.
	  If unsure, say N.
```

## drivers/input/touchscreen/xiaomi_tp/Kconfig
```kconfig
 config TOUCHSCREEN_COMMON    
     tristate "xiaomi touch"
     help
     Say Y here if you want to add lct touchscreen driver.
     If unsure, say N.
```

## drivers/input/touchscreen/zinitix_bt541/Kconfig
```kconfig
config TOUCHSCREEN_ZINITIX_BT541
	tristate "ZINITIX BT541 I2C TouchScreen"
	depends on I2C
	help
	  Say Y here if you have zinitix bt541 I2C touchscreen.

	  If unsure, say N.

	  To compile this driver as a module, choose M here: the
	  module will be called zinitix.
```

## drivers/input/virtualsar/Kconfig
```kconfig
config VIRTUALSAR
	bool "virtualsar Sar series"
	depends on I2C
	help
	 Say Y here if you have a Goodix GT9xx touchscreen.
	 Gt9xx controllers are multi touch controllers which can
	 report 5 touches at a time.
	 If unsure, say N.
```

## drivers/interconnect/mediatek/Kconfig
```kconfig
config INTERCONNECT_MTK
	bool "Mediatek Network-on-Chip interconnect drivers"
	depends on ARCH_MEDIATEK
	help
	  Support for Mediatek's Network-on-Chip interconnect hardware.

config INTERCONNECT_MTK_EMI
	tristate "Mediatek EMI interconnect driver"
	depends on INTERCONNECT_MTK
	depends on (MTK_DVFSRC && OF)
	help
	  This is a driver for the Mediatek Network-on-Chip on DVFSRC-based
	  platforms.

config INTERCONNECT_MTK_MMQOS_COMMON
	tristate "Mediatek MMQoS support"
	select INTERCONNECT_MTK_EXTENSION
	help
	  Support for multimedia QoS in Mediatek's SoCs.
	  The Mediatek MMQoS(Multimedia Quality of Service) Interconnect
	  driver will collect BW requests from MM users, such as display,
	  camera, mdp and video codec, and configure SMI settings dynamically
	  according to the aggregated BW.

config INTERCONNECT_MTK_MMQOS_MT6873
	tristate "Mediatek MT6873 MMQoS interconnect driver"
	depends on INTERCONNECT_MTK
	depends on MTK_SMI
	select INTERCONNECT_MTK_MMQOS_COMMON
	help
	  Support MT6873 multimedia QoS.

config INTERCONNECT_MTK_MMQOS_MT6853
	tristate "Mediatek MT6853 MMQoS interconnect driver"
	depends on INTERCONNECT_MTK
	depends on MTK_SMI
	select INTERCONNECT_MTK_MMQOS_COMMON
	help
	  Support MT6853 multimedia QoS.

config INTERCONNECT_MTK_MMQOS_MT6886
	tristate "Mediatek MT6886 MMQoS interconnect driver"
	depends on INTERCONNECT_MTK
	depends on MTK_SMI
	select INTERCONNECT_MTK_MMQOS_COMMON
	help
	  Support MT6886 for multimedia QoS in Mediatek's SoCs.
	  The Mediatek MMQoS(Multimedia Quality of Service) Interconnect
	  driver will collect BW requests from MM users, such as display,
	  camera, mdp and video codec, and configure SMI settings dynamically
	  according to the aggregated BW.

config INTERCONNECT_MTK_MMQOS_MT6983
	tristate "Mediatek MT6983 MMQoS interconnect driver"
	depends on INTERCONNECT_MTK
	depends on MTK_SMI
	select INTERCONNECT_MTK_MMQOS_COMMON
	help
	  Support MT6983 multimedia QoS.

config INTERCONNECT_MTK_MMQOS_MT6985
	tristate "Mediatek MT6985 MMQoS interconnect driver"
	depends on INTERCONNECT_MTK
	depends on MTK_SMI
	select INTERCONNECT_MTK_MMQOS_COMMON
	help
	  Support MT6985 multimedia QoS.

config INTERCONNECT_MTK_MMQOS_MT6835
	tristate "Mediatek MT6835 MMQoS interconnect driver"
	depends on INTERCONNECT_MTK
	depends on MTK_SMI
	select INTERCONNECT_MTK_MMQOS_COMMON
	help
	  Support MT6835 multimedia QoS.

config MTK_MMQOS_DEBUG
	tristate "enable MMQoS driver debug"
	help
	  This debug config is for mmqos driver to enable systrace in user/eng
	  load and avoid user load performance concern.
```

## drivers/interconnect/qcom/Kconfig
```kconfig
# SPDX-License-Identifier: GPL-2.0-only
config INTERCONNECT_QCOM
	tristate "Qualcomm Technologies, Inc. Network-on-Chip interconnect drivers"
	depends on ARCH_QCOM
	help
	  Support for Qualcomm's Network-on-Chip interconnect hardware.

config INTERCONNECT_QCOM_BCM_VOTER
	tristate

config INTERCONNECT_QCOM_QOS_RPM
	tristate

config INTERCONNECT_QCOM_MONACO
	tristate "MONACO interconnect driver"
	depends on INTERCONNECT_QCOM
	depends on MSM_RPM_SMD
	select INTERCONNECT_QCOM_RPM
	select INTERCONNECT_QCOM_QOS_RPM
	help
	  This is a driver for the Qualcomm Technologies, Inc. Network-on-Chip
	  on monaco-based platforms. The interconnect provider collects and
	  aggreagates the cosumer bandwidth requests to satisfy constraints
	  placed on Network-on-Chip performance states.

config INTERCONNECT_QCOM_MSM8916
	tristate "Qualcomm MSM8916 interconnect driver"
	depends on INTERCONNECT_QCOM
	depends on QCOM_SMD_RPM
	select INTERCONNECT_QCOM_SMD_RPM
	help
	  This is a driver for the Qualcomm Network-on-Chip on msm8916-based
	  platforms.

config INTERCONNECT_QCOM_MSM8939
	tristate "Qualcomm MSM8939 interconnect driver"
	depends on INTERCONNECT_QCOM
	depends on QCOM_SMD_RPM
	select INTERCONNECT_QCOM_SMD_RPM
	help
	  This is a driver for the Qualcomm Network-on-Chip on msm8939-based
	  platforms.

config INTERCONNECT_QCOM_MSM8974
	tristate "Qualcomm MSM8974 interconnect driver"
	depends on INTERCONNECT_QCOM
	depends on QCOM_SMD_RPM
	select INTERCONNECT_QCOM_SMD_RPM
	help
	 This is a driver for the Qualcomm Network-on-Chip on msm8974-based
	 platforms.

config INTERCONNECT_QCOM_OSM_L3
	tristate "Qualcomm OSM L3 interconnect driver"
	depends on INTERCONNECT_QCOM || COMPILE_TEST
	help
	  Say y here to support the Operating State Manager (OSM) interconnect
	  driver which controls the scaling of L3 caches on Qualcomm SoCs.

config INTERCONNECT_QCOM_QCS404
	tristate "Qualcomm QCS404 interconnect driver"
	depends on INTERCONNECT_QCOM
	depends on QCOM_SMD_RPM
	select INTERCONNECT_QCOM_SMD_RPM
	help
	  This is a driver for the Qualcomm Network-on-Chip on qcs404-based
	  platforms.

config INTERCONNECT_QCOM_RPMH_POSSIBLE
	tristate
	default INTERCONNECT_QCOM
	depends on QCOM_RPMH || (COMPILE_TEST && !QCOM_RPMH)
	depends on QCOM_COMMAND_DB || (COMPILE_TEST && !QCOM_COMMAND_DB)
	depends on OF || COMPILE_TEST
	help
	  Compile-testing RPMH drivers is possible on other platforms,
	  but in order to avoid link failures, drivers must not be built-in
	  when QCOM_RPMH or QCOM_COMMAND_DB are loadable modules

config INTERCONNECT_QCOM_RPMH
	tristate

config INTERCONNECT_QCOM_CINDER
	tristate "CINDER interconnect driver"
	depends on INTERCONNECT_QCOM
	depends on QCOM_RPMH && QCOM_COMMAND_DB && OF
	select INTERCONNECT_QCOM_BCM_VOTER
	select INTERCONNECT_QCOM_RPMH
	select INTERCONNECT_QCOM_QOS
	help
	  This is a driver for the Qualcomm Technologies, Inc. Network-on-Chip
	  on Cinder-based platforms. Interconnect driver provides interfaces
	  for setting bandwidth between two endpoints (path). It also used to
	  configure NOC QoS settings (Quality of Service).

config INTERCONNECT_QCOM_EPSS_L3
	tristate "EPSS L3 interconnect driver"
	depends on INTERCONNECT_QCOM
	help
	  This is a driver for the Qualcomm Technologies, Inc. EPSS L3 control.
	  The EPSS L3 provider collects and aggregates consumer requests to
	  satisfy constraints placed on L3 performance states of the
	  CPU subsystem.

config INTERCONNECT_QCOM_SC7180
	tristate "Qualcomm SC7180 interconnect driver"
	depends on INTERCONNECT_QCOM_RPMH_POSSIBLE
	select INTERCONNECT_QCOM_RPMH
	select INTERCONNECT_QCOM_BCM_VOTER
	help
	  This is a driver for the Qualcomm Network-on-Chip on sc7180-based
	  platforms.

config INTERCONNECT_QCOM_SC7280
	tristate "Qualcomm SC7280 interconnect driver"
	depends on INTERCONNECT_QCOM_RPMH_POSSIBLE
	select INTERCONNECT_QCOM_RPMH
	select INTERCONNECT_QCOM_BCM_VOTER
	help
	  This is a driver for the Qualcomm Network-on-Chip on sc7280-based
	  platforms.

config INTERCONNECT_QCOM_SC8180X
	tristate "Qualcomm SC8180X interconnect driver"
	depends on INTERCONNECT_QCOM_RPMH_POSSIBLE
	select INTERCONNECT_QCOM_RPMH
	select INTERCONNECT_QCOM_BCM_VOTER
	help
	  This is a driver for the Qualcomm Network-on-Chip on sc8180x-based
	  platforms.

config INTERCONNECT_QCOM_SDM660
	tristate "Qualcomm SDM660 interconnect driver"
	depends on INTERCONNECT_QCOM
	depends on QCOM_SMD_RPM
	select INTERCONNECT_QCOM_SMD_RPM
	help
	  This is a driver for the Qualcomm Network-on-Chip on sdm660-based
	  platforms.

config INTERCONNECT_QCOM_SDM845
	tristate "Qualcomm SDM845 interconnect driver"
	depends on INTERCONNECT_QCOM_RPMH_POSSIBLE
	select INTERCONNECT_QCOM_RPMH
	select INTERCONNECT_QCOM_BCM_VOTER
	help
	  This is a driver for the Qualcomm Network-on-Chip on sdm845-based
	  platforms.

config INTERCONNECT_QCOM_SDX55
	tristate "Qualcomm SDX55 interconnect driver"
	depends on INTERCONNECT_QCOM_RPMH_POSSIBLE
	select INTERCONNECT_QCOM_RPMH
	select INTERCONNECT_QCOM_BCM_VOTER
	help
	  This is a driver for the Qualcomm Network-on-Chip on sdx55-based
	  platforms.

config INTERCONNECT_QCOM_SM8150
	tristate "SM8150 interconnect driver"
	depends on INTERCONNECT_QCOM
	depends on QCOM_RPMH && QCOM_COMMAND_DB && OF
	select INTERCONNECT_QCOM_BCM_VOTER
	select INTERCONNECT_QCOM_RPMH
	select INTERCONNECT_QCOM_QOS
	help
	  This is a driver for the Qualcomm Technologies, Inc. Network-on-Chip
	  on sm8150-based platforms. The interconnect provider collects and
	  aggregates the cosumer bandwidth requests to satisfy constraints
	  placed on Network-on-Chip performance states.

config INTERCONNECT_QCOM_SM8250
	tristate "Qualcomm SM8250 interconnect driver"
	depends on INTERCONNECT_QCOM_RPMH_POSSIBLE
	select INTERCONNECT_QCOM_RPMH
	select INTERCONNECT_QCOM_BCM_VOTER
	help
	  This is a driver for the Qualcomm Network-on-Chip on sm8250-based
	  platforms.

config INTERCONNECT_QCOM_SM8350
	tristate "Qualcomm SM8350 interconnect driver"
	depends on INTERCONNECT_QCOM_RPMH_POSSIBLE
	select INTERCONNECT_QCOM_RPMH
	select INTERCONNECT_QCOM_BCM_VOTER
	help
	  This is a driver for the Qualcomm Network-on-Chip on SM8350-based
	  platforms.

config INTERCONNECT_QCOM_SCUBA
	tristate "SCUBA interconnect driver"
	depends on INTERCONNECT_QCOM
	depends on MSM_RPM_SMD
	select INTERCONNECT_QCOM_RPM
	select INTERCONNECT_QCOM_QOS_RPM
	help
	  This is a driver for the Qualcomm Technologies, Inc. Network-on-Chip
	  on scuba-based platforms. The interconnect provider collects and
	  aggreagates the cosumer bandwidth requests to satisfy constraints
	  placed on Network-on-Chip performance states.

config INTERCONNECT_QCOM_SDXPINN
	tristate "SDXPINN interconnect driver"
	depends on INTERCONNECT_QCOM
	depends on QCOM_RPMH && QCOM_COMMAND_DB && OF
	select INTERCONNECT_QCOM_BCM_VOTER
	select INTERCONNECT_QCOM_RPMH
	select INTERCONNECT_QCOM_QOS
	help
	  This is a driver for the Qualcomm Technologies, Inc. Network-on-Chip
	  on SDXPINN-based platforms. Interconnect driver provides interfaces
	  for setting bandwidth between two endpoints (path). It also used to
	  configure NOC QoS settings (Quality of Service).

config INTERCONNECT_QCOM_WAIPIO
	tristate "WAIPIO interconnect driver"
	depends on INTERCONNECT_QCOM
	depends on QCOM_RPMH && QCOM_COMMAND_DB && OF
	select INTERCONNECT_QCOM_BCM_VOTER
	select INTERCONNECT_QCOM_RPMH
	select INTERCONNECT_QCOM_QOS
	help
	  This is a driver for the Qualcomm Technologies, Inc. Network-on-Chip
	  on Waipio-based platforms. Interconnect driver provides interfaces
	  for setting bandwidth between two endpoints (path). It also used to
	  configure NOC QoS settings (Quality of Service).

config INTERCONNECT_QCOM_RPM
	tristate

config INTERCONNECT_QCOM_SMD_RPM
	tristate

config INTERCONNECT_QCOM_QOS
	tristate

config INTERCONNECT_QCOM_KALAMA
	tristate "KALAMA interconnect driver"
	depends on INTERCONNECT_QCOM
	depends on OF
	select INTERCONNECT_QCOM_BCM_VOTER
	select INTERCONNECT_QCOM_RPMH
	select INTERCONNECT_QCOM_QOS
	help
	  This is a driver for the Qualcomm Technologies, Inc. Network-on-Chip
	  on Kalama-based platforms. Interconnect driver provides interfaces
	  for setting bandwidth between two endpoints (path). It also used to
	  configure NOC QoS settings (Quality of Service).

config INTERCONNECT_QCOM_SDXBAAGHA
	tristate "SDXBAAGHA interconnect driver"
	depends on INTERCONNECT_QCOM
	depends on OF
	select INTERCONNECT_QCOM_BCM_VOTER
	select INTERCONNECT_QCOM_RPMH
	select INTERCONNECT_QCOM_QOS
	help
	  This is a driver for the Qualcomm Technologies, Inc. Network-on-Chip
	  on SDXBAAGHA-based platforms. Interconnect driver provides interfaces
	  for setting bandwidth between two endpoints (path). It also used to
	  configure NOC QoS settings (Quality of Service).

config INTERCONNECT_QCOM_BENGAL
	tristate "BENGAL interconnect driver"
	depends on INTERCONNECT_QCOM
	depends on MSM_RPM_SMD
	select INTERCONNECT_QCOM_RPM
	select INTERCONNECT_QCOM_QOS_RPM
	help
	  This is a driver for the Qualcomm Technologies, Inc. Network-on-Chip
	  on bengal-based platforms. The interconnect provider collects and
	  aggreagates the cosumer bandwidth requests to satisfy constraints
	  placed on Network-on-Chip performance states.

config INTERCONNECT_QCOM_SA410M
	tristate "SA410M interconnect driver"
	depends on INTERCONNECT_QCOM
	help
	  This is a driver for the Qualcomm Technologies, Inc. Network-on-Chip
	  on sa410m-based platforms. The interconnect provider collects and
	  aggreagates the cosumer bandwidth requests to satisfy constraints
	  placed on Network-on-Chip performance states.

config INTERCONNECT_QCOM_DEBUG
	tristate "QCOM-specific interconnect debug features"
	depends on INTERCONNECT_QCOM
	help
          This driver provides QCOM-specific interconnect debug features. These
          features include optionally printing all enabled interconnect votes
          when entering suspend.

config INTERCONNECT_QCOM_LEMANS
	tristate "LEMANS interconnect driver"
	depends on INTERCONNECT_QCOM
	depends on QCOM_RPMH && QCOM_COMMAND_DB && OF
	select INTERCONNECT_QCOM_BCM_VOTER
	select INTERCONNECT_QCOM_RPMH
	select INTERCONNECT_QCOM_QOS
	help
	  This is a driver for the Qualcomm Technologies, Inc. Network-on-Chip
	  on lemans-based platforms. The interconnect provider collects and
	  aggreagates the cosumer bandwidth requests to satisfy constraints
	  placed on Network-on-Chip performance states.
```
