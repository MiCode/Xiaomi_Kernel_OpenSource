## drivers/irqchip/Kconfig
```kconfig
config IRQCHIP
	def_bool y
	depends on OF_IRQ

config ARM_GIC
	bool
	select IRQ_DOMAIN
	select IRQ_DOMAIN_HIERARCHY
	select MULTI_IRQ_HANDLER

config GIC_NON_BANKED
	bool

config ARM_GIC_V3
	bool
	select IRQ_DOMAIN
	select MULTI_IRQ_HANDLER

config ARM_NVIC
	bool
	select IRQ_DOMAIN
	select GENERIC_IRQ_CHIP

config ARM_VIC
	bool
	select IRQ_DOMAIN
	select MULTI_IRQ_HANDLER

config ARM_VIC_NR
	int
	default 4 if ARCH_S5PV210
	default 2
	depends on ARM_VIC
	help
	  The maximum number of VICs available in the system, for
	  power management.

config ATMEL_AIC_IRQ
	bool
	select GENERIC_IRQ_CHIP
	select IRQ_DOMAIN
	select MULTI_IRQ_HANDLER
	select SPARSE_IRQ

config ATMEL_AIC5_IRQ
	bool
	select GENERIC_IRQ_CHIP
	select IRQ_DOMAIN
	select MULTI_IRQ_HANDLER
	select SPARSE_IRQ

config BRCMSTB_L2_IRQ
	bool
	depends on ARM
	select GENERIC_IRQ_CHIP
	select IRQ_DOMAIN

config DW_APB_ICTL
	bool
	select IRQ_DOMAIN

config IMGPDC_IRQ
	bool
	select GENERIC_IRQ_CHIP
	select IRQ_DOMAIN

config CLPS711X_IRQCHIP
	bool
	depends on ARCH_CLPS711X
	select IRQ_DOMAIN
	select MULTI_IRQ_HANDLER
	select SPARSE_IRQ
	default y

config OR1K_PIC
	bool
	select IRQ_DOMAIN

config OMAP_IRQCHIP
	bool
	select GENERIC_IRQ_CHIP
	select IRQ_DOMAIN

config ORION_IRQCHIP
	bool
	select IRQ_DOMAIN
	select MULTI_IRQ_HANDLER

config RENESAS_INTC_IRQPIN
	bool
	select IRQ_DOMAIN

config RENESAS_IRQC
	bool
	select IRQ_DOMAIN

config TB10X_IRQC
	bool
	select IRQ_DOMAIN
	select GENERIC_IRQ_CHIP

config VERSATILE_FPGA_IRQ
	bool
	select IRQ_DOMAIN

config VERSATILE_FPGA_IRQ_NR
       int
       default 4
       depends on VERSATILE_FPGA_IRQ

config XTENSA_MX
	bool
	select IRQ_DOMAIN

config IRQ_CROSSBAR
	bool
	help
	  Support for a CROSSBAR ip that precedes the main interrupt controller.
	  The primary irqchip invokes the crossbar's callback which inturn allocates
	  a free irq and configures the IP. Thus the peripheral interrupts are
	  routed to one of the free irqchip interrupt lines.

config KEYSTONE_IRQ
	tristate "Keystone 2 IRQ controller IP"
	depends on ARCH_KEYSTONE
	help
		Support for Texas Instruments Keystone 2 IRQ controller IP which
		is part of the Keystone 2 IPC mechanism

config MTK_GIC
	bool
	select IRQ_DOMAIN
	select MULTI_IRQ_HANDLER
	help
	  Support for Mediatek generic interrupt controller

config MTK_EIC
	bool
	select IRQ_DOMAIN
	help
	  Support for Mediatek external interrupt controller

config MTK_SEC_DEINT_SUPPORT
	bool
	def_bool n
	depends on MTK_EIC
	help
	  This option is used to enable a feature called secure direct eint support.
	  This feature have to be enabled with MTK_SEC_DEIC_SUPPORT in ATF. ATF direct
	  secure EINT driver have provide secure DEINT Configuration and Release command
	  for SMC call originated from TEE and filter the SMC call from kernel. The change for
	  kernel EINT driver is that mt_eint_set_deint() will check the wanted deint is secure
	  direct eint, if yes, skip the configuration. if not, kernel can configure this deint.
	  Since not every platform support secure direct eint, you must enable this config carefully.

config MTK_INTPOL
	bool
	help
	  Support for MediaTek intpol used on mt65xx/mt81xx


config MTK_EIC_HISTORY_DUMP
	bool "Enable MTK EIC HISTORY Debugger"
	def_bool n
	depends on MTK_EIC
	---help---
	  This option is used to collect last eint
	  interupts and its property before WDT TIMEOUT.
	  with thie option, we could know which
	  eint interrupt is triggered too often to cause system
	  watchdog timeout.


config MTK_IRQ_NEW_DESIGN
	bool
	help
	  Support for MediaTek new interrupt design

config MTK_IRQ_NEW_DESIGN_DEBUG
	bool
	select MTK_IRQ_NEW_DESIGN
	help
	  Support for debugging feature for MediaTek new interrupt design
```

## drivers/irqchip/qcom/Kconfig
```kconfig
config QTI_PDC
        bool "QTI PDC"
        depends on ARCH_QCOM
	select IRQ_DOMAIN
	select IRQ_DOMAIN_HIERARCHY
        help
          QTI Power Domain Controller driver to manage and configure wakeup
          IRQs

config QTI_PDC_SM8150
        bool "QTI PDC SM8150"
        select QTI_PDC
        select QTI_PDC_SAVE_RESTORE
        default y if ARCH_SM8150
        help
          QTI Power Domain Controller for SM8150

config QTI_PDC_SM6150
        bool "QTI PDC SM6150"
        select QTI_PDC
        select QTI_PDC_SAVE_RESTORE
        default y if ARCH_SM6150
        help
          QTI Power Domain Controller for SM6150

config QTI_PDC_SDMMAGPIE
        bool "QTI PDC SDMMAGPIE"
        select QTI_PDC
        default y if ARCH_SDMMAGPIE
        help
          QTI Power Domain Controller for SDMMAGPIE
	  This is used for managing and configuring
	  the wakeup interrupts. Enable it when
	  ARCH_SDMMAGPIE is selected.

config QTI_PDC_SDXPRAIRIE
        bool "QTI PDC SDXPRAIRIE"
        select QTI_PDC
        default y if ARCH_SDXPRAIRIE
        help
          QTI Power Domain Controller for SDXPRAIRIE
	  This is used for managing and configuring
	  the wakeup interrupts. Enable it when
	  ARCH_SDXPRAIRIE is selected.

config QTI_PDC_ATOLL
        bool "QTI PDC ATOLL"
        select QTI_PDC
        help
          QTI Power Domain Controller for ATOLL
	  This is used for managing and configuring
	  the wakeup interrupts. Enable it when
	  ARCH_ATOLL is selected.

config QTI_MPM
	bool "QTI MPM"
	depends on ARCH_QCOM
	select IRQ_DOMAIN
	select IRQ_DOMAIN_HIERARCHY
	help
	  QTI MSM Power Manager driver to manage and configure wakeup
	  IRQs.

config QTI_PDC_VIRT
        bool "QTI PDC VIRT"
        select QTI_PDC
        help
          QTI Power Domain Controller for Virtual platforms
	  This is used for managing and configuring
	  the wakeup interrupts on virtual platforms.

config QTI_PDC_SAVE_RESTORE
        bool "QTI PDC SAVE RESTORE"
        depends on QTI_PDC
        help
          Enables the QTI PDC feature to save/restore pin configurations
          during suspend/resume.
```

## drivers/leds/flash/Kconfig
```kconfig
config LEDS_MT6370_FLASH
	tristate "Flash LED Support for MediaTek MT6370 PMIC"
	depends on LEDS_CLASS && OF
	depends on LEDS_CLASS_FLASH || !LEDS_CLASS_FLASH
	depends on V4L2_FLASH_LED_CLASS || !V4L2_FLASH_LED_CLASS
	depends on MFD_MT6370
	help
	  Support 2 channels and torch/strobe mode.
	  Say Y here to enable support for
	  MT6370_FLASH_LED device.

	  This driver can also be built as a module. If so, the module
	  will be called "leds-mt6370-flash".
```

## drivers/leds/rgb/Kconfig
```kconfig
config LEDS_MT6370_RGB
	tristate "LED Support for MediaTek MT6370 PMIC"
	depends on MFD_MT6370
	select LINEAR_RANGE
	select LEDS_CLASS_MULTICOLOR
	help
	  Say Y here to enable support for MT6370_RGB LED device.
	  In MT6370, there are four channel current-sink LED drivers that
	  support hardware pattern for constant current, PWM, and breath mode.
	  Isink4 channel can also be used as a CHG_VIN power good indicator.

	  This driver can also be built as a module. If so, the module
	  will be called "leds-mt6370-rgb".
```

## drivers/media/dvb/mpq/Kconfig
```kconfig
config DVB_MPQ
	tristate "Qualcomm Multimedia Processor DVB Adapter"
	depends on ARCH_MSM && DVB_CORE
	default n

	help
	  Support for Qualcomm MPQ based DVB adapter.
	  Say Y or M if you own such a device and want to use it.

source "drivers/media/dvb/mpq/demux/Kconfig"
```

## drivers/media/dvb/mpq/demux/Kconfig
```kconfig
config DVB_MPQ_DEMUX
	tristate "DVB Demux Device"
	depends on DVB_MPQ && ION && ION_MSM
	default n

	help
	  Support for Qualcomm based dvb demux device.
	  Say Y or M if you own such a device and want to use it.

config DVB_MPQ_NUM_DMX_DEVICES
	int "Number of demux devices"
	depends on DVB_MPQ_DEMUX
	default 4
	range 1 255

	help
	  Configure number of demux devices. Depends on your use-cases for maximum concurrent stream playback.

choice
	prompt "Demux Hardware Plugin"
	depends on DVB_MPQ_DEMUX
	default DVB_MPQ_TSIF
	help
	  Enable support of specific demux HW plugin depending on the existing HW support.
	  Depending on the enabled HW, demux may take advantage of HW capbailities to perform some tasks in HW instead of SW.

	config DVB_MPQ_TSPP1
		bool "TSPPv1 plugin"
		depends on TSPP
		help
			Use this option of your HW has Transport Stream Packet Processor (TSPP) version1 support

	config DVB_MPQ_TSPP2
		bool "TSPPv2 plugin"
		depends on TSPP
		help
			Use this option of your HW has Transport Stream Packet Processor (TSPP) version2 support

	config DVB_MPQ_TSIF
		bool "TSIF plugin"
		depends on TSIF
		help
			Use this option of your HW has only TSIF input without any Transport Stream Packet Processor (TSPP) support
endchoice
```

## drivers/media/i2c/atomisp/Kconfig
```kconfig
config VIDEO_GC0310
       tristate "GC0310 sensor support"
       depends on I2C && VIDEO_V4L2
       ---help---
         This is a Video4Linux2 sensor-level driver for the Galaxycore
         GC0310 0.3MP sensor.

         It currently only works with the atomisp driver.

config VIDEO_GC2155
       tristate "GC2155 sensor support"
       depends on I2C && VIDEO_V4L2
       ---help---
         This is a Video4Linux2 sensor-level driver for the Galaxycore
         GC2155 2MP sensor.

         It currently only works with the atomisp driver.
```

## drivers/media/platform/altek/Kconfig
```kconfig
config VIDEO_ALTEK_ISP
	tristate "Altek mini isp support"
	depends on I2C && SPI
	---help---
	  This is a camera driver for Altek mini isp which is to process
	  depth data from dual IR camera sensors.
	  Say Y here to enable Altek mini isp support.
```
