## drivers/input/touchscreen/mediatek/NT36xxx_HOSTDL_SPI/Kconfig
```kconfig
#
# Novatek NT36xxx touchscreen driver configuration
#
config TOUCHSCREEN_NT36xxx_HOSTDL_SPI
	bool "Novatek NT36xxx host download SPI driver"
	default n
	help
	  Say Y here if you have a Novatek NT36xxx no flash touchscreen connected
	  to your system by SPI bus.

	  If unsure, say N.

config  NVT_ITO_SELFTEST
	bool "Novatek NT36xxx ITO self test"
	default n
	help
	  Say Y here if you have a Novatek NT36xxx no flash touchscreen connected
	  to your system by SPI bus.

	  If unsure, say N.
```

## drivers/input/touchscreen/mediatek/SOLOMON/Kconfig
```kconfig
#
# Touchscreen driver configuration
#
config TOUCHSCREEN_MTK_SOLOMON
    bool "SOLOMON for Mediatek"
    depends on I2C
    default n
    help
      Say Y here if you have Focaltech touch panel.
      If unsure, say N.
      
    
```

## drivers/input/touchscreen/mediatek/chipone-tddi/Kconfig
```kconfig
#
# NLic icnl9911 touchscreen driver configuration
#

config TOUCHSCREEN_CHIPONE
	bool "ICNL icnl9911 host download SPI driver"
	depends on SPI
	default n
	help
	  Say Y here if you have a icnl9911 no flash touchscreen connected
	  to your system by SPI bus.

	  If unsure, say N.
```

## drivers/input/touchscreen/mediatek/chipone-tddi_9916/Kconfig
```kconfig
config TOUCHSCREEN_CHIPONE
	tristate "Chipone TDDI touchscreen for Mediatek package"
	default n
	help
	  Say y here if you have chipone TDDI touch panel.
	  If unsure, say N.
```

## drivers/input/touchscreen/mediatek/chipone_ICNL_9916/Kconfig
```kconfig
config TOUCHSCREEN_CHIPONE
    bool "Chipone Touchscreen"
    default n
    help
      Say Y here if you have chipone touch panel.
      If unsure, say N.
```

## drivers/input/touchscreen/mediatek/focaltech_touch/Kconfig
```kconfig
#
# Focaltech Touchscreen driver configuration
#

config TOUCHSCREEN_FTS
    bool "Focaltech Touchscreen"
    default n
	help
	  Say Y here if you have focaltech_touch touch panel.

	  If unsure, say N.

	  To compile this dirver as a module, choose M here: the
	  module will be called.

config TOUCHSCREEN_FTS_DIRECTORY
    string "Focaltech ts directory name"
    default "focaltech_touch"
    depends on TOUCHSCREEN_FTS
```

## drivers/input/touchscreen/mediatek/ft5x0x/Kconfig
```kconfig
#
# Touchscreen driver configuration
#
if TOUCHSCREEN_MTK_FT5X0X

config FT5X0X_FIRMWARE
	string "FT5X0X for Mediatek firmware"

config TPD_ROTATE_90
	bool "ft5x0x for Mediatek package"
	default n
	help
	Say Y here if you have ft5x0x touch panel TPD_ROTATE_90.

	If unsure, say N.

	To compile this dirver as a module, choose M here: the
	module will be called.

config TPD_ROTATE_180
	bool "ft5x0x for Mediatek package"
	default n
	help
	Say Y here if you have ft5x0x touch panel TPD_ROTATE_180.

	If unsure, say N.

	To compile this dirver as a module, choose M here: the
	module will be called.

config TPD_ROTATE_270
	bool "ft5x0x for Mediatek package"
	default n
	help
	Say Y here if you have ft5x0x touch panel TPD_ROTATE_270.

	If unsure, say N.

	To compile this dirver as a module, choose M here: the
	module will be called.

config FT_AUTO_UPGRADE_SUPPORT
	bool "ft5x0x for Mediatek package"
	default n
	help
	Say Y here if you have ft5x0x touch panel FT_AUTO_UPGRADE_SUPPORT.

	If unsure, say N.

	To compile this dirver as a module, choose M here: the
	module will be called.

config CUST_FTS_APK_DEBUG
	bool "ft5x0x for Mediatek package"
	default n
	help
	Say Y here if you have ft5x0x touch panel CUST_FTS_APK_DEBUG.

	If unsure, say N.

	To compile this dirver as a module, choose M here: the
	module will be called.

config TPD_HAVE_CALIBRATION
	bool "ft5x0x for Mediatek package"
	default n
	help
	Say Y here if you have ft5x0x touch panel TPD_HAVE_CALIBRATION.

	If unsure, say N.

	To compile this dirver as a module, choose M here: the
	module will be called.

config TPD_CUSTOM_CALIBRATION
	bool "ft5x0x for Mediatek package"
	default n
	help
	Say Y here if you have ft5x0x touch panel TPD_CUSTOM_CALIBRATION.

	If unsure, say N.

	To compile this dirver as a module, choose M here: the
	module will be called.
endif
```

## drivers/input/touchscreen/mediatek/ft8719_spi/Kconfig
```kconfig
#
# Focaltech Touchscreen driver configuration
#

config TOUCHSCREEN_FTS_C3J1
    bool "Focaltech Touchscreen"
    default n
    help
      Say Y here if you have Focaltech touch panel.
      If unsure, say N.

config TOUCHSCREEN_FTS_DIRECTORY
    string "Focaltech ts directory name"
    default "fts8719_spi"
    depends on TOUCHSCREEN_FTS_C3J1
```

## drivers/input/touchscreen/mediatek/goodix_berlin_driver/Kconfig
```kconfig
#
# Goodix touchscreen driver configuration
#
menuconfig TOUCHSCREEN_GOODIX_BRL
	tristate "Goodix berlin touchscreen"
	help
	  Say Y here if you have a Goodix berlin series touch controller
	  to your system

	  If build module, say M.
	  If unsure, say N.

if TOUCHSCREEN_GOODIX_BRL

config TOUCHSCREEN_GOODIX_BRL_SPI
	bool "support SPI bus connection"
	help
		Say Y here if the touchscreen is connected via SPI bus.

endif
```

## drivers/input/touchscreen/mediatek/hxchipset/Kconfig
```kconfig
#
# Himax Touchscreen driver configuration
#

config TOUCHSCREEN_HIMAX_COMMON
        tristate "HIMAX chipset i2c touchscreen"
		depends on TOUCHSCREEN_HIMAX_CHIPSET
		help
		This enables support for HIMAX CHIPSET over I2C based touchscreens.

choice
	prompt "HIMAX touch IC types"
	depends on TOUCHSCREEN_HIMAX_COMMON
	default TOUCHSCREEN_HIMAX_INCELL

config TOUCHSCREEN_HIMAX_ONCELL
        bool "HIMAX chipset on-cell function"
		depends on TOUCHSCREEN_HIMAX_COMMON
		help
		This enables support for HIMAX CHIPSET of on-cell function.

config TOUCHSCREEN_HIMAX_INCELL
        bool "HIMAX chipset in-cell function"
		depends on TOUCHSCREEN_HIMAX_COMMON
		help
		This enables support for HIMAX CHIPSET of in-cell function.

endchoice

# ***************** On-cell Start *****************
config TOUCHSCREEN_HIMAX_IC_HX852xH
        tristate "HIMAX chipset HX852xH function"
		depends on TOUCHSCREEN_HIMAX_ONCELL
		help
		This enables support for HIMAX CHIPSET of HX852xH.

config TOUCHSCREEN_HIMAX_IC_HX852xG
        tristate "HIMAX chipset HX852xG function"
		depends on TOUCHSCREEN_HIMAX_ONCELL
		help
		This enables support for HIMAX CHIPSET of HX852xG.

# ***************** On-cell End *******************
# ***************** In-cell Start *****************
config TOUCHSCREEN_HIMAX_IC_HX83192
        tristate "HIMAX chipset HX83192 function"
		depends on TOUCHSCREEN_HIMAX_INCELL
		help
		This enables support for HIMAX CHIPSET of HX83192.

config TOUCHSCREEN_HIMAX_IC_HX83191
        tristate "HIMAX chipset HX83191 function"
		depends on TOUCHSCREEN_HIMAX_INCELL
		help
		This enables support for HIMAX CHIPSET of HX83191.

config TOUCHSCREEN_HIMAX_IC_HX83113
        tristate "HIMAX chipset HX83113 function"
		depends on TOUCHSCREEN_HIMAX_INCELL
		help
		This enables support for HIMAX CHIPSET of HX83113.

config TOUCHSCREEN_HIMAX_IC_HX83112
        tristate "HIMAX chipset HX83112 function"
		depends on TOUCHSCREEN_HIMAX_INCELL
		help
		This enables support for HIMAX CHIPSET of HX83112.

config TOUCHSCREEN_HIMAX_IC_HX83111
        tristate "HIMAX chipset HX83111 function"
		depends on TOUCHSCREEN_HIMAX_INCELL
		help
		This enables support for HIMAX CHIPSET of HX83111.

config TOUCHSCREEN_HIMAX_IC_HX83106
        tristate "HIMAX chipset HX83106 function"
		depends on TOUCHSCREEN_HIMAX_INCELL
		help
		This enables support for HIMAX CHIPSET of HX83106.

config TOUCHSCREEN_HIMAX_IC_HX83103
        tristate "HIMAX chipset HX83103 function"
		depends on TOUCHSCREEN_HIMAX_INCELL
		help
		This enables support for HIMAX CHIPSET of HX83103.

config TOUCHSCREEN_HIMAX_IC_HX83102
        tristate "HIMAX chipset HX83102 function"
		depends on TOUCHSCREEN_HIMAX_INCELL
		help
		This enables support for HIMAX CHIPSET of HX83102.

# ***************** In-cell End *******************

config TOUCHSCREEN_HIMAX_DEBUG
        bool "HIMAX debug function"
		depends on TOUCHSCREEN_HIMAX_INCELL || TOUCHSCREEN_HIMAX_ONCELL
		help
		This enables support for HIMAX debug function.
config TOUCHSCREEN_HIMAX_INSPECT
        bool "HIMAX inspect function"
		depends on TOUCHSCREEN_HIMAX_INCELL || TOUCHSCREEN_HIMAX_ONCELL
		help
		This enables support for HIMAX debug function.

config TOUCHSCREEN_HIMAX_EMBEDDED_FIRMWARE
	bool "HIMAX embedded firmware function"
		depends on TOUCHSCREEN_HIMAX_INCELL || TOUCHSCREEN_HIMAX_ONCELL
		help
		This enables built-in FW inside kernel as binary array

config HMX_DB
	bool "HIMAX driver test over Dragon Board"
	depends on TOUCHSCREEN_HIMAX_COMMON
	help
	  This enables support for HIMAX driver test over Dragon Board.
```

## drivers/input/touchscreen/mediatek/hxchipset_8789p1_8185p3/Kconfig
```kconfig
#
# Himax Touchscreen driver configuration
#

config TOUCHSCREEN_HIMAX_COMMON
        tristate "HIMAX common touchscreen"
	depends on TOUCHSCREEN_HIMAX_CHIPSET_8789P1_8185P3
	help
	Say Y here to enable support for I2C based touchscreens.
	To compile this driver as a module, choose M here: the
	module will be called HimaxChipsetTs.

choice
	prompt "HIMAX touch IC types"
	depends on TOUCHSCREEN_HIMAX_COMMON
	default TOUCHSCREEN_HIMAX_INCELL

config TOUCHSCREEN_HIMAX_ONCELL
        bool "HIMAX chipset on-cell function"
	depends on TOUCHSCREEN_HIMAX_COMMON
	help
	  if you want to use on-cell function, you must set the config.
	  If unsure, not set it.
	  there are some on-cell function in the code of Himax touch.
	  choose the config here to support for the on-cell function.

config TOUCHSCREEN_HIMAX_INCELL
        bool "HIMAX chipset in-cell function"
	depends on TOUCHSCREEN_HIMAX_COMMON
	help
	  if you want to use in-cell function, you must set the config.
	  If unsure, not set it.
	  there are some in-cell function in the code of Himax touch.
	  choose the config here to support for the in-cell function.

endchoice

# ***************** On-cell Start *****************
config TOUCHSCREEN_HIMAX_IC_HX852xH
	tristate "HIMAX chipset HX852xH function"
	depends on TOUCHSCREEN_HIMAX_ONCELL
	help
	This enables support for HIMAX CHIPSET of HX852xH.
	if you want to use HX852xH, you must set the config.
	If unsure, not set it.
	there are some chip type in the code of Himax touch.


config TOUCHSCREEN_HIMAX_IC_HX852xG
	tristate "HIMAX chipset HX852xG function"
	depends on TOUCHSCREEN_HIMAX_ONCELL
	help
	This enables support for HIMAX CHIPSET of HX852xG.
	if you want to use HX852xG, you must set the config.
	If unsure, not set it.
	there are some chip type in the code of Himax touch.

# ***************** On-cell End *******************
# ***************** In-cell Start *****************
config TOUCHSCREEN_HIMAX_IC_HX83192
        tristate "HIMAX chipset HX83192 function"
	depends on TOUCHSCREEN_HIMAX_INCELL
	help
	This enables support for HIMAX CHIPSET of HX83192.
	if you want to use HX83192, you must set the config.
	If unsure, not set it.
	there are some chip type in the code of Himax touch.

config TOUCHSCREEN_HIMAX_IC_HX83191
        tristate "HIMAX chipset HX83191 function"
	depends on TOUCHSCREEN_HIMAX_INCELL
	help
	This enables support for HIMAX CHIPSET of HX83191.
	if you want to use HX83191, you must set the config.
	If unsure, not set it.
	there are some chip type in the code of Himax touch.

config TOUCHSCREEN_HIMAX_IC_HX83113
        tristate "HIMAX chipset HX83113 function"
	depends on TOUCHSCREEN_HIMAX_INCELL
	help
	This enables support for HIMAX CHIPSET of HX83113.
	if you want to use HX83113, you must set the config.
	If unsure, not set it.
	there are some chip type in the code of Himax touch.

config TOUCHSCREEN_HIMAX_IC_HX83112
        tristate "HIMAX chipset HX83112 function"
	depends on TOUCHSCREEN_HIMAX_INCELL
	help
	This enables support for HIMAX CHIPSET of HX83112.
	if you want to use HX83112, you must set the config.
	If unsure, not set it.
	there are some chip type in the code of Himax touch.

config TOUCHSCREEN_HIMAX_IC_HX83111
        tristate "HIMAX chipset HX83111 function"
	depends on TOUCHSCREEN_HIMAX_INCELL
	help
	This enables support for HIMAX CHIPSET of HX83111.
	if you want to use HX83111, you must set the config.
	If unsure, not set it.
	there are some chip type in the code of Himax touch.

config TOUCHSCREEN_HIMAX_IC_HX83106
        tristate "HIMAX chipset HX83106 function"
	depends on TOUCHSCREEN_HIMAX_INCELL
	help
	This enables support for HIMAX CHIPSET of HX83106.
	if you want to use HX83106, you must set the config.
	If unsure, not set it.
	there are some chip type in the code of Himax touch.

config TOUCHSCREEN_HIMAX_IC_HX83103
        tristate "HIMAX chipset HX83103 function"
	depends on TOUCHSCREEN_HIMAX_INCELL
	help
	This enables support for HIMAX CHIPSET of HX83103.
	if you want to use HX83103, you must set the config.
	If unsure, not set it.
	there are some chip type in the code of Himax touch.

config TOUCHSCREEN_HIMAX_IC_HX83102
        tristate "HIMAX chipset HX83102 function"
	depends on TOUCHSCREEN_HIMAX_INCELL
	help
	This enables support for HIMAX CHIPSET of HX83102.
	if you want to use HX83102, you must set the config.
	If unsure, not set it.
	there are some chip type in the code of Himax touch.

# ***************** In-cell End *******************

config TOUCHSCREEN_HIMAX_DEBUG
        bool "HIMAX debug function"
	depends on TOUCHSCREEN_HIMAX_INCELL || TOUCHSCREEN_HIMAX_ONCELL
	help
	This enables support for HIMAX debug function of HimaxChipsetTs.
	if you want to use debug, you must set the config.
	If unsure, not set it.
	there are some chip type in the code of Himax touch.

config TOUCHSCREEN_HIMAX_INSPECT
        bool "HIMAX inspect function"
	depends on TOUCHSCREEN_HIMAX_INCELL || TOUCHSCREEN_HIMAX_ONCELL
	help
	help
	This enables support for HIMAX INSPECT function of HimaxChipsetTs.
	if you want to use INSPECT, you must set the config.
	If unsure, not set it.
	there are some chip type in the code of Himax touch.

config TOUCHSCREEN_HIMAX_EMBEDDED_FIRMWARE
	bool "HIMAX embedded firmware function"
	depends on TOUCHSCREEN_HIMAX_INCELL || TOUCHSCREEN_HIMAX_ONCELL
	help
	This enables support for HIMAX FIRMWARE function of HimaxChipsetTs.
	if you want to use INSPECT, you must set the config.
	If unsure, not set it.
	there are some chip type in the code of Himax touch.

config HMX_DB
	bool "HIMAX driver test over Dragon Board"
	depends on TOUCHSCREEN_HIMAX_COMMON
	help
	This enables support for HIMAX COMMON function of HimaxChipsetTs.
	if you want to use INSPECT, you must set the config.
	If unsure, not set it.
	there are some chip type in the code of Himax touch.
```

## drivers/input/touchscreen/msg2838/Kconfig
```kconfig
#
# Goodix GT9xx Touchscreen driver
#

config MSG28XX_TOUCHPANEL_DRIVER
	tristate "Msg2838 touchpanel driver"
	depends on TOUCHSCREEN_MSG28XX
	default y
	help
	  This is the main file for touchpanel driver for Goodix GT9xx
	  touchscreens.

	  Say Y here if you have a Goodix GT9xx touchscreen connected
	  to your system.

	  If unsure, say N.

	  To compile this driver as a module, choose M here: the
	  module will be called gt9xx_update.
```

## drivers/input/touchscreen/nt36523/Kconfig
```kconfig
#
# Novatek NT36523 touchscreen driver configuration
#
config TOUCHSCREEN_NT36523_HOSTDL_SPI
	tristate "Novatek NT36523 host download SPI driver"
	default n
	help
	  Say Y here if you have a Novatek NT36523 no flash touchscreen connected
	  to your system by SPI bus.

	  If unsure, say N.

config TOUCHSCREEN_SUPPORT_NEW_GAME_MODE
    tristate "Touch Support New Game Mode"
    default n
    help
      Say Y here if the device support new game mode

      If not support, say N.

config TOUCHSCREEN_NVT_DEBUG_FS
	bool "Touch debug interface"
	help
	  Control IRQ,suspend,sensor,debug firmware,etc.
```
