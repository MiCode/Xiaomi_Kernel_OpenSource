## drivers/input/touchscreen/nt36525b_spi/Kconfig
```kconfig
#
# Novatek NT36xxx touchscreen driver configuration
#
config TOUCHSCREEN_NT36xxx_HOSTDL_SPI
	bool "Novatek NT36xxx host download SPI driver"
	default y
	help
	  Say Y here if you have a Novatek NT36xxx no flash touchscreen connected
	  to your system by SPI bus.

	  If unsure, say N.
```

## drivers/input/touchscreen/nt36532/Kconfig
```kconfig
#
# Novatek NT36xxx touchscreen driver configuration
#
config TOUCHSCREEN_NT36532_HOSTDL_SPI
	bool "Novatek NT36532 host download SPI driver"
	default n
	help
	  Say Y here if you have a Novatek NT36532 no flash touchscreen connected
	  to your system by SPI bus.

	  If unsure, say N.

config TOUCHSCREEN_SUPPORT_NEW_GAME_MODE
    tristate "Touch Support New Game Mode"
    default n
    help
      Say Y here if the device support new game mode

      If not support, say N.
```

## drivers/input/touchscreen/nt36572_common/Kconfig
```kconfig
#
# Novatek NT36xxx touchscreen driver configuration
#
menu "NT36xxx support"
	depends on INPUT_TOUCHSCREEN

config TOUCHSCREEN_NT36xxx
	bool "Novatek NT36xxx"
	help
	  Say Y here if you have a Novatek NT36xxx touchscreen connected
	  to your system.

	  If unsure, say N.

endmenu
```

## drivers/input/touchscreen/nt36672c/Kconfig
```kconfig
#
# Novatek NT36xxx touchscreen driver configuration
#
config TOUCHSCREEN_NT36xxx_HOSTDL_SPI
	bool "Novatek NT36xxx host download SPI driver"
	select TOUCHSCREEN_TDDI_DBCLK
	help
	  Say Y here if you have a Novatek NT36xxx no flash touchscreen connected
	  to your system by SPI bus.

	  If unsure, say N.

config TOUCHSCREEN_NVT_DEBUG_FS
	bool "Touch debug interface"
	help
	  Control IRQ,suspend,sensor,debug firmware,etc.
```

## drivers/input/touchscreen/nt36xxx/Kconfig
```kconfig
# SPDX-License-Identifier: GPL-2.0-only
#
# Novatek NT36XXX touchscreen driver configuration
#
config TOUCHSCREEN_NT36XXX_I2C
	tristate "Novatek NT36XXX over I2C"
	help
	  Say Y here if you have a Novatek NT36XXX over I2C touchscreen connected
	  to your system.
	  Say M, compile into a module.

	  If unsure, say N.

config NOVATEK_TRUSTED_TOUCH
	bool "Novatek Trusted Touch"
	depends on TOUCHSCREEN_NT36XXX_I2C
	help
	  Say Y here to enable Novatek Trusted Touch over I2C.
	  It requires more on Trust VM.
	  Choose this when you need.

	  If unsure, say N.

config TOUCHSCREEN_NT36XXX_SPI
	tristate "Novatek NT36XXX over SPI"
	help
	  Say Y here if you have a Novatek NT36XXX over SPI touchscreen connected
	  to your system.
	  Say M, compile into a module.

	  If unsure, say N.
```

## drivers/input/touchscreen/nt36xxx_spi/Kconfig
```kconfig
#
# Novatek NT36xxx touchscreen driver configuration
#
config TOUCHSCREEN_NT36xxx_HOSTDL_SPI
	tristate "Novatek NT36xxx host download SPI driver"
	depends on SPI
	default y
	help
	  Say Y here if you have a Novatek NT36xxx no flash touchscreen connected
	  to your system by SPI bus.

	  If unsure, say N.
```

## drivers/input/touchscreen/nt36xxx_spi_bbb/Kconfig
```kconfig
#
# Novatek NT36xxx touchscreen driver configuration
#
config TOUCHSCREEN_NT36xxx_HOSTDL_SPI_BBB
	bool "Novatek NT36xxx host download SPI driver"
	depends on ( SPI || TOUCHSCREEN_AAAAAA_BBB )
	default n
	help
	  Say Y here if you have a Novatek NT36xxx no flash touchscreen connected
	  to your system by SPI bus.

	  If unsure, say N.

config TOUCHSCREEN_NT36xxx_HOSTDL_SPI_CCC
	bool "Novatek NT36xxx host download SPI driver"
	depends on ( SPI || TOUCHSCREEN_AAAAAA_CCC )
	default n
	help
	  Say Y here if you have a Novatek NT36xxx no flash touchscreen connected
	  to your system by SPI bus.

	  If unsure, say N.
```

## drivers/input/touchscreen/nt36xxx_spi_c3j/Kconfig
```kconfig
#
# Novatek NT36xxx touchscreen driver configuration
#
config TOUCHSCREEN_NT36xxx_HOSTDL_SPI_C3J
	bool "Novatek NT36xxx host download SPI driver"
	depends on ( SPI || TOUCHSCREEN_XIAOMI_C3J )
	default n
	help
	  Say Y here if you have a Novatek NT36xxx no flash touchscreen connected
	  to your system by SPI bus.

	  If unsure, say N.

config TOUCHSCREEN_NT36xxx_HOSTDL_SPI_C3X
	bool "Novatek NT36xxx host download SPI driver"
	depends on ( SPI || TOUCHSCREEN_XIAOMI_C3X )
	default n
	help
	  Say Y here if you have a Novatek NT36xxx no flash touchscreen connected
	  to your system by SPI bus.

	  If unsure, say N.
```

## drivers/input/touchscreen/nvt_touch_e7s/Kconfig
```kconfig
#
# Novatek NT36xxx touchscreen driver configuration
#
config TOUCHSCREEN_NVT_E7S
	tristate "Novatek touchscreens NT36xxx"
	help
		Say Y here if you have a Novatek NT36xxx touchscreen connected
		to your system.
		If unsure, say N.
```

## drivers/input/touchscreen/rmi4/Kconfig
```kconfig
#
# RMI4 configuration
#
config RMI4_CORE
	tristate "Synaptics RMI4 bus support"
	help
	  Say Y here if you want to support the Synaptics RMI4 bus.  This is
	  required for all RMI4 device support.

	  If unsure, say Y.

config RMI4_DEBUG
	bool "RMI4 Debugging"
	depends on RMI4_CORE
	select DEBUG_FS
	help
	  Say Y here to enable debug feature in the RMI4 driver.

	  Note that the RMI4 driver debug features can generate a lot of
	  output (potentially clogging up your dmesg output) and generally
	  slow down driver operation.  It's recommended to enable them only
	  if you are actively developing/debugging RMI4 features.

	  If unsure, say N.

config RMI4_FWLIB
	bool "RMI4 Firmware Update"
	depends on RMI4_CORE
	help
	  Say Y here to enable in-kernel firmware update capability.

	  The RMI4 core will check for firmware updates during the device
	  initialization process, and apply the updates if appropriate.

config RMI4_I2C
	tristate "RMI4 I2C Support"
	depends on RMI4_CORE && I2C
	help
	  Say Y here if you want to support RMI4 devices connected to an I2C
	  bus.

	  If unsure, say Y.


config RMI4_SPI
	tristate "RMI4 SPI Support"
	depends on RMI4_CORE && SPI
	help
	  Say Y here if you want to support RMI4 devices connected to an SPI
	  bus.

	  If unsure, say Y.

config RMI4_SMB
	tristate "RMI4 SMB Support"
	depends on RMI4_CORE
	help
	  Say Y here if you want to support RMI4 devices connected to an SMB
	  bus.

	  If unsure, say Y.


config RMI4_F1A
	tristate "RMI4 Function 1A (capacitive button sensor)"
	depends on RMI4_CORE
	help
	  Say Y here if you want to add support for RMI4 function 1A.

	  Function 1A provides self testing for touchscreens and touchpads.

	  To compile this driver as a module, choose M here: the
	  module will be called rmi-f1a.

config RMI4_F09
	tristate "RMI4 Function 09 (self testing)"
	depends on RMI4_CORE
	help
	  Say Y here if you want to add support for RMI4 function 09.

	  Function 09 provides self testing for touchscreens and touchpads.

	  To compile this driver as a module, choose M here: the
	  module will be called rmi-f09.

config RMI4_F11
	tristate "RMI4 Function 11 (2D pointing)"
	depends on RMI4_CORE
	help
	  Say Y here if you want to add support for RMI4 function 11.

	  Function 11 provides 2D multifinger pointing for touchscreens and
	  touchpads.  For sensors that support relative pointing, F11 also
	  provides mouse input.

	  To compile this driver as a module, choose M here: the
	  module will be called rmi-f11.

config RMI4_F11_PEN
	bool "RMI4 F11 Pen Support"
	depends on RMI4_F11
	help
	  Say Y here to add support for pen input to RMI4 function 11.

	  If this feature is enabled, when pen inputs are detected they
	  will be reported to the input stream as MT_TOOL_PEN.  Otherwise,
	  pens will be treated the same as fingers.

	  Not all UI implementations deal gracefully with pen discrimination.
	  If your system is not recognizing pen touches and you know your
	  sensor supports pen input, you probably want to turn this feature
	  off.

config RMI4_VIRTUAL_BUTTON
	tristate "RMI4 Vitual Button"
	depends on RMI4_F11
	help
	  Say Y here if you want to add support for RMI4 virtual button to F11.

	  The virtual button feature implement the virtual button device in
	  certain RMI4 touch sensors.

	  This works only if your sensor supports F11 gestures.

config RMI4_F17
	tristate "RMI4 Function 17 (pointing sticks)"
	depends on RMI4_CORE
	help
	  Say Y here if you want to add support for RMI4 function 17.

	  Function 19 provides support for capacitive and resistive
	  pointing sticks.

	  To compile this driver as a module, choose M here: the
	  module will be called rmi-f17.

config RMI4_F19
	tristate "RMI4 Function 19 (0D pointing)"
	depends on RMI4_CORE
	help
	  Say Y here if you want to add support for RMI4 function 19.

	  Function 19 provides support for capacitive buttons for sensors
	  that implement capacitive buttons.

	  To compile this driver as a module, choose M here: the
	  module will be called rmi-f19.

config RMI4_F21
	tristate "RMI4 Function 21 (2D Force)"
	depends on RMI4_CORE
	help
	  Say Y here if you want to add support for RMI4 function 21.

	  Function 21 provides 2D Force Sensing for ForcePad products.

	  To compile this driver as a module, choose M here: the
	  module will be called rmi-f21.

config RMI4_F30
	tristate "RMI4 Function 30 (GPIO LED)"
	depends on RMI4_CORE
	help
	  Say Y here if you want to add support for RMI4 function 30.

	  Function 30 provides GPIO LED support for sensors.

	  To compile this driver as a module, choose M here: the
	  module will be called rmi-f30.

config RMI4_F31
	tristate "RMI4 Function 31 (LED)"
	depends on RMI4_CORE
	help
	  Say Y here if you want to add support for RMI4 function 31.

	  Function 31 provides LED support for sensors.

	  To compile this driver as a module, choose M here: the
	  module will be called rmi-f31.

config RMI4_F34
	tristate "RMI4 Function 34 (device reflash)"
	depends on RMI4_CORE
	help
	  Say Y here if you want to add support for RMI4 function 34.

	  Function 34 provides firmware upgrade capability for your sensor.

	  To compile this driver as a module, choose M here: the
	  module will be called rmi-f34.

config RMI4_F41
	tristate "RMI4 Function 41 (active pen)"
	depends on RMI4_CORE
	help
	  Say Y here if you want to add support for RMI4 function 41.

	  Function 41 provides active pen support for active pen enabled sensors.

	  To compile this driver as a module, choose M here: the
	  module will be called rmi-f41.

config RMI4_F54
	tristate "RMI4 Function 54 (analog diagnostics)"
	depends on RMI4_CORE
	help
	  Say Y here if you want to add support for RMI4 function 54.

	  Function 54 provides access to various diagnostic features in
	  certain RMI4 touch sensors.

	  To compile this driver as a module, choose M here: the
	  module will be called rmi-f54.

config RMI4_DEV
	tristate "Synaptics direct RMI device support (rmidev)"
	depends on GPIO_SYSFS && (RMI4_I2C || RMI4_SPI)
	help
	  Say Y here to add support for rmidev.

	  The rmidev feature implements a character device providing access
	  to RMI4 sensor register maps.

	  To compile this driver as a module, choose M here: the
	  module will be called rmi-dev.
```

## drivers/input/touchscreen/st/Kconfig
```kconfig
#
# STMicroelectronics touchscreen driver configuration
#

#config TOUCHSCREEN_ST
#	bool "STMicroelectronics Touchscreen Driver"
#	default n
#	depends on I2C
#	help
#	  Say Y here if you have a STMicroelectronics Touchscreen.
#	  If unsure, say N.
#

#if TOUCHSCREEN_ST

config TOUCHSCREEN_ST_I2C
	#tristate "STMicroelectronics i2c touchscreen"
	string "STMicroelectronics ts directory name"
	default "st"
	depends on TOUCHSCREEN_ST
	help
	 This enables support for ST touch panel over I2C based touchscreens.

#endif
```

## drivers/input/touchscreen/synaptics_dsx/Kconfig
```kconfig
#
# Synaptics DSX touchscreen driver configuration
#
menuconfig TOUCHSCREEN_SYNAPTICS_DSX
	bool "Synaptics DSX touchscreen"
	help
	  Say Y here if you have a Synaptics DSX touchscreen connected
	  to your system.

	  If unsure, say N.

if TOUCHSCREEN_SYNAPTICS_DSX

choice
	default TOUCHSCREEN_SYNAPTICS_DSX_I2C
	prompt "Synaptics DSX bus interface"
config TOUCHSCREEN_SYNAPTICS_DSX_I2C
	bool "RMI over I2C"
	depends on I2C
config TOUCHSCREEN_SYNAPTICS_DSX_SPI
	bool "RMI over SPI"
	depends on SPI_MASTER
config TOUCHSCREEN_SYNAPTICS_DSX_RMI_HID_I2C
	bool "HID over I2C"
	depends on I2C
endchoice

config TOUCHSCREEN_SYNAPTICS_DSX_CORE
	tristate "Synaptics DSX core driver module"
	depends on I2C || SPI_MASTER
	help
	  Say Y here to enable basic touch reporting functionality.

	  If unsure, say N.

	  To compile this driver as a module, choose M here: the
	  module will be called synaptics_dsx_core.

config TOUCHSCREEN_SYNAPTICS_DSX_RMI_DEV
	tristate "Synaptics DSX RMI device module"
	depends on TOUCHSCREEN_SYNAPTICS_DSX_CORE
	help
	  Say Y here to enable support for direct RMI register access.

	  If unsure, say N.

	  To compile this driver as a module, choose M here: the
	  module will be called synaptics_dsx_rmi_dev.

config TOUCHSCREEN_SYNAPTICS_DSX_FW_UPDATE
	tristate "Synaptics DSX firmware update module"
	depends on TOUCHSCREEN_SYNAPTICS_DSX_CORE
	help
	  Say Y here to enable support for doing firmware update.

	  If unsure, say N.

	  To compile this driver as a module, choose M here: the
	  module will be called synaptics_dsx_fw_update.

config TOUCHSCREEN_SYNAPTICS_DSX_FW_UPDATE_EXTRA_SYSFS
	bool "Synaptics DSX firmware update sysfs attributes"
	depends on TOUCHSCREEN_SYNAPTICS_DSX_FW_UPDATE
	help
	  Say Y here to enable support for sysfs attributes for
	  performing firmware update in a development environment.
	  This does not affect the core or other subsystem attributes.

	  If unsure, say N.

config TOUCHSCREEN_SYNAPTICS_DSX_TEST_REPORTING
	tristate "Synaptics DSX test reporting module"
	depends on TOUCHSCREEN_SYNAPTICS_DSX_CORE
	help
	  Say Y here to enable support for retrieving production test reports.

	  If unsure, say N.

	  To compile this driver as a module, choose M here: the
	  module will be called synaptics_dsx_test_reporting.

config TOUCHSCREEN_SYNAPTICS_DSX_PROXIMITY
	tristate "Synaptics DSX proximity module"
	depends on TOUCHSCREEN_SYNAPTICS_DSX_CORE
	help
	  Say Y here to enable support for proximity functionality.

	  If unsure, say N.

	  To compile this driver as a module, choose M here: the
	  module will be called synaptics_dsx_proximity.

config TOUCHSCREEN_SYNAPTICS_DSX_ACTIVE_PEN
	tristate "Synaptics DSX active pen module"
	depends on TOUCHSCREEN_SYNAPTICS_DSX_CORE
	help
	  Say Y here to enable support for active pen functionality.

	  If unsure, say N.

	  To compile this driver as a module, choose M here: the
	  module will be called synaptics_dsx_active_pen.

config TOUCHSCREEN_SYNAPTICS_DSX_GESTURE
	tristate "Synaptics DSX user defined gesture module"
	depends on TOUCHSCREEN_SYNAPTICS_DSX_CORE
	help
	  Say Y here to enable support for user defined gesture functionality.

	  If unsure, say N.

	  To compile this driver as a module, choose M here: the
	  module will be called synaptics_dsx_gesture.

config TOUCHSCREEN_SYNAPTICS_DSX_VIDEO
	tristate "Synaptics DSX video module"
	depends on TOUCHSCREEN_SYNAPTICS_DSX_CORE
	help
	  Say Y here to enable support for video communication functionality.

	  If unsure, say N.

	  To compile this driver as a module, choose M here: the
	  module will be called synaptics_dsx_video.

config TOUCHSCREEN_SYNAPTICS_DSX_DEBUG
	tristate "Synaptics DSX debug module"
	depends on TOUCHSCREEN_SYNAPTICS_DSX_CORE
	help
	  Say Y here to enable support for firmware debug functionality.

	  If unsure, say N.

	  To compile this driver as a module, choose M here: the
	  module will be called synaptics_dsx_debug.

endif
```
