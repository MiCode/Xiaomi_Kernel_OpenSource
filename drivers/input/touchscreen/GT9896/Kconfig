## drivers/input/touchscreen/GT9896/Kconfig
```kconfig
#
# Goodix touchscreen driver configuration
#
config TOUCHSCREEN_GOODIX_GTX8
	bool "Goodix GTx8 touchscreen"
	depends on I2C
	default y
	help
	  Say Y here if you have a Goodix GTx8 touch controller
	  to your system.

	  If unsure, say N.

if TOUCHSCREEN_GOODIX_GTX8

config TOUCHSCREEN_GOODIX_GTX8_UPDATE
	tristate "Goodix GTx8 firmware update module"
	default y
	help
	  Say Y here to enable support for doing firmware update.

	  If unsure, say N.

	  To compile this driver as a module, choose M here.

config TOUCHSCREEN_GOODIX_GTX8_GESTURE
	tristate "Goodix GTx8 gesture wakeup feature"
	default y
	help
	  Say Y here to enable support for gesture wakeup feature..

	  If unsure, say N.

	  To compile this driver as a module, choose M here.

config TOUCHSCREEN_GOODIX_GTX8_TOOLS
	tristate "Goodix touch tools support"
	default y
	help
	  Say Y here to enable debug tools.

	  If unsure, say N.

	  To compile this driver as a module, choose M here.

endif
```

## drivers/input/touchscreen/GT9966/Kconfig
```kconfig
#
# Goodix touchscreen driver configuration
#
menuconfig TOUCHSCREEN_GOODIX_BRL
	tristate "Goodix berlin touchscreen"
	help
	  Say Y here if you have a Goodix berlin series touch controller
	  to your system.
	  If build module, say M.
	  If unsure, say N.
```

## drivers/input/touchscreen/IST30xx/Kconfig
```kconfig
config TOUCHSCREEN_IST30XX
	tristate "IMAGES IST30XX touchpanel driver"
	depends on CONFIG_INPUT_TOUCHSCREEN
	default n
```
