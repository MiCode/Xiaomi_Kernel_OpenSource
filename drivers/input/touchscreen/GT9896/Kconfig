## drivers/input/touchscreen/NT36525B/Kconfig
```kconfig
#
# Novatek NT36xxx touchscreen driver configuration
#
config CONFIG_TOUCHSCREEN_NT36525B
	bool "Novatek NT36xxx host download SPI driver"
	default n
	help
	  Say Y here if you have a Novatek NT36xxx no flash touchscreen connected
	  to your system by SPI bus.

	  If unsure, say N.
```

## drivers/input/touchscreen/NT36672A/Kconfig
```kconfig
#
# Novatek NT36xxx touchscreen driver configuration
#
config TOUCHSCREEN_NT36xxx_HOSTDL_SPI
	bool "Novatek NT36xxx host download SPI driver"
	default y
	help
	  Say Y here if you have a Novatek NT36xxx no flash touchscreen connected
	  to your system by SPI bus.

	  If unsure, say N.

config TOUCHSCREEN_NVT_DEBUG_FS
	bool "Touch debug interface"
	default y
	help
	  Control IRQ,suspend,sensor,debug firmware,etc.
```

## drivers/input/touchscreen/NT36672C/Kconfig
```kconfig
#
# Touchscreen driver configuration
#
menu "NT36672C support"
	depends on INPUT_TOUCHSCREEN

config TOUCH_FW_MP_ONE
	bool "TOUCH_FW_MP_ONE to determine novatek fw bin"
	help
	  To determine the novatek_firmware bin corresponding
	  to lcm_name.
endmenu
```

## drivers/input/touchscreen/NT36672C_SPI/Kconfig
```kconfig
#
# Novatek NT36xxx touchscreen driver configuration
#
config TOUCHSCREEN_NT36XXX_HOSTDL_SPI
# N19A code for HQ-359934 by p-huangyunbiao at 2023/12/19 start
	tristate "Novatek NT36xxx host download SPI driver"
# N19A code for HQ-378484 by p-huangyunbiao at 2024/3/20 start
	depends on TOUCHSCREEN_TPD_NOTIFY
	depends on DRM_PANEL_N19A_36_02_0A_DSC_VDO && DRM_PANEL_N19A_43_02_0C_DSC_VDO
# N19A code for HQ-378484 by p-huangyunbiao at 2024/3/20 end
	default n
# N19A code for HQ-359934 by p-huangyunbiao at 2023/12/19 end
	help
	  Say Y here if you have a Novatek NT36xxx no flash touchscreen connected
	  to your system by SPI bus.

	  If unsure, say N.
```

## drivers/input/touchscreen/NVT36672C/Kconfig
```kconfig
#
# Novatek NT36xxx touchscreen driver configuration
#
config TOUCHSCREEN_NVT36672C_HOSTDL_SPI
	tristate  "Novatek NT36xxx host download SPI driver"
	help
	  Say Y here if you have a Novatek NT36xxx no flash touchscreen connected
	  to your system by SPI bus.

	  If unsure, say N.
```

## drivers/input/touchscreen/aaabbb/Kconfig
```kconfig
config TOUCHSCREEN_AAABBB_TOUCHFEATURE
	tristate "Touch Feature"
	depends on INPUT_TOUCHSCREEN
	help
	  Say Y here if you enable feature.

	  If unsure, say N.

	  To compile this driver as a module, choose M here:
```

## drivers/input/touchscreen/f4_goodix_driver_gt9886/Kconfig
```kconfig
#
# Goodix touchscreen driver configuration
#
menuconfig TOUCHSCREEN_GOODIX_GTX9886_F4
	bool "Goodix GTx9886 touchscreen for F4"
	depends on I2C
	help
	  Say Y here if you have a Goodix GTx5xx touchscreen connected
	  to your system.

	  If unsure, say N.

if TOUCHSCREEN_GOODIX_GTX9886_F4

config TOUCHSCREEN_GOODIX_GTX8_UPDATE
	tristate "Goodix GTx8 firmware update module"
	default y
	help
	  Say Y here to enable support for doing firmware update.

	  If unsure, say N.

	  To compile this driver as a module, choose M here.

config TOUCHSCREEN_GOODIX_GTX8_GESTURE
	tristate "Goodix GTx8 gesture wakeup feature"
	default y
	help
	  Say Y here to enable support for gesture wakeup feature..

	  If unsure, say N.

	  To compile this driver as a module, choose M here.

config TOUCHSCREEN_GOODIX_GTX8_TOOLS
	tristate "Goodix touch tools support"
	default y
	help
	  Say Y here to enable debug tools.

	  If unsure, say N.

	  To compile this driver as a module, choose M here.

endif
```

## drivers/input/touchscreen/focaltech_3658u/Kconfig
```kconfig
#
# Focaltech Touchscreen driver configuration
#

config TOUCHSCREEN_FOCALTECH_3658U
    tristate "Focaltech Touchscreen"
    default n
    help
      Say Y here if you have Focaltech touch panel.

      If unsure, say N.

      To compile this driver as a module, choose M here: the
      module will be called focaltech_touch.

config TOUCHSCREEN_FTS_DIRECTORY
    string "Focaltech ts directory name"
    default "focaltech_touch"
    depends on TOUCHSCREEN_FTS
```

## drivers/input/touchscreen/focaltech_3680/Kconfig
```kconfig
#
# Focaltech Touchscreen driver configuration
#

config TOUCHSCREEN_FOCALTECH_3680
    tristate "Focaltech Touchscreen"
    default n
    help
      Say Y here if you have Focaltech touch panel.
      If unsure, say N.

config TOUCHSCREEN_FTS_DIRECTORY
    string "Focaltech ts directory name"
    default "focaltech_touch"
    depends on TOUCHSCREEN_FOCALTECH_3680
```

## drivers/input/touchscreen/focaltech_spi/Kconfig
```kconfig
#
# Focaltech Touchscreen driver configuration
#

config TOUCHSCREEN_FOCALTECH
    tristate "Focaltech Touchscreen"
    default n
    help
      Say Y here if you have Focaltech touch panel.

      If unsure, say N.

      To compile this driver as a module, choose M here: the
      module will be called focaltech_touch.

config TOUCHSCREEN_FTS_DIRECTORY
    string "Focaltech ts directory name"
    default "focaltech_touch"
    depends on TOUCHSCREEN_FTS


config TOUCHSCREEN_SUPPORT_NEW_GAME_MODE
    tristate "Touch Support New Game Mode"
    default n
    help
      Say Y here if the device support new game mode

      If not support, say N.
```

## drivers/input/touchscreen/focaltech_touch/Kconfig
```kconfig
#
# Focaltech Touchscreen driver configuration
#

config TOUCHSCREEN_FTS
	tristate "Focaltech Touchscreen"
	help
	  Say Y here if you have Focaltech touch panel.
	  If unsure, say N.

config TOUCHSCREEN_FTS_DIRECTORY
	string "Focaltech ts directory name"
	default "focaltech_touch"
	depends on TOUCHSCREEN_FTS

config FTS_TRUSTED_TOUCH
	bool "Focaltech Trusted Touch"
	depends on TOUCHSCREEN_FTS
	help
	  Say Y here to enable Focaltech Trusted Touch.
	  If unsure, say N.
```

## drivers/input/touchscreen/ft5435/Kconfig
```kconfig
#
# Focaltech Touchscreen driver configuration
#

config TOUCHSCREEN_FT5435
		bool "Focaltech Touchscreen"
		depends on I2C
		default n
		help
		  Say Y here if you have Focaltech touch panel.
		  If unsure, say N.

config TOUCHSCREEN_FT5435_DIRECTORY
	string "Focaltech ts directory name"
	default "focaltech_touch"
	depends on TOUCHSCREEN_FT5435
```

## drivers/input/touchscreen/ft5446/Kconfig
```kconfig
#
# Focaltech Touchscreen driver configuration
#

config TOUCHSCREEN_FT5446
        bool "Focaltech Touchscreen"
		depends on I2C
		default n
		help
		  Say Y here if you have Focaltech touch panel.
		  If unsure, say N.

config TOUCHSCREEN_FTS_DIRECTORY
    string "Focaltech ts directory name"
    default "focaltech_touch"
    depends on TOUCHSCREEN_FTS
```

## drivers/input/touchscreen/ft5x46/Kconfig
```kconfig
config TOUCHSCREEN_FT5X46
       tristate "FocalTech touchscreens"
       depends on I2C
       help
         Say Y here if you have a FT5X46 touchscreen.
	 Ft5x06 controllers are multi touch controllers which can
	 report 5 touches at a time.

         If unsure, say N.

         To compile this driver as a module, choose M here: the
         module will be called ft5x46_ts.

config TOUCHSCREEN_FT5X46_CALIBRATE
        bool "calibrate after flash firmware"
        depends on TOUCHSCREEN_FT5X46
        default y
        help
          must turn off after all pre-production device get upgrade.

config TOUCHSCREEN_FT5X46_TYPEB
        bool "use type B for touch report"
        depends on TOUCHSCREEN_FT5X46
        default y
        help
          enable typeB for multi-touch report.

config TOUCHSCREEN_FT5X46_I2C
        tristate "Focaltech FT5X0X I2C touchscreens"
        depends on I2C
        select TOUCHSCREEN_FT5X46
        help
          Say Y here if you have a Focaltech FT5X46 I2C touchscreen connected
          to your system.

          If unsure, say N.

          To compile this driver as a set of modules, choose M here: the
          modules will be called ft5x46_ts_i2c.

config TOUCHSCREEN_FT5X46_SPI
        tristate "Focaltech FT5X0X SPI touchscreens"
        depends on SPI
        select TOUCHSCREEN_FT5X46
        help
          Say Y here if you have a Focaltech FT5X46 SPI touchscreen connected
          to your system.

          If unsure, say N.

          To compile this driver as a set of modules, choose M here: the
          modules will be called ft5x46_ts_spi.

config TOUCHSCREEN_FT5X46P_PROXIMITY
        bool "focaltech touch proximity enable"
        depends on TOUCHSCREEN_FT5X46
        default n
        help
          focaltech touch proximity enable.
```

## drivers/input/touchscreen/ft8719_spi_bbb/Kconfig
```kconfig
#
# Focaltech Touchscreen driver configuration
#

config TOUCHSCREEN_FTS_BBB
	bool "Focaltech Touchscreen"
	depends on ( SPI || TOUCHSCREEN_AAAAAA_BBB )
	default n
	help
		Say Y here if you have Focaltech touch panel.
		If unsure, say N.
```

## drivers/input/touchscreen/ft8719_spi_c3j/Kconfig
```kconfig
#
# Focaltech Touchscreen driver configuration
#

config TOUCHSCREEN_FTS_C3J
	bool "Focaltech Touchscreen"
	depends on ( SPI || TOUCHSCREEN_XIAOMI_C3J )
	default n
	help
		Say Y here if you have Focaltech touch panel.
		If unsure, say N.
```

## drivers/input/touchscreen/fts/Kconfig
```kconfig
menuconfig CONFIG_TOUCHSCREEN_ST_FTS
	bool "St touchscreen"
	default y
	help
	  Say Y here if you have a St touchscreen connected
	  to your system.

	  If unsure, say N.

config TOUCHSCREEN_ST_CORE
	tristate "St core driver module"
	depends on I2C || SPI_MASTER
	help
	  Say Y here to enable basic touch reporting functionality.

	  If unsure, say N.

	  To compile this driver as a module, choose M here: the
	  module will be called fts.

config TOUCHSCREEN_ST_GUI
	tristate "St gui driver module"
	depends on TOUCHSCREEN_ST_CORE
	help
	  Say Y here to enable touch gui functionality.

	  If unsure, say N.

	  To compile this driver as a module, choose M here: the
	  module will be called fts_gui.


config TOUCHSCREEN_ST_DRIVER_TEST
	tristate "St core driver test module"
	depends on TOUCHSCREEN_ST_CORE
	help
	  Say Y here to enable touch driver test functionality.

	  If unsure, say N.

	  To compile this driver as a module, choose M here: the
	  module will be called fts_driver_test.

config TOUCHSCREEN_ST_DEBUG_FS
	tristate "St core driver module"
	depends on TOUCHSCREEN_ST_CORE
	help
	  Say Y here to enable  touch debugfs functionality.

	  If unsure, say N.
```

## drivers/input/touchscreen/fts8719/Kconfig
```kconfig
#
# Focaltech Touchscreen driver configuration
#

config TOUCHSCREEN_FTS
    bool "Focaltech Touchscreen"
    default n
    help
      Say Y here if you have Focaltech touch panel.
      If unsure, say N.

config TOUCHSCREEN_FTS_DIRECTORY
    string "Focaltech ts directory name"
    default "focaltech_touch"
    depends on TOUCHSCREEN_FTS
```

## drivers/input/touchscreen/fts_521/Kconfig
```kconfig
config TOUCHSCREEN_ST_FTS_V521
	tristate "ST FTS V521 I2C Touchscreen"
	depends on I2C
	help
	  Say Y here if you have ST FTS series I2C touchscreen.

	  If unsure, say N.

	  To compile this driver as a module, choose M here: the

config FTS_FOD_AREA_REPORT
	tristate "FTS FOD area report"
	depends on TOUCHSCREEN_ST_FTS_V521
	help
          Say Y here to enable  fod area report functionality.

          If unsure, say N.

config TOUCHSCREEN_ST_DEBUG_FS
	tristate "St core driver module"
	depends on TOUCHSCREEN_ST_FTS_V521
	help
          Say Y here to enable  touch debugfs functionality.

          If unsure, say N.
```

## drivers/input/touchscreen/fts_dual/Kconfig
```kconfig
config TOUCHSCREEN_ST_FTS_V521_DUAL
	tristate "ST FTS V521 DUAL Touchscreen"
	depends on I2C
	help
	  Say Y here if you have ST FTS series I2C touchscreen.

	  If unsure, say N.

	  To compile this driver as a module, choose M here: the
source "drivers/input/touchscreen/fts_dual/xiaomi/Kconfig"
```

## drivers/input/touchscreen/fts_spi/Kconfig
```kconfig
config TOUCHSCREEN_ST_FTS_V521_SPI
	tristate "ST FTS V521 I2C Touchscreen"
	depends on I2C
	help
	  Say Y here if you have ST FTS series I2C touchscreen.

	  If unsure, say N.

	  To compile this driver as a module, choose M here: the
```
