## drivers/input/touchscreen/mediatek/GT9271TB_hotknot/Kconfig
```kconfig
#
# Touchscreen driver configuration
#
if TOUCHSCREEN_MTK_GT9271TB_HOTKNOT

config GT9271_FIRMWARE
	string "GT9271 for Mediatek firmware"

config GT9271_CONFIG
	string "GT9271 for Mediatek config"

config GTP_DRIVER_SEND_CFG
	bool "GT9271 for Mediatek package"
	default n
	help
	Say Y here if you have GT9271 touch panel GTP_DRIVER_SEND_CFG.

	If unsure, say N.

	To compile this dirver as a module, choose M here: the
	module will be called.

config GTP_CUSTOM_CFG
	bool "GT9271 for Mediatek package"
	default n
	help
	Say Y here if you have GT9271 touch panel GTP_CUSTOM_CFG.

	If unsure, say N.

	To compile this dirver as a module, choose M here: the
	module will be called.

config GTP_HAVE_TOUCH_KEY
	bool "GT9271 for Mediatek package"
	default n
	help
	Say Y here if you have GT9271 touch panel GTP_HAVE_TOUCH_KEY.

	If unsure, say N.

	To compile this dirver as a module, choose M here: the
	module will be called.

config GTP_CHANGE_X2Y
	bool "GT9271 for Mediatek package"
	default n
	help
	Say Y here if you have GT9271 touch panel GTP_CHANGE_X2Y.

	If unsure, say N.

	To compile this dirver as a module, choose M here: the
	module will be called.

config GTP_COMPATIBLE_MODE
	bool "GT9271 for Mediatek package"
	default n
	help
	Say Y here if you have GT9271 touch panel GTP_COMPATIBLE_MODE.

	If unsure, say N.

	To compile this dirver as a module, choose M here: the
	module will be called.

config GTP_WARP_X_ON
	bool "GT9271 for Mediatek package"
	default n
	help
	Say Y here if you have GT9271 touch panel GTP_WARP_X_ON.

	If unsure, say N.

	To compile this dirver as a module, choose M here: the
	module will be called.

config GTP_WARP_Y_ON
	bool "GT9271 for Mediatek package"
	default n
	help
	Say Y here if you have GT9271 touch panel GTP_WARP_Y_ON.

	If unsure, say N.

	To compile this dirver as a module, choose M here: the
	module will be called.

config GTP_GESTURE_WAKEUP
	bool "GT9271 for Mediatek package"
	default n
	help
	Say Y here if you have GT9271 touch panel GTP_GESTURE_WAKEUP.

	If unsure, say N.

	To compile this dirver as a module, choose M here: the
	module will be called.

config HOTKNOT_BLOCK_RW
	bool "GT9271 for Mediatek package"
	default n
	help
	Say Y here if you have GT9271 touch panel HOTKNOT_BLOCK_RW.

	If unsure, say N.

	To compile this dirver as a module, choose M here: the
	module will be called.

config GTP_PROXIMITY
	bool "GT9271 for Mediatek package"
	default n
	help
	Say Y here if you have GT9271 touch panel GTP_PROXIMITY.

	If unsure, say N.

	To compile this dirver as a module, choose M here: the
	module will be called.

config GTP_WITH_PEN
	bool "GT9271 for Mediatek package"
	default n
	help
	Say Y here if you have GT9271 touch panel GTP_WITH_PEN.

	If unsure, say N.

	To compile this dirver as a module, choose M here: the
	module will be called.

config GTP_AUTO_UPDATE
	bool "GT9271 for Mediatek package"
	default n
	help
	Say Y here if you have GT9271 touch panel GTP_AUTO_UPDATE.

	If unsure, say N.

	To compile this dirver as a module, choose M here: the
	module will be called.

config GTP_AUTO_UPDATE_CFG
	bool "GT9271 for Mediatek package"
	default n
	help
	Say Y here if you have GT9271 touch panel GTP_AUTO_UPDATE_CFG.

	If unsure, say N.

	To compile this dirver as a module, choose M here: the
	module will be called.

config GTP_HEADER_FW_UPDATE
	bool "GT9271 for Mediatek package"
	default n
	help
	Say Y here if you have GT9271 touch panel GTP_HEADER_FW_UPDATE.

	If unsure, say N.

	To compile this dirver as a module, choose M here: the
	module will be called.

config GTP_SUPPORT_I2C_DMA
	bool "GT9271 for Mediatek package"
	default n
	help
	Say Y here if you have GT9271 touch panel GTP_SUPPORT_I2C_DMA.

	If unsure, say N.

	To compile this dirver as a module, choose M here: the
	module will be called.

config GTP_CREATE_WR_NODE
	bool "GT9271 for Mediatek package"
	default n
	help
	Say Y here if you have GT9271 touch panel GTP_CREATE_WR_NODE.

	If unsure, say N.

	To compile this dirver as a module, choose M here: the
	module will be called.

config GTP_ESD_PROTECT
	bool "GT9271 for Mediatek package"
	default n
	help
	Say Y here if you have GT9271 touch panel GTP_ESD_PROTECT.

	If unsure, say N.

	To compile this dirver as a module, choose M here: the
	module will be called.

config GTP_CHARGER_DETECT
	bool "GT9271 for Mediatek package"
	default n
	help
	Say Y here if you have GT9271 touch panel GTP_CHARGER_DETECT.

	If unsure, say N.

	To compile this dirver as a module, choose M here: the
	module will be called.

config GTP_CHARGER_SWITCH
	bool "GT9271 for Mediatek package"
	default n
	help
	Say Y here if you have GT9271 touch panel GTP_CHARGER_SWITCH.

	If unsure, say N.

	To compile this dirver as a module, choose M here: the
	module will be called.

config GTP_DEBUG_ARRAY_ON
	bool "GT9271 for Mediatek package"
	default n
	help
	Say Y here if you have GT9271 touch panel GTP_DEBUG_ARRAY_ON.

	If unsure, say N.

	To compile this dirver as a module, choose M here: the
	module will be called.

config GTP_DEBUG_FUNC_ON
	bool "GT9271 for Mediatek package"
	default n
	help
	Say Y here if you have GT9271 touch panel GTP_DEBUG_FUNC_ON.

	If unsure, say N.

	To compile this dirver as a module, choose M here: the
	module will be called.

config GTP_POWER_CTRL_SLEEP
	bool "GT9271 for Mediatek package"
	default n
	help
	Say Y here if you have GT9271 touch panel GTP_POWER_CTRL_SLEEP.

	If unsure, say N.

	To compile this dirver as a module, choose M here: the
	module will be called.
endif
```

## drivers/input/touchscreen/mediatek/GT928/Kconfig
```kconfig
#
# Touchscreen driver configuration
#
if TOUCHSCREEN_MTK_GT928

config GT928_FIRMWARE
	string "GT928 for Mediatek firmware"

config GT928_CONFIG
	string "GT928 for Mediatek config"

config GTP_DRIVER_SEND_CFG
	bool "GT928 for Mediatek package"
	default n
	help
	Say Y here if you have GT928 touch panel GTP_DRIVER_SEND_CFG.

	If unsure, say N.

	To compile this dirver as a module, choose M here: the
	module will be called.

config GTP_CUSTOM_CFG
	bool "GT928 for Mediatek package"
	default n
	help
	Say Y here if you have GT928 touch panel GTP_CUSTOM_CFG.

	If unsure, say N.

	To compile this dirver as a module, choose M here: the
	module will be called.

config GTP_CHANGE_X2Y
	bool "GT928 for Mediatek package"
	default n
	help
	Say Y here if you have GT928 touch panel GTP_CHANGE_X2Y.

	If unsure, say N.

	To compile this dirver as a module, choose M here: the
	module will be called.

config GTP_WARP_X_ON
	bool "GT928 for Mediatek package"
	default n
	help
	Say Y here if you have GT928 touch panel GTP_WARP_X_ON.

	If unsure, say N.

	To compile this dirver as a module, choose M here: the
	module will be called.

config GTP_WARP_Y_ON
	bool "GT928 for Mediatek package"
	default n
	help
	Say Y here if you have GT928 touch panel GTP_WARP_Y_ON.

	If unsure, say N.

	To compile this dirver as a module, choose M here: the
	module will be called.

config GTP_GESTURE_WAKEUP
	bool "GT928 for Mediatek package"
	default n
	help
	Say Y here if you have GT928 touch panel GTP_GESTURE_WAKEUP.

	If unsure, say N.

	To compile this dirver as a module, choose M here: the
	module will be called.

config GTP_HOTKNOT
	bool "GT928 for Mediatek package"
	default n
	help
	Say Y here if you have GT928 touch panel GTP_HOTKNOT.

	If unsure, say N.

	To compile this dirver as a module, choose M here: the
	module will be called.

config HOTKNOT_TYPE
	bool "GT928 for Mediatek package"
	default n
	help
	Say Y here if you have GT928 touch panel HOTKNOT_TYPE.

	If unsure, say N.

	To compile this dirver as a module, choose M here: the
	module will be called.

config HOTKNOT_BLOCK_RW
	bool "GT928 for Mediatek package"
	default n
	help
	Say Y here if you have GT928 touch panel HOTKNOT_BLOCK_RW.

	If unsure, say N.

	To compile this dirver as a module, choose M here: the
	module will be called.

config GTP_PROXIMITY
	bool "GT928 for Mediatek package"
	default n
	help
	Say Y here if you have GT928 touch panel GTP_PROXIMITY.

	If unsure, say N.

	To compile this dirver as a module, choose M here: the
	module will be called.

config GTP_WITH_STYLUS
	bool "GT928 for Mediatek package"
	default n
	help
	Say Y here if you have GT928 touch panel GTP_WITH_STYLUS.

	If unsure, say N.

	To compile this dirver as a module, choose M here: the
	module will be called.

config GTP_HAVE_STYLUS_KEY
	bool "GT928 for Mediatek package"
	default n
	help
	Say Y here if you have GT928 touch panel GTP_HAVE_STYLUS_KEY.

	If unsure, say N.

	To compile this dirver as a module, choose M here: the
	module will be called.

config GTP_AUTO_UPDATE
	bool "GT928 for Mediatek package"
	default n
	help
	Say Y here if you have GT928 touch panel GTP_AUTO_UPDATE.

	If unsure, say N.

	To compile this dirver as a module, choose M here: the
	module will be called.

config GTP_HEADER_FW_UPDATE
	bool "GT928 for Mediatek package"
	default n
	help
	Say Y here if you have GT928 touch panel GTP_HEADER_FW_UPDATE.

	If unsure, say N.

	To compile this dirver as a module, choose M here: the
	module will be called.

config GTP_CREATE_WR_NODE
	bool "GT928 for Mediatek package"
	default n
	help
	Say Y here if you have GT928 touch panel GTP_CREATE_WR_NODE.

	If unsure, say N.

	To compile this dirver as a module, choose M here: the
	module will be called.

config GTP_ESD_PROTECT
	bool "GT928 for Mediatek package"
	default n
	help
	Say Y here if you have GT928 touch panel GTP_ESD_PROTECT.

	If unsure, say N.

	To compile this dirver as a module, choose M here: the
	module will be called.

config GTP_CHARGER_SWITCH
	bool "GT928 for Mediatek package"
	default n
	help
	Say Y here if you have GT928 touch panel GTP_CHARGER_SWITCH.

	If unsure, say N.

	To compile this dirver as a module, choose M here: the
	module will be called.

config GTP_DEBUG_ARRAY_ON
	bool "GT928 for Mediatek package"
	default n
	help
	Say Y here if you have GT928 touch panel GTP_DEBUG_ARRAY_ON.

	If unsure, say N.

	To compile this dirver as a module, choose M here: the
	module will be called.

config GTP_DEBUG_FUNC_ON
	bool "GT928 for Mediatek package"
	default n
	help
	Say Y here if you have GT928 touch panel GTP_DEBUG_FUNC_ON.

	If unsure, say N.

	To compile this dirver as a module, choose M here: the
	module will be called.
endif
```
