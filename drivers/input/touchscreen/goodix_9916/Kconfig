## drivers/input/touchscreen/goodix_9916/Kconfig
```kconfig
#
# Goodix touchscreen driver configuration
#
config TOUCHSCREEN_GOODIX_BRL_9916
	tristate "Goodix berlin touchscreen"
	default n
	help
	  Say Y here if you have a Goodix berlin series touch controller
	  to your system.
	  If build module, say M.
	  If unsure, say N.
```

## drivers/input/touchscreen/goodix_9916_l9s/Kconfig
```kconfig
#
# Goodix touchscreen driver configuration
#
config TOUCHSCREEN_GOODIX_BRL_9916_L9S
	tristate "Goodix berlin touchscreen"
	default n
	help
	  Say Y here if you have a Goodix berlin series touch controller
	  to your system.
	  If build module, say M.
	  If unsure, say N.
```

## drivers/input/touchscreen/gt1151q/Kconfig
```kconfig
#
# Touchscreen driver configuration
#
config TOUCHSCREEN_GX
	bool "GOODIX GT1X Touchscreen"
	default y
	help
	  Say Y here if you have GOODIX GT1X Touchscreen.

	  If unsure, say N.
```

## drivers/input/touchscreen/gt1511q/Kconfig
```kconfig
#
# Touchscreen driver configuration
#
menuconfig TOUCHSCREEN_GOODIX_GT1X
	bool "GOODIX GT1X Touchscreen"
	default y
	help
	  Say Y here if you have GOODIX GT1X Touchscreen.

	  If unsure, say N.

if TOUCHSCREEN_GOODIX_GT1X
config GTP_INT_SEL_SYNC
	bool "GTP INT GPIO SELECT I2C-ADDR AND SYNC"
	default y
	help
	  Say Y here if your want int gpio select i2c-addr

	  If unsure, say N

config GTP_INCELL_PANEL
	bool "GTP_INCELL_PANEL"
	default n
	help
	Say Y here if you have GT1152 incell panel..

	If unsure, say N.

config GTP_DRIVER_SEND_CFG
	bool "GTP_DRIVER_SEND_CONFIG"
	default y
	help
	Say Y here if you want touch driver send chip config
	data to hardware.

	If unsure, say N.

config GTP_CUSTOM_CFG
	bool "GTP_CUSTOM_CONFIG"
	default y
	help
	Say Y here if you want to customize the resolution and
	INT trigger type.

	If unsure, say N.

config GTP_CHANGE_X2Y
	bool "GTP_CHANGE_X2Y"
	default n
	help
	Say Y here if you want to change x/y coordinate.

	If unsure, say N.

config GTP_WARP_X_ON
	bool "GTP_WARP_X_ON"
	default n
	help
	Say Y here if you want to mirror x.

	If unsure, say N.

config GTP_WARP_Y_ON
	bool "GTP_WARP_Y_ON"
	default n
	help
	Say Y here if you want to mirror y.

	If unsure, say N.

config GTP_GESTURE_WAKEUP
	bool "GTP_GESTURE_WAKEUP Feature"
	default y
	help
	Say Y here if you want to enable gesture feature.

	If unsure, say N.

config GTP_EDGE_INHIBITION
	bool "GTP_EDGE_INHIBITION Feature"
	default n
	help
	Say Y here if you want to send cmd change edge Inhibition feature.

	If unsure, say N.

config GTP_HOTKNOT
	bool "GTP_HOTKNOT Feature"
	default n
	help
	Say Y here if you want to enable hotknot feature.

	If unsure, say N.

config HOTKNOT_BLOCK_RW
	bool "HOTKNOT_BLOCK_RW"
	default n
	help
	Say Y here if you have want to enable blocking rw
	feature when using hotknot.

	If unsure, say N.

config GTP_FW_UPDATE_VERIFY
	bool "GTP_FW_UPDATE_VERIFY"
	default n
	help
	Say Y here if you want verify firmware in chip flash
	during firmware update, it's unnecessary to enable
	verification if you use the latest firmwrae.

	If unsure, say N.

config GTP_HAVE_TOUCH_KEY
	bool "GTP_HAVE_TOUCH_KEY"
	default n
	help
	Say Y here if you have touch key.

	If unsure, say N.

config GTP_PROXIMITY
	bool "GTP_PROXIMITY Feature"
	default n
	help
	Say Y here if you want enable proximity feature.

	If unsure, say N.

config GTP_WITH_STYLUS
	bool "GTP_WITH_STYLUS"
	default n
	help
	Say Y here if you have pen.

	If unsure, say N.

config GTP_HAVE_STYLUS_KEY
	bool "GTP_HAVE_STYLUS_KEY"
	default n
	help
	Say Y here if you have GTP_HAVE_STYLUS_KEY.

	If unsure, say N.

config GTP_AUTO_UPDATE
	bool "GTP_AUTO_UPDATE"
	default y
	help
	Say Y here if you want to check and update firmware
	during kernel booting.

	If unsure, say N.

config GTP_ITO_TEST_SELF
	bool "GTP_ITO_TEST_SELF"
	default y
	help
	Say Y here if you want to test TP ITO
	during kernel booting.

	If unsure, say N.

config GTP_CREATE_WR_NODE
	bool "GTP_CREATE_WR_NODE DebugTools Node"
	default y
	help
	Say Y here if you want to use Goodix debug tools..

	If unsure, say N.

config GTP_ESD_PROTECT
	bool "GTP_ESD_PROTECT"
	default n
	help
	Say Y here if you want ESD protection.

	If unsure, say N.

config GTP_CHARGER_SWITCH
	bool "GTP_CHARGER_SWITCH"
	default n
	help
	Say Y here if you want ot turn on charger detector.

	If unsure, say N.

config GTP_POWER_CTRL_SLEEP
	bool "GTP_POWER_CTRL_SLEEP"
	default n
	help
	Say Y here if you want ot power off touch panel
	after suspend.

	If unsure, say N.

config GTP_TYPE_B_PROTOCOL
	bool "GTP_TYPE_B_PROTOCOL"
	default y
	help
	Say Y here if you want to use input type B protocol.

	If unsure, say N.

config GTP_SMART_COVER
	bool "GTP_SMART_COVER"
	default n
	help
	Say Y here if you want to use smart cover feature.

	If unsure, say N.

config GTP_DEBUG_ON
	bool "GTP_DEBUG_ON"
	default n
	help
	Say Y here if you want to keep debug logs.

	If unsure, say N.

config GTP_DEBUG_ARRAY_ON
	bool "GTP_DEBUG_ARRAY_ON"
	depends on GTP_DEBUG_ON
	default n
	help
	Say Y here if you have GTP_DEBUG_ARRAY_ON.

	If unsure, say N.

config GTP_DEBUG_FUNC_ON
	bool "GTP_DEBUG_FUNC_ON"
	depends on GTP_DEBUG_ON
	default n
	help
	Say Y here if you have GTP_DEBUG_FUNC_ON.

	If unsure, say N.

config TPD_HAVE_BUTTON
	bool "TPD_HAVE_BUTTON"
	depends on MTK_PLATFORM
	default n
	help
	Say Y here if you have tpd button.

	If unsure, say N.

config GTP_REQUEST_FW_UPDATE
	bool "GTP_REQUEST_FW_UPDATE"
	default y
	help
	Say Y here if you have touch panel GTP_REQUEST_FW_UPDATE.

	If unsure, say N.

	To compile this dirver as a module, choose M here: the
	module will be called.

endif
```

## drivers/input/touchscreen/gt9896/Kconfig
```kconfig
#
# Goodix touchscreen driver configuration
#
config TOUCHSCREEN_GOODIX_GTX9896_I2C
	bool "Goodix GTx8 touchscreen"
	depends on I2C
	help
	  Say Y here if you have a Goodix GTX9896 touch controller
	  to your system.

	  If unsure, say N.

if TOUCHSCREEN_GOODIX_GTX9896_I2C

config TOUCHSCREEN_GOODIX_GTX9896_UPDATE
	tristate "Goodix GTx9896 firmware update module"
	default y
	help
	  Say Y here to enable support for doing firmware update.

	  If unsure, say N.

	  To compile this driver as a module, choose M here.

config TOUCHSCREEN_GOODIX_GTX9896_GESTURE
	tristate "Goodix GTx9896 gesture wakeup feature"
	default y
	help
	  Say Y here to enable support for gesture wakeup feature..

	  If unsure, say N.

	  To compile this driver as a module, choose M here.

config TOUCHSCREEN_GOODIX_GTX9896_TOOLS
	tristate "Goodix touch tools support"
	default y
	help
	  Say Y here to enable debug tools.

	  If unsure, say N.

	  To compile this driver as a module, choose M here.

endif
```

## drivers/input/touchscreen/gt9897t/Kconfig
```kconfig
config TOUCHSCREEN_GOODIX_BRL
	tristate "Goodix 9897 Touchscreen"
	default n
	depends on SPI_MASTER
	help
	  Say Y here if you have Goodix series I2C touchscreen.

	  If unsure, say N.

	  To compile this driver as a module, choose M here.

config TOUCHSCREEN_GOODIX_TS_TOOLS
	tristate "Goodix debug tools support"
	default n
	depends on TOUCHSCREEN_GOODIX_BRL
	help
	  Say Y here to enable debug tools

	  If unsure, say N.

	  To compile this driver as a module, choose M here.

config TOUCHSCREEN_GOODIX_TS_GESTURE
	tristate "Goodix gesture support"
	default n
	depends on TOUCHSCREEN_GOODIX_BRL
	help
	  Say Y to enable gesture

	  If unsure, say N.

	  To compile this driver as a module, choose M here.
```

## drivers/input/touchscreen/gt9xx/Kconfig
```kconfig
#
# Goodix GT9xx Touchscreen driver
#
config TOUCHSCREEN_GT9XX
	bool "Goodix touchpanel GT9xx series"
	depends on I2C
	help
	  Say Y here if you have a Goodix GT9xx touchscreen
	  controller.

          If unsure, say N.

config TOUCHSCREEN_GT9XX_UPDATE
	tristate "Goodix GT9xx touch controller auto update support"
	depends on TOUCHSCREEN_GT9XX
	default n
	help
	  Enable this for support firmware update.

	  Say Y here if you want update touch controller firmware.

	  If unsure, say N.

config TOUCHSCREEN_GT9XX_DEBUG
	tristate "Goodix GT9xx Tools for debuging"
	depends on TOUCHSCREEN_GT9XX
	default n
	help
	  This implement interface support for Goodix GT9xx
	  touchscreen debug.

	  Say Y here if you want to have a Android app debug interface
	  to your system.

	  If unsure, say N.

config TOUCHSCREEN_GT9XX_DEBUG_FS
	bool "touch debugfs suport"
	default n
	depends on DEBUG_FS
	help
	  Say Y here to enable support for touch debugfs.
config TOUCHSCREEN_GT9XX_SELFTEST
	tristate "Goodix GT9xx selftest test"
	depends on TOUCHSCREEN_GT9XX
	default n
	help
	  Say Y here if you want to do selftest
```

## drivers/input/touchscreen/gt9xx_v2.8/Kconfig
```kconfig
#
# Goodix GT9xx Touchscreen driver
#
config TOUCHSCREEN_GT9XX_v28
	bool "Goodix touchpanel GT9xx series"
	depends on I2C
	help
	  Enable this for support Goodix GT9xx_v28 driver.

	  Say Y here if you have a Goodix GT9xx touchscreen
	  controller.

          If unsure, say N.

config TOUCHSCREEN_GT9XX_UPDATE
	tristate "Goodix GT9xx touch controller auto update support"
	depends on TOUCHSCREEN_GT9XX_v28
	help
	  Enable this for support firmware update.

	  Say Y here if you want update touch controller
	  firmware.

	  If unsure, say N.

config TOUCHSCREEN_GT9XX_TOOL
	tristate "Goodix GT9xx Tools for debuging"
	depends on TOUCHSCREEN_GT9XX_v28
	help
	  This implement interface support for Goodix GT9xx
	  touchscreen debug.

	  Say Y here if you want to have a Android app debug interface
	  to your system.

	  If unsure, say N.
```

## drivers/input/touchscreen/gt9xx_zql6019/Kconfig
```kconfig
#
# Goodix GT9xx Touchscreen driver
#
config TOUCHSCREEN_GT9XX
	bool "Goodix touchpanel GT9xx series"
	depends on I2C
	help
	  Say Y here if you have a Goodix GT9xx touchscreen
	  controller.

	  If unsure, say N.

config TOUCHSCREEN_GT9XX_UPDATE
	tristate "Goodix GT9xx touch controller auto update support"
	depends on TOUCHSCREEN_GT9XX
	default y
	help
	  Enable this for support firmware update.

	  Say Y here if you want update touch controller firmware.

	  If unsure, say N.

config TOUCHSCREEN_GT9XX_TOOL
	tristate "Goodix GT9xx Tools for debuging"
	depends on TOUCHSCREEN_GT9XX
	default y
	help
	  This implement interface support for Goodix GT9xx
	  touchscreen debug.

	  Say Y here if you want to have a Android app debug interface
	  to your system.

	  If unsure, say N.
```

## drivers/input/touchscreen/hxchipset/Kconfig
```kconfig
#
# Himax Touchscreen driver configuration
#

config TOUCHSCREEN_HIMAX_COMMON
        tristate "HIMAX chipset i2c touchscreen"
		depends on TOUCHSCREEN_HIMAX_CHIPSET
		help
		This enables support for HIMAX CHIPSET touchscreens.

choice
	prompt "HIMAX touch IC types"
	depends on TOUCHSCREEN_HIMAX_COMMON
	default TOUCHSCREEN_HIMAX_INCELL

config TOUCHSCREEN_HIMAX_ONCELL
        bool "HIMAX chipset on-cell function"
		depends on TOUCHSCREEN_HIMAX_COMMON
		help
		This enables support for HIMAX CHIPSET of on-cell function.

config TOUCHSCREEN_HIMAX_INCELL
        bool "HIMAX chipset in-cell function"
		depends on TOUCHSCREEN_HIMAX_COMMON
		help
		This enables support for HIMAX CHIPSET of in-cell function.

endchoice

# ***************** On-cell Start *****************
config TOUCHSCREEN_HIMAX_IC_HX852xH
        tristate "HIMAX chipset HX852xH function"
		depends on TOUCHSCREEN_HIMAX_ONCELL
		help
		This enables support for HIMAX CHIPSET of HX852xH.

config TOUCHSCREEN_HIMAX_IC_HX852xG
        tristate "HIMAX chipset HX852xG function"
		depends on TOUCHSCREEN_HIMAX_ONCELL
		help
		This enables support for HIMAX CHIPSET of HX852xG.

config TOUCHSCREEN_HIMAX_IC_HX852xJ
        tristate "HIMAX chipset HX852xJ function"
		depends on TOUCHSCREEN_HIMAX_ONCELL
		help
		This enables support for HIMAX CHIPSET of HX852xJ.

# ***************** On-cell End *******************
# ***************** In-cell Start *****************
config TOUCHSCREEN_HIMAX_IC_HX83192
        tristate "HIMAX chipset HX83192 function"
		depends on TOUCHSCREEN_HIMAX_INCELL
		help
		This enables support for HIMAX CHIPSET of HX83192.

config TOUCHSCREEN_HIMAX_IC_HX83191
        tristate "HIMAX chipset HX83191 function"
		depends on TOUCHSCREEN_HIMAX_INCELL
		help
		This enables support for HIMAX CHIPSET of HX83191.

config TOUCHSCREEN_HIMAX_IC_HX83113
        tristate "HIMAX chipset HX83113 function"
		depends on TOUCHSCREEN_HIMAX_INCELL
		help
		This enables support for HIMAX CHIPSET of HX83113.

config TOUCHSCREEN_HIMAX_IC_HX83112
        tristate "HIMAX chipset HX83112 function"
		depends on TOUCHSCREEN_HIMAX_INCELL
		help
		This enables support for HIMAX CHIPSET of HX83112.

config TOUCHSCREEN_HIMAX_IC_HX83111
        tristate "HIMAX chipset HX83111 function"
		depends on TOUCHSCREEN_HIMAX_INCELL
		help
		This enables support for HIMAX CHIPSET of HX83111.

config TOUCHSCREEN_HIMAX_IC_HX83106
        tristate "HIMAX chipset HX83106 function"
		depends on TOUCHSCREEN_HIMAX_INCELL
		help
		This enables support for HIMAX CHIPSET of HX83106.

config TOUCHSCREEN_HIMAX_IC_HX83108
        tristate "HIMAX chipset HX83108 function"
		depends on TOUCHSCREEN_HIMAX_INCELL
		help
		This enables support for HIMAX CHIPSET of HX83108.

config TOUCHSCREEN_HIMAX_IC_HX83103
        tristate "HIMAX chipset HX83103 function"
		depends on TOUCHSCREEN_HIMAX_INCELL
		help
		This enables support for HIMAX CHIPSET of HX83103.

config TOUCHSCREEN_HIMAX_IC_HX83102
        tristate "HIMAX chipset HX83102 function"
		depends on TOUCHSCREEN_HIMAX_INCELL
		help
		This enables support for HIMAX CHIPSET of HX83102.

config TOUCHSCREEN_HIMAX_IC_HX83121
        tristate "HIMAX chipset HX83121 function"
		depends on TOUCHSCREEN_HIMAX_INCELL
		help
		This enables support for HIMAX CHIPSET of HX83121.

# ***************** In-cell End *******************

config TOUCHSCREEN_HIMAX_DEBUG
        bool "HIMAX debug function"
		depends on TOUCHSCREEN_HIMAX_INCELL || TOUCHSCREEN_HIMAX_ONCELL
		help
		This enables support for HIMAX debug function.
config TOUCHSCREEN_HIMAX_INSPECT
        bool "HIMAX inspect function"
		depends on TOUCHSCREEN_HIMAX_INCELL || TOUCHSCREEN_HIMAX_ONCELL
		help
		This enables support for HIMAX inspect function.

config TOUCHSCREEN_HIMAX_EMBEDDED_FIRMWARE
	bool "HIMAX embedded firmware function"
		depends on TOUCHSCREEN_HIMAX_INCELL || TOUCHSCREEN_HIMAX_ONCELL
		help
		This enables built-in FW inside kernel as binary array

config HMX_DB
	bool "HIMAX driver test over Dragon Board"
	depends on TOUCHSCREEN_HIMAX_COMMON
	help
	  This enables support for HIMAX driver test over Dragon Board.

config HIMAX_SUPPORT_KERNEL_419
        bool "HIMAX support kernel 4.19"
		depends on TOUCHSCREEN_HIMAX_COMMON
		help
		This enables support for support kernel 4.19.

# ****************** WAKE UP *************************

config HIMAX_WAKE_UP
       tristate "himax TP wake up"
       help
         This supports himax wake up.
```

## drivers/input/touchscreen/lct_tp/Kconfig
```kconfig
config TOUCHSCREEN_COMMON
     tristate "lct Touchscreen Driver"
     help
     Say Y here if you want to add lct touchscreen driver.
     If unsure, say N.
```
