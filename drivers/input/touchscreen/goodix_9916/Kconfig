## drivers/input/touchscreen/mediatek/FT5X26/Kconfig
```kconfig
#
# Touchscreen driver configuration
#
if TOUCHSCREEN_FT5X26

config ft5x26_FIRMWARE
	string "ft5x26 for Mediatek firmware"
	help
	  Say Y here if you have ft5x26 touch panel ft5x26_FIRMWARE.

	  If unsure, say N.

	  To compile this dirver as a module, choose M here: the
	  module will be called.

config TPD_ROTATE_90
	bool "ft5x26 for Mediatek package"
	help
	  Say Y here if you have ft5x26 touch panel TPD_ROTATE_90.

	  If unsure, say N.

	  To compile this dirver as a module, choose M here: the
	  module will be called.

config TPD_ROTATE_180
	bool "ft5x26 for Mediatek package"
	help
	  Say Y here if you have ft5x26 touch panel TPD_ROTATE_180.

	  If unsure, say N.

	  To compile this dirver as a module, choose M here: the
	  module will be called.

config TPD_ROTATE_270
	bool "ft5x26 for Mediatek package"
	help
	  Say Y here if you have ft5x26 touch panel TPD_ROTATE_270.

	  If unsure, say N.

	  To compile this dirver as a module, choose M here: the
	  module will be called.

config FT_AUTO_UPGRADE_SUPPORT
	bool "ft5x26 for Mediatek package"
	default y
	help
	  Say Y here if you have ft5x26 touch panel FT_AUTO_UPGRADE_SUPPORT.

	  If unsure, say N.

	  To compile this dirver as a module, choose M here: the
	  module will be called.

config CUST_FTS_APK_DEBUG
	bool "ft5x26 for Mediatek package"
	default y
	help
	  Say Y here if you have ft5x26 touch panel CUST_FTS_APK_DEBUG.

	  If unsure, say N.

	  To compile this dirver as a module, choose M here: the
	  module will be called.

config TPD_HAVE_CALIBRATION
	bool "ft5x26 for Mediatek package"
	help
	  Say Y here if you have ft5x26 touch panel TPD_HAVE_CALIBRATION.

	  If unsure, say N.

	  To compile this dirver as a module, choose M here: the
	  module will be called.

config TPD_CUSTOM_CALIBRATION
	bool "ft5x26 for Mediatek package"
	help
	  Say Y here if you have ft5x26 touch panel TPD_CUSTOM_CALIBRATION.

	  If unsure, say N.

	  To compile this dirver as a module, choose M here: the
	  module will be called.
endif
```

## drivers/input/touchscreen/mediatek/GT1151/Kconfig
```kconfig
#
# Touchscreen driver configuration
#
if TOUCHSCREEN_MTK_GT1151

config GT1151_FIRMWARE
	string "GT1151 for Mediatek firmware"

config GT1151_CONFIG
	string "GT1151 for Mediatek config"

config GTP_DRIVER_SEND_CFG
	bool "GT1151 for Mediatek send config"
	default n
	help
	  Say Y here if you have GT1151 touch panel GTP_DRIVER_SEND_CFG
	  to enable driver to send config.
	  Enable this feature if driver needs to send config to touch.
	  If unsure, say N.


config GTP_CUSTOM_CFG
	bool "GT1151 for Mediatek custome cfg"
	default n
	help
	  Say Y here if you have GT1151 touch panel GTP_CUSTOM_CFG
	  to enable custom config.
	  It enables user to use custom cfg.
	  If unsure, say N.


config GTP_CHANGE_X2Y
	bool "GT1151 for Mediatek change x to y"
	default n
	help
	  Say Y here if you have GT1151 touch panel GTP_CHANGE_X2Y
	  to enable change X to Y.
	  It is used in touch rotation case.
	  If unsure, say N.


config GTP_WARP_X_ON
	bool "GT1151 for Mediatek warp x"
	default n
	help
	  Say Y here if you have GT1151 touch panel GTP_WARP_X_ON
	  to switch warp X on.
	  It is used in touch rotation case.
	  If unsure, say N.


config GTP_WARP_Y_ON
	bool "GT1151 for Mediatek warp y"
	default n
	help
	  Say Y here if you have GT1151 touch panel GTP_WARP_Y_ON
	  to switch warp Y on.
	  It is used in touch rotation case.
	  If unsure, say N.


config GTP_GESTURE_WAKEUP
	bool "GT1151 for Mediatek gesture wakeup"
	default n
	help
	  Say Y here if you have GT1151 touch panel GTP_GESTURE_WAKEUP
	  to enable gesture wakeup mode.
	  If this feature is enabled, touch can be waked up by gesture.
	  If unsure, say N.


config GTP_HOTKNOT
	bool "GT1151 for Mediatek hotknot"
	default n
	help
	  Say Y here if you have GT1151 touch panel GTP_HOTKNOT
	  to enable hotknot.
	  Enable this feature if hotknot is used.
	  If unsure, say N.


config HOTKNOT_TYPE
	bool "GT1151 for Mediatek hotknot type"
	default n
	help
	  Say Y here if you have GT1151 touch panel HOTKNOT_TYPE
	  to enable hotknot.
	  Enable this feature if hotknot is used.
	  If unsure, say N.


config HOTKNOT_BLOCK_RW
	bool "GT1151 for Mediatek hotknot block rw"
	default n
	help
	  Say Y here if you have GT1151 touch panel HOTKNOT_BLOCK_RW
	  to enable hotknot block rw.
	  Enable this feature if hotknot is used.
	  If unsure, say N.


config GTP_PROXIMITY
	bool "GT1151 for Mediatek proximity"
	default n
	help
	  Say Y here if you have GT1151 touch panel GTP_PROXIMITY
	  to enable proximity.
	  Enable this feature if proximity is needed.
	  If unsure, say N.


config GTP_WITH_STYLUS
	bool "GT1151 for Mediatek with stylus"
	default n
	help
	  Say Y here if you have GT1151 touch panel GTP_WITH_STYLUS
	  to support stylus.
	  Enable this feature if stylus is used.
	  If unsure, say N.


config GTP_HAVE_STYLUS_KEY
	bool "GT1151 for Mediatek have stylus key"
	default n
	help
	  Say Y here if you have GT1151 touch panel GTP_HAVE_STYLUS_KEY
	  to enable stylus key.
	  Enable this feature if stylus is used.
	  If unsure, say N.


config GTP_AUTO_UPDATE
	bool "GT1151 for Mediatek auto update"
	default n
	help
	  Say Y here if you have GT1151 touch panel GTP_AUTO_UPDATE
	  to enable auto update.
	  Enable this feature if firmware auto update is needed.
	  If unsure, say N.


config GTP_HEADER_FW_UPDATE
	bool "GT1151 for Mediatek header fw update"
	default n
	help
	  Say Y here if you have GT1151 touch panel GTP_HEADER_FW_UPDATE
	  to enable header fw update which means to get firmware from .h
	  file.
	  If unsure, say N.


config GTP_REQUEST_FW_UPDATE
	bool "GT1151 for Mediatek request fw update"
	default n
	help
	Say Y here if you have GT1151 touch panel GTP_REQUEST_FW_UPDATE
	to enable request fw update which means to get firmware using
	request method.
	If unsure, say N.


config GTP_CREATE_WR_NODE
	bool "GT1151 for Mediatek create wr node"
	default n
	help
	  Say Y here if you have GT1151 touch panel GTP_CREATE_WR_NODE
	  to create WR node.
	  it is used for debug.
	  If unsure, say N.


config GTP_ESD_PROTECT
	bool "GT1151 for Mediatek esd protect"
	default n
	help
	  Say Y here if you have GT1151 touch panel GTP_ESD_PROTECT
	  to add GTP esd protect.
	  It is used for esd protect feature.
	  If unsure, say N.


config GTP_CHARGER_SWITCH
	bool "GT1151 for Mediatek charger switch"
	default n
	help
	  Say Y here if you have GT1151 touch panel GTP_CHARGER_SWITCH
	  to enable charger switch.
	  It is ued for charger switch.
	  If unsure, say N.


config GTP_DEBUG_ARRAY_ON
	bool "GT1151 for Mediatek debug array on"
	default n
	help
	  Say Y here if you have GT1151 touch panel GTP_DEBUG_ARRAY_ON.
	  It enables debug array on.
	  It is used for debug.
	  If unsure, say N.


config GTP_DEBUG_FUNC_ON
	bool "GT1151 for Mediatek debug func on"
	default n
	help
	  Say Y here if you have GT1151 touch panel GTP_DEBUG_FUNC_ON.
	  It enables debug func on.
	  It is used for debug.
	  If unsure, say N.


config GTP_POWER_CTRL_SLEEP
	bool "GT1151 for Mediatek power ctrl sleep"
	default n
	help
	  Say Y here if you have GT1151 touch panel GTP_POWER_CTRL_SLEEP.
	  It's use power control to enter sleep.
	  Touch enter sleep when power down.
	  If unsure, say N.


config GTP_ICS_SLOT_REPORT
	bool "GT1151 for TYPE_B_PROTOCOL"
	default n
	help
	  Say Y here if you have GT1151 touch panel GTP_ICS_SLOT_REPORT
	  to support TYPE_B_PROTOCOL.
	  If unsure, say N.

endif
```

## drivers/input/touchscreen/mediatek/GT5688/Kconfig
```kconfig
#
# Touchscreen driver configuration
#
if TOUCHSCREEN_MTK_GT5688

config GT5688_FIRMWARE
	string "GT5688 for Mediatek firmware"

config GT5688_CONFIG
	string "GT5688 for Mediatek config"

config GTP_DRIVER_SEND_CFG
	bool "GT5688 for Mediatek package"
	default y
	help
	  Say Y here if you have GT5688 touch panel GTP_DRIVER_SEND_CFG.

	  If unsure, say N.

	  To compile this dirver as a module, choose M here: the
	  module will be called.

config GTP_CUSTOM_CFG
	bool "GT5688 for Mediatek package"
	help
	  Say Y here if you have GT5688 touch panel GTP_CUSTOM_CFG.

	  If unsure, say N.

	  To compile this dirver as a module, choose M here: the
	  module will be called.

config GTP_CHANGE_X2Y
	bool "GT5688 for Mediatek package"
	help
	  Say Y here if you have GT5688 touch panel GTP_CHANGE_X2Y.

	  If unsure, say N.

	  To compile this dirver as a module, choose M here: the
	  module will be called.

config GTP_WARP_X_ON
	bool "GT5688 for Mediatek package"
	help
	  Say Y here if you have GT5688 touch panel GTP_WARP_X_ON.

	  If unsure, say N.

	  To compile this dirver as a module, choose M here: the
	  module will be called.

config GTP_WARP_Y_ON
	bool "GT5688 for Mediatek package"
	help
	  Say Y here if you have GT5688 touch panel GTP_WARP_Y_ON.

	  If unsure, say N.

	  To compile this dirver as a module, choose M here: the
	  module will be called.

config GTP_GESTURE_WAKEUP
	bool "GT5688 for Mediatek package"
	help
	  Say Y here if you have GT5688 touch panel GTP_GESTURE_WAKEUP.

	  If unsure, say N.

	  To compile this dirver as a module, choose M here: the
	  module will be called.

config GTP_HOTKNOT
	bool "GT5688 for Mediatek package"
	help
	  Say Y here if you have GT5688 touch panel GTP_HOTKNOT.

	  If unsure, say N.

	  To compile this dirver as a module, choose M here: the
	  module will be called.

config HOTKNOT_TYPE
	bool "GT5688 for Mediatek package"
	help
	  Say Y here if you have GT5688 touch panel HOTKNOT_TYPE.

	  If unsure, say N.

	  To compile this dirver as a module, choose M here: the
	  module will be called.

config HOTKNOT_BLOCK_RW
	bool "GT5688 for Mediatek package"
	help
	  Say Y here if you have GT5688 touch panel HOTKNOT_BLOCK_RW.

	  If unsure, say N.

	  To compile this dirver as a module, choose M here: the
	  module will be called.

config GTP_PROXIMITY
	bool "GT5688 for Mediatek package"
	help
	  Say Y here if you have GT5688 touch panel GTP_PROXIMITY.

	  If unsure, say N.

	  To compile this dirver as a module, choose M here: the
	  module will be called.

config GTP_WITH_STYLUS
	bool "GT5688 for Mediatek package"
	help
	  Say Y here if you have GT5688 touch panel GTP_WITH_STYLUS.

	  If unsure, say N.

	  To compile this dirver as a module, choose M here: the
	  module will be called.

config GTP_HAVE_STYLUS_KEY
	bool "GT5688 for Mediatek package"
	help
	  Say Y here if you have GT5688 touch panel GTP_HAVE_STYLUS_KEY.

	  If unsure, say N.

	  To compile this dirver as a module, choose M here: the
	  module will be called.

config GTP_AUTO_UPDATE
	bool "GT5688 for Mediatek package"
	help
	  Say Y here if you have GT5688 touch panel GTP_AUTO_UPDATE.

	  If unsure, say N.

	  To compile this dirver as a module, choose M here: the
	  module will be called.

config GTP_HEADER_FW_UPDATE
	bool "GT5688 for Mediatek package"
	help
	  Say Y here if you have GT5688 touch panel GTP_HEADER_FW_UPDATE.

	  If unsure, say N.

	  To compile this dirver as a module, choose M here: the
	  module will be called.

config GTP_REQUEST_FW_UPDATE
	bool "GT5688 for Mediatek package"
	help
	Say Y here if you have GT5688 touch panel GTP_REQUEST_FW_UPDATE.

	If unsure, say N.

	To compile this dirver as a module, choose M here: the
	module will be called.

config GTP_CREATE_WR_NODE
	bool "GT5688 for Mediatek package"
	help
	  Say Y here if you have GT5688 touch panel GTP_CREATE_WR_NODE.

	  If unsure, say N.

	  To compile this dirver as a module, choose M here: the
	  module will be called.

config GTP_ESD_PROTECT
	bool "GT5688 for Mediatek package"
	help
	  Say Y here if you have GT5688 touch panel GTP_ESD_PROTECT.

	  If unsure, say N.

	  To compile this dirver as a module, choose M here: the
	  module will be called.

config GTP_CHARGER_SWITCH
	bool "GT5688 for Mediatek package"
	help
	  Say Y here if you have GT5688 touch panel GTP_CHARGER_SWITCH.

	  If unsure, say N.

	  To compile this dirver as a module, choose M here: the
	  module will be called.

config GTP_DEBUG_ARRAY_ON
	bool "GT5688 for Mediatek package"
	help
	  Say Y here if you have GT5688 touch panel GTP_DEBUG_ARRAY_ON.

	  If unsure, say N.

	  To compile this dirver as a module, choose M here: the
	  module will be called.

config GTP_DEBUG_FUNC_ON
	bool "GT5688 for Mediatek package"
	help
	  Say Y here if you have GT5688 touch panel GTP_DEBUG_FUNC_ON.

	  If unsure, say N.

	  To compile this dirver as a module, choose M here: the
	  module will be called.

config GTP_POWER_CTRL_SLEEP
	bool "GT5688 for Mediatek package"
	help
	  Say Y here if you have GT5688 touch panel GTP_POWER_CTRL_SLEEP.

	  If unsure, say N.

	  To compile this dirver as a module, choose M here: the
	  module will be called.

config GTP_ICS_SLOT_REPORT
	bool "GT5688 for TYPE_B_PROTOCOL"
	help
	  Say Y here if you have GT5688 touch panel GTP_ICS_SLOT_REPORT
	  to support TYPE_B_PROTOCOL.

	  If unsure, say N.

	  To compile this dirver as a module, choose M here: the
	  module will be called.
endif
```

## drivers/input/touchscreen/mediatek/GT910/Kconfig
```kconfig
#
# Touchscreen driver configuration
#
if TOUCHSCREEN_MTK_GT910

config GT910_CONFIG
	string "GT910 for Mediatek config"

endif
```
