## drivers/input/touchscreen/GT1151/Kconfig
```kconfig
#
# Touchscreen driver configuration
#
menu "GT1151 support"
	depends on INPUT_TOUCHSCREEN

config GT1151_CONFIG
	string "GT1151 for Mediatek config"
	help
	  this string is used for cfg update
endmenu
```

## drivers/input/touchscreen/GT915L/Kconfig
```kconfig
config TOUCHSCREEN_GT915L
	tristate "ATMEL GT915L touchpanel driver"
	depends on CONFIG_INPUT_TOUCHSCREEN
	default n
```

## drivers/input/touchscreen/GT917D/Kconfig
```kconfig
config TOUCHSCREEN_GT917D
	tristate "ATMEL GT917D touchpanel driver"
	depends on CONFIG_INPUT_TOUCHSCREEN
	default n
```
