## drivers/input/misc/aw86927_haptic/Kconfig
```kconfig
#
# Awinic aw8697 driver
#
config INPUT_AW86927_HAPTIC
	tristate "Awinic AW8697 HAPTIC"
	depends on I2C
	help
	  Say Y here if you have Awinic AW86927 haptic controller
	  chip in your system.

	  If unsure, say N.

	  To compile this driver as a module, choose M here.
```

## drivers/input/misc/aw8697_haptic/Kconfig
```kconfig
#
# Awinic aw8697 driver
#

config INPUT_AW8697_HAPTIC
	tristate "Awinic AW8697 HAPTIC"
	depends on I2C
	help
	  Say Y here if you have Awinic AW8697 haptic controller
	  chip in your system.

	  If unsure, say N.

	  To compile this driver as a module, choose M here.
```

## drivers/input/misc/aw8697_haptic_xm/Kconfig
```kconfig
#
# Mediatek AW9233 Driver
#

config AW8697_XM_HAPTIC
	tristate "Freescale AW8697 Touchkey"
	depends on I2C
	help
	  Say Y here if you have Freescale AW8697 touchkey controller
	  chip in your system.

	  If unsure, say N.

	  To compile this driver as a module, choose M here: the
	  module will be called mpr121_touchkey.
```

## drivers/input/misc/aw_haptic/Kconfig
```kconfig
config INPUT_AW_HAPTIC
	tristate "awinic aw haptics support"
	depends on I2C
	help
	  Say Y to enable support for the AW869x haptics driver.

	  To compile this driver as a module, choose M here.
```

## drivers/input/misc/compass/Kconfig
```kconfig
#
# Kconfig for stand-alone compass input device drivers
#

config INV_AK8975
    tristate "Invensense AKM AK8975 compass input device driver"
    depends on I2C && SYSFS && INPUT && INPUT_EVDEV
    default n
    help
      This driver supports the AKM AK8975 compass device.
      This driver can be built as a module. The module will be called
      inv-ak8975.
```

## drivers/input/misc/cs40l26_haptic/Kconfig
```kconfig
# SPDX-License-Identifier: GPL-2.0-only
#
# Input misc drivers configuration
#

config INPUT_CS40L26
	tristate "Cirrus Logic CS40L26 haptic amplifier support"
	select CL_DSP
	help
	  Say Y here to enable support for CS40L26 boosted haptic amplifier.

	  To compile the driver as a module choose M here: the module will be
	  called cs40l26_core.

config INPUT_CS40L26_I2C
	tristate "Support I2C bus connection"
	depends on INPUT_CS40L26 && I2C
	select REGMAP_I2C
	help
	   Say Y if you have CS40L26 hooked to an I2C bus.

	   To compile the driver as a module choose M here: the
	   module will be called cs40l26_i2c.

config INPUT_CS40L26_SPI
	tristate "Cirrus Logic CS40L26 Haptic Driver (SPI)"
	depends on INPUT_CS40L26 && SPI_MASTER
	select REGMAP_SPI
	help
	   Say Y if you have CS40L26 hooked to a SPI bus.

	   To compile the driver as a module choose M here: the
	   module will be called cs40l26_spi.
```

## drivers/input/misc/goodix/Kconfig
```kconfig
config FINGERPRINT_GOODIX_GF318M
	tristate "Goodix GFX18M fingerprint drvier support"
	help
	  Say Y here to enable goodix fingerprint driver support!
```

## drivers/input/misc/mpu/Kconfig
```kconfig
#
# inv-mpu drivers for Invensense MPU devices and combos
#

config INV_MPU
    tristate "Invensense MPU devices"
    depends on I2C && SYSFS && INPUT
    default n
    help
      This driver supports the Invensense MPU devices.
      This driver can be built as a module. The module will be called
      inv-mpu.
```

## drivers/input/misc/ots_pat9125/Kconfig
```kconfig
#
# PixArt OTS switch driver configuration
#

config INPUT_PIXART_OTS_PAT9125_SWITCH
	tristate "PixArt PAT9125 Rotating Switch driver"
	depends on INPUT && I2C && GPIOLIB
	help
	  Say Y to enable support for the PixArt OTS pat9125
	  rotating switch driver.
	  If unsure, say N.

	  To compile this driver as a module, choose M here: the
	  module will be called ots_pat9125.
```

## drivers/input/misc/pressure/Kconfig
```kconfig
#
# Kconfig for stand-alone pressure input device drivers
#

config INV_BMP180
    tristate "Bosch BMP180 pressure input device driver"
    depends on I2C && SYSFS && INPUT && INPUT_EVDEV
    default n
    help
      This driver supports the Bosch BMP180 pressure sensor.
      This driver can be built as a module. The module will be called
      inv-bmp180.

config BMP280
	tristate "BMP280 digital pressure sensor"
	depends on (I2C || SPI_MASTER) && SYSFS
	help
	  If you say yes here you get support for Bosch Sensortec
	  digital pressure sensors BMP280.

	  To compile this driver as a module, choose M here: the
	  module will be called bmp280-core.

config BMP280_I2C
	tristate "support I2C bus communication"
	depends on BMP280 && I2C
	help
	  Say Y here if you want to support Bosch Sensortec digital pressure
	  sensor hooked to an I2C bus.

	  To compile this driver as a module, choose M here: the
	  module will be called bmp280-i2c.

config BMP280_SPI
	tristate "support SPI bus communication"
	depends on BMP280 && SPI_MASTER
	help
	  Say Y here if you want to support Bosch Sensortec digital pressure
	  sensor hooked to an SPI bus.

	  To compile this driver as a module, choose M here: the
	  module will be called bmp280-spi.
```

## drivers/input/misc/si_haptic/Kconfig
```kconfig
config SIH_VIBRATOR
    tristate "SI Vibrator driver"
    help 
    SI Vibrator driver
```

## drivers/input/misc/xiaomi_keyboard/Kconfig
```kconfig
config XIAOMI_KEYBOARD
	bool "xiaomi keyboard control-driver"
	depends on INPUT
	default n
	help
	  Say Y here, compile xiaomi keyboard control driver.

	  If unsure, say N.
```

## drivers/input/sensors/bmi160/Kconfig
```kconfig
#
# Makefile for Bosch sensors driver.
#
config BOSCH_DRIVER_LOG_FUNC
	tristate "Bosch Sensortec driver smart log function support"
	depends on (I2C || SPI_MASTER) && SYSFS
	help
	 If you say yes here, you get support for smart log function in Bosch Sensortec driver.

config SENSORS_BMA2X2
	tristate "BMA2x2 acceleration sensor support"
	depends on I2C
	help
	  If you say yes here, you get support for Bosch Sensortec's
	  acceleration sensors BMA255/BMA254/BMA355/BMA250E/BMA222E/BMA280.

config SENSORS_BMA2X2_ENABLE_INT1
	tristate "BMA2X2 acceleration sensor interrupt INT1 support"
	depends on SENSORS_BMA2X2
	help
	 If you say yes here, you get INT1 support for Bosch Sensortec
	 acceleration sensors BMA255/BMA250E/BMA222E/BMA280.
	 Select it will disable interrupt INT2 support

config SENSORS_BMA2X2_ENABLE_INT2
	tristate "BMA2X2 acceleration sensor interrupt INT2 support"
	depends on SENSORS_BMA2X2 && !SENSORS_BMA2X2_ENABLE_INT1
	help
	 If you say yes here, you get INT2 support for Bosch Sensortec
	 acceleration sensors BMA255/BMA250E/BMA222E/BMA280.
	 Can only open if you do NOT open interrupt INT1 support

config SIG_MOTION
	tristate "support significant motion sensor function"
	depends on SENSORS_BMA2X2  && ( SENSORS_BMA2X2_ENABLE_INT1 || SENSORS_BMA2X2_ENABLE_INT2)
	help
	 If you say yes here, if you want to support Bosch significant motion sensor function

config DOUBLE_TAP
	tristate "support double tap sensor function"
	depends on SENSORS_BMA2X2  && ( SENSORS_BMA2X2_ENABLE_INT1 || SENSORS_BMA2X2_ENABLE_INT2)
	help
	 If you say yes here, you get support Bosch double tap sensor function

config SENSORS_BMG
	tristate "Bosch Gyroscope Sensor Driver"
	depends on I2C
	help
	 If you say yes here, you get support for Bosch Sensortec's
	 gyroscope sensor drivers of BMG160/BMI055/BMI058 e.t.c.

config SENSORS_BMG_FIFO
	tristate "Bosch Gyroscope FIFO Support"
	depends on SENSORS_BMG
	help
	 If you say yes here, you get support for Gyroscope sensor FIFO operations.
	 Please check whether the chip supports fifo feature to open it.

config SENSORS_BMI058
	tristate "BMI058 Sensor Support"
	depends on (SENSORS_BMG || SENSORS_BMA2X2)
	help
	 If you say yes here, you get support for Bosch Sensortec's
	 sensor driver of BMI058.

config SENSORS_YAS537
	tristate "YAS537 Magnetic Sensor Driver"
	depends on I2C
	help
	 If you say yes here, you get support for YAMAHA
	 sensor YAS537 Magnetic Sensor

config SENSORS_BMM050
	tristate "BMM050 Magnetic Sensor Driver"
	depends on I2C
	help
	 If you say yes here, you get support for Bosch Sensortec's
	 sensor BMM050 Magnetic Sensor

config SENSORS_AKM09911
	tristate "AKM09911 Mag Sensor Driver"
	depends on I2C
	help
	 If you say yes here, you get support AKM09911 Sensor support.

config SENSORS_AKM09912
	tristate "AKM09912 Mag Sensor Driver"
	depends on I2C
	help
	 If you say yes here, you get support AKM09912 Sensor support.

config SENSORS_BMA420
	tristate "BMA4XY Sensor Support"
	depends on I2C || SPI_MASTER
	help
	If you say yes here, you get support for Bosch Sensortec's sensor driver of BMA420.
config SENSORS_BMA421
	tristate "BMA4XY Sensor Support"
	depends on I2C || SPI_MASTER
	help
	If you say yes here, you get support for Bosch Sensortec's sensor driver of BMA421.
config SENSORS_BMA422
	tristate "BMA4XY Sensor Support"
	depends on I2C || SPI_MASTER
	help
	If you say yes here, you get support for Bosch Sensortec's sensor driver of BMA422.
config SENSORS_BMA455
	tristate "BMA4XY Sensor Support"
	depends on I2C || SPI_MASTER
	help
	If you say yes here, you get support for Bosch Sensortec's sensor driver of BMA455.

config BMA4XY_MAG_INTERFACE_SUPPORT
tristate "BMA4XY Sensor mag interface support"
depends on SENSORS_BMA4XY
	help
	 If you say yes here, you get support for Bosch Sensortec's
	 sensor driver of BMA4XY with mag sensor support.
```

## drivers/input/sensors/smi130/Kconfig
```kconfig
#
# Makefile for Bosch sensors driver.
#
config BOSCH_DRIVER_LOG_FUNC
	tristate "Bosch Sensortec driver smart log function support"
	depends on (I2C || SPI_MASTER) && SYSFS
	help
	 If you say yes here, you get support for smart log function in Bosch Sensortec driver.

config SENSORS_SMI_ACC2X2
	tristate "SMI130_ACC acceleration sensor support"
	depends on I2C
	help
	  If you say yes here, you get support for Bosch Sensortec's
	  acceleration sensors SMI_ACC255/SMI_ACC254/SMI_ACC355/SMI_ACC250E/SMI_ACC222E/SMI_ACC280.

config SENSORS_SMI_ACC2X2_ENABLE_INT1
	tristate "SMI_ACC2X2 acceleration sensor interrupt INT1 support"
	depends on SENSORS_SMI_ACC2X2
	help
	 If you say yes here, you get INT1 support for Bosch Sensortec
	 acceleration sensors SMI_ACC255/SMI_ACC250E/SMI_ACC222E/SMI_ACC280.
	 Select it will disable interrupt INT2 support

config SENSORS_SMI_ACC2X2_ENABLE_INT2
	tristate "SMI_ACC2X2 acceleration sensor interrupt INT2 support"
	depends on SENSORS_SMI_ACC2X2 && !SENSORS_SMI_ACC2X2_ENABLE_INT1
	help
	 If you say yes here, you get INT2 support for Bosch Sensortec
	 acceleration sensors SMI_ACC255/SMI_ACC250E/SMI_ACC222E/SMI_ACC280.
	 Can only open if you do NOT open interrupt INT1 support

config SIG_MOTION
	tristate "support significant motion sensor function"
	depends on SENSORS_SMI_ACC2X2  && ( SENSORS_SMI_ACC2X2_ENABLE_INT1 || SENSORS_SMI_ACC2X2_ENABLE_INT2)
	help
	 If you say yes here, if you want to support Bosch significant motion sensor function

config DOUBLE_TAP
	tristate "support double tap sensor function"
	depends on SENSORS_SMI_ACC2X2  && ( SENSORS_SMI_ACC2X2_ENABLE_INT1 || SENSORS_SMI_ACC2X2_ENABLE_INT2)
	help
	 If you say yes here, you get support Bosch double tap sensor function

config SENSORS_SMI_GYRO
	tristate "Bosch Gyroscope Sensor Driver"
	depends on I2C
	help
	 If you say yes here, you get support for Bosch Sensortec's
	 gyroscope sensor drivers of SMI130_GYRO/SMI055/BMI058 e.t.c.

config SENSORS_SMI_GYRO_FIFO
	tristate "Bosch Gyroscope FIFO Support"
	depends on SENSORS_SMI_GYRO
	help
	 If you say yes here, you get support for Gyroscope sensor FIFO operations.
	 Please check whether the chip supports fifo feature to open it.

config SENSORS_BMI058
	tristate "BMI058 Sensor Support"
	depends on (SENSORS_SMI_GYRO || SENSORS_SMI_ACC2X2)
	help
	 If you say yes here, you get support for Bosch Sensortec's
	 sensor driver of BMI058.

config SENSORS_YAS537
	tristate "YAS537 Magnetic Sensor Driver"
	depends on I2C
	help
	 If you say yes here, you get support for YAMAHA
	 sensor YAS537 Magnetic Sensor

config SENSORS_BMM050
	tristate "BMM050 Magnetic Sensor Driver"
	depends on I2C
	help
	 If you say yes here, you get support for Bosch Sensortec's
	 sensor BMM050 Magnetic Sensor

config SENSORS_AKM09911
	tristate "AKM09911 Mag Sensor Driver"
	depends on I2C
	help
	 If you say yes here, you get support AKM09911 Sensor support.

config SENSORS_AKM09912
	tristate "AKM09912 Mag Sensor Driver"
	depends on I2C
	help
	 If you say yes here, you get support AKM09912 Sensor support.

config SENSORS_SMI_ACC420
	tristate "SMI_ACC4XY Sensor Support"
	depends on I2C || SPI_MASTER
	help
	If you say yes here, you get support for Bosch Sensortec's sensor driver of SMI_ACC420.
config SENSORS_SMI_ACC421
	tristate "SMI_ACC4XY Sensor Support"
	depends on I2C || SPI_MASTER
	help
	If you say yes here, you get support for Bosch Sensortec's sensor driver of SMI_ACC421.
config SENSORS_SMI_ACC422
	tristate "SMI_ACC4XY Sensor Support"
	depends on I2C || SPI_MASTER
	help
	If you say yes here, you get support for Bosch Sensortec's sensor driver of SMI_ACC422.
config SENSORS_SMI_ACC455
	tristate "SMI_ACC4XY Sensor Support"
	depends on I2C || SPI_MASTER
	help
	If you say yes here, you get support for Bosch Sensortec's sensor driver of SMI_ACC455.

config SMI_ACC4XY_MAG_INTERFACE_SUPPORT
tristate "SMI_ACC4XY Sensor mag interface support"
depends on SENSORS_SMI_ACC4XY
	help
	 If you say yes here, you get support for Bosch Sensortec's
	 sensor driver of SMI_ACC4XY with mag sensor support.

config ENABLE_SMI_ACC_GYRO_BUFFERING
	bool "Enable accel & gyro  boot time sensor sample buffering"
	depends on IIO_ST_ASM330LHH
	help
	 Say Y here if you want to buffer boot time sensor
	 samples for ASM330 accelerometer and gyroscope
```

## drivers/input/stmvl53l5/Kconfig
```kconfig
#
# ST SPI stmvl53l5  devices
#
menu "stmvl53l5"
config STMVL53L5
	tristate "ST stmvl53l5 driver"
	help
	This enables the ST stmvl53l5 driver
endmenu
```

## drivers/input/touchscreen/Atmel308U/Kconfig
```kconfig
config TOUCHSCREEN_ATMEL308U
	tristate "ATMEL A308U touchpanel driver"
	depends on CONFIG_INPUT_TOUCHSCREEN
	default n
```

## drivers/input/touchscreen/FT3683G/Kconfig
```kconfig
#
# Focaltech Touchscreen driver configuration
#

config TOUCHSCREEN_FTS
    tristate "Focaltech Touchscreen"
    default m
    help
      Say Y here if you have Focaltech touch panel.
      If unsure, say N.
```

## drivers/input/touchscreen/FT5336/Kconfig
```kconfig
config TOUCHSCREEN_FT5336
	tristate "FOCALTECH FT5336 touchpanel driver"
	depends on CONFIG_INPUT_TOUCHSCREEN
	default n
```

## drivers/input/touchscreen/FT5346/Kconfig
```kconfig
config TOUCHSCREEN_FT5346
	tristate "FOCALTECH FT5346 touchpanel driver"
	depends on CONFIG_INPUT_TOUCHSCREEN
	default n
```

## drivers/input/touchscreen/FT8006S/Kconfig
```kconfig
#
# Focaltech Touchscreen driver configuration
#

config CONFIG_TOUCHSCREEN_FT8006S
    bool "Focaltech Touchscreen"
    default n
    help
      Say Y here if you have Focaltech touch panel.
      If unsure, say N.

config TOUCHSCREEN_FTS_DIRECTORY
    string "Focaltech ts directory name"
    default "focaltech_touch"
    depends on TOUCHSCREEN_FT8006S
```

## drivers/input/touchscreen/FT8720/Kconfig
```kconfig
#
# Focaltech Touchscreen driver configuration
#

config TOUCHSCREEN_FT8720
    tristate "Focaltech Touchscreen"
    default m
    help
      Say Y here if you have Focaltech touch panel.
      If unsure, say N.
      
config TOUCHSCREEN_FTS_DIRECTORY
    string "Focaltech ts directory name"
    default "FT8720"
    depends on TOUCHSCREEN_FT8720
    
```

## drivers/input/touchscreen/FT8725_SPI/Kconfig
```kconfig
#
# Focaltech Touchscreen driver configuration
#

config TOUCHSCREEN_FTS_SPI
# N19A code for HQ-359934 by p-huangyunbiao at 2023/12/19 start
    tristate "Focaltech Touchscreen"
    depends on TOUCHSCREEN_TPD_NOTIFY
# N19A code for HQ-359934 by p-huangyunbiao at 2023/12/19 end
    default n
    help
      Say Y here if you have Focaltech touch panel.
      If unsure, say N.

config TOUCHSCREEN_FTS_DIRECTORY
    string "Focaltech ts directory name"
    default "focaltech_touch"
    depends on TOUCHSCREEN_FTS_SPI
```
