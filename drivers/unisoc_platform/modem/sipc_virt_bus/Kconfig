## drivers/unisoc_platform/modem/sipc_virt_bus/Kconfig
```kconfig
# SPDX-License-Identifier: GPL-2.0-only
config UNISOC_SIPC_VIRT_BUS
	tristate "Unisoc IPC Virt Bus"
	default n
	help
	  sipc virt bus driver implementation for the Unisoc platform.
	  it is used to populating sub-devices.

	  Say M here if you want to build a module.
```

## drivers/unisoc_platform/net/Kconfig
```kconfig
# SPDX-License-Identifier: GPL-2.0-only
#
# Unisoc Network device configuration
#

menu "Unisoc Net Devices"
source "drivers/unisoc_platform/net/ims_bridge/Kconfig"
source "drivers/unisoc_platform/net/seth/Kconfig"
source "drivers/unisoc_platform/net/sipa_sys/Kconfig"
source "drivers/unisoc_platform/net/sipa_v3/Kconfig"
source "drivers/unisoc_platform/net/sipa_delegate/Kconfig"
source "drivers/unisoc_platform/net/ursp/Kconfig"

endmenu
```

## drivers/unisoc_platform/net/ims_bridge/Kconfig
```kconfig
#
# IMS Bridge configuration
#

config SPRD_IMS_BRIDGE
	tristate "Spreadtrum ims stack bridge support"
	depends on INET && NETFILTER && UNISOC_SIPC
	default m
	help
	  This option adds ims stack bridge support to the kernel. We will
	  *route* the packets to the proper interface and ims stack, and
	  all of these are transparent to the ims stacks.
	  To compile it as a module, choose M here.  If unsure, say N.

config SPRD_IMS_BRIDGE_TEST
	bool "Spreadtrum ims stack bridge test suite feature"
	depends on SPRD_IMS_BRIDGE
	default y
	help
	  This option supports for ims bridge kernel test suite,
	  the supported lists can be retrieved by
	  /d/ims_bridge/test-suite.
	  If unsure, say N.

config SPRD_IMS_BRIDGE_TRANSIT
	tristate "Spreadtrum ims stack bridge config for orca board"
	depends on INET && NETFILTER && UNISOC_SIPC
	default m
	help
	  This option add only on orca board, so the imsbr on orca on play
	  a role as a data-transfer.
	  If unsure, say N.

config SPRD_IMS_BRIDGE_GCOV
    bool "open gcov for ims stack bridge"
    depends on GCOV_PROFILE_MODULES
    help
      Say Y here to enable gcov for ims stack bridge
```

## drivers/unisoc_platform/net/seth/Kconfig
```kconfig
config UNISOC_SIPC_SETH
	tristate "UNISOC SETH Ethernet driver"
	default n
	depends on UNISOC_SIPC
	depends on UNISOC_SIPC_ZERO_COPY_SIPX
	help
	  SETH driver implementation for the Unisoc platform.
	  This driver supports the Unisoc Ethernet based on
	  share memory.

	  Say M here if you want to build a module.
```

## drivers/unisoc_platform/net/sipa_delegate/Kconfig
```kconfig
menu "SIPA_DELEGATE modules"
config UNISOC_SIPA_DELEGATE
	tristate "UNISOC SIPA_DELEGATE for modem"
	default n
	depends on UNISOC_SIPA_V3
	depends on UNISOC_SIPC
	help
	  This option enables delegate for modem side sipa.

	  This function is used to synchronize resource status with CP,
	  ensure the synchronization of the power-on and power-off status
	  between AP and CP.
endmenu
```

## drivers/unisoc_platform/net/sipa_sys/Kconfig
```kconfig
menu "SIPA_SYS modules"
config UNISOC_SIPA_SYS
	tristate "UNISOC SIPA_SYS Power Management"
	default n
	select PM_GENERIC_DOMAINS if PM
	help
	  Sipa sys is a module that manages ipa low power, realized by creating
	  a power domain.

	  When you select this feature, it will enable the pm generic
	  power domain for ipa_sys module.
endmenu
```

## drivers/unisoc_platform/net/sipa_v3/Kconfig
```kconfig
menu "SIPA_V3 modules"

config UNISOC_SIPA_V3
	tristate "UNISOC SIPA_V3"
	default n
	help
	  SIPA is a module designed by Spreadtrum to
	  accelerate IP packets, which is mainly suitable
	  for 5g scenarios.

	  This option be opend indicate that the SIPA
	  module will use the SIPA version 3.

config UNISOC_SIPA_ETH
	tristate "UNISOC Cellular Data Network Card"
	default n
	depends on UNISOC_SIPA_V3
	help
	  Sprd Cellular data network card, all Cellular data will be sent and
	  received through this network card.

	  This module is a cellular data network card virtualized on the basis
	  of sipa, it is only used to send Cellular network data.

config UNISOC_SIPA_USB
	tristate "UNISOC Sipa Usb Networ Card"
	default n
	depends on UNISOC_SIPA_V3
	help
	  Sprd usb network card, all usb network data will be sent and received
	  through this network card.

	  This module is a usb network card virtualized on the basis of sipa,
	  it is only used to send Cellular network data.

config UNISOC_SIPA_V3_GCOV
	bool "open gcov for sipa_v3"
	default n
	depends on GCOV_PROFILE_MODULES
	help
	  Say Y here to enable sipa_v3 gcov, this can support ltp for sipa_v3.
          so sipa_v3 gcov will success.

	  It is only enable for sipa v3 gcov, this can make ltp for SIPA_V3
          be ok.

endmenu
```

## drivers/unisoc_platform/net/ursp/Kconfig
```kconfig
menu "URSP modules"

config UNISOC_URSP_REPORT
	tristate "REPORT IP INFO"
	depends on ARCH_SPRD && NF_CONNTRACK
	default n
	help
		Choosing this option will include conntrack support in the image.
		This will report establish event and close event to user space from conntrack.

		This module is used to report the IP triplet information of TCP/UDP link
		establishment and disconnection events to user space.
endmenu
```

## drivers/unisoc_platform/past_record/Kconfig
```kconfig
config SPRD_PAST_RECORD
	tristate "SPRD past event debug"
	depends on SPRD_DEBUG
	help
	  SPRD past record for Debug.

config ENABLE_SPRD_IO_TRACING
	tristate "SPRD IO TRACING event debug"
	depends on SPRD_PAST_RECORD
	help
	  SPRD IO TRACING for Debug.

config ENABLE_SPRD_DEEP_SLEEP_TRACING
	tristate "SPRD deep sleep debug"
	depends on SPRD_PAST_RECORD
	help
	  SPRD deep sleep TRACING for Debug. For user version, say no.
```

## drivers/unisoc_platform/performance/Kconfig
```kconfig
config SPRD_PTM
	tristate "Spreadtrum Performance Trace Monitor Support"
	default m
	depends on SPRD_DEBUG
	help
	  Say M here to support ptm support.

config SPRD_PTM_DIFF_R6P1
	bool "Spreadtrum Performance Trace Monitor Support For R6P1"
	default n
	depends on SPRD_PTM
	help
	  Say Y here to support dpu0 ~ dpu9 overflow info and
	  dcam0 ~ dcam9 overflow info;
	  say N here to cancel support dpu0 ~ dpu9 overflow info and
	  dcam0 ~ dcam9 overflow info.

config SPRD_PTM_R6P2
	bool "Spreadtrum Performance Trace Monitor Support For R6P2"
	default n
	depends on SPRD_PTM_DIFF_R6P1
	help
	  Say Y here to support ptm ip version for r6p2, some registers
	  have changed, for example, remove bit15 and bit16 from the
	  address 0x00 and hide it, do not want the software to modify
	  the default values of these two bits as aback door.
```

## drivers/unisoc_platform/power/power_debug/Kconfig
```kconfig
#
# SPRD Soc power debug drivers
#
menuconfig SPRD_POWER_DEBUG
	tristate "Spreadtrum power debug driver"
	depends on PM_SLEEP && ARCH_SPRD
	default n
	help
	Select this to enable power debug log driver for sprd soc. This driver
	is only used to output the power state, wakeup interrupt and some specific
	register values before the system enter deep sleep mode. and output the
	power state and wakeup source information in sprd_pm_thread every 30s.
	These logs will help to analysis system power issue.
```

## drivers/unisoc_platform/preemptirq_warn/Kconfig
```kconfig
config IRQSOFF_WARN
	tristate "Interrupts-off Latency Warning"
	depends on IRQSOFF_TRACER
	help
	  This option measures the time spent in irqs-off critical sections,
	  and print some information if the time exceeds the set threshold.

config PREEMPT_WARN
	tristate "Preemption-off Latency Warning"
	depends on PREEMPT_TRACER
	help
	  This option measures the time spent in preemption-off critical
	  sections, and print some information if the time exceeds the set
	  threshold.
```

## drivers/unisoc_platform/printk_cpuid/Kconfig
```kconfig
config PRINTK_CPUID
	tristate "Show both processor id and thread id in kernel logs"
	depends on PRINTK_CALLER
	help
	  Selecting this options causes printk to show both processor id and
	  thread id.
```

## drivers/unisoc_platform/pub/Kconfig
```kconfig
config SPRD_DMC_DRV
	tristate "Spreadtrum DMC DRV Support"
	depends on ARCH_SPRD
	default n
	help
	  Say Y or M here to support dmc drv.
```

## drivers/unisoc_platform/sfp/Kconfig
```kconfig
menu "SFP modules"

config SPRD_SFP_SUPPORT
	tristate "Software Network Fast Processing (SFP) Support"
	default m
	help
		Choosing this option will include conntrack support in the image.
		This will enable fast path rule from conntrack.
		Include api for net drivers.
		Support soft and hardware fast path.

config SPRD_IPA_SUPPORT
	bool "Sfp ipa config"
	depends on SPRD_SFP_SUPPORT
	default n
	help
		Sfp ipa configurations.
		This will enable hardware fast path.
		Hash table and entries on dma.
		Software fastpath will disnable when this marco open.

config SPRD_SFP_TEST
	bool "Do snfp test"
	depends on SPRD_SFP_SUPPORT
	default n
	help
		This will include ipa test module.
		Do snfp self test.
		Echo m to test proc file
		to run foward rule config.

config SPRD_SFP_GCOV
	bool "open gcov for Software Network Fast Processing"
	depends on GCOV_PROFILE_MODULES
	help
		This will enable gcov.
		Based on Software Network Fast Processing.
		Say y in configs.
		Perform statistics on the entire directory.

endmenu
```

## drivers/unisoc_platform/shutdown_detect/Kconfig
```kconfig
config SPRD_SHUTDOWN_DETECT
	tristate "UNISOC Soc SHUTDOWN_DETECT Module"
	depends on ARCH_SPRD
	help
	  Choose this option can support unisoc shutdowndect driver
```

## drivers/unisoc_platform/sla/Kconfig
```kconfig
menu "SLA modules"

config SPRD_SLA_SUPPORT
	tristate "Smartlink Aggregation (SLA) Technology"
	default n
	help
		Choosing this option will include conntrack support in the image.
		This will enable sla from conntrack.
		Include api for net drivers.
		Support sla.

config SPRD_SLA_GCOV
	bool "open gcov for Smartlink Aggregation (SLA) Technology"
	depends on GCOV_PROFILE_MODULES
	help
		This will enable gcov.
		Based on Smartlink Aggregation (SLA) Technology.
		Say y in configs.
		Perform statistics on the entire directory.

endmenu
```

## drivers/unisoc_platform/sprd_cache_print/Kconfig
```kconfig
config SPRD_CACHE_PRINT
	tristate "SPRD print cache of crash context"
	help
	  SPRD print cache of crash context
```

## drivers/unisoc_platform/sprd_coresight/Kconfig
```kconfig
# SPDX-License-Identifier: GPL-2.0-only
#
# Unisoc coresight configuration
#
menuconfig UNISOC_CORESIGHT
	tristate "Unisoc CoreSight Tracing Support"
	depends on ARM || ARM64
	depends on OF || ACPI
	select ARM_AMBA
	select PERF_EVENTS
	select CONFIGFS_FS
	help
	  This framework provides a kernel interface for the CoreSight debug
	  and trace drivers to register themselves with. It's intended to build
	  a topological view of the CoreSight components based on a DT
	  specification and configure the right series of components when a
	  trace source gets enabled.

	  To compile this driver as a module, choose M here: the
	  module will be called sprd_coresight.

if UNISOC_CORESIGHT
config UNISOC_CORESIGHT_LINKS_AND_SINKS
	tristate "Unisoc CoreSight Link and Sink drivers"
	help
	  This enables support for CoreSight link and sink drivers that are
	  responsible for transporting and collecting the trace data
	  respectively.  Link and sinks are dynamically aggregated with a trace
	  entity at run time to form a complete trace path.

	  To compile these drivers as modules, choose M here: the
	  modules will be called sprd_coresight-funnel and coresight-replicator.

config UNISOC_CORESIGHT_LINK_AND_SINK_TMC
	tristate "Unisoc Coresight generic TMC driver"

	depends on UNISOC_CORESIGHT_LINKS_AND_SINKS
	help
	  This enables support for the Trace Memory Controller driver.
	  Depending on its configuration the device can act as a link (embedded
	  trace router - ETR) or sink (embedded trace FIFO).  The driver
	  complies with the generic implementation of the component without
	  special enhancement or added features.

	  To compile this driver as a module, choose M here: the
	  module will be called sprd_coresight-tmc.

config UNISOC_CORESIGHT_SOURCE_ETM4X
	tristate "Unisoc CoreSight ETMv4.x / ETE driver"
	depends on ARM64
	select UNISOC_CORESIGHT_LINKS_AND_SINKS
	select PID_IN_CONTEXTIDR
	help
	  This driver provides support for the CoreSight Embedded Trace Macrocell
	  version 4.x and the Embedded Trace Extensions (ETE). Both are CPU tracer
	  modules, tracing the instructions that a processor is executing. This is
	  primarily useful for instruction level tracing.

	  To compile this driver as a module, choose M here: the
	  module will be called sprd_coresight-etm4x.

config UNISOC_CORESIGHT_APETB
	tristate "Unisoc CoreSight APETB driver"
	depends on UNISOC_CORESIGHT_SOURCE_ETM4X
	select UNISOC_CORESIGHT_LINKS_AND_SINKS
	help
	  This driver provides support for ylog control APETB function, will automatic
	  call enable_sink and enable_source.

config UNISOC_CORESIGHT_TMC_GROUP
	tristate "Unisoc CoreSight tmc group drivers"
	help
	  This enables support for CoreSight tmc group drivers that are
	  responsible for dump several tmc data.

config UNISOC_CORESIGHT_TMC_GROUP_CTRL
	bool "Unisoc CoreSight tmc group drivers control"
	depends on UNISOC_CORESIGHT_TMC_GROUP
	help
	  This enables support for CoreSight tmc group drivers control that is
	  responsible for dump several tmc data.

source "drivers/unisoc_platform/sprd_coresight/phy/Kconfig"

endif
```

## drivers/unisoc_platform/sprd_coresight/phy/Kconfig
```kconfig
#
# Physical Layer Coresight PHY driver configuration
#
menu "Coresight Physical Layer drivers"

config UNISOC_CORESIGHT_PHY
	depends on UNISOC_CORESIGHT_TMC_GROUP
	select EXTCON
	def_bool n

config UNISOC_SHARKL6PRO_CORESIGHT_PHY
	tristate "UNISOC SHARKL6PRO CORESIGHT PHY Driver"
	select UNISOC_CORESIGHT_PHY
	help
	  Enable this to support SHARKL6PRO CORESIGHT PHY that is part of SOC.

endmenu
```

## drivers/unisoc_platform/sprd_disp/Kconfig
```kconfig
# SPDX-License-Identifier: GPL-2.0-only
config UNISOC_DISP
	tristate "Unisoc Display Platform"
	depends on ARCH_SPRD || COMPILE_TEST
	depends on DRM && OF
	select DRM_KMS_HELPER
	select VIDEOMODE_HELPERS
	select DRM_GEM_CMA_HELPER
	select DRM_KMS_CMA_HELPER
	select DRM_MIPI_DSI
	help
	  Choose this option if you have a Unisoc chipset.
	  If M is selected the module will be called sprd_drm.

#
#SPRD DRM GSP driver
#
source "drivers/unisoc_platform/sprd_disp/gsp/Kconfig"

if UNISOC_DISP

comment "Unisoc Dummy CRTC&Encoder"

config DRM_SPRD_DUMMY
	bool "Dummy CRTC&Encoder"
	help
	  Choose this option if you want to use dummy crtc&encoder.

comment "Unisoc CRTCs"

config DRM_SPRD_DPU0
	bool "Primary Display Controller"
	help
	  Choose this option if you want to use primary display controller.

comment "Unisoc Encoders and Bridges"

config DRM_SPRD_DSI
	bool "DSI Host Controller"
	depends on DRM_SPRD_DPU0
	select DRM_MIPI_DSI
	select DRM_PANEL
	select BACKLIGHT_CLASS_DEVICE
	help
	  Choose this option if you want to use DSI host controller.

config DRM_SPRD_WB_DEBUG
	bool "DPU WriteBack Debug"
	depends on DRM_SPRD_DPU0
	help
	  Choose this option if you want to use DPU WriteBack Debug.

endif
```

## drivers/unisoc_platform/sprd_disp/gsp/Kconfig
```kconfig
# SPDX-License-Identifier: GPL-2.0-only
config UNISOC_GSP
	tristate "SPRD DRM GSP driver"
	depends on ARCH_SPRD
	depends on UNISOC_DISP
	help
	  GSP is hardware which not only can compose multiple layers
	  but also can transform and scale layers.
```
