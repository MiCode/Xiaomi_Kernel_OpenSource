## drivers/unisoc_platform/sprd_gnss/gnss_pmnotify_ctl/Kconfig
```kconfig
# SPDX-License-Identifier: GPL-2.0
#
# Makefile for Unisoc wcn platform configuration
#

config UNISOC_GNSS_PMNOTIFY_CTL
	tristate "Gnss pmnotify ctl support"
	help
	Choose Y here if you want to support gnss_pmnotify_ctl function
        for unisoc wcn sc23xx series chip.

	In order to control your ext wcn chip, you will need enable it.
	that include "boot, log, procfs, debugfs, at cmd, loopcheck, dumpmem,
	reset, reboot,etc"
```

## drivers/unisoc_platform/sprd_map/Kconfig
```kconfig
config UNISOC_MAPUSER
	tristate "UNISOC MapUser Module"
	depends on ARM || ARM64
	depends on ARCH_SPRD
	help
	  Choose this option can support unisoc mapuser driver used in faceid.
```

## drivers/unisoc_platform/sprd_time_sync/Kconfig
```kconfig
config SPRD_SYSTIMER
	tristate "Spreadtrum system timer driver (systimer/sysfrt)"
	depends on ARCH_SPRD
	default m
	help
	  Support sprd system timer driver.

config SPRD_TIME_SYNC
	tristate "Spreadtrum time sync driver"
	depends on ARCH_SPRD
	default m
	help
	  Support sprd time sync with other subsystem.

config SPRD_TIME_SYNC_CH
	tristate "Spreadtrum AP/CH time synchronization"
	depends on ARCH_SPRD && SPRD_SYSTIMER && SPRD_TIME_SYNC
	default n
	help
	  Support sprd sensor time synchronization between AP
	  (Application Processor) and CH(Context Hub).

config SPRD_TIME_SYNC_CP
	tristate "Spreadtrum cp time sync driver"
	depends on ARCH_SPRD && SPRD_TIME_SYNC
	default m
	help
	  Support sprd time sync with cp system.
```

## drivers/unisoc_platform/sprdwcn/Kconfig
```kconfig
#
# Unisoc WCN device (NEW )configuration
#
menu "Unisoc WCN Device Drivers"
config UNISOC_WCN_BSP
	tristate "UNISOC_WCN_BSP"
	help
	  This is support wcn chip for Unisoc.
	  if you want to use 23xx series wcn chip of Unisoc.
	  please say "y".
config SC23XX
	bool "SC23XX chip Support"
	#depends on MMC
	default n
	help
	  This is support wcn chip for Unisoc.
	  if you want to use 23xx series wcn chip of Unisoc.
	  please say "y".

config WCN_INTEG
	bool "WCN Integrated chip Support"
	depends on SC23XX
	default n
	help
	  This is support wcn chip for Unisoc.
	  If you want to use WCN integrated chip of Unisoc.
	  Please say "y".

config SC2355
	bool "SC2355 chip Support"
	depends on SC23XX
	default n
	help
	  This is support wcn chip for Unisoc.
	  If you want to use sc2355 chip of Unisoc.
	  Please say "y".

config UMW2652
	bool "UMW2652 chip Support"
	depends on SC23XX
	default n
	help
	  This is support wcn chip for Unisoc.
	  If you want to use umw2652 chip of Unisoc.
	  Please say "y".

config UMW2653
	bool "UMW2653 chip Support"
	depends on SC23XX
	default n
	help
	  This is support wcn chip for Unisoc.
	  If you want to use umw2653 chip of Unisoc.
	  Please say "y".

config SC2342_I
	bool "SC2342 integrated chip Support"
	depends on WCN_INTEG
	default n
	help
	  This is support wcn sc2342 integrated chip unique config for Unisoc.
	  use it distinguish with other integrated chip.
	  If you want to use sc2342 integrated chip of Unisoc.
	  Please say "y".

config UMW2631_I
	bool "UMW2631 integrated chip Support"
	depends on WCN_INTEG
	default n
	help
	  This is support wcn umw2631 integrated chip unique config for unisoc.
	  If you want to use umw2631 integrated chip of unisoc.
	  Please say "y".


# sprd's SDIO device driver based on SC2355...,etc
source "drivers/unisoc_platform/sprdwcn/sdio/Kconfig"

# sprd's wcn platform driver based on SC2355/SC2342...,etc
source "drivers/unisoc_platform/sprdwcn/platform/Kconfig"

# sprd's sleep device driver based on SC2355...,etc
source "drivers/unisoc_platform/sprdwcn/sleep/Kconfig"

# sprd's SIPC device driver based on WCN_INTEG...,etc
source "drivers/unisoc_platform/sprdwcn/sipc/Kconfig"

endmenu
```

## drivers/unisoc_platform/sprdwcn/pcie/Kconfig
```kconfig
config WCN_PCIE
	tristate "PCIE Support"
	depends on PCI && UNISOC_WCN_BSP
	default n
	help
          Enable this module for Spreadtrum SC2355 chip pcie interface bus Support.
          Please insmod this module before any other WCN subsystems.
```

## drivers/unisoc_platform/sprdwcn/platform/Kconfig
```kconfig
# SPDX-License-Identifier: GPL-2.0
#
# Makefile for Unisoc wcn platform configuration
#

config WCN_BOOT
	tristate "Core Support"
	help
	Choose Y here if you want to support boot function
        for unisoc wcn sc23xx series chip.

	In order to control your ext wcn chip, you will need enable it.
	that include "boot, log, procfs, debugfs, at cmd, loopcheck, dumpmem,
	reset, reboot,etc"

config WCN_UTILS
	bool "wcn debug for read and write register"
	depends on SPRD_DEBUG
	help
	Choose Y here if you need to read/write register of wcn chip,
	this is used for RD debug.

	In order to control or debug your marlin chip, you will need to support
	procfs command to read/write register of marlin chip on.

config WCN_RDCDBG
	bool "wcn kernel_write log and mermory to file"
	help
	Choose Y here if you need to save log and memory not by native server,
	this is used for RD debug.

	In order to control or debug your marlin chip, you will need to support
	save log and mermory auto.

config WCN_PLATFORM
	tristate "Platform Support"
	depends on WCN_INTEG
	default n
	help
	Enable this module for Unisoc WCN integration
	chip debug and manage function.

	In order to control or debug your marlin chip, you will need to
	support procfs command and memory dump,cp log and so on.

config WCN_SWD
	bool "wcn swd support"
	depends on UMW2653
	help
	Choose Y here if you need to support SWD driver to access arm registers,
	this is used for RD debug.

	In order to control or debug your marlin chip, you will need to support
	swd driver to access arm registers.
```

## drivers/unisoc_platform/sprdwcn/sdio/Kconfig
```kconfig
# SPDX-License-Identifier: GPL-2.0
#
# Unisoc WCN sdio configuration
#

config SDIOHAL
	tristate "SDIO Support"
	depends on SC23XX
	default n
	help
	  Enable this module for Unisoc WCN sdio device
	  chip sdio interface bus Support.
	  Please insmod this module before any other
	  WCN subsystems. Thanks.
```

## drivers/unisoc_platform/sprdwcn/sipc/Kconfig
```kconfig
config WCN_SIPC
	tristate "WCN SIPC Support"
	depends on WCN_INTEG
	default y
	help
	  Enable this module for Unisoc WCN integration
	  chip sipc Support.
	  Please insmod this module before any other
	  WCN subsystems. Thanks.
```

## drivers/unisoc_platform/sprdwcn/sleep/Kconfig
```kconfig
config WCN_SLP
	tristate "Sleep Support"
	depends on SDIOHAL
        default n
	help
	  Enable this module for Unisoc SC2355
	  chip sdio interface bus Support.
	  Please insmod this module before any other
	  WCN subsystems. Thanks.
```

## drivers/unisoc_platform/thermal/Kconfig
```kconfig
# SPDX-License-Identifier: GPL-2.0-only
#
# Generic thermal drivers configuration
#
menu "Unisoc Thermal Management"

config UNISOC_CPU_COOLING_DEVICE
        tristate "sprd cpu cooling device"
        depends on ARCH_SPRD
        depends on THERMAL_OF
        help
	  Say M here to support core control cooling mechanism through
	  hotplug out/hotplug in or pause/resume cpus.

config UNISOC_GPU_COOLING_DEVICE
	tristate "sprd gpu cooling device"
	depends on ARCH_SPRD || THERMAL_OF
	depends on DEVFREQ_THERMAL
	help
	  Say M or y here to support gpu cooling device and build power model for IPA.
	  This implements the generic gpu cooling mechanism through frequency reduction.

config UNISOC_NPU_COOLING_DEVICE
	tristate "sprd npu cooling device"
	depends on ARCH_SPRD || THERMAL_OF
	depends on DEVFREQ_THERMAL
	help
	  Say M or y here to support npu cooling device and build power model for IPA.
	  This implements the generic npu cooling mechanism through frequency reduction.

config UNISOC_SOC_THERMAL
	tristate "sprd soc thermal"
	depends on ARCH_SPRD || THERMAL_OF
	help
	  Say M here to support virtual thermal for soc chip.

config UNISOC_THERMAL_CTL
	tristate "sprd thermal control"
	depends on ARCH_SPRD || THERMAL_OF
	depends on THERMAL_GOV_POWER_ALLOCATOR
	depends on CPU_FREQ_THERMAL
	help
	  Say M here to support platform thermal control.

endmenu
```

## drivers/unisoc_platform/usbpinmux/Kconfig
```kconfig
config SPRD_USBPINMUX
	tristate "Spreadtrum USBPINMUX Support"
        default n
	help
	  Say M here to support USBPINMUX.

config SPRD_USBPINMUX_QOGIRL6_CTRL
	bool "Spreadtrum QOGIRL6 USBPINMUX Control Support"
	depends on SPRD_USBPINMUX
	help
	  Say Y here to support QOGIRL6 USBPINMUX CONTROL.

config SPRD_USBPINMUX_QOGIRN6PRO_CTRL
	bool "Spreadtrum QOGIRN6PRO USBPINMUX Control Support"
	depends on SPRD_USBPINMUX
	help
	  Say Y here to support QOGIRN6PRO USBPINMUX CONTROL.
```

## drivers/unisoc_platform/userlog/Kconfig
```kconfig
config UNISOC_USERLOG
	tristate "Enable UNISOC user log point feature"
	default n
	help
	  This option enables UNISOC log feature for user log point.
```

## drivers/usb/function/Kconfig
```kconfig
menu "USB Function Support"
	depends on !USB_GADGET

config USB_MSM_OTG
	bool "OTG support for Qualcomm on-chip USB controller"
	depends on USB && USB_FUNCTION && USB_EHCI_MSM
	help
	  USB OTG driver.
	  This driver is required if you want to use USB in
	  Host mode and Device mode.

config USB_FUNCTION
	boolean "Support for USB Function Drivers"
	help
	   The USB Function framework is similar to the Gadget framework
	   but a little simpler and a little more plugable.  It trades
	   some flexibility in the framework for smaller and simpler
	   function drivers that can be combined into a composite driver.

choice
	prompt "USB Peripheral Controller"
	depends on USB_FUNCTION
	help
	  USB devices interfaces with the host using a controller.
	  Many controller drivers are platform-specific; these
	  often need board-specific hooks.

config USB_FUNCTION_MSM_HSUSB
	boolean "MSM Highspeed USB Peripheral Controller"
	depends on ARCH_MSM
	help
	  High speed USB device controller for Qualcomm chipsets using
	  USB Function framework. Controller supports IAD and
	  32 endpoints(16 IN and 16 OUT).

endchoice

config USB_FUNCTION_NULL
	boolean "Null Function -- eats packets"
	depends on USB_FUNCTION
	depends on USB_FUNCTION_MSM_HSUSB
	default n

config USB_FUNCTION_ZERO
	boolean "Zero Function -- generates packets"
	depends on USB_FUNCTION
	depends on USB_FUNCTION_MSM_HSUSB
	default n

config USB_FUNCTION_LOOPBACK
	boolean "Loopback Function -- returns packets"
	depends on USB_FUNCTION
	depends on USB_FUNCTION_MSM_HSUSB
	default n

config USB_FUNCTION_ADB
	tristate "ADB Transport Function"
	depends on USB_FUNCTION
	depends on USB_FUNCTION_MSM_HSUSB
	help
	  Function Driver for the Android ADB Protocol

	  Say "y" to link the driver statically, or "m" to build a
	  dynamically linked module called "adb"

	default USB_FUNCTION_MSM_HSUSB

config USB_FUNCTION_UMS
	boolean "USB Mass Storage Function (userspace)"
	depends on USB_FUNCTION
	depends on USB_FUNCTION_MSM_HSUSB
	default n

config USB_FUNCTION_MASS_STORAGE
	tristate "USB Mass Storage Function (kernel based)"
	depends on USB_FUNCTION
	depends on USB_FUNCTION_MSM_HSUSB && SWITCH
	help
	  The File-backed Storage function driver acts as a USB Mass Storage
	  disk drive.  As its storage repository it can use a regular
	  file or a block device specified as a module parameter. Initial
	  driver version is derived from Gadget framework and ported to
	  Function driver framework.

	  Say "y" to link the driver statically, or "m" to build a
	  dynamically linked module called "file_storage".

	default USB_FUNCTION_MSM_HSUSB

config USB_CSW_HACK
	boolean "USB Mass storage csw hack Feature"
	depends on USB_FUNCTION
	depends on USB_FUNCTION_MASS_STORAGE
	help
	 This csw hack feature is for increasing the performance of the mass
	 storage

	default n

config USB_FUNCTION_DIAG
	tristate "USB MSM Diag Function"
	depends on USB_FUNCTION
	depends on USB_FUNCTION_MSM_HSUSB
	help
	  Simple bridge driver between smd and debug client(host side)

	  Say "y" to link the driver statically, or "m" to build a
	  dynamically linked module called "diag".

	default USB_FUNCTION_MSM_HSUSB

config USB_FUNCTION_ETHER
	tristate "USB Ethernet Function"
	depends on USB_FUNCTION
	depends on USB_FUNCTION_MSM_HSUSB
	help
	  Implements the Ethernet style communication using CDC/ECM.

	  Say "y" to link the driver statically, or "m" to build a
	  dynamically linked module called "ether".

	default USB_FUNCTION_MSM_HSUSB

config USB_FUNCTION_SERIAL
	tristate "USB Serial Function"
	depends on USB_FUNCTION
	depends on USB_FUNCTION_MSM_HSUSB
	help
	  Implements serial communication using single interface; uses
	  two endpoints(bulk-in and bulk out) for data transfer and a
	  interrupt endpoint for control data transfer.

	  Say "y" to link the driver statically, or "m" to build a
	  dynamically linked module called "serial".

	default USB_FUNCTION_MSM_HSUSB

config USB_FUNCTION_RMNET
	bool "RmNet function driver"
	depends on USB_FUNCTION
	depends on USB_FUNCTION_MSM_HSUSB
	default n
	help
	  Implements Rmnet function.
	  Rmnet is an alternative to CDC-ECM and Windows RNDIS. It uses
	  QUALCOMM MSM Interface for control transfers. It acts like a
	  bridge between Host and modem found in MSM chipsets.

config RMNET_SMD_CTL_CHANNEL
	string "control SMD channel name"
	depends on USB_FUNCTION_RMNET
	default ""
	help
	  Control SMD channel for transferring QMI messages

config RMNET_SMD_DATA_CHANNEL
	string "Data SMD channel name"
	depends on USB_FUNCTION_RMNET
	default ""
	help
	  Data SMD channel for transferring network data

endmenu
```
