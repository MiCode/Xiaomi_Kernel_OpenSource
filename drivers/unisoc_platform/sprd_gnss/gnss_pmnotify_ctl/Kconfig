## drivers/usb/phy/Kconfig
```kconfig
# SPDX-License-Identifier: GPL-2.0
#
# Physical Layer USB driver configuration
#
menu "USB Physical Layer drivers"

config USB_PHY
	select EXTCON
	def_bool n

#
# USB Transceiver Drivers
#
config AB8500_USB
	tristate "AB8500 USB Transceiver Driver"
	depends on AB8500_CORE
	select USB_PHY
	help
	  Enable this to support the USB OTG transceiver in AB8500 chip.
	  This transceiver supports high and full speed devices plus,
	  in host mode, low speed.

config FSL_USB2_OTG
	tristate "Freescale USB OTG Transceiver Driver"
	depends on USB_EHCI_FSL && USB_FSL_USB2 && USB_OTG_FSM=y && PM
	depends on USB_GADGET || !USB_GADGET # if USB_GADGET=m, this can't be 'y'
	select USB_PHY
	help
	  Enable this to support Freescale USB OTG transceiver.

config ISP1301_OMAP
	tristate "Philips ISP1301 with OMAP OTG"
	depends on I2C && ARCH_OMAP_OTG
	depends on USB
	depends on USB_GADGET || !USB_GADGET # if USB_GADGET=m, this can't be 'y'
	select USB_PHY
	help
	  If you say yes here you get support for the Philips ISP1301
	  USB-On-The-Go transceiver working with the OMAP OTG controller.
	  The ISP1301 is a full speed USB  transceiver which is used in
	  products including H2, H3, and H4 development boards for Texas
	  Instruments OMAP processors.

	  This driver can also be built as a module.  If so, the module
	  will be called phy-isp1301-omap.

config KEYSTONE_USB_PHY
	tristate "Keystone USB PHY Driver"
	depends on ARCH_KEYSTONE || COMPILE_TEST
	depends on NOP_USB_XCEIV
	help
	  Enable this to support Keystone USB phy. This driver provides
	  interface to interact with USB 2.0 and USB 3.0 PHY that is part
	  of the Keystone SOC.

config NOP_USB_XCEIV
	tristate "NOP USB Transceiver Driver"
	depends on USB_GADGET || !USB_GADGET # if USB_GADGET=m, NOP can't be built-in
	select USB_PHY
	help
	  This driver is to be used by all the usb transceiver which are either
	  built-in with usb ip or which are autonomous and doesn't require any
	  phy programming such as ISP1x04 etc.

config AM335X_CONTROL_USB
	tristate

config AM335X_PHY_USB
	tristate "AM335x USB PHY Driver"
	depends on ARM || COMPILE_TEST
	depends on NOP_USB_XCEIV
	select USB_PHY
	select AM335X_CONTROL_USB
	select USB_COMMON
	help
	  This driver provides PHY support for that phy which part for the
	  AM335x SoC.

config TWL6030_USB
	tristate "TWL6030 USB Transceiver Driver"
	depends on TWL4030_CORE && OMAP_USB2 && USB_MUSB_OMAP2PLUS
	depends on OF
	help
	  Enable this to support the USB OTG transceiver on TWL6030
	  family chips. This TWL6030 transceiver has the VBUS and ID GND
	  and OTG SRP events capabilities. For all other transceiver functionality
	  UTMI PHY is embedded in OMAP4430. The internal PHY configurations APIs
	  are hooked to this driver through platform_data structure.
	  The definition of internal PHY APIs are in the mach-omap2 layer.

config USB_GPIO_VBUS
	tristate "GPIO based peripheral-only VBUS sensing 'transceiver'"
	depends on GPIOLIB || COMPILE_TEST
	depends on USB_GADGET || !USB_GADGET # if USB_GADGET=m, this can't be 'y'
	select USB_PHY
	help
	  Provides simple GPIO VBUS sensing for controllers with an
	  internal transceiver via the usb_phy interface, and
	  optionally control of a D+ pullup GPIO as well as a VBUS
	  current limit regulator.

config OMAP_OTG
	tristate "OMAP USB OTG controller driver"
	depends on ARCH_OMAP_OTG && EXTCON
	help
	  Enable this to support some transceivers on OMAP1 platforms. OTG
	  controller is needed to switch between host and peripheral modes.

	  This driver can also be built as a module. If so, the module
	  will be called phy-omap-otg.

config TAHVO_USB
	tristate "Tahvo USB transceiver driver"
	depends on MFD_RETU
	depends on USB_GADGET || !USB_GADGET # if USB_GADGET=m, this can't be 'y'
	select USB_PHY
	help
	  Enable this to support USB transceiver on Tahvo. This is used
	  at least on Nokia 770.

config TAHVO_USB_HOST_BY_DEFAULT
	depends on TAHVO_USB
	bool "Device in USB host mode by default"
	help
	  Say Y here, if you want the device to enter USB host mode
	  by default on bootup.

config USB_ISP1301
	tristate "NXP ISP1301 USB transceiver support"
	depends on USB || USB_GADGET
	depends on I2C
	select USB_PHY
	help
	  Say Y here to add support for the NXP ISP1301 USB transceiver driver.
	  This chip is typically used as USB transceiver for USB host, gadget
	  and OTG drivers (to be selected separately).

	  To compile this driver as a module, choose M here: the
	  module will be called phy-isp1301.

config USB_MV_OTG
	tristate "Marvell USB OTG support"
	depends on USB_EHCI_MV && USB_MV_UDC && PM && USB_OTG
	depends on USB_GADGET || !USB_GADGET # if USB_GADGET=m, this can't be 'y'
	select USB_PHY
	help
	  Say Y here if you want to build Marvell USB OTG transceiver
	  driver in kernel (including PXA and MMP series). This driver
	  implements role switch between EHCI host driver and gadget driver.

	  To compile this driver as a module, choose M here.

config USB_MXS_PHY
	tristate "Freescale MXS USB PHY support"
	depends on ARCH_MXC || ARCH_MXS
	select STMP_DEVICE
	select USB_PHY
	help
	  Enable this to support the Freescale MXS USB PHY.

	  MXS Phy is used by some of the i.MX SoCs, for example imx23/28/6x.

config USB_TEGRA_PHY
	tristate "NVIDIA Tegra USB PHY Driver"
	depends on ARCH_TEGRA || COMPILE_TEST
	select USB_COMMON
	select USB_PHY
	select USB_ULPI
	help
	  This driver provides PHY support for the USB controllers found
	  on NVIDIA Tegra SoC's.

config SPRD_SHARKL3_USB2_PHY
	tristate "Unisoc Sharkl3 USB2 PHY Driver"
	depends on ARCH_SPRD || COMPILE_TEST
	select USB_PHY
	select SPRD_BC1P2
	help
	  Enable this to support the SPRD SHARKL3 USB2 PHY that is part of SOC.
	  This driver takes care of all the PHY functionality, normally paired with
	  DesignWare USB20 (DRD) Controller.

config SPRD_SHARKL5_USB2_PHY
	tristate "Unisoc Sharkl5 USB2 PHY Driver"
	select USB_PHY
	select SPRD_BC1P2
	help
	  Enable this to support the SPRD SHARKL5 USB2 PHY that is part of SOC.
	  This driver takes care of all the PHY functionality, normally paired with
	  DesignWare USB20 (DRD) Controller.
	  different config parameter define different way to load devices.

config USB_SPRD_UMS512_PHY
	tristate "Unisoc ums512 USB2 PHY Driver"
	depends on ARCH_SPRD || COMPILE_TEST
	select USB_PHY
	select SPRD_BC1P2
	help
	  Enable this to support the SPRD ums512 USB2 PHY that is part of SOC.
	  This driver takes care of all the PHY functionality, normally paired with
	  DesignWare USB20 (DRD) Controller.

config SPRD_PIKE2_USB2_PHY
	tristate "Spreadtrum PIKE2 USB2 PHY Driver"
	depends on (ARM && ARCH_SPRD) || COMPILE_TEST
	select USB_PHY
	select SPRD_BC1P2
	help
	  Enable this to support the SPRD PIKE2 USB2 PHY that is part of SOC.
	  This driver takes care of all the PHY functionality, normally paired with
	  DesignWare USB20 (DRD) Controller.
	  different config parameter define different way to load devices.

config SPRD_SHARKLE_USB2_PHY
	tristate "Spreadtrum Sharkle USB2 PHY Driver"
	depends on (ARM && ARCH_SPRD) || COMPILE_TEST
	select USB_PHY
	select SPRD_BC1P2
	help
	  Enable this to support the SPRD SHARKLE USB2 PHY that is part of SOC.
	  This driver takes care of all the PHY functionality, normally paired with
	  DesignWare USB20 (DRD) Controller.
	  different config parameter define different way to load devices.

config SPRD_QOGIRL6_USB2_PHY
	tristate "Unisoc Qogirl6 USB2 PHY Driver"
	depends on ARCH_SPRD || COMPILE_TEST
	select USB_PHY
	select SPRD_BC1P2
	help
	  Enable this to support the SPRD QOGIRL6 USB2 PHY that is part of SOC.
	  This driver takes care of all the PHY functionality,
	  normally paired with DesignWare USB20 (DRD) Controller or
	  UNISOC musb phy (DRD )controller.

config SPRD_USB_DUMMY_PHY
	tristate "Unisoc USB DUMMY PHY Driver"
	select USB_PHY
	help
	  Enable this to support the SPRD USB DUMMY PHY that is needed for
	  usb (DWC3/MUSB) switch function.

config SPRD_BC1P2
	tristate "Spreadtrum USB BC1P2 support"
	select USB_PHY
	help
	  Added this to support the sprd USB BC1P2.
	  This driver provides secondary BC1P2 detection.
	  This driver is supported by default.

config SPRD_QOGIRN6PRO_USB2_PHY
	tristate "Spreadtrum Qogirn6pro USB2 PHY Driver"
	select USB_PHY
	select SPRD_BC1P2
	help
	  Enable this to support the SPRD QOGIRN6PRO USB2 PHY that is part of SOC.
	  This driver takes care of all the PHY functionality, normally paired with
	  DesignWare USB20 (DRD) Controller.

config SPRD_QOGIRN6PRO_USB31_PHY
	tristate "Unisoc QOGIRN6PRO PHY Driver"
	select USB_PHY
	select SPRD_BC1P2
	depends on USB_DWC3_SPRD ||  COMPILE_TEST
	help
	  Enable this to support QOGIRN6PRO USB3 PHY that is part of SOC. This
	  driver takes care of all the PHY functionality, normally paired
	  with DesignWare USB3.0 (DRD) Controller.

config SPRD_QOGIRN6LITE_USB2_PHY
	tristate "Spreadtrum Qogirn6lite USB2 PHY Driver"
	select USB_PHY
	select SPRD_BC1P2
	help
	  Enable this to support the SPRD QOGIRN6LITE USB2 PHY that is part of SOC.
	  This driver takes care of all the PHY functionality, normally paired with
	  DesignWare USB20 (DRD) Controller.

config SPRD_COMMONPHY
	tristate "Spreadtrum COMMON PHY EVENT Driver"
	depends on ARCH_SPRD || COMPILE_TEST
	select USB_PHY
	help
	  Enable this to support the SPRD USB PHY that is part of data role switch.
	  Used for event notification, dpdm switch to the hardware or the usb phy.
	  It is an indispensable part of the data role switch.
	  Group the same members of different structures together

config USB_ULPI
	bool "Generic ULPI Transceiver Driver"
	depends on ARM || ARM64 || COMPILE_TEST
	select USB_ULPI_VIEWPORT
	help
	  Enable this to support ULPI connected USB OTG transceivers which
	  are likely found on embedded boards.

config USB_ULPI_VIEWPORT
	bool
	help
	  Provides read/write operations to the ULPI phy register set for
	  controllers with a viewport register (e.g. Chipidea/ARC controllers).

config JZ4770_PHY
	tristate "Ingenic SoCs Transceiver Driver"
	depends on MIPS || COMPILE_TEST
	select USB_PHY
	help
	  This driver provides PHY support for the USB controller found
	  on the JZ-series and X-series SoCs from Ingenic.

config SPRD_REDRIVER_PTN38003A
	tristate "Unisoc PTN38003A Driver"
	select USB_PHY
	depends on SPRD_QOGIRN6PRO_USB31_PHY
	help
	  Enable this to support QOGIRN6PRO USB3 PHY . This
	  driver is redriver for usb3.0.

endmenu
```

## drivers/usb/redriver/Kconfig
```kconfig
# SPDX-License-Identifier: GPL-2.0-only

menuconfig USB_REDRIVER
	tristate "USB super speed (plus) redriver support"
	help
	  USB super speed (plus) redriver chip used to improve
	  USB signal which have long path(USB connector <-->
	  FPC cable <---> USB PHY).

	  Normally this kind of chip have i2c bus interface.


if USB_REDRIVER

config USB_REDRIVER_NB7VPQ904M
	tristate "USB 3.1 Gen1/Gen2 10Gbps driver for NB7VPQ904M redriver"
	select REGMAP_I2C
	help
	  NB7VPQ904M come from ON-SEMI company,
	  it enhance USB super (plus) signal on mobile platform.
	  it have i2c program interface.
	  Say Y/M here if you want to support it.

endif
```

## drivers/usb/repeater/Kconfig
```kconfig
# SPDX-License-Identifier: GPL-2.0-only
#
# USB eUSB2 repeater driver configuration
#
menu "USB eUSB2 repeater drivers"

config USB_REPEATER
	tristate "usb repeater framework"
	help
	  Enable this to allow eUSB2 PHY driver and connected repeater driver
	  to bind with together, and provide eUS2 PHY driver ways to perform
	  set of operations with repeater for USB2 functionality using eUSB2
	  PHY and eUSB2 repeater.

endmenu
```

## drivers/usb/typec/Kconfig
```kconfig
config USB_TYPEC_CORE
	bool "Support for Type-C phy and detect"
	depends on USB_TYPEC
	help
	  Say Y here if your system has a Type-C connector support
	  for USB controller based on the USB phy IP Core and detection
	  available based on cc pull-up, pull-down or floating.

config USB_TYPEC_PHY_FUSB300
	depends on USB_TYPEC_CORE
	tristate "Support FUSB300 Type-C Phy"
	help
	  Say Y or M here if your system has a Dual Role SuperSpeed
	  USB controller based on the DesignWare FUSB300/FUSB302 IP Core.

	  If you choose to build this driver is a dynamically linked
	  module, the module will be called  phy-fusb300.ko.
```

## drivers/usb/typec/maxim/Kconfig
```kconfig
#
# CCIC devices
#

comment "CCIC configs"

config CCIC_MAX77705
	tristate "CCIC 77705"
	depends on I2C
	default n
	help
	  If you say yes here you will get support for
	  max77705 ccic full version chipset

config CCIC_MAX77729
	tristate "CCIC 77729"
	depends on I2C
	default n
	help
	  If you say yes here you will get support for
	  max77729 ccic full version chipset

config MAXIM_CCIC_ALTERNATE_MODE
	bool "support alternate mode"
	depends on I2C
	default n
	help
	  If you say yes here you will get support for
	  alternate mode function with max77705 ccic chipset

config CCIC_MAX77705_DEBUG
	bool "CCIC 77705 DEBUG"
	depends on I2C
	default n
	help
	  If you say yes here you will get support for
	  debugging feature with max77705 ccic chipset

config MAX77705_FW_PID03_SUPPORT
	bool "support MAX77705 FW PID 0x03"
	depends on I2C
	default n
	help
	  If you say yes here you will get support for
	  specified firmware with max77705 ccic chipset

config MUIC_MAX77705
	tristate "Using MAX77705 MUIC"
	depends on I2C
	default n
	help
	  If you say yes here you will get support for
	  the MAX77705 MUIC chip.
	  To enable this driver,
	  USE_MUIC should be enabled.

config MUIC_MAX77729
	tristate "Using MAX77729 MUIC"
	depends on I2C
	default n
	help
	  If you say yes here you will get support for
	  the MAX77729 MUIC chip.
	  To enable this driver,
	  USE_MUIC should be enabled.

config HV_MUIC_MAX77705_AFC
	tristate "Using MAX77705 AFC MUIC"
	default n
	help
	  If you say yes here you will get support for
	  the MAX77705 AFC MUIC.
	  To enable this driver,
	  MUIC_MAX77705 should be enabled.

config MUIC_MAX77705_PDIC
	tristate "Using MAX77705 MUIC supports CCIC chip interface"
	default n
	help
	  If you say yes here you will get support for
	  the CCIC chip with MAX77705 MUIC.
	  To enable this driver,
	  MUIC_MAX77705 and MUIC_SUPPORT_CCIC should be enabled.

config AFC
	bool "Using MAX77705 AFC"
	default n
	help
	  If you say yes here you will get support for
	  the MAX77705 AFC.
	  To enable this driver,
	  MUIC_MAX77705 should be enabled.

config SUPPORT_QC30
	bool "SUPPORT_QC30"
	default n
	help
	  If you say yes here you will get support for the QC3.0 charger.

config MUIC_QC_DISABLE
	bool "Using QC charging"
	depends on I2C
	default n
	help
	  If you say yes here you will not get support for the QC charging
```

## drivers/usb/typec/platform/external/tcpc/Kconfig
```kconfig
#
# TypeC Port Controller Device Configuration
#

config TCPC_CLASS
	tristate "TypeC Port Controller Device Class"
	depends on TYPEC
	default n
	help
	  Say Y to enable
	  Typec Port
	  Controller Device
	  Class

config USB_POWER_DELIVERY
	tristate "Support USB power delivery Function"
	depends on TCPC_CLASS
	default n
	help
	  Say Y to enable
	  USB
	  Power Delivery
	  support

config DUAL_ROLE_USB_INTF
	tristate "Support DUAL ROLE USB INTF Function"
	depends on TCPC_CLASS
	default n
	help
	  Say Y to enable
	  Dual Role USB Intf
	  support

config TCPC_RT1711H
	tristate "Richtek RT1711H TypeC port Controller Driver"
	depends on TCPC_CLASS
	default n
	help
	  Say Y to enable
	  Richtek RT1711H
	  TypeC port Controller
	  Driver

config USB_PD_VBUS_STABLE_TOUT
	int "PD VBUS Stable Timeout"
	depends on USB_POWER_DELIVERY
	range 0 1000                       # >= 0,  <= 1000
	default 125
	help
	  Setup a timeout value (ms)
	  for
	  VBUS change
	  stable

config PD_DBG_INFO
	bool "PD debug information"
	depends on TCPC_CLASS
	default y
	help
	  Say Y to enable PD debug
	  information
	  Say N to disable
```
