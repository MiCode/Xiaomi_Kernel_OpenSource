## drivers/usb/musb/Kconfig
```kconfig
# SPDX-License-Identifier: GPL-2.0
#
# USB Dual Role (OTG-ready) Controller Drivers
# for silicon based on Mentor Graphics INVENTRA designs
#

# (M)HDRC = (Multipoint) Highspeed Dual-Role Controller
config USB_MUSB_HDRC
	tristate 'Inventra Highspeed Dual Role Controller'
	depends on (USB || USB_GADGET)
	depends on HAS_IOMEM
	help
	  Say Y here if your system has a dual role high speed USB
	  controller based on the Mentor Graphics silicon IP.  Then
	  configure options to match your silicon and the board
	  it's being used with, including the USB peripheral role,
	  or the USB host role, or both.

	  Texas Instruments families using this IP include DaVinci
	  (35x, 644x ...), OMAP 243x, OMAP 3, and TUSB 6010.

	  Allwinner SoCs using this IP include A10, A13, A20, ...

	  If you do not know what this is, please say N.

	  To compile this driver as a module, choose M here; the
	  module will be called "musb-hdrc".

if USB_MUSB_HDRC

choice
	bool "MUSB Mode Selection"
	default USB_MUSB_DUAL_ROLE if (USB && USB_GADGET)
	default USB_MUSB_HOST if (USB && !USB_GADGET)
	default USB_MUSB_GADGET if (!USB && USB_GADGET)

config USB_MUSB_HOST
	bool "Host only mode"
	depends on USB=y || USB=USB_MUSB_HDRC
	help
	  Select this when you want to use MUSB in host mode only,
	  thereby the gadget feature will be regressed.

config USB_MUSB_GADGET
	bool "Gadget only mode"
	depends on USB_GADGET=y || USB_GADGET=USB_MUSB_HDRC
	depends on HAS_DMA
	help
	  Select this when you want to use MUSB in gadget mode only,
	  thereby the host feature will be regressed.

config USB_MUSB_DUAL_ROLE
	bool "Dual Role mode"
	depends on ((USB=y || USB=USB_MUSB_HDRC) && (USB_GADGET=y || USB_GADGET=USB_MUSB_HDRC))
	depends on HAS_DMA
	help
	  This is the default mode of working of MUSB controller where
	  both host and gadget features are enabled.

endchoice

comment "Platform Glue Layer"

config USB_MUSB_SUNXI
	tristate "Allwinner (sunxi)"
	depends on ARCH_SUNXI
	depends on NOP_USB_XCEIV
	depends on PHY_SUN4I_USB
	depends on EXTCON
	select GENERIC_PHY
	select SUNXI_SRAM

config USB_MUSB_DAVINCI
	tristate "DaVinci"
	depends on ARCH_DAVINCI_DMx
	depends on NOP_USB_XCEIV
	depends on BROKEN

config USB_MUSB_DA8XX
	tristate "DA8xx/OMAP-L1x"
	depends on ARCH_DAVINCI_DA8XX
	depends on NOP_USB_XCEIV
	select PHY_DA8XX_USB

config USB_MUSB_TUSB6010
	tristate "TUSB6010"
	depends on HAS_IOMEM
	depends on ARCH_OMAP2PLUS || COMPILE_TEST
	depends on NOP_USB_XCEIV!=m || USB_MUSB_HDRC=m

config USB_MUSB_OMAP2PLUS
	tristate "OMAP2430 and onwards"
	depends on ARCH_OMAP2PLUS && USB
	depends on OMAP_CONTROL_PHY || !OMAP_CONTROL_PHY
	select GENERIC_PHY

config USB_MUSB_AM35X
	tristate "AM35x"
	depends on ARCH_OMAP
	depends on NOP_USB_XCEIV

config USB_MUSB_DSPS
	tristate "TI DSPS platforms"
	depends on ARCH_OMAP2PLUS || COMPILE_TEST
	depends on OF_IRQ

config USB_MUSB_UX500
	tristate "Ux500 platforms"
	depends on ARCH_U8500 || COMPILE_TEST

config USB_MUSB_JZ4740
	tristate "JZ4740"
	depends on OF
	depends on MIPS || COMPILE_TEST
	depends on USB_MUSB_GADGET
	depends on USB=n || USB_OTG_DISABLE_EXTERNAL_HUB
	select USB_ROLE_SWITCH

config USB_MUSB_MEDIATEK
	tristate "MediaTek platforms"
	depends on ARCH_MEDIATEK || COMPILE_TEST
	depends on NOP_USB_XCEIV
	select GENERIC_PHY
	select USB_ROLE_SWITCH

config USB_MUSB_SPRD
	tristate 'SPRD platforms'
	help
	  Enable this to support the SPRD MUSB that is part of gadget. This driver
	  takes care of all the usb driver functionality, normally paired with
	  DesignWare MUSB20 (DRD) Controller.

comment "MUSB DMA mode"

config MUSB_PIO_ONLY
	bool 'Disable DMA (always use PIO)'
	help
	  All data is copied between memory and FIFO by the CPU.
	  DMA controllers are ignored.

	  Do not choose this unless DMA support for your SOC or board
	  is unavailable (or unstable).  When DMA is enabled at compile time,
	  you can still disable it at run time using the "use_dma=n" module
	  parameter.

if !MUSB_PIO_ONLY

config USB_SPRD_DMA
	tristate 'USE DMA MODE SPRD'
	depends on USB_MUSB_SPRD
	help
	  Enable this to support the SPRD USB DMA mode that is part of gadget. This driver
	  takes care of all the usb driver functionality, normally paired with
	  DesignWare MUSB20 (DRD) Controller.

config MUSB_SPRD_LOWPOWER
	bool 'MUSB LOWPOWER FUNCTION'
	depends on USB_MUSB_SPRD
	help
	  Enable this to support the SPRD MUSB LOWPOWER that hardware can enter into chipsleep
	  when usb is working in peripheral mode or host mode. In addition, it support remote
	  wakeup too. Software need to add this macro to enable musb lowpower function in
	  peripheral mode.

config USB_SPRD_DMA_V3
	bool 'DMA VERSION V3'
	depends on USB_SPRD_DMA
	help
	  Enable this to support the SPRD USB DMA mode V3 version that is part of gadget.
	  Because of usb dma hardware upgrading,software need to add this macro,used for
	  compatibility with old dma version.

config USB_SPRD_ADAPTIVE
	bool 'USB ADAPTIVE MODE'
	depends on USB_SPRD_DMA
	help
	  Enable this to support the SPRD USB ADAPTIVE that hardware transport data using dma
	  to DSP MCDT automatically within host audio mode. Software need to add this macro to
	  enable adaptive function.

config USB_SPRD_OFFLOAD
	bool 'USB OFFLOAD MODE'
	depends on USB_SPRD_DMA
	help
	  Enable this to support the SPRD USB OFFLOAD that hardware transport data using IIS
	  interface automatically within host audio mode. Software need to add this macro to
	  enable offload function.

config USB_SPRD_LINKFIFO
	bool 'USB LINKFIFO MODE'
	depends on USB_SPRD_DMA
	help
	  Enable this to support the SPRD LINKFIFO that software can prepare linknode firstly
	  without waiting for interrupt.
	  Add this macro can speed up musb throughput.
	  This begins from r4p0.

config USB_UX500_DMA
	bool 'ST Ericsson Ux500'
	depends on USB_MUSB_UX500
	help
	  Enable DMA transfers on UX500 platforms.

config USB_INVENTRA_DMA
	bool 'Inventra'
	depends on USB_MUSB_OMAP2PLUS || USB_MUSB_MEDIATEK || USB_MUSB_JZ4740
	help
	  Enable DMA transfers using Mentor's engine.

config USB_TI_CPPI_DMA
	bool 'TI CPPI (Davinci)'
	depends on USB_MUSB_DAVINCI
	help
	  Enable DMA transfers when TI CPPI DMA is available.

config USB_TI_CPPI41_DMA
	bool 'TI CPPI 4.1'
	depends on (ARCH_OMAP || ARCH_DAVINCI_DA8XX) && DMADEVICES
	select TI_CPPI41

config USB_TUSB_OMAP_DMA
	bool 'TUSB 6010'
	depends on USB_MUSB_TUSB6010 = USB_MUSB_HDRC # both built-in or both modules
	depends on ARCH_OMAP
	help
	  Enable DMA transfers on TUSB 6010 when OMAP DMA is available.

endif # !MUSB_PIO_ONLY

endif # USB_MUSB_HDRC
```

## drivers/usb/otg/Kconfig
```kconfig
#
# USB OTG infrastructure may be needed for peripheral-only, host-only,
# or OTG-capable configurations when OTG transceivers or controllers
# are used.
#

comment "OTG and related infrastructure"

config USB_OTG_UTILS
	bool
	help
	  Select this to make sure the build includes objects from
	  the OTG infrastructure directory.

config USB_OTG_WAKELOCK
	bool "Hold a wakelock when USB connected"
	depends on WAKELOCK
	select USB_OTG_UTILS
	help
	  Select this to automatically hold a wakelock when USB is
	  connected, preventing suspend.

if USB || USB_GADGET

#
# USB Transceiver Drivers
#
config USB_GPIO_VBUS
	tristate "GPIO based peripheral-only VBUS sensing 'transceiver'"
	depends on GENERIC_GPIO
	select USB_OTG_UTILS
	help
	  Provides simple GPIO VBUS sensing for controllers with an
	  internal transceiver via the usb_phy interface, and
	  optionally control of a D+ pullup GPIO as well as a VBUS
	  current limit regulator.

config ISP1301_OMAP
	tristate "Philips ISP1301 with OMAP OTG"
	depends on I2C && ARCH_OMAP_OTG
	select USB_OTG_UTILS
	help
	  If you say yes here you get support for the Philips ISP1301
	  USB-On-The-Go transceiver working with the OMAP OTG controller.
	  The ISP1301 is a full speed USB  transceiver which is used in
	  products including H2, H3, and H4 development boards for Texas
	  Instruments OMAP processors.

	  This driver can also be built as a module.  If so, the module
	  will be called isp1301_omap.

config USB_ULPI
	bool "Generic ULPI Transceiver Driver"
	depends on ARM
	select USB_OTG_UTILS
	help
	  Enable this to support ULPI connected USB OTG transceivers which
	  are likely found on embedded boards.

config USB_ULPI_VIEWPORT
	bool
	depends on USB_ULPI
	help
	  Provides read/write operations to the ULPI phy register set for
	  controllers with a viewport register (e.g. Chipidea/ARC controllers).

config TWL4030_USB
	tristate "TWL4030 USB Transceiver Driver"
	depends on TWL4030_CORE && REGULATOR_TWL4030
	select USB_OTG_UTILS
	help
	  Enable this to support the USB OTG transceiver on TWL4030
	  family chips (including the TWL5030 and TPS659x0 devices).
	  This transceiver supports high and full speed devices plus,
	  in host mode, low speed.

config USB_MSM_OTG_72K
	bool "OTG support for Legcay Qualcomm on-chip USB controller"
	depends on ARCH_MSM
	select USB_OTG_UTILS
	default USB_MSM_72K
	help
	  Enable this to support the USB OTG transceiver on MSM chips. It
	  handles PHY initialization, clock management, low power mode and
	  workarounds required after resetting the hardware. This driver is
	  required for even peripheral only or host only mode configuration.
	  Supports SRP and HNP when both gadget and Host are selected.

config MSM_OTG_ENABLE_A_WAIT_BCON_TIMEOUT
	bool "Enable A-device timeout for B-device connection"
	depends on USB_MSM_OTG_72K
	default n
	help
	   OTG specification allows A-device to turn off VBUS if B-device
	   fails to signal connect event before TA_WAIT_BCON (1.1 - 30 sec).
	   SRP detection is enabled and hardware is put into low power mode
	   upon this timeout.

	   If you say yes, VBUS will be turned off if B-device does not signal
	   connect in 30 sec. Otherwise VBUS is not turned off when Micro-A
	   cable is connected. But hardware is put into LPM. Say no if leakage
	   currents in your system are minimum.


config TWL6030_USB
	tristate "TWL6030 USB Transceiver Driver"
	depends on TWL4030_CORE
	select USB_OTG_UTILS
	help
	  Enable this to support the USB OTG transceiver on TWL6030
	  family chips. This TWL6030 transceiver has the VBUS and ID GND
	  and OTG SRP events capabilities. For all other transceiver functionality
	  UTMI PHY is embedded in OMAP4430. The internal PHY configurations APIs
	  are hooked to this driver through platform_data structure.
	  The definition of internal PHY APIs are in the mach-omap2 layer.

config NOP_USB_XCEIV
	tristate "NOP USB Transceiver Driver"
	select USB_OTG_UTILS
	help
	  This driver is to be used by all the usb transceiver which are either
	  built-in with usb ip or which are autonomous and doesn't require any
	  phy programming such as ISP1x04 etc.

config USB_MSM_OTG
	tristate "OTG support for Qualcomm on-chip USB controller"
	depends on (USB || USB_GADGET) && ARCH_MSM
	select USB_OTG_UTILS
	help
	  Enable this to support the USB OTG transceiver on MSM chips. It
	  handles PHY initialization, clock management, and workarounds
	  required after resetting the hardware and power management.
	  This driver is required even for peripheral only or host only
	  mode configurations.
	  This driver is not supported on boards like trout which
	  has an external PHY.

config USB_MSM_ACA
	bool "Support for Accessory Charger Adapter (ACA)"
	depends on (USB_MSM_OTG || USB_MSM_OTG_72K) && ARCH_MSM
	default n
	help
	  Accesory Charger Adapter is a charger specified in USB Battery
	  Charging Specification(1.1). It enables OTG devices to charge
	  while operating as a host or peripheral at the same time.

config USB_MSM_STANDARD_ACA
	bool "Support for Standard ACA"
	depends on USB_MSM_ACA
	default USB_MSM_OTG_72K
	help
	  A Standard ACA has a Standard-A receptacle on the Accessory Port,
	  and can only be attached to a B-device.  RID_A and RID_GND states
	  are only possible with Standard ACA.  Select this feature if the
	  board is intended to support only Standard ACA.

config AB8500_USB
	tristate "AB8500 USB Transceiver Driver"
	depends on AB8500_CORE
	select USB_OTG_UTILS
	help
	  Enable this to support the USB OTG transceiver in AB8500 chip.
	  This transceiver supports high and full speed devices plus,
	  in host mode, low speed.

config FSL_USB2_OTG
	bool "Freescale USB OTG Transceiver Driver"
	depends on USB_EHCI_FSL && USB_GADGET_FSL_USB2 && USB_SUSPEND
	select USB_OTG
	select USB_OTG_UTILS
	help
	  Enable this to support Freescale USB OTG transceiver.

config USB_MV_OTG
	tristate "Marvell USB OTG support"
	depends on USB_EHCI_MV && USB_MV_UDC && USB_SUSPEND
	select USB_OTG
	select USB_OTG_UTILS
	help
	  Say Y here if you want to build Marvell USB OTG transciever
	  driver in kernel (including PXA and MMP series). This driver
	  implements role switch between EHCI host driver and gadget driver.

	  To compile this driver as a module, choose M here.

endif # USB || OTG
```

## drivers/usb/pd/Kconfig
```kconfig
#
# USB Power Delivery driver configuration
#
menu "USB Power Delivery"

config USB_PD
	def_bool n

config USB_PD_POLICY
	tristate "USB Power Delivery Protocol and Policy Engine"
	depends on EXTCON
	select USB_PD
	help
          Say Y here to enable USB PD protocol and policy engine.

endmenu
```
