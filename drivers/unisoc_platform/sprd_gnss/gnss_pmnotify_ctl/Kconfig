## drivers/usb/typec/tcpc/Kconfig
```kconfig
#
# TypeC Port Controller Device Configuration
#

config TCPC_CLASS
	tristate "TypeC Port Controller Device Class"
	select TYPEC
	help
	  Say Y to enable
	  Typec Port
	  Controller Device
	  Class

config USB_POWER_DELIVERY
	tristate "Support USB power delivery Function"
	depends on TCPC_CLASS
	default n
	help
	  Say Y to enable
	  USB
	  Power Delivery
	  support

config DUAL_ROLE_USB_INTF
	tristate "Support USB power delivery Function"
	depends on TCPC_CLASS
	default n
	help
	  Say Y to enable
	  USB
	  Power Delivery
	  support

config TCPC_SC660X
	tristate "SouthChip SC660X TypeC port Controller Driver"
	depends on TCPC_CLASS
	default n
	help
	  Say Y to enable
	  SouthChip SC660X
	  TypeC port Controller
	  Driver

config TCPC_SC2150
	tristate "SouthChip SC2150 TypeC port Controller Driver"
	depends on TCPC_CLASS
	default n
	help
	  Say Y to enable
	  SouthChip SC2150
	  TypeC port Controller
	  Driver

config TCPC_BA41A
	tristate "SY BA41A TypeC port Controller Driver"
	depends on TCPC_CLASS
	default n
	help
	  Say Y to enable
	  SY BA41A
	  TypeC port Controller
	  Driver

config TCPC_NU660X
	tristate "SY NU660X TypeC port Controller Driver"
	depends on TCPC_CLASS
	default n
	help
	  Say Y to enable
	  SY NU660X
	  TypeC port Controller
	  Driver

config USB_PD_VBUS_STABLE_TOUT
	int "PD VBUS Stable Timeout"
	depends on USB_POWER_DELIVERY
	range 0 1000                       # >= 0,  <= 1000
	default 125
	help
	  Setup a timeout value (ms)
	  for
	  VBUS change
	  stable

config PD_DBG_INFO
	tristate "PD debug information"
	depends on TCPC_CLASS
	default y
	help
	  Say Y to enable PD debug
	  information
	  Say N to disable
```

## drivers/usb/typec/wusb3801x/Kconfig
```kconfig
#
# USB Miscellaneous driver configuration
#
comment "USB Miscellaneous drivers"


config WUSB3801_DEBUG
	bool "IGC WUSB3801X Configuration Channel Controller for USB Type-C"
	depends on USB || I2C
	default n
	help
	  Enable this to support WUSB3801X CC Controller for USB Type C.



config DUAL_ROLE_USB_INTF
        bool "IGC WUSB3801X Configuration Channel Controller for USB Type-C"
        depends on USB || I2C
        default n
        help
          Enable this to support WUSB3801X CC Controller for USB Type C.
```

## drivers/uwb-sr100/Kconfig
```kconfig
#
# Nxp SPI SR100  devices
#

config NXP_SR100
	tristate "Nxp SPI driver for SR100 devices"
```
