## drivers/unisoc_platform/binder/Kconfig
```kconfig
# SPDX-License-Identifier: GPL-2.0-only
#
# Copyright 2023 Unisoc(Shanghai) Technologies Co.Ltd
# This program is free software; you can redistribute it and/or modify it under the terms of the
# GNU General Public License as published by the Free Software Foundation; version 2.
# This program is distributed in the hope that it will be useful, but WITHOUT ANY WARRANTY;
# without even the implied warranty of MERCHANTABILITY or FITNESS FOR A PARTICULAR PURPOSE.
# See the GNU General Public License for more details.
# You should have received a copy of the GNU General Public License along with this program;
# if not, write to the Free Software Foundation, Inc., 51 Franklin Street, Fifth Floor, Boston,
# MA 02110-1301, USA.

menu "Unisoc Binder Features"

config UNISOC_BINDER
	tristate "Support Unisoc Binder Features"
	depends on ANDROID_BINDER_IPC
	default n
	help
	  This is the base of unisoc binder feature.

	  Unisoc binder is add some customized changes into Android binder driver through
	  Android binder driver vendor hooks.And now we support the binder netlink feature,
	  and binder thread related schedule policy and priority adjust.

config UNISOC_BINDER_NETLINK
	bool "Support binder netlink feature"
	default y
	depends on UNISOC_BINDER
	help
	  binder netlink feature is used to communication between userspace and binder driver.

	  When enable this feature, userspace process can send genl message to binder driver, and binder
	  driver also can send some genl message to userspace.
	  If you do not want to receive the messege, turn off it.

config UNISOC_BINDER_SCHED
	tristate "Support Binder thread sched feature."
	default y
	depends on UNISOC_BINDER_NETLINK
	help
	  This feature contains two features now:
		1) dynamic abort the binder priority restore flow when user required
		2) dynamic enable the binder thread inherit rt when user required

	  Unisoc binder sched feature is used to add some customized changes for the binder thread
	  schedule policy and priority.

endmenu
```

## drivers/unisoc_platform/cpufreq/Kconfig
```kconfig
# SPDX-License-Identifier: GPL-2.0-only
#
# unisoc multi freq control for cpufreq
#

config UNISOC_MULTI_FREQ_CONTROL
	tristate "enable unisoc multi freq control"
	depends on CPU_FREQ
	help
	This option enables cpufreq high level freq control for user.

config UNISOC_FIX_FREQ
	bool "enable unisoc fix freq for debug"
	depends on UNISOC_MULTI_FREQ_CONTROL
	default n
	help
	Add scaling_fix_freq ops for debug.
```

## drivers/unisoc_platform/debug/apb_prot/Kconfig
```kconfig
config SPRD_APB_PROT
	tristate "Spreadtrum APB PROT Support"
	depends on SPRD_DEBUG
	help
	  Say Y here to support APB PROT
```

## drivers/unisoc_platform/debug/busmonitor/Kconfig
```kconfig
config SPRD_BUSMONITOR
	tristate "Spreadtrum BUS Monitor Support"
	depends on SPRD_DEBUG
	help
	  Say Y here to support BUS monitor.

config SPRD_APB_BUSMONITOR
	tristate "Spreadtrum APB BUS Monitor Support"
	depends on SPRD_DEBUG
	help
	  Say Y here to support APB BUS monitor.
```

## drivers/unisoc_platform/debug/djtag/Kconfig
```kconfig
config SPRD_DJTAG_CORE
	tristate "Spreadtrum DJTAG Core Support"
	depends on SPRD_DEBUG
	help
	  Say Y here to support the djtag core.

config SPRD_DJTAG
	tristate "Spreadtrum DJTAG Support"
	depends on SPRD_DEBUG
	help
	  Say Y here to support djtag For sharkle, sharkl3
```

## drivers/unisoc_platform/debug/dmc_mpu/Kconfig
```kconfig
config SPRD_DMC_MPU
	tristate "Spreadtrum DMC MPU Support"
	depends on SPRD_DEBUG
	select SPRD_DMC_MPU_CORE
	help
	  Say Y here to support dmc mpu support.

config SPRD_DMC_MPU_R4P0
	tristate "Spreadtrum DMC MPU R4P0 Support"
	depends on SPRD_DEBUG
	help
	  Say Y here to support R3P0 dmc mpu support.

config SPRD_DMC_MPU_R3P0
	tristate "Spreadtrum DMC MPU R3P0 Support"
	depends on SPRD_DEBUG
	help
	  Say Y here to support R3P0 dmc mpu support.

config SPRD_DMC_MPU_CORE
	bool "Spreadtrum DMC MPU Core Support"
	depends on SPRD_DEBUG
	default n
	help
	  Say Y here to support the dmc mpu core.
```

## drivers/unisoc_platform/debug/sprd_undef_hook/Kconfig
```kconfig
config SPRD_UNDEF_HOOK
	bool "SPRD print cache when undefined instruction exception occurs"
	depends on ARM64 && SPRD_DEBUG
	help
	  SPRD print cache when undefined instruction exception occurs
```

## drivers/unisoc_platform/debug/userspace_debug/Kconfig
```kconfig
# SPDX-License-Identifier: GPL-2.0

config SHOW_UREGS_WITH_PHYSICAL
	tristate "SPRD userspace debug: show uregs with phys"
	depends on ARM64
	help
	  This option enables process show user regs with their physcial
          address before coredump

config SPRD_SCREEN_ONOFF_CHECK
	tristate "SPRD userspace debug: screen onoff timeout check"
	depends on ARCH_SPRD
	help
	  This option enables screen onoff timeout checking while
	  powerkey pressed.
```

## drivers/unisoc_platform/debug_log/Kconfig
```kconfig
menu "DEBUG_LOG modules"

config SPRD_MODEM_DEBUG
	tristate "Spreadtrum SoC Modem Debug Log Driver"
	default n
	help
	  Spreadtrum modem debug log is a module that
	  just for modem engineers to catch modem debug
	  logs through MIPI D-PHY interface.

config SPRD_MIPI_LOG_R0P0
	tristate "Spreadtrum SoC Modem Debug Log Driver_R0P0"
	help
	  Just for synopsys D-PHY that support whale2 and
	  Say Y here to support MIPI LOG support.

config SPRD_MIPI_LOG_R1P0
	tristate "Spreadtrum SoC Modem Debug Log Driver_R1P0"
	help
	  Just for sprd D-PHY that support sharkl2 and
	  Say Y here to support R1P0 MIPI LOG interface.

config SPRD_MIPI_LOG_R2P0
	tristate "Spreadtrum SoC Modem Debug Log Driver_R2P0"
	help
	  Just for sprd D-PHY that not support pll config and
	  Say Y here to support R2P0 MIPI LOG support.

config SPRD_MIPI_LOG_R3P0
	tristate "Spreadtrum SoC Modem Debug Log Driver_R3P0"
	help
	  Just for sprd D-PHY that support isharkl2 and
	  Say Y here to support R3P0 MIPI LOG support.

config SPRD_MIPI_LOG_R4P0
	tristate "Spreadtrum SoC Modem Debug Log Driver_R4P0"
	help
	  Just for sprd D-PHY that support sharklj1 and
	  Say Y here to support R4P0 MIPI LOG support.

config SPRD_MIPI_LOG_R4P2
	tristate "Spreadtrum SoC Modem Debug Log Driver_R4P2"
	help
	  Just for sprd D-PHY that support SerDes R4P2 and CSI_DSI TWPLL
	  Say Y here to support R4P2 MIPI LOG support.

config SPRD_MIPI_LOG_R5P0
	tristate "Spreadtrum SoC Modem Debug Log Driver_R5P0"
	help
	  Just for sprd D-PHY that support SerDes R5P0 and CSI_DSI TWPLL
	  Say Y here to support R5P0 MIPI LOG support.

config SPRD_MIPI_LOG_R5P1
	tristate "Spreadtrum SoC Modem Debug Log Driver_R5P1"
	help
	  Just for sprd D-PHY that support SerDes R5P1 and CSI_DSI TWPLL
	  Say Y here to support R5P1 MIPI LOG support.

config SPRD_MIPI_LOG_QOGIRN6PRO
	tristate "Spreadtrum SoC Modem Debug Log Driver_qogirn6pro"
	help
	  Just for sprd D-PHY that support SerDes qogirn6pro and CSI_DSI TWPLL
	  Say Y here to support qogirn6pro MIPI LOG support.

config SPRD_MIPI_SWITCH
	tristate "Spreadtrum SoC Modem Debug Log MIPI_SWITCH"
	help
	  Just for sprd MIPI SWITCH
	  Say Y here to support MIPI SWITCH.

endmenu
```

## drivers/unisoc_platform/dmabufheap/Kconfig
```kconfig
config UNISOC_DMABUF
	tristate "UNISOC DMABUF Support"
	depends on DMABUF_HEAPS
	help
	   Choose this option to enable UNISOC dmabuf support.
```

## drivers/unisoc_platform/hang_debug/Kconfig
```kconfig
config SPRD_HANG_DEBUG
	bool "Enable SPRD hang debug feature"
	default n
	help
	  This option enables SPRD hang debug feature which dump and
	  print debug info when kernel panics.

config SPRD_APHANG
	tristate "Enable SPRD hang debug wdf wdh feature"
	depends on SPRD_HANG_DEBUG
	help
	  This option combines two ko, wdh and wdf,
	  in order to reduce the number of ko and
	  ensures that the original function
	  is not lost.

config SPRD_HANG_RESET
	bool "trigger cm4 handling ap watchdog reset"
	depends on SPRD_APHANG
	default y

config SPRD_HANG_TRIGGER
	bool "supply a driver for trigger AP cpu hang"
	depends on SPRD_HANG_DEBUG
	help
	  This option triggers SPRD cpu hang.

config SPRD_WDF_FEED_TIME_MS
	int "modify feed watchdog time ms"
	depends on SPRD_HANG_DEBUG
	default 8000
	help
	  This option enables modify feed watchdog interval config.

config SPRD_WDT_TIMEOUT_MS
	int "modify watchdog timeout ms"
	depends on SPRD_HANG_DEBUG
	default 40000
	help
	  This option enables modify watchdog timeout.

config SPRD_WDT_PRETIMEOUT_MS
	int "modify pertimeout ms"
	depends on SPRD_HANG_DEBUG
	default 20000
	help
	  This option enables modify watchdog pretimeout.
```

## drivers/unisoc_platform/iommu/Kconfig
```kconfig
#SPDX-FileCopyrightText: 2019 Unisoc (Shanghai) Technologies Co.Ltd
#SPDX-License-Identifier: GPL-2.0-only

config UNISOC_IOMMU
	tristate "UNISOC Soc IOMMU Module"
	depends on ARM || ARM64
	depends on ARCH_SPRD
	help
	  Choose this option can support unisoc iommu driver, which can use as an address translater
	  for Device DMA address access, support above 4G address access and scatter pages
	  access.
```

## drivers/unisoc_platform/irq_monitor/Kconfig
```kconfig
config	IRQ_MONITOR
	tristate "Warn if interrupts occur too frequently"
	help
	  If selected, a warning log will be thrown out if any interrupt occurs
	  too frequently.

config	IRQ_CONSUMPTION_MONITOR
	tristate "Warn if interrupts handlers occupy too much cpu time"
        depends on IRQ_MONITOR
	help
	  If selected, a warning log will be thrown out if single irq or whole
	  irq handlers occpupy too much cpu time.
```

## drivers/unisoc_platform/kts_sync/Kconfig
```kconfig
config TIMESTAMP_SYNC
	tristate "Print the boot time when system resumes"
	depends on PRINTK_CALLER
	help
	  Selecting this options to print the boot time when system resumes. It
	  also creates the '/proc/kts_sync' node, which provides the boot time.
```

## drivers/unisoc_platform/mm/Kconfig
```kconfig
# SPDX-License-Identifier: GPL-2.0-only
#
# unisoc memory managerment vendor hook
#
menu "Unisoc Memory Management Vendor Hook"

source "drivers/unisoc_platform/mm/emem/Kconfig"
source "drivers/unisoc_platform/mm/reclaim/Kconfig"
source "drivers/unisoc_platform/mm/cma/Kconfig"

endmenu
```

## drivers/unisoc_platform/mm/cma/Kconfig
```kconfig
# SPDX-License-Identifier: GPL-2.0-only

config UNISOC_CMA_FEATURES
	tristate "unisoc cma features"
	help
	  This item introduce two vendor hooks for unisoc cma
	  related features.
	  gfp_highuser_adjust is used for anon allocation.
	  use_cma_check is used for pre-condition check of optimization of
	  cma allocation.

config GFP_HIGHUSER_ADJUST
	bool "gfp flag adjust"
	default y
	help
	  This config implement the vendor hook function to do the adjust
	  on gfp flags.
	  This could be useful for anon or zram pages as android have them
	  use GFP_CMA now.

config USE_CMA_FIRST_CHECK
	bool "use cma first check"
	default y
	help
	  This config revise the default value of use_cma_first_check which
	  is introduced to keep AOSP's behaviour unchanged by default.
	  This value should be set to Y in any circumstance as it is indeed
	  a bug there.
```

## drivers/unisoc_platform/mm/emem/Kconfig
```kconfig
# SPDX-License-Identifier: GPL-2.0-only

config UNISOC_MM_ENHANCE_MEMINFO
	tristate "Enable enhance meminfo on unisoc platform"
	depends on ARCH_SPRD && MMU && ARM64
	default n
	help
	  Output more memory information for unisoc SoC on ARM64,
	  which includes task meminfo, vmstat meminfo, vmalloc meminfo,
	  slub meminfo and memory usage in drivers beyond kmalloc
	  such as ZRAM, DMABUF and GPU etc.
```

## drivers/unisoc_platform/mm/reclaim/Kconfig
```kconfig
# SPDX-License-Identifier: GPL-2.0-only

config UNISOC_MM_RECLAIM
	tristate "mm vendor hook for unisoc"
	default n
	help
	  This option enables unisoc precise reclaim policy,
	  which include asynchronously reclaiming inactive file LRU,
	  shrinking reclaimable slabs cache and changing swappiness
	  in dirctly reclaim path.

config UNISOC_MM_SHRINKLRU
	bool "mm kshrink lru for unisoc"
	depends on UNISOC_MM_RECLAIM
	default n
	help
	  This option enables unisoc asynchronous shrinklru reclaim function

config UNISOC_MM_SHRINKSLAB
	bool "mm kshrink slab for unisoc"
	depends on UNISOC_MM_RECLAIM
	default n
	help
	  This option enables unisoc asynchronous shrinkslab reclaim function

config UNISOC_MM_DIRECT_SWAPPINESS
	bool "config swappiness on direct reclaim"
	depends on UNISOC_MM_RECLAIM && ARM64
	default n
	help
	  The swappiness value influnce file pages and anon pages when page
	  reclaim. The value may not be the same in kswapd reclaim path and
	  direct reclaim path and range is 0 ~ 100.

config UNISOC_MM_SHRINK_ANON
	bool "mm shrink anon for unisoc"
	depends on UNISOC_MM_RECLAIM
	default n
	help
	  This option enables unisoc shrink anon reclaim function
```

## drivers/unisoc_platform/modem/Kconfig
```kconfig
#
# UNISOC MODEM drivers
#

config UNISOC_MODEM
	tristate "UNISOC modem driver"
	depends on ARCH_SPRD
	help
	  UNISOC modem driver

source "drivers/unisoc_platform/modem/cp_dump/Kconfig"
source "drivers/unisoc_platform/modem/iq/Kconfig"
source "drivers/unisoc_platform/modem/mailbox/Kconfig"
source "drivers/unisoc_platform/modem/modem_loader/Kconfig"
source "drivers/unisoc_platform/modem/pcie/Kconfig"
source "drivers/unisoc_platform/modem/power_manager/Kconfig"
source "drivers/unisoc_platform/modem/sipc/Kconfig"
source "drivers/unisoc_platform/modem/sipc_virt_bus/Kconfig"
```

## drivers/unisoc_platform/modem/cp_dump/Kconfig
```kconfig
config UNISOC_CP_DUMP
	tristate "UNISOC CP Dump"
	default n
	help
	  UNISOC cp dump driver, used for cp dump.
```

## drivers/unisoc_platform/modem/iq/Kconfig
```kconfig
menu "SPRD IQ modules"

config UNISOC_IQ
	tristate "Sprd IQ"
	default n
	help
	  Sprd IQ module, capture the iq data.

endmenu
```

## drivers/unisoc_platform/modem/mailbox/Kconfig
```kconfig
#
# SPRD MAILBOX drivers
#
config UNISOC_MAILBOX
	tristate "Unisoc Mailbox"
	depends on ARCH_SPRD || COMPILE_TEST
	select MAILBOX
	help
	  Mailbox driver implementation for the Unisoc platform only. It is used
	  to send message between application processors and MCU. Say Y here if
	  you want to build the Unisoc mailbox controller driver.

config UNISOC_MAILBOX_R1
	bool "Unisoc Mailbox R1 Version"
	depends on UNISOC_MAILBOX
	help
	  This feature be opened indicate that the mailbox
	  module will use the mailbox r1 version.

config UNISOC_MAILBOX_R2
	bool "Unisoc Mailbox R2 Version"
	depends on UNISOC_MAILBOX
	help
	  This feature be opened indicate that the mailbox
	  module will use the mailbox r2 version.
```

## drivers/unisoc_platform/modem/modem_loader/Kconfig
```kconfig
config UNISOC_MODEM_LOADER
	tristate "UNISOC Modem Loader"
	select UNISOC_MODEM_POWER_MANAGER
	default n
	help
	  UNISOC modem loader driver. It be user for modem poweron,
	  modem image load, modem memory dump, modem boot and modem reset.
config UNISOC_MODEM_LOADER_RAM_VMAP
	bool "Enable modem ram vmap ext in ARM"
	default n
	help
	  This option is use for modem map ram in ARM.
```

## drivers/unisoc_platform/modem/power_manager/Kconfig
```kconfig
config UNISOC_MODEM_POWER_MANAGER
	tristate "UNISOC Modem Power Manager"
	depends on PM_SLEEP
	default n
	help
	  UNISOC modem power manager. It be user for modem power management,
```
