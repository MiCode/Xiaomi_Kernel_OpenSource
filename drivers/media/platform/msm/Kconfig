## drivers/media/platform/msm/dvb/Kconfig
```kconfig
# SPDX-License-Identifier: GPL-2.0-only

config DVB_MPQ
	tristate "Qualcomm Technologies Inc Multimedia Processor DVB Adapter"
	depends on ARCH_QCOM && DVB_CORE
	default n

	help
	Support for Qualcomm Technologies Inc MPQ based DVB adapter.
	DVB Adapter implements Digital Video Broadcasting devices according
	to LinuxTV (http://www.linuxtv.org) defined API and infrastructure.
	Implemented devices are dvb/demux devices, dvb/dvr devices and
	dvb/video devices.
	Say Y or M if you own such a device and want to use it.

source "drivers/media/platform/msm/dvb/demux/Kconfig"
```

## drivers/media/platform/msm/dvb/demux/Kconfig
```kconfig
# SPDX-License-Identifier: GPL-2.0-only

comment "Qualcomm Technologies, Inc. Demux device config"
menuconfig DVB_MPQ_DEMUX
	tristate "DVB Demux Device"
	depends on DVB_MPQ && ION
	default n

	help
	  Support for Qualcomm Technologies Inc based dvb demux device.
	  Say Y if you own such a device and want to use it.
	  The Demux device is used to stream playback either
	  from TSIF interface or from DVR interface.

config DVB_MPQ_NUM_DMX_DEVICES
	int "Number of demux devices"
	depends on DVB_MPQ_DEMUX
	default 4
	range 1 255

	help
	  Configure number of demux devices.
	  Depends on your use-cases for maximum concurrent stream playback.

config DVB_MPQ_TSPP1
	bool "TSPPv1 plugin"
	depends on DVB_MPQ_DEMUX && TSPP
	help
		Use this option if your HW has
		Transport Stream Packet Processor(TSPP) version1 support.
		Demux may take adavantage of HW capabilities to perform
		some tasks in HW instead of SW.

config DVB_MPQ_SW
	bool "Software plugin"
	depends on DVB_MPQ_DEMUX && !DVB_MPQ_TSPP1
	help
		Use this option if your HW does not have any
		TSPP hardware support. All  demux tasks will be
		performed in SW.
```

## drivers/media/platform/msm/dvb/video/Kconfig
```kconfig
config DVB_MPQ_VIDEO
	tristate "DVB Video Device"
	depends on DVB_MPQ

	---help---
	  This is a dvb/video interface with extensions for
	  Qualcomm Chipset Video hardware. For dvb/video
	  specification please check http://linuxtv.org/

	  Say Y or M if you own such a device and want to use it.

config DVB_MPQ_NUM_VIDEO_DEVICES
	int "Number of video devices"
	depends on DVB_MPQ_VIDEO
	default 4
	range 1 255
```

## drivers/media/platform/msm/npu/Kconfig
```kconfig
# SPDX-License-Identifier: GPL-2.0-only

config MSM_NPU
	tristate "QTI MSM Neural Processing Unit support"
	depends on ARCH_QCOM
	help
	  Enable support for Neural Processing Unit
	  for specific QTI chipsets.
	  This module serves as the common driver
	  for npu which provides acceleration for neural
	  network processing.

config VIRTIO_NPU
	tristate "Virtio MSM Neural Processing Unit support"
	depends on VIRTIO && MSM_NPU
	help
	  This is the virtual frontend driver for Neural Processing Unit
	  based on virtio. Say Y if you want to support virtual NPU.
```

## drivers/media/platform/msm/npu_v2/Kconfig
```kconfig
config MSM_NPU_V2

	tristate "QTI MSM Neural Processing Unit support V2"
	depends on ARCH_QCOM && MSM_NPU=n
	help
	  Enable support for Neural Processing Unit V2.0
	  for specific QTI chipsets.
	  This module serves as the common driver
	  for npu which provides acceleration for neural
	  network processing.
```

## drivers/media/platform/msm/sde/Kconfig
```kconfig
# SPDX-License-Identifier: GPL-2.0-only
config SDE_ROTATOR
	bool "QTI V4L2 based SDE Rotator"
	depends on ARCH_QCOM && VIDEO_V4L2
	select V4L2_MEM2MEM_DEV
	select VIDEOBUF2_CORE
	select SYNC_FILE
	help
	  Enable support of V4L2 rotator driver.
	  This feature enables the MSM SDE rotator v4l2
	  video driver for Qualcomm Technologies, Inc.
	  SYNC_FILE objects are used to help manage buffer
	  synchronization.

config SDE_ROTATOR_EVTLOG_DEBUG
	depends on SDE_ROTATOR
	bool "Enable sde rotator debugging"
	help
	The SDE rotator debugging provides support to enable rotator debugging
	features to: Dump rotator registers during driver errors, panic
	driver during fatal errors and enable some rotator driver logging
	into an internal buffer (this avoids logging overhead).
```

## drivers/media/platform/msm/synx/Kconfig
```kconfig
# SPDX-License-Identifier: GPL-2.0-only

menuconfig MSM_GLOBAL_SYNX
	tristate "Qualcomm Technologies, Inc. Global Synchronization Framework"
	depends on ARCH_QCOM
	help
	  Say M here to enable global synchronization module for
	  Qualcomm Technologies, Inc. chipsets.
	  Enabling this adds support for global synchronization across
	  heterogeneous cores.

menuconfig MSM_GLOBAL_IPCLITE
	tristate "Qualcomm Technologies, Inc. IPCLite Framework"
	depends on ARCH_QCOM
	help
	  Say M here to enable ipclite protocol module for
	  Qualcomm Technologies, Inc. chipsets.
	  Enabling this adds support for communication across
	  cores via ipclite protocol.

menuconfig MSM_GLOBAL_SYNX_V2
	tristate "Qualcomm Technologies, Inc. Global Synchronization Framework"
	depends on ARCH_QCOM
	help
	  Say M here to enable global synchronization V2 module for
	  Qualcomm Technologies, Inc. chipsets.
	  Enabling this adds support for global synchronization across
	  heterogeneous cores.
```

## drivers/media/platform/msm/vcap/Kconfig
```kconfig
config MSM_VCAP
	tristate "Qualcomm MSM VCAP"
	depends on VIDEO_DEV && VIDEO_V4L2
	default y
	---help---
		Enables VCAP driver. This device allows for video capture and
		video processing using the v4l2 api
```

## drivers/media/platform/msm/vidc/Kconfig
```kconfig
# SPDX-License-Identifier: GPL-2.0
#
# VIDEO CORE
#

menuconfig MSM_VIDC_V4L2
    tristate "Qualcomm Technologies, Inc. MSM V4L2 based video driver"
        depends on ARCH_QCOM && VIDEO_V4L2
        select VIDEOBUF2_CORE
        help
          Enable support of MSM V4L2 video driver for
          Qualcomm Technologies, Inc.
```

## drivers/media/platform/msm/vidc/vmem/Kconfig
```kconfig
menuconfig MSM_VIDC_VMEM
	tristate "Qualcomm Technologies Inc MSM VMEM driver"
	depends on ARCH_QCOM && MSM_VIDC_V4L2
```

## drivers/media/platform/msm/vidc_3x/Kconfig
```kconfig
# SPDX-License-Identifier: GPL-2.0-only
#
# VIDEO CORE
#
source "drivers/media/platform/msm/vidc_3x/governors/Kconfig"

menuconfig MSM_VIDC_3X_V4L2
	tristate "Qualcomm Technologies, Inc. MSM V4L2 3X based video driver"
		depends on ARCH_QCOM && VIDEO_V4L2
		select VIDEOBUF2_CORE
	help
		Enable support of MSM V4L2 3X based video driver for
		Qualcomm Technologies, Inc.
```

## drivers/media/platform/msm/vidc_3x/governors/Kconfig
```kconfig
menuconfig MSM_VIDC_3X_GOVERNORS
	tristate "Clock and bandwidth governors for QTI MSM V4L2 based video driver"
	depends on MSM_VIDC_3X_V4L2 && PM_DEVFREQ
	help
	Chooses a set of devfreq governors aimed at providing accurate bandwidth
	or clock frequency values for MSM V4L2 video driver.
```

## drivers/media/platform/msm/vidc_3x/vmem/Kconfig
```kconfig
# SPDX-License-Identifier: GPL-2.0-only
menuconfig MSM_VIDC_VMEM
	bool "Qualcomm Technologies Inc MSM VMEM driver"
	depends on ARCH_MSM && MSM_VIDC_V4L2
```

## drivers/media/platform/msm/vpu/Kconfig
```kconfig
config MSM_VPU
	tristate "MSM VPU"
	depends on VIDEO_V4L2
	---help---
		This flag enables enables the MSM VPU driver.
		This device allows for advanced video post processing using the
		v4l2 api.
		In its original version (no tunneling features) buffers are
		received from HLOS and sent back to HLOS after VPU hardware
		processing.
```

## drivers/media/platform/msm/wfd/Kconfig
```kconfig
menuconfig MSM_WFD
	bool "Qualcomm MSM Wifi Display Driver"
		depends on (MSM_VIDC_1080P || MSM_VIDC_V4L2)
		---help---
		Enables the Wifi Display driver.
```

## drivers/media/platform/mtk-aie/Kconfig
```kconfig
config MTK_CAMERA_FD_ISP7
	tristate "Mediatek AI engine function"
	select V4L2_MEM2MEM_DEV
	depends on VIDEOBUF2_DMA_CONTIG
	help
		Support the AI engine (AIE) feature

		AIE driver is a V4L2 memory-to-memory device driver which
		provides hardware accelerated face detection function,
		it can detect different sizes of faces in a raw image.
```

## drivers/media/platform/mtk-isp/Kconfig
```kconfig
config VIDEO_MTK_ISP_COMMON
	bool "Mediatek camera subsystem driver"
	select DMA_SHARED_BUFFER
	select VIDEO_V4L2_SUBDEV_API
	select VIDEOBUF2_DMA_CONTIG
	select VIDEOBUF2_CORE
	select VIDEOBUF2_V4L2
	select VIDEOBUF2_MEMOPS
	select MEDIA_CONTROLLER
	select MEDIA_CONTROLLER_REQUEST_API

	help
	    Generic helpers for Mediatek SoCs ISP drivers. Mediatek
	    SoCs ISP drivers have similar image handling flow. For
	    example, Mediatek's ISP IPs may accept multiple input
	    buffers of a frame and generate multiple output buffers
	    of different format, size and effect. The helpers
	    provide the functions to create the common flow.

	    This feature will be removed in the upstream version
	    of Mediatek SoCs ISP drivers. It added some
	    abstraction implementing V4L2 and VB2 ops using
	    MTK-specific ops, which is not a discouraged pattern
	    of V4L2 drivers.

	    Choose y if you have drivers using the common utilities.

config VIDEO_MTK_ISP_CAMSYS
	tristate "Mediatek camsys processing function"
	select RPMSG_MTK
	select RPMSG_MTK_CCD
	select MTK_CCD_REMOTEPROC
	help
	    Camsys driver controls 3A (autofocus, exposure,
	    and white balance) with tuning feature and output
	    the first capture image buffer in Mediatek's camera system.

	    This driver also provides a mipi-csi2 host driver used as a
	    interface to connect camera with Mediatek's SOCs. It is able
	    to handle multiple cameras
	    simultaneously.

	    Choose y if you want to use Mediatek SoCs to create image
	    capture application such as video recording and still image
	    capture.

config VIDEO_MTK_ISP_CAMSYS_DUBUG
	tristate "Mediatek camsys debug function"
	help
	    Camsys driver controls 3A (autofocus, exposure,
	    and white balance) with tuning feature and output
	    the first capture image buffer in Mediatek's camera system.
	    This configuration provides more debug information.

config VIDEO_MTK_ISP_HCP
	tristate "Mediatek hcp processing function"
	help
	    HCP driver acts a message protocol between imgsys driver and
	    userspace daemon. messages can include enqueue event, dequeue
	    events, and other notification events that are needed for a
	    working camera session.

config VIDEO_MTK_ISP_IMGSYS
	tristate "Mediatek imgsys processing function"
	help
	    imgsys driver controls post-processing on the streaming images
	    and/or statistics for better image qualities
	    such as noise reduction, edge enhencement,
	    and motion estimation, etc.

config VIDEO_MTK_ISP_IPESYS
	tristate "Mediatek ipesys processing function"
	help
	    ipesys driver is a varaint of imgsys driver
	    which process the images to generate useful statistics
	    for isp pipeline image computation such
	    as motion estimation.
```

## drivers/media/platform/mtk-vcodec/Kconfig
```kconfig
config VIDEO_MEDIATEK_VCODEC_V1
	bool "Specify Mediatek Video Vcodec Platform V1"
	help
	  Select MediaTek Video Vcodec Platform V1
	  v1 folder is dvfs setting for policy 1
	  Set Y to select this feature for specific platform-V1.
	  If unsure, set N to disable.

config VIDEO_MEDIATEK_VCODEC_V2
	bool "Specify Mediatek Video Vcodec Platform V2"
	help
	  Select MediaTek Video Vcodec Platform V2
	  v2 folder is dvfs setting for policy 2
	  Set Y to select this feature for specific platform-V2.
	  If unsure, set N to disable.
```
