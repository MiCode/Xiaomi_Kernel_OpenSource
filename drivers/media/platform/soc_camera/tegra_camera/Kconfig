## drivers/media/platform/soc_camera/tegra_camera/Kconfig
```kconfig
config VIDEO_TEGRA
	tristate "Tegra soc_camera host driver"
	depends on VIDEO_DEV && ARCH_TEGRA && SOC_CAMERA && HAS_DMA && HAVE_CLK
	select VIDEOBUF2_DMA_CONTIG
	---help---
	  This is a v4l2 driver for the Tegra camera interface
```

## drivers/media/platform/tegra/Kconfig
```kconfig
#
# camera/video device drivers supported.
#

source "drivers/media/platform/tegra/avp/Kconfig"
source "drivers/media/platform/tegra/mediaserver/Kconfig"
source "drivers/media/platform/tegra/nvavp/Kconfig"

# only involve device specific PCL drivers while virtual driver cannot
# handle it full functionally.
#source "drivers/media/video/tegra/cam_dev/Kconfig"

config TEGRA_DTV
        bool "Enable support for tegra dtv interface"
        depends on ARCH_TEGRA
        default y
        help
          Enables support for the Tegra dtv interface

          If unsure, say Y

config VIDEO_OV5650
        tristate "OV5650 camera sensor support"
        depends on I2C && ARCH_TEGRA
        ---help---
          This is a driver for the Omnivision OV5650 5MP camera sensor
          for use with the tegra isp.

config VIDEO_OV5640
        tristate "OV5640 camera sensor support"
        depends on I2C && ARCH_TEGRA
        ---help---
          This is a driver for the Omnivision OV5640 5MP camera sensor
          for use with the tegra isp.

config VIDEO_OV14810
        tristate "OV14810 camera sensor support"
        depends on I2C && ARCH_TEGRA
        ---help---
          This is a driver for the Omnivision OV14810 14MP camera sensor
          for use with the tegra isp.


config VIDEO_OV9726
        tristate "OV9726 camera sensor support"
        depends on I2C && ARCH_TEGRA
        ---help---
          This is a driver for the Omnivision OV9726 camera sensor
          for use with the tegra isp.

config VIDEO_OV2710
        tristate "OV2710 camera sensor support"
        depends on I2C && ARCH_TEGRA
        ---help---
          This is a driver for the Omnivision OV2710 camera sensor
          for use with the tegra isp.

config VIDEO_AR0832
        tristate "AR0832 camera sensor support"
        depends on I2C && ARCH_TEGRA
        ---help---
          This is a driver for the AR0832 camera sensor
          for use with the tegra isp.

config VIDEO_SOC380
        tristate "SOC380 camera sensor support"
        depends on I2C && ARCH_TEGRA
        ---help---
          This is a driver for the Semco soc380 camera sensor
          for use with the tegra isp.

config VIDEO_IMX091
        tristate "IMX091 camera sensor support"
        depends on I2C && ARCH_TEGRA
        ---help---
          This is a driver for the IMX091 camera sensor
          for use with the tegra isp.

config VIDEO_IMX135
        tristate "IMX135 camera sensor support"
        depends on I2C && ARCH_TEGRA
        ---help---
          This is a driver for the IMX135 camera sensor
          for use with the tegra isp.  The sensor has a
          maximum of 13MP (4208x3120) resolution with HDR
          capability.

config VIDEO_AR0261
        tristate "AR0261 camera sensor support"
        depends on I2C && ARCH_TEGRA
        ---help---
          This is a driver for the AR0261 camera sensor

config VIDEO_IMX132
        tristate "IMX132 camera sensor support"
        depends on I2C && ARCH_TEGRA
        ---help---
          This is a driver for the IMX132 camera sensor

config VIDEO_OV9772
        tristate "OV9772 camera sensor support"
        depends on I2C && ARCH_TEGRA
        ---help---
          This is a driver for the OV9772 camera sensor
          for use with the tegra isp.

config VIDEO_OV5693
        tristate "OV5693 camera sensor support"
        depends on I2C && ARCH_TEGRA
        ---help---
          This is a driver for the OV5693 camera sensor
          for use with the tegra isp.

config VIDEO_OV7695
        tristate "OV7695 camera sensor support"
        depends on I2C && ARCH_TEGRA
        ---help---
          This is a driver for the OV7695 YUV camera sensor device
          This sensor has external ISP, it isn't using tegra ISP.

config TORCH_SSL3250A
        tristate "SSL3250A flash/torch support"
        depends on I2C && ARCH_TEGRA
        ---help---
          This is a driver for the SSL3250A flash/torch camera device

config TORCH_TPS61050
        tristate "TPS61050 flash/torch support"
        depends on I2C && ARCH_TEGRA
        ---help---
          This is a driver for the TPS61050 flash/torch camera device

config MAX77665_FLASH
        tristate "MAX77665 flash/torch support"
        depends on I2C && ARCH_TEGRA
        select MFD_MAX77665
        ---help---
          This is a driver for the MAX77665 flash/torch camera device

config TORCH_MAX77387
        tristate "MAX77387 flash/torch support"
        depends on I2C && ARCH_TEGRA
        ---help---
          This is a driver for the MAX77387 flash/torch camera device
          for use with the tegra isp.

config TORCH_AS364X
        tristate "AS364X flash/torch support"
        depends on I2C && ARCH_TEGRA
        ---help---
          This is a driver for the AS364X flash/torch camera device

config TORCH_LM3565
        tristate "LM3565 flash/torch support"
        depends on I2C && ARCH_TEGRA
        ---help---
          This is a driver for the LM3565 flash/torch camera device

config VIDEO_SH532U
        tristate "SH532U focuser support"
        depends on I2C && ARCH_TEGRA
        ---help---
          This is a driver for the SEMCO SH532U focuser
          for use with the tegra isp.

config VIDEO_AD5820
        tristate "AD5820 focuser support"
        depends on I2C && ARCH_TEGRA
        ---help---
          This is a driver for the AD5820 focuser
          for use with the tegra isp.

config VIDEO_AD5823
        tristate "AD5823 focuser support"
        depends on I2C && ARCH_TEGRA
        ---help---
          This is a driver for the AD5823 focuser
          for use with the tegra isp.

config VIDEO_AD5816
        tristate "AD5816 focuser support"
        depends on I2C && ARCH_TEGRA
        ---help---
          This is a driver for the AD5816 focuser
          for use with the tegra isp.

config VIDEO_DW9718
        tristate "DW9718 focuser support"
        depends on I2C && ARCH_TEGRA
        ---help---
          This is a driver for the DW9718 focuser
          for use with the tegra isp.

config VIDEO_AR0833
        tristate "AR0833 camera sensor support"
        depends on I2C && ARCH_TEGRA
        ---help---
          This is a driver for the AR0833 camera sensor
          for use with the tegra isp.

config VIDEO_MT9M114
        tristate "SOC1040 camera sensor support"
        depends on I2C && ARCH_TEGRA
        ---help---
          This is a driver for the SOC1040 camera sensor
          for use with the tegra isp.

config VIDEO_IMX179
        tristate "IMX179 camera sensor support"
        depends on I2C && ARCH_TEGRA
        ---help---
          This is a driver for the IMX179 camera sensor
          for use with the tegra isp.

config VIDEO_CAMERA
        tristate "generic camera device support"
        depends on I2C && ARCH_TEGRA
        ---help---
          This is a driver for generic camera devices
          for use with the tegra isp.
```

## drivers/media/platform/tegra/avp/Kconfig
```kconfig
# Copyright (c) 2012-2013, NVIDIA CORPORATION.  All rights reserved.
#
# This program is free software; you can redistribute it and/or modify it
# under the terms and conditions of the GNU General Public License,
# version 2, as published by the Free Software Foundation.
#
# This program is distributed in the hope it will be useful, but WITHOUT
# ANY WARRANTY; without even the implied warranty of MERCHANTABILITY or
# FITNESS FOR A PARTICULAR PURPOSE.  See the GNU General Public License for
# more details.
#
# You should have received a copy of the GNU General Public License
# along with this program.  If not, see <http://www.gnu.org/licenses/>.

config TEGRA_RPC
	bool "Enable support for Tegra RPC"
	depends on ARCH_TEGRA
	default y
	help
	  Enables support for the RPC mechanism necessary for the Tegra
	  multimedia framework. It is both used to communicate locally on the
	  CPU between multiple multimedia components as well as to communicate
	  with the AVP for offloading media decode.

	  Exports the local tegra RPC interface on device node
	  /dev/tegra_rpc. Also provides tegra fd based semaphores needed by
	  the tegra multimedia framework.

	  If unsure, say Y
```

## drivers/media/platform/tegra/cam_dev/Kconfig
```kconfig
#
# devices supported by generic pcl kernel driver
#

config CAMERA_DEV_AS364X
	bool "Enable support for AS364X flash device"
	depends on VIDEO_CAMERA
	default n
	help

	  If unsure, say N

config CAMERA_DEV_IMX135
	bool "Enable support for IMX135 camera device"
	depends on VIDEO_CAMERA
	default n
	help

	  If unsure, say N
```

## drivers/media/platform/tegra/mediaserver/Kconfig
```kconfig
config TEGRA_MEDIASERVER
bool "Tegra Media Server support"
depends on ARCH_TEGRA && TEGRA_RPC
default y
help
  Enables support for the multiple OpenMAX clients.  Exports the
  interface on the device node /dev/tegra_mediaserver.

  If unsure, say Y
```

## drivers/media/platform/tegra/nvavp/Kconfig
```kconfig
config TEGRA_NVAVP
	bool "Enable support for Tegra NVAVP driver"
	depends on ARCH_TEGRA && TEGRA_GRHOST
	default n
	help
	  Enables support for the push-buffer mechanism based driver for the Tegra
	  multimedia framework. Exports the Tegra nvavp interface on device node
	  /dev/tegra_avpchannel.

	  If unsure, say N

config TEGRA_NVAVP_AUDIO
	bool "Enable Audio Channel support for Tegra NVAVP driver"
	depends on TEGRA_NVAVP
	default n
	help
	  Enables support for the push-buffer mechanism based driver for the Tegra
	  audio multimedia framework. Exports the Tegra nvavp interface on device node
	  /dev/tegra_audio_avpchannel.

	  If unsure, say N
```

## drivers/media/platform/xiaomi/Kconfig
```kconfig
config MIISP
    tristate "XIAOMI ISP"
    depends on PCI
    depends on PCI_MSM
    depends on REMOTEPROC
    help
      Enable support for XIAOMI ISP

config MIISP_CHIP
    bool "XIAOMI ISP real CHIP"
    depends on MIISP
    help
      Say Y here to fit systems with XIAOMI ISP real CHIP.
```

## drivers/media/platform/xiaomi/ispv3/Kconfig
```kconfig
config ISPV3
    tristate "XIAOMI isp for SN/MFNR capture and SN video support"
    depends on PCI
    depends on PCI_MSM
    help
      Enable support for XIAOMI isp SN/MFNR capture and SN video
```
