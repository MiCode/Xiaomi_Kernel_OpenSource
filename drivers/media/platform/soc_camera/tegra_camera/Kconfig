## drivers/memory/mediatek/Kconfig
```kconfig
# SPDX-License-Identifier: GPL-2.0

config MTK_SMI_BWC
	tristate "MediaTek BWC driver"
	help
	  BWC is mainy to optimize the bus access latency based on
	  multimedia scenarios.
	  It is required for many MTK multimedia middlewares including
	  camera and video middlewares on some legacy chips.
	  This config enables BWC functions.

config MTK_SMI_BWC_MT6761
	tristate "MediaTek BWC driver for MT6761"
	help
	  BWC is mainly to optimize the bus access latency based on
	  multimedia scenarios.
	  It is required for many MTK multimedia middlewares including
	  camera and video middlewares on some legacy chips.
	  This config enables BWC functions.

config MTK_SMI_BWC_MT6739
	tristate "MediaTek BWC driver for MT6739"
	help
	  BWC is mainly to optimize the bus access latency based on
	  multimedia scenarios.
	  It is required for many MTK multimedia middlewares including
	  camera and video middlewares on some legacy chips.
	  This config enables BWC functions.

config MTK_SMI_BWC_MT6765
	tristate "MediaTek BWC driver for MT6765"
	help
	  BWC is mainly to optimize the bus access latency based on
	  multimedia scenarios.
	  It is required for many MTK multimedia middlewares including
	  camera and video middlewares on some legacy chips.
	  This config enables BWC functions.

config HAVE_MTK_MC
	bool "MediaTek Memory Controller support"
	help
	  Support for the Memory Controller (MC) devices found on
	  MediaTek(R) SoCs.
	  This config enables MTK_EMI and MTK_DRAMC for EMI and
	  DRAMC drivers.

if HAVE_MTK_MC

config MTK_EMI_LEGACY_V0
	tristate "MediaTek External Memory Interface Legacy V0 driver"
	depends on HAVE_MTK_MC
	help
	  This selects the MediaTek(R) EMI driver.
	  Provide the API for MPU registration, EMI MPU violation handling,
	  the API for EMI information, the BWL golden setting,
	  and the sysfs for EMI ISU control.

config MTK_EMI_LEGACY
	tristate "MediaTek External Memory Interface Legacy driver"
	depends on HAVE_MTK_MC
	help
	  This selects the MediaTek(R) EMI driver.
	  Provide the API for MPU registration, EMI MPU violation handling,
	  the API for EMI information, the BWL golden setting,
	  and the sysfs for EMI ISU control.

config MTK_EMI_BWL_VERSION
	int "MTK_EMI_BWL_VERSION"
	depends on HAVE_MTK_MC
	default 0
	help
	  This selects the MediaTek(R) EMI driver.
	  Provide version for emi bwl implementation in kernel,
	  0 means not support by default.

config MTK_EMI
	tristate "MediaTek External Memory Interface driver"
	depends on HAVE_MTK_MC
	help
	  This selects the MediaTek(R) EMI driver.
	  Provide the API for MPU registration, EMI MPU violation handling,
	  the API for EMI information, the BWL golden setting,
	  and the sysfs for EMI ISU control.

config MTK_EMI_MPU_TEST
	tristate "MediaTek EMI MPU test"
	depends on HAVE_MTK_MC
	depends on MTK_EMI
	help
	  Enable support for the test of the Mediatek(R) EMI driver.
	  This driver is mainly for testing purposes. It creates interfaces
	  for the self-test code of EMI MPU running in the user space.
	  This driver should not be enabled in the release version.

config MTK_DRAMC_LEGACY
        tristate "MediaTek DRAMC LEGACY driver"
        depends on HAVE_MTK_MC
        help
          This selects the MediaTek(R) DRAMC driver.
          Provide the API for DRAMC low power scenario, and the interface
          for reporting DRAM information, e.g. DRAM mode register (MR) for
          DRAM vendor ID, temperature, and density.

config MTK_DRAMC
	tristate "MediaTek DRAMC driver"
	depends on HAVE_MTK_MC
	help
	  This selects the MediaTek(R) DRAMC driver.
	  Provide the API for DRAMC low power scenario, and the interface
	  for reporting DRAM information, e.g. DRAM mode register (MR) for
	  DRAM vendor ID, temperature, and density.

endif
```

## drivers/mfd/maxim/Kconfig
```kconfig
config MFD_MAX77705
	tristate "Maxim Semiconductor MAX77705 PMIC Support"
	depends on I2C=y
	select MFD_CORE
	help
	  Say yes here to support for Maxim Semiconductor MAX77705.
	  This is a Power Management IC with Charger, safe LDOs, Flash, Haptic
	  and MUIC controls on chip.
	  This driver provides common support for accessing the device;
	  additional drivers

config MFD_MAX77729
	tristate "Maxim Semiconductor MAX77729 PMIC Support"
	depends on I2C=y
	select MFD_CORE
	help
	  Say yes here to support for Maxim Semiconductor MAX77729.
	  This is a Power Management IC with Charger, safe LDOs, Flash, Haptic
	  and MUIC controls on chip.
	  This driver provides common support for accessing the device;
	  additional drivers

config QCOM_IFPMIC_SUSPEND
	tristate "QCOM_IFPMIC_SUSPEND Function Support"
	default n
	help
	  If you say yes here you will get support for
	  QCOM_IFPMIC_SUSPEND function
```

## drivers/mipi_bif/Kconfig
```kconfig
menuconfig MIPI_BIF
	tristate "MIPI_BIF support"
	depends on HAS_IOMEM
	select RT_MUTEXES
	---help---
	 Say y here if you want MIPI_BIF support to be
	 enabled.

if MIPI_BIF


config MIPI_BIF_TEGRA
	tristate "NVIDIA Tegra internal MIPIBIF controller"
	depends on ARCH_TEGRA_14x_SOC
	help
	 If you say yes to this option, support will be included for the
	 Tegra MIPIBIF Controller

endif
```

## drivers/misc/al6021/Kconfig
```kconfig
config ISPV2_AL6021
	tristate "ispv2 AL6021"
	help
	  Say Y here if you want to enable support altek AL6021
	  in your system.

	  If not, say N.

	  To compile this driver as a module, choose M here.
```

## drivers/misc/aw8622_haptic/Kconfig
```kconfig
#
# mediatek AW8622 Driver
#
config AW8622_HAPTIC 
	tristate "Awinic Aw8622 haptic driver"
	help
	  Say y here if you have Awinic AW8622 haptic controller 
	  chip in yours system

	  If unsure, say y.
```

## drivers/misc/aw8624_haptic/Kconfig
```kconfig
#
# Mediatek AW8624 Driver
#

config AW8624_HAPTIC
	tristate "Awinic AW8624 haptic driver"
	depends on I2C
	default n
```

## drivers/misc/aw869x_haptic/Kconfig
```kconfig
config AW869X_HAPTIC
    tristate "Haptic driver for awinic AW869X series"
    depends on I2C
    help
      This option enables support for AW869X series Haptic Driver.
```

## drivers/misc/bcm-lpm/Kconfig
```kconfig
config BCM_BT_LPM
	tristate "Broadcom Bluetooth Low Power Mode"
	depends on SERIAL_HSU
	default n
	help
	   Select this module for Broadcom Bluetooth low power management.
```

## drivers/misc/bt_lpm/Kconfig
```kconfig
config BT_LPM
	tristate "Bluetooth Low Power Mode"
	depends on SERIAL_HSU
	default n
	help
	   Select this module for Bluetooth Low Power Management.
```

## drivers/misc/cdfingerfp/Kconfig
```kconfig
config CDFINGER_FINGERPRINT
	tristate "generic cdfinger fingerprint driver"
	default y
	help
	add support for cdfinger fingerprint driver.
```

## drivers/misc/cpufreq/Kconfig
```kconfig
config CPUMAXFREQ
	bool "Enable CPUMAXFREQ Proc Interface"
	help
	Provide a interface for getting the maximum frequency supported by cpu core
```

## drivers/misc/dgnss/Kconfig
```kconfig
#
# Intel DGNSS driver.
#

config  DGNSS
	tristate "Intel DGNSS driver"
	default n
	help
	  Select this driver to enable kernel interface for GPS devices
	  used in Intel core platforms.
	  This driver exports GPIO to user space GPS software
	  that use a standard tty to communicate with the GPS device.
```

## drivers/misc/drv2624_haptic/Kconfig
```kconfig
config DRV2624_HAPTIC
	tristate "DRV2624 haptic driver"
	depends on I2C
	help
	  Say Y here if you have Awinic DRV2624 haptic controller
	  chip in your system.

	  If unsure, say N.

	  To compile this driver as a module, choose M here: the
	  module will be called mpr121_touchkey.
```

## drivers/misc/focaltech/Kconfig
```kconfig
config FOCALTECH_FINGERPRINT
	tristate "generic focaltech fingerprint driver"
	default y
	help
	add support for focaltech fingerprint driver.
```

## drivers/misc/fpr_FingerprintCard/Kconfig
```kconfig
# SPDX-License-Identifier: GPL-2.0-only

config FPR_FPC
	tristate "FPC fingerprint sensor support"
	depends on SPI_MASTER
	help
	  support fpc1020 and fpc1028.
	  This driver can also be built as a module.  If so, the module
	  will be called fpc1020.
```
