## drivers/mmc/core/Kconfig
```kconfig
#
# MMC core configuration
#
config PWRSEQ_EMMC
	tristate "HW reset support for eMMC"
	default y
	depends on OF
	help
	  This selects Hardware reset support aka pwrseq-emmc for eMMC
	  devices. By default this option is set to y.

	  This driver can also be built as a module. If so, the module
	  will be called pwrseq_emmc.

config PWRSEQ_SD8787
	tristate "HW reset support for SD8787 BT + Wifi module"
	depends on OF && (MWIFIEX || BT_MRVL_SDIO)
	help
	  This selects hardware reset support for the SD8787 BT + Wifi
	  module. By default this option is set to n.

	  This driver can also be built as a module. If so, the module
	  will be called pwrseq_sd8787.

config PWRSEQ_SIMPLE
	tristate "Simple HW reset support for MMC"
	default y
	depends on OF
	help
	  This selects simple hardware reset support aka pwrseq-simple for MMC
	  devices. By default this option is set to y.

	  This driver can also be built as a module. If so, the module
	  will be called pwrseq_simple.

config MMC_BLOCK
	tristate "MMC block device driver"
	depends on BLOCK
	default y
	help
	  Say Y here to enable the MMC block device driver support.
	  This provides a block device driver, which you can use to
	  mount the filesystem. Almost everyone wishing MMC support
	  should say Y or M here.

config MMC_BLOCK_MINORS
	int "Number of minors per block device"
	depends on MMC_BLOCK
	range 4 256
	default 8
	help
	  Number of minors per block device. One is needed for every
	  partition on the disk (plus one for the whole disk).

	  Number of total MMC minors available is 256, so your number
	  of supported block devices will be limited to 256 divided
	  by this number.

	  Default is 8 to be backwards compatible with previous
	  hardwired device numbering.

	  If unsure, say 8 here.

config MMC_BLOCK_DEFERRED_RESUME
	bool "Defer MMC layer resume until I/O is requested"
	depends on MMC_BLOCK
	default n
	help
	  Say Y here to enable deferred MMC resume until I/O
	  is requested.

	  This will reduce overall resume latency and
	  save power when there is an SD card inserted but not being used.

config SDIO_UART
	tristate "SDIO UART/GPS class support"
	depends on TTY
	help
	  SDIO function driver for SDIO cards that implements the UART
	  class, as well as the GPS class which appears like a UART.

config MMC_TEST
	tristate "MMC host test driver"
	help
	  Development driver that performs a series of reads and writes
	  to a memory card in order to expose certain well known bugs
	  in host controllers. The tests are executed by writing to the
	  "test" file in debugfs under each card. Note that whatever is
	  on your card will be overwritten by these tests.

	  This driver is only of interest to those developing or
	  testing a host driver. Most people should say N here.

config MMC_RING_BUFFER
	bool "MMC_RING_BUFFER"
	depends on MMC
	default n
	help
	  This enables the ring buffer tracing of significant
	  events for mmc driver to provide command history for
	  debugging purpose.

	  If unsure, say N.

config MMC_EMBEDDED_SDIO
	boolean "MMC embedded SDIO device support"
	help
	  If you say Y here, support will be added for embedded SDIO
	  devices which do not contain the necessary enumeration
	  support in hardware to be properly detected.

config MMC_PARANOID_SD_INIT
	bool "Enable paranoid SD card initialization"
	help
	  If you say Y here, the MMC layer will be extra paranoid
	  about re-trying SD init requests. This can be a useful
	  work-around for buggy controllers and hardware. Enable
	  if you are experiencing issues with SD detection.

config MMC_CLKGATE
	bool "MMC host clock gating"
	help
	  This will attempt to aggressively gate the clock to the MMC card.
	  This is done to save power due to gating off the logic and bus
	  noise when the MMC card is not in use. Your host driver has to
	  support handling this in order for it to be of any use.

	  If unsure, say N.

config MMC_SIMULATE_MAX_SPEED
	bool "Turn on maximum speed control per block device"
	depends on MMC_BLOCK
	help
	  Say Y here to enable MMC device speed limiting. Used to test and
	  simulate the behavior of the system when confronted with a slow MMC.

	  Enables max_read_speed, max_write_speed and cache_size attributes to
	  control the write or read maximum KB/second speed behaviors.

	  If unsure, say N here.

config MMC_CRYPTO
	bool "MMC Crypto Engine Support"
	depends on BLK_INLINE_ENCRYPTION
	help
	  Enable Crypto Engine Support in MMC.
	  Enabling this makes it possible for the kernel to use the crypto
	  capabilities of the MMC device (if present) to perform crypto
	  operations on data being transferred to/from the device.
```

## drivers/mmc/host/mediatek/Kconfig
```kconfig
#
# MTK MSDC Driver Configs
#
config MTK_MMC_DEBUG
	bool "enable msdc debug buffer"
	depends on (MMC_MTK_PRO||MMC_MTK_SDIO) && !(MTK_ENABLE_AGO)
	default y
	help
	   if y, then enable msdc debug buffer.
```

## drivers/modem/Kconfig
```kconfig
#
# Modem
#

config SC8800G_MODEM
	bool "Spreadtrum SC8800G 3G modem support"
	default n
	help
	  Spreadtrum SC8800G 3G modem is a TD-SCDMA modem which use SPI interface
	  to communicate with AP. Set this option will enable AP serial & IPC
	  driver support at AP side.
```

## drivers/net/can/spi/Kconfig
```kconfig
menu "CAN SPI interfaces"
	depends on SPI

config CAN_HI311X
	tristate "Holt HI311x SPI CAN controllers"
	depends on CAN_DEV && SPI && HAS_DMA
	---help---
	  Driver for the Holt HI311x SPI CAN controllers.

config CAN_MCP251X
	tristate "Microchip MCP251x and MCP25625 SPI CAN controllers"
	depends on HAS_DMA
	---help---
	  Driver for the Microchip MCP251x and MCP25625 SPI CAN
	  controllers.


config QTI_CAN
	tristate "Unified driver for QTI CAN controllers"
	depends on SPI
	---help---
	  Unified driver for QTI CAN controllers.
endmenu
```

## drivers/net/ethernet/aquantia/Kconfig
```kconfig
#
# aQuantia device configuration
#

config NET_VENDOR_AQUANTIA
	bool "aQuantia devices"
	default y
	---help---
	  Set this to y if you have an Ethernet network cards that uses the aQuantia
	  AQC107/AQC108 chipset.

	  This option does not build any drivers; it casues the aQuantia
	  drivers that can be built to appear in the list of Ethernet drivers.


if NET_VENDOR_AQUANTIA

config AQTION
	tristate "aQuantia AQtion(tm) Support"
	depends on PCI && X86_64
	---help---
	  This enables the support for the aQuantia AQtion(tm) Ethernet card.

config AQFWD
	tristate "aQuantia Forwarding driver"
	depends on PCI && (X86_64 || ARM64 || ARM)
	---help---
	  This enables the support for forwarding driver for the aQuantia AQtion(tm) Ethernet card.

source "drivers/net/ethernet/aquantia/atlantic-fwd/Kconfig"

config AQFWD_QCOM
	bool "QTI MSM/MDM target support"
	depends on AQFWD
	depends on ARCH_QCOM
	help
	  Enable support for integration with Qualcomm Technologies, Inc. chipsets.

config AQFWD_QCOM_IPA
	bool "QTI IPA offload support"
	depends on IPA_ETH
	select AQFWD_QCOM
	select ATLFWD_FWD
	help
	  Enable support for Qualcomm Technologies, Inc. IPA (Internet Protocol Accelerator).
	  If unsure, say N.

endif # NET_VENDOR_AQUANTIA
```

## drivers/net/ethernet/aquantia/atlantic-fwd/Kconfig
```kconfig
#
# Aquantia atlantic-forwarding driver config
#

if AQFWD

config ATLFWD_FWD
       bool "Enable forwarding-engine API"
       default n
       help

         Say Y to enable the forwarding-engine API

config ATLFWD_FWD_RXBUF
       int
       prompt "Rx buffer space for forwarding engine's rings" if ATLFWD_FWD
       range 0 320
       default 160 if ATLFWD_FWD
       default 0
       help

         Amount of Rx buffer to reserve for the forwarding-engine
         rings. This sets the default value of the fwd_rx_buf_reserve
         module option.

         Value in kiB, 0 to 320, defaults to 160 if forwarding-engine
         API enabled, 0 otherwise.

config ATLFWD_FWD_TXBUF
       int
       prompt "Tx buffer space for forwarding engine's rings" if ATLFWD_FWD
       range 0 160
       default 80 if ATLFWD_FWD
       default 0
       help

         Amount of Tx buffer to reserve for the forwarding-engine
         rings. This sets the default value of the fwd_tx_buf_reserve
         module option.

         Value in kiB, 0 to 320, defaults to 80 if forwarding-engine
         API enabled, 0 otherwise.

config ATLFWD_FWD_NETLINK
        bool "Enable netlink control socket for forwarding engine"
        default n
        depends on ATLFWD_FWD
        help

          Expose forwarding engine APIs over the netlink socket.

endif

config AQFWD_QCOM
	bool "QTI MSM/MDM target support"
	depends on AQFWD
	depends on ARCH_QCOM
	help
	  Some older targets using Qualcomm Technologies, Inc. chipsets
	  require peripheral drivers to explicitly set IOMMU attributes
	  and perform IOMMU attach. Enable this option if your platform
	  is affected. Using this feature will also require the user to
	  provide SMMU configuration via PCI device tree.
	  If unsure, say N.

config AQFWD_QCOM_IPA
	bool "QTI IPA offload support"
	depends on IPA_ETH
	select AQFWD_QCOM
	select ATLFWD_FWD
	help
	  Enable support for Qualcomm Technologies, Inc. IPA (Internet Protocol Accelerator).
	  If unsure, say N.
```

## drivers/net/ethernet/mediatek/Kconfig
```kconfig
#
# Mediatek net configuration
#

config NET_VENDOR_MEDIATEK
	tristate "Mediatek devices"
	---help---
	  If you have a network (Ethernet) chipset belonging to this class,
	  say Y.

	  Note that the answer to this question does not directly affect
	  the kernel: saying N will just case the configurator to skip all
	  the questions regarding Mediatek chipsets. If you say Y, you will be asked
	  for your specific chipset/driver in the following questions.

if NET_VENDOR_MEDIATEK

config MEDIATEK_STAR
	tristate "Mediatek STAR MAC ethernet support"
	select MII
	---help---
	  If you have a network (Ethernet) chipset belonging to this class,
	  say Y.

	  To compile this driver as a module, choose Y here. The module
	  will be called star_mac.

endif
```

## drivers/net/ethernet/msm/Kconfig
```kconfig
#
# msm network device configuration
#

config ECM_IPA
	tristate "STD ECM LAN Driver support"
	depends on IPA || IPA3
	help
	  Enables LAN between applications processor and a tethered
	  host using the STD ECM protocol.
	  This Network interface is aimed to allow data path go through
	  IPA core while using STD ECM protocol.

config RNDIS_IPA
	tristate "RNDIS_IPA Network Interface Driver support"
	depends on IPA || IPA3
	help
	  Enables LAN between applications processor and a tethered
	  host using the RNDIS protocol.
	  This Network interface is aimed to allow data path go through
	  IPA core while using RNDIS protocol.
```

## drivers/net/ethernet/qcom/Kconfig
```kconfig
#
# msm network device configuration
#
config MSM_RMNET_BAM
	bool "RMNET BAM Driver"
	depends on MSM_BAM_DMUX
	default n
	help
	  Implements RMNET over BAM interface.
	  RMNET provides a virtual ethernet interface
	  for routing IP packets within the MSM using
	  BAM as a physical transport.

config MSM_RMNET_DEBUG
	bool "MSM RMNET debug interface"
	depends on MSM_RMNET
	default n
```

## drivers/net/ip_over_tty/Kconfig
```kconfig
config IP_OVER_TTY
	tristate "IP Over TTY driver"
	help
	  Choose this option if you want a network interface which sends ip packets over tty devices.

	  To compile this driver as a module, choose M here: the
	  module will be called ttynet.
```

## drivers/net/phy/nxp/Kconfig
```kconfig
config NXP_TJA110X_PHY
	tristate "NXP TJA110X PHY support"
	help
	  This is the NXP TJA110X PHY driver module

	  To compile this driver as a module, choose M here: the
	  module will be called nxp.ko.
```

## drivers/net/rmnet/Kconfig
```kconfig
#
# RMNET MAP driver
#

menuconfig RMNET
	depends on NETDEVICES
	bool "RmNet MAP driver"
	---help---
	  If you say Y here, then the rmnet module will be statically
	  compiled into the kernel. The rmnet module provides MAP
	  functionality for embedded and bridged traffic.
if RMNET

config RMNET_DEBUG
	bool "RmNet Debug Logging"
	---help---
	  Say Y here if you want RmNet to be able to log packets in main
	  system log. This should not be enabled on production builds as it can
	  impact system performance. Note that simply enabling it here will not
	  enable the logging; it must be enabled at run-time as well.
endif # RMNET
```

## drivers/net/wireless/ath/ath10k/Kconfig
```kconfig
config ATH10K
        tristate "Atheros 802.11ac wireless cards support"
        depends on MAC80211 && HAS_DMA
	select ATH_COMMON
	select CRC32
        ---help---
          This module adds support for wireless adapters based on
          Atheros IEEE 802.11ac family of chipsets.

          If you choose to build a module, it'll be called ath10k.

config ATH10K_PCI
	tristate "Atheros ath10k PCI support"
	depends on ATH10K && PCI
	---help---
	  This module adds support for PCIE bus

config ATH10K_AHB
	bool "Atheros ath10k AHB support"
	depends on ATH10K_PCI && OF && RESET_CONTROLLER
	---help---
	  This module adds support for AHB bus

config ATH10K_TARGET_SNOC
	tristate "Atheros ath10k SNOC support"
	depends on ATH10K
	---help---
	  This module adds support for the Integrated WCN3990 WLAN module,
	  WCN3990 has integrated 802.11ac chipset with SNOC bus interface.
	  This module also adds support to register the WCN3990 wlan module
	  with MAC80211 network subsystem.

config ATH10K_SNOC
	bool "Enable/disable Atheros ath10k SNOC bus interface support"
	depends on ATH10K
	depends on ATH10K_TARGET_SNOC
	---help---
	  This module add support for WLAN SNOC bus registration, WLAN
	  copy engine configuration for the WCN3990 chipset, WLAN hardware
	  shadow register configuration, create host to target communication
	  interface to interact with WLAN firmware, WLAN module interface
	  control and data receive(RX)/transmit(TX) control.

config ATH10K_DEBUG
	bool "Atheros ath10k debugging"
	depends on ATH10K
	---help---
	  Enables debug support

	  If unsure, say Y to make it easier to debug problems.

config ATH10K_DEBUGFS
	bool "Atheros ath10k debugfs support"
	depends on ATH10K && DEBUG_FS
	select RELAY
	---help---
	  Enabled debugfs support

	  If unsure, say Y to make it easier to debug problems.

config ATH10K_TRACING
	bool "Atheros ath10k tracing support"
	depends on ATH10K
	depends on EVENT_TRACING
	---help---
	  Select this to ath10k use tracing infrastructure.

config ATH10K_DFS_CERTIFIED
	bool "Atheros DFS support for certified platforms"
	depends on ATH10K && CFG80211_CERTIFICATION_ONUS
	default n
	---help---
	This option enables DFS support for initiating radiation on
	ath10k.
```

## drivers/net/wireless/bcm4335/Kconfig
```kconfig
config BCM4335
	tristate "Broadcom 4335 wireless cards support"
	depends on MMC
	---help---
	  This module adds support for wireless adapters based on
	  Broadcom 4335 chipset.

	  This driver uses the kernel's cfg80211 subsystem.

	  If you choose to build a module, it'll be called dhd. Say M if
	  unsure.

config BCM4335_FW_PATH
	depends on BCM4335
	string "Firmware path"
	default "/system/etc/firmware/fw_BCM4335.bin"
	---help---
	  Path to the firmware file.

config BCM4335_NVRAM_PATH
	depends on BCM4335
	string "NVRAM path"
	default "/system/etc/wifi/BCM4335.cal"
	---help---
	  Path to the calibration file.

config DHD_USE_STATIC_BUF
	bool "Enable memory preallocation"
	depends on BCM4335
	default n
	---help---
	  Use memory preallocated in platform

config DHD_USE_SCHED_SCAN
	bool "Use CFG80211 sched scan"
	depends on BCM4335 && CFG80211
	default y
	---help---
	  Use CFG80211 sched scan

config BCM4335_WIFI_CONTROL_FUNC
	bool "Use BCM4335_wlan device"
	depends on BCM4335
	default n
	---help---
	  Use this option to get various parameters from architecture specific
	  BCM4335_wlan platform device. Say n if unsure.

config BCM4335_HW_OOB
	bool "Use out of band interrupt"
	depends on BCM4335
	default n
	---help---
	  Use out of band interrupt for card interrupt and wake on wireless.
```
