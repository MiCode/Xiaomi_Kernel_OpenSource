## drivers/net/wireless/bcmdhd/Kconfig
```kconfig
config BCMDHD
	tristate "Broadcom wireless cards support"
	depends on WLAN
	---help---
	  This module adds support for wireless adapters based on
	  Broadcom WLAN chipset.

	  If you choose to build a module, it will be called bcmdhd. Say M if
	  unsure.

choice
	prompt "---Enable chip specific options"
	depends on BCMDHD
	---help---
	  Enable specific chip.

config BCMDHD_GENERIC_CHIP_SUPPORT
	bool "No chip specific options"
	depends on BCMDHD
	---help---
	  Disable any chip specific options.

config BCM4330
	bool "Broadcom BCM4330 support only"
	depends on BCMDHD
	---help---
	  Enable any BCM4330 specific options.

config BCM4334
	bool "Broadcom BCM4334 support only"
	depends on BCMDHD
	---help---
	  Enable any BCM4334 specific options.

config BCM43341
	bool "Broadcom BCM43341 support only"
	depends on BCMDHD
	---help---
	  Enable any BCM43341 specific options.

config BCM43241
	bool "Broadcom BCM43241 support only"
	depends on BCMDHD
	---help---
	  Enable any BCM43241 specific options.

config BCM4335
	bool "Broadcom BCM4335 support only"
	depends on BCMDHD
	---help---
	  Enable any BCM4335 specific options.

config BCM4339
	bool "Broadcom BCM4339 support only"
	depends on BCMDHD
	---help---
	  Enable any BCM4339 specific options.

config BCM4343
	bool "BCM4343 support"
	depends on BCMDHD
	---help---
	  Enable any BCM4354 specific options.

config BCM4354
	bool "BCM4354 support"
	depends on BCMDHD
	---help---
	  Enable any BCM4354 specific options.

config BCM4356
	bool "BCM4356 support"
	depends on BCMDHD
	---help---
	  Enable any BCM4356 specific options.
endchoice

choice
	prompt "---Enable Chip Interface"
	depends on BCMDHD
	---help---
	  Enable chip Internaface.

config BCMDHD_SDIO
	bool "SDIO bus interface support"
	depends on BCMDHD && MMC

config BCMDHD_PCIE
	bool "PCIe bus interface support"
	depends on BCMDHD && PCI

endchoice

config INTEL_PLATFORM
	bool "Enable Intel specific flags"
	depends on BCMDHD
	default y
	---help---
	  Enable Intel specific flags

config BCMDHD_FW_PATH
	depends on BCMDHD
	string "Firmware path"
	default "/system/etc/firmware/fw_bcmdhd.bin"
	---help---
	  Path to the firmware file.

config BCMDHD_NVRAM_PATH
	depends on BCMDHD
	string "NVRAM path"
	default "/system/etc/wifi/bcmdhd.cal"
	---help---
	  Path to the calibration file.

config BCMDHD_WEXT
	bool "Enable WEXT support"
	depends on BCMDHD && CFG80211 = n
	select WIRELESS_EXT
	select WEXT_PRIV
	help
	  Enables WEXT support

config DHD_USE_STATIC_BUF
	bool "Enable memory preallocation"
	depends on BCMDHD
	default n
	---help---
	  Use memory preallocated in platform

config DHD_USE_SCHED_SCAN
	bool "Use CFG80211 sched scan"
	depends on BCMDHD && CFG80211
	default n
	---help---
	  Use CFG80211 sched scan
```

## drivers/net/wireless/cnss/Kconfig
```kconfig
config CNSS
	tristate "CNSS driver for wifi module"
	select CNSS_UTILS
	select CRYPTO
	select CRYPTO_HASH
	select CRYPTO_BLKCIPHER
	---help---
	  This module adds support for the CNSS connectivity subsystem used
	  for wifi devices based on the QCA AR6320 chipset.
	  This driver also adds support to integrate WLAN module to subsystem
	  restart framework.

config CNSS_ASYNC
	bool "Enable/disable cnss pci platform driver asynchronous probe"
	depends on CNSS || CNSS2
	---help---
	 If enabled, CNSS PCI platform driver would do asynchronous probe.
	 Using asynchronous probe will allow CNSS PCI platform driver to
	 probe in parallel with other device drivers and will help to
	 reduce kernel boot time.

config CNSS_MAC_BUG
	bool "Enable/disable 0-4K memory initialization for QCA6174"
	depends on CNSS
	---help---
	  If enabled, 0-4K memory is reserved for QCA6174 to address
	  a MAC HW bug. MAC would do an invalid pointer fetch based on
	  the data, that was read from 0 to 4K. So fill it with zero's;
	  to an address for which PCIe root complex would honor the read
	  without any errors.

config CLD_DEBUG
	bool "Enable/disable CLD debug features"
	help
	 WLAN CLD driver uses this config to enable certain debug features.
	 Some of the debug features may affect performance or may compromise
	 on security.

	  Say N, if you are building a release kernel for production use.
	  Only say Y, if you are building a kernel with debug support.

config CLD_HL_SDIO_CORE
	tristate "Qualcomm CORE driver for QCA6174 with SDIO interface"
	select WIRELESS_EXT
	select WEXT_PRIV
	select WEXT_CORE
	select WEXT_SPY
	select NL80211_TESTMODE
	depends on MMC

config CLD_LL_CORE
	tristate "Qualcomm core WLAN driver for QCA6174 chipset"
	select NL80211_TESTMODE
	select WEXT_CORE
	select WEXT_PRIV
	select WEXT_SPY
	select WIRELESS_EXT
	select CRYPTO
	select CRYPTO_HASH
	select CRYPTO_BLKCIPHER
	---help---
	  This section contains the necessary modules needed to enable the
	  core WLAN driver for Qualcomm QCA6174 chipset.
	  Select Y to compile the driver in order to have WLAN functionality
	  support.

config CNSS_SECURE_FW
	bool "Enable/Disable Memory Allocation for Secure Firmware Feature"
	depends on CNSS
	---help---
	  CLD Driver can use this for holding local copy of firmware
	  binaries which is used for sha crypto computation.
	  The Memory Allocation is done only if this Config Parameter is
	  enabled

config BUS_AUTO_SUSPEND
	bool "Enable/Disable Runtime PM support for PCIe based WLAN Drivers"
	depends on CNSS || CNSS2
	depends on PCI
	---help---
	  Runtime Power Management is supported for PCIe based WLAN Drivers.
	  The features enable cld wlan driver to suspend pcie bus when APPS
	  is awake based on the driver inactivity with the Firmware.
	  The Feature uses runtime power management framework from kernel to
	  track bus access clients and to synchronize the driver activity
	  during system pm.
	  This config flag controls the feature per target based. The feature
	  requires CNSS driver support.
```

## drivers/net/wireless/cnss/logger/Kconfig
```kconfig
# SPDX-License-Identifier: GPL-2.0-only
#
# cnss logger configuration
#

config CNSS_LOGGER
	tristate "CNSS Logging Service Driver"
	help
	  This module adds support for the CNSS Logging Service for CLD
	  driver, including the netlink socket service registration, transmit,
	  event receive.
```

## drivers/net/wireless/cnss2/Kconfig
```kconfig
# SPDX-License-Identifier: GPL-2.0-only

config CNSS2
	tristate "CNSS2 Platform Driver for Wi-Fi Module"
	depends on !CNSS && PCI_MSM
	help
	  This module adds the support for Connectivity Subsystem (CNSS) used
	  for PCIe based Wi-Fi devices with QCA6174/QCA6290 chipsets.
	  This driver also adds support to integrate WLAN module to subsystem
	  restart framework.

config CNSS2_DEBUG
	bool "CNSS2 Platform Driver Debug Support"
	depends on CNSS2
	help
	  This option is to enable CNSS2 platform driver debug support which
	  primarily includes providing additional verbose logs for certain
	  features, enabling kernel panic for certain cases to aid the
	  debugging, and enabling any other debug mechanisms.

config CNSS2_QMI
	bool "CNSS2 Platform Driver QMI support"
	depends on CNSS2
	help
	  CNSS2 platform driver uses QMI framework to communicate with WLAN
	  firmware. It sends and receives boot handshake messages to WLAN
	  firmware, which includes hardware and software capabilities and
	  configurations. It also sends WLAN on/off control message to
	  firmware over QMI channel.

config CNSS_ASYNC
	bool "Enable/disable CNSS platform driver asynchronous probe"
	depends on CNSS2
	help
	  If enabled, CNSS platform driver would do asynchronous probe.
	  Using asynchronous probe will allow CNSS platform driver to
	  probe in parallel with other device drivers and will help to
	  reduce kernel boot time.

config BUS_AUTO_SUSPEND
	bool "Enable/Disable Runtime PM support for PCIe based WLAN Drivers"
	depends on CNSS2
	depends on PCI
	help
	  Runtime Power Management is supported for PCIe based WLAN Drivers.
	  The features enable cld wlan driver to suspend pcie bus when APPS
	  is awake based on the driver inactivity with the Firmware.
	  The Feature uses runtime power management framework from kernel to
	  track bus access clients and to synchronize the driver activity
	  during system pm.
	  This config flag controls the feature per target based. The feature
	  requires CNSS driver support.

config CNSS_QCA6290
	bool "Enable CNSS QCA6290 chipset specific changes"
	help
	  This enables the changes from WLAN host driver that are specific to
	  CNSS QCA6290 chipset.
	  These changes are needed to support the new hardware architecture
	  for CNSS QCA6290 chipset.

config CNSS_QCA6390
	bool "Enable CNSS QCA6390 chipset specific changes"
	help
	  This enables the changes from WLAN host driver that are specific to
	  CNSS QCA6390 chipset.
	  These changes are needed to support the new hardware architecture
	  for CNSS QCA6390 chipset.

config CNSS_EMULATION
	bool "Enable specific changes for emulation hardware"
	help
	  This enables the changes from WLAN drivers that are specific to
	  emulation hardware.
	  These changes are needed for WLAN drivers to support and meet the
	  requirement of emulation hardware.
```

## drivers/net/wireless/cnss_genl/Kconfig
```kconfig
config CNSS_GENL
	tristate "CNSS Generic Netlink Socket Driver"
	---help---
	  This module creates generic netlink family "CLD80211". This can be
	  used by cld driver and userspace utilities to communicate over
	  netlink sockets. This module creates different multicast groups to
	  facilitate the same.
```

## drivers/net/wireless/cnss_prealloc/Kconfig
```kconfig
# SPDX-License-Identifier: GPL-2.0-only

config WCNSS_MEM_PRE_ALLOC
	tristate "WCNSS pre-alloc memory support"
	help
	  Pre-allocate memory for the WLAN driver module.
	  This feature enable cld wlan driver to use pre allocated memory
	  for it's internal usage and release it to back to pre allocated pool.
	  This memory is allocated at the cold boot time.
```

## drivers/net/wireless/cnss_utils/Kconfig
```kconfig
# SPDX-License-Identifier: GPL-2.0-only

config CNSS_UTILS
	tristate "CNSS utilities support"
	help
	  Add CNSS utilities support for the WLAN driver module.
	  This feature enables wlan driver to use CNSS utilities APIs to set
	  and get wlan related information.

config CNSS_QMI_SVC
	tristate "CNSS QMI SVC support"
	help
	  Add CNSS QMI SVC support for the WLAN driver module.
	  This feature enable wlan driver to use CNSS QMI service APIs to set
	  and get wlan related information.
```

## drivers/net/wireless/mi_cnss_statistic/Kconfig
```kconfig
# SPDX-License-Identifier: GPL-2.0-only

config MI_CNSS_STATISTIC
	tristate "MI CNSS STATISTIC Driver"
	help
	  This module creates generic netlink family "mi_cnss_statistic". This can be
	  used by CNSS driver and userspace utilities to communicate over
	  netlink sockets for statistic.
```

## drivers/net/wireless/qca402x/Kconfig
```kconfig
config QCA402X
	tristate "Qualcomm QCA402X wireless support"
	default n
	---help---
	Software for Qualcomm QCA402x including HIF and HTCA.

	Say Y here if support for Qualcomm's QCA402x wireless SoC
	via host-target communication protocol is required.
	Say N to disable completely if support for that device is
	not needed or if not sure.
```

## drivers/net/wireless/sd8797/Kconfig
```kconfig
config SD8797
	tristate "Marvel 8797 wireless cards support"
	depends on MMC
	default n
	---help---
	  This module adds support for wireless adapters based on
	  Marvel 8797 chipset.

config STA_SUPPORT
	depends on SD8797
	bool "WLAN station support"
	default y

config UAP_SUPPORT
	depends on SD8797
	bool "Soft AP Support"
	default y

config WIFI_DIRECT_SUPPORT
	depends on SD8797
	bool "WiFi Direct Support"
	default y

config WIFI_DISPLAY_SUPPORT
	depends on SD8797
	bool "WiFi Display Support"
	default n

config STA_WEXT
	depends on SD8797
	depends on !CFG80211
	bool "station wext support"
	default n

config UAP_WEXT
	depends on SD8797
	depends on !CFG80211
	bool "UAP wext support"
	default n

config DEBUG
	depends on SD8797
	bool "Debug option"
	default n
	---help---
          DEBUG LEVEL n/1/2:
          n: NO DEBUG
          1: Only PRINTM(MMSG,...), PRINTM(MFATAL,...), ...
          2: All PRINTM()
```

## drivers/net/wireless/sd8897/Kconfig
```kconfig
config SD8897
	tristate "Marvel 8897 wireless cards support"
	depends on MMC
	default n
	---help---
	  This module adds support for wireless adapters based on
	  Marvel 8897 chipset.

config SD8897_STA_SUPPORT
	depends on SD8897
	bool "WLAN station support"
	default y

config SD8897_UAP_SUPPORT
	depends on SD8897
	bool "Soft AP Support"
	default y

config SD8897_WIFI_DIRECT_SUPPORT
	depends on SD8897
	bool "WiFi Direct Support"
	default y

config SD8897_WIFI_DISPLAY_SUPPORT
	depends on SD8897
	bool "WiFi Display Support"
	default n

config SD8897_STA_WEXT
	depends on SD8897
	depends on !CFG80211
	bool "station wext support"
	default n

config SD8897_UAP_WEXT
	depends on SD8897
	depends on !CFG80211
	bool "UAP wext support"
	default n

config SD8897_DEBUG
	depends on SD8897
	bool "Debug option"
	default n
	---help---
          DEBUG LEVEL n/1/2:
          n: NO DEBUG
          1: Only PRINTM(MMSG,...), PRINTM(MFATAL,...), ...
          2: All PRINTM()
```
