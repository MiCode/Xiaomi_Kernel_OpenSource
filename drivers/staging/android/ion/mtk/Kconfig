## drivers/staging/android/ion/mtk/Kconfig
```kconfig
#
# Copyright (C) 2015 MediaTek Inc.
#
# This program is free software: you can redistribute it and/or modify
# it under the terms of the GNU General Public License version 2 as
# published by the Free Software Foundation.
#
# This program is distributed in the hope that it will be useful,
# but WITHOUT ANY WARRANTY; without even the implied warranty of
# MERCHANTABILITY or FITNESS FOR A PARTICULAR PURPOSE. See the
# GNU General Public License for more details.
#
config MTK_ION
	tristate "MTK ION -- ion multimedia heap"
	depends on ION
	help
	  Choose this option to support multimedia heap.
	  It means support ION.
	  It set in xxxx_defconfig.mk
	  default is on.
```

## drivers/staging/android/perfguard/Kconfig
```kconfig
config PERFGUARD
	bool "Performance guard"
	default n
	depends on ANDROID && DEBUG_FS
	help
	  Choose this to enable performance guard feature
```

## drivers/staging/fdp/Kconfig
```kconfig
#
# Near Field Communication (NFC) devices
#

config ANDROID_NFC_FDP

	tristate "Enable Android FDP NFC device"
	depends on I2C
	depends on ANDROID
	---help---
	   This module adds support for FDP NFC i2c driver and
	   its designed mainly to work with libnfc android stack
	   If you choose to build this driver as module, choose
	   m here. This module will be called fdp_nfc. If unsure
	   say N.
```

## drivers/staging/gobi/Kconfig
```kconfig
config GOBI_USBNET
        tristate "Qualcomm GOBI2k and QCQMI support"
        help
        This module adds network device support for GOBI2k 3G radios.
~
```

## drivers/staging/iio/imu/inv_mpu/Kconfig
```kconfig
#
# inv-mpu-iio driver for Invensense MPU devices and combos
#

config INV_MPU_IIO
	tristate "Invensense MPU devices"
	depends on I2C && SYSFS && IIO && IIO_KFIFO_BUF && IIO_TRIGGER && !INV_MPU
	default n
	help
	  This driver supports the Invensense MPU devices.
	  This includes MPU6050/MPU3050/MPU9150/ITG3500/MPU6500/MPU9250.
	  This driver can be built as a module. The module will be called
	  inv-mpu-iio.

config INV_IIO_MPU3050_ACCEL_SLAVE_BMA250
	bool  "Invensense MPU3050 slave accelerometer device for bma250"
	depends on INV_MPU_IIO
	default n
	help
	  This is slave device enable MPU3050 accelerometer slave device.
	  Right now, it is only bma250. For other acceleromter device,
	  it can be added to this menu if the proper interface is filled.
	  There are some interface function to be defined.

config INV_IIO_MPU6050_FAST_PROBE
	bool  "Invensense MPU6050 fast probe"
	depends on INV_MPU_IIO
	default n
	help
	  This is an optimiztion for the probe time of MPU6050.
	  Reading product info will cost 100+ ms, if we only use MPU6050,
	  we can use the knewn value to avoid the reading time.
```

## drivers/staging/iio/inv_test/Kconfig
```kconfig
#
# Kconfig for Invensense IIO testing hooks
#

config INV_TESTING
	boolean "Invensense IIO testing hooks"
	depends on INV_MPU_IIO || INV_AMI306_IIO || INV_YAS530
	default n
	help
	  This flag enables display of additional testing information from the
	  Invensense IIO drivers
```

## drivers/staging/iio/light/Kconfig
```kconfig
#
# Light sensors
#
menu "Light sensors"

config SENSORS_CM3218
	tristate "CM3218 Ambient light sensor"
	depends on I2C
	select REGMAP_I2C
	default n
	help
	  Say Y here to enable the CM3218 Ambient Light Sensor.
	  This driver will provide the measurements of ambient light intensity
	  in its own units.
	  Data from sensor is accessible via sysfs.

config SENSORS_ISL29018
	tristate "ISL 29018 light and proximity sensor"
	depends on I2C
	select REGMAP_I2C
	default n
	help
	 If you say yes here you get support for ambient light sensing and
	 proximity infrared sensing from Intersil ISL29018.
	 This driver will provide the measurements of ambient light intensity
	 in lux, proximity infrared sensing and normal infrared sensing.
	 Data from sensor is accessible via sysfs.

config SENSORS_ISL29028
	tristate "Intersil ISL29028/ISL29028 Concurrent Light and Proximity Sensor"
	depends on I2C
	select REGMAP_I2C
	help
	 Provides driver for the Intersil's ISL29028/ISL29029 device.
	 This driver supports the sysfs interface to get the ALS, IR intensity,
	 Proximity value via iio. The ISL29028 provides the concurrent sensing
	 of ambient light and proximity.

config SENSORS_JSA1127
	tristate "JSA1127 Ambient light sensor"
	depends on I2C
	default n
	help
	  Say Y here to enable the JSA1127 Ambient Light Sensor.
	  This driver provides measurements of ambient light intensity in
	  its own units.
	  Data from sensor is accessible via sysfs.

config TSL2583
	tristate "TAOS TSL2580, TSL2581 and TSL2583 light-to-digital converters"
	depends on I2C
	help
	 Provides support for the TAOS tsl2580, tsl2581 and tsl2583 devices.
	 Access ALS data via iio, sysfs.

config TSL2x7x
	tristate "TAOS TSL/TMD2x71 and TSL/TMD2x72 Family of light and proximity sensors"
	depends on I2C
	help
	 Support for: tsl2571, tsl2671, tmd2671, tsl2771, tmd2771, tsl2572, tsl2672,
	 tmd2672, tsl2772, tmd2772 devices.
	 Provides iio_events and direct access via sysfs.

config SENSORS_LTR558
	tristate "LTR558 Ambient light and proximity sensor"
	depends on I2C
	default n
	help
	  If you say yes here you get support for ambient light sensing and
	  proximity ir sensing from Lite On Technology LTR558.

config SENSORS_MAX44005
	tristate "MAX44005 ALS, RGB, temperature, IR, proximity Sensor"
	depends on I2C
	default n
	help
	  If you say yes here you get support for ambient light, RGB, IR,
	  Proximity and temperature sensing from MAX44005.

config SENSORS_STM8T143
	tristate "STM8T143 proximity sensor"
	default n
	help
	  If you say yes here you get support for ST Microelectronics
	  STM8T143 sensor driver.
	  The STM8T143 sensor driver provices suport for proximity sensing.
	  Data from sensor is accessible via sysfs.

config SENSORS_TCS3772
	tristate "TCS3772 Ambient light, RGB and proximity Sensor"
	depends on I2C
	select REGMAP_I2C
	default n
	help
	  If you say yes here you get support for ambient light, RGB and
	  Proximity sensing from TCS3772.

config SENSORS_CM3217
	tristate "CM3217 Ambient light sensor"
	depends on I2C
	default n
	help
	  Say Y here to enable the CM3217 Ambient Light Sensor.

config LS_OF
	tristate "Device Tree parsing for Light sensor specification details"
	depends on OF
	default n
	help
	  Say Y for helpers to retrieve the sensor specification details like
	  vendor, power consumed, max range, resolution and integration.
	  This information is common to most Ambient light sensors as well as
	  proximity sensors. Hence, have common callbacks to retrive this
	  information from the respective device tree nodes.

config LS_SYSFS
	tristate "IIO registration for sensor meta data"
	depends on LS_OF
	default n
	help
	  Say Y for to share sensor specification details to user space.
	  The information is retrieved from device platform data. If you are
	  using helpers from this file, make sure device's platform data
	  contains all the required information.

config SENSORS_IQS253
	tristate "IQS253 capacitive sensor"
	depends on I2C
	select LS_OF
	select LS_SYFS
	default n
	help
	  Say Y to enable proximity detection using IQS253 capacitive sensor.
	  This driver exports sensor's specifications in DT node to user space.
	  Hence, it needs LS_OF and LS_SYSFS support.
	  This driver uses I2C to program the device.

endmenu
```

## drivers/staging/iio/magnetometer/inv_compass/Kconfig
```kconfig
#
# Kconfig for Invensense IIO compass drivers of 3rd party compass devices.
#

# Yamaha YAS530/YAS532/YAS533
config INV_YAS53X_IIO
	tristate "Invensense IIO driver for Yamaha YAS530/YAS532/YAS533 compass"
	depends on I2C && SYSFS && IIO && IIO_KFIFO_BUF
	default n
	help
	  This driver supports the Yamaha YAS530/YAS532/YAS533. It is the Invensense
	  implementation of YAS53x series compass devices.
	  This driver can be built as a module. The module will be called
	  inv_yas53x_iio.

# Aichi AMI306
config INV_AMI306_IIO
	tristate "Invensense IIO driver for Aichi AMI306 compass"
	depends on I2C && SYSFS && IIO && IIO_KFIFO_BUF
	default n
	help
	  This driver supports the Aichi AMI306 compass. It is the Invensense
	  IIO implementation for the AMI306 compass device.
	  This driver can be built as a module. The module will be called
	  inv-ami306-iio.
```

## drivers/staging/iio/pressure/Kconfig
```kconfig
#
# Pressure sensors
#
menu "Pressure sensors"
config SENSORS_BMP180
	tristate "BMP 180 pressure sensor"
	depends on I2C
	help
	  If you say yes here you get support for pressure sensing
	  from Bosch BMP180 sensor. This driver will provide the measurements
	  of pressure intensity. You can also set the pressure measurement
	  precision using sysfs. Data from sensor is accessible via sysfs.
endmenu
```

## drivers/staging/ktrace/Kconfig
```kconfig
config KTRACE
	bool "enable ktrace"
	select DEBUG_FS
	default y
	help
	  add kernel trace, such as slow path time, direct reclaim time
```

## drivers/staging/mi-log/Kconfig
```kconfig
config MI_LOG
	tristate "mi log"
	default n

config MI_EXCEPTION_LOG
	tristate "mi exception log"
	default n
```

## drivers/staging/mi-perf/Kconfig
```kconfig
source "drivers/staging/mi-perf/mi_mempool/Kconfig"
source "drivers/staging/mi-perf/mi_proc_exit/Kconfig"
source "drivers/staging/mi-perf/mi_io_limit/Kconfig"
source "drivers/staging/mi-perf/mi_wmark/Kconfig"
```

## drivers/staging/mi-perf/low_free_memory_kill/Kconfig
```kconfig
config LOW_FREE_MEMORY_KILL
	tristate "kill process in low free memory"
	default m
```

## drivers/staging/mi-perf/mi_mempool/Kconfig
```kconfig
config MI_MEMPOOL
	tristate "a preserved page pool can be  used before core apps try to make direct memory reclamation during  memory allocation"
	default n
```

## drivers/staging/mi-perf/mi_wmark/Kconfig
```kconfig
config MI_WMARK
	tristate "Deleted alternative for extra_free_kbytes"
	default n
```

## drivers/staging/misysinfofreader/Kconfig
```kconfig
config MISYSINFOFREADER
	bool "enable miui sys info fast reader"
	depends on MMU
	default y
	help
	  This module is created by MIUI to read sys info from kernel fastly.
```

## drivers/staging/modem_control/Kconfig
```kconfig
#
# Modem Control Driver.
# Perform power on/reset/power off on IMC modems
#

config MDM_CTRL
	tristate "Modem control driver"
	default y
	---help---
	  The modem control driver for IMC modems. This driver will perform any
	  power request on IMC modems. It will create /dev/mdm_ctrl char device
	  by default.
	  Verified for XMM6260, XMM7160, XMM6360 and XMM 6263 modems.

config MDM_CTRL_DEV_NAME
	string "Boot driver device name"
	depends on MDM_CTRL
	default "mdm_ctrl"
	---help---
	  Sets the name for the modem control driver device.

	  If unsure, use the default value.
```
