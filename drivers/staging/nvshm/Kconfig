## drivers/tee/tkcore/Kconfig
```kconfig
# SPDX-License-Identifier: GPL-2.0
# Copyright (c) 2015-2019 TrustKernel Incorporated

config TRUSTKERNEL_TEE_SUPPORT
	bool "TrustKernel Trusted Execution Environment Support"
	default n
	help
	  Enable the support of TrustKernel TEE drivers.
	  All Trustkernel related functions will depend on this option.
	  Say Y if you would like yo enable this feature.
	  If unsure, say N.

config TRUSTKERNEL_TEE_FP_SUPPORT
	bool "TrustKernel Trusted Execution Environment Finger Print Support"
	depends on TRUSTKERNEL_TEE_SUPPORT
	default n
	help
	  Enable TrustKernel TEE clock management mechanism.
	  This feature allows TEE OS to manage clock already
	  used by Linux.
	  Say Y if you would like yo enable this feature.
	  If unsure, say Y.

config TRUSTKERNEL_TEE_RPMB_SUPPORT
	bool "TrustKernel Trusted Execution Environment RPMB Support"
	depends on TRUSTKERNEL_TEE_SUPPORT
	default n
	help
	  Enable the access of Replay Protected Memory Block
	  region for Trustkernel TEE.
	  Say Y if you would like yo enable this feature.
	  If unsure, say Y.
```

## drivers/thermal/Kconfig
```kconfig
#
# Generic thermal sysfs drivers configuration
#

menuconfig THERMAL
	tristate "Generic Thermal sysfs driver"
	help
	  Generic Thermal Sysfs driver offers a generic mechanism for
	  thermal management. Usually it's made up of one or more thermal
	  zone and cooling device.
	  Each thermal zone contains its own temperature, trip points,
	  cooling devices.
	  All platforms with ACPI thermal support can use this driver.
	  If you want this support, you should say Y or M here.

config THERMAL_HWMON
	bool
	depends on THERMAL
	depends on HWMON=y || HWMON=THERMAL
	default y

config CPU_THERMAL
	bool "generic cpu cooling support"
	depends on THERMAL && CPU_FREQ
	select CPU_FREQ_TABLE
	help
	  This implements the generic cpu cooling mechanism through frequency
	  reduction, cpu hotplug and any other ways of reducing temperature. An
	  ACPI version of this already exists(drivers/acpi/processor_thermal.c).
	  This will be useful for platforms using the generic thermal interface
	  and not the ACPI interface.
	  If you want this support, you should say Y here.

config SPEAR_THERMAL
	bool "SPEAr thermal sensor driver"
	depends on THERMAL
	depends on PLAT_SPEAR
	help
	  Enable this to plug the SPEAr thermal sensor driver into the Linux
	  thermal framework

config GENERIC_ADC_THERMAL
	tristate
	prompt "Generic ADC thermal sensor support using IIO framework"
	depends on THERMAL
	depends on IIO
	help
	  Enable support for the generic ADC thermal sensor driver
	  using IIO framework.

config FAIR_SHARE
	bool "Fair-share thermal governor"
	depends on THERMAL
	help
	  Enable this to manage platform thermals using fair-share governor.

config STEP_WISE
	bool "Step_wise thermal governor"
	depends on THERMAL
	help
	  Enable this to manage platform thermals using a simple linear

config THERMAL_GOV_PID
	bool
	prompt "PID thermal governor"
	depends on THERMAL
	help
	  This governor manages thermals based on output values of
	  PID controller.

config USER_SPACE
	bool "User_space thermal governor"
	depends on THERMAL
	help
	  Enable this to let the user space manage the platform thermals.

choice
	prompt "Default Thermal governor"
	depends on THERMAL
	default THERMAL_DEFAULT_GOV_STEP_WISE
	help
	  This option sets which thermal governor shall be loaded at
	  startup. If in doubt, select 'step_wise'.

config THERMAL_DEFAULT_GOV_STEP_WISE
	bool "step_wise"
	select STEP_WISE
	help
	  Use the step_wise governor as default. This throttles the
	  devices one step at a time.

config THERMAL_DEFAULT_GOV_FAIR_SHARE
	bool "fair_share"
	select FAIR_SHARE
	help
	  Use the fair_share governor as default. This throttles the
	  devices based on their 'contribution' to a zone. The
	  contribution should be provided through platform data.

config THERMAL_DEFAULT_GOV_PID
	bool
	prompt "pid_thermal_gov"
	select THERMAL_GOV_PID
	help
	  Use the PID thermal governor as default. This throttles the
	  devices based on output values of PID controller.

config THERMAL_DEFAULT_GOV_USER_SPACE
	bool "user_space"
	select USER_SPACE
	help
	  Select this if you want to let the user space manage the
	  platform thermals.
endchoice

config PWM_FAN
	bool "PWM Fan driver"
	depends on THERMAL
	help
	  Enables the fan driver that is controlled by pwm
```

## drivers/thermal/mediatek/Kconfig
```kconfig
config MTK_THERMAL
	tristate "Mediatek thermal drivers"
	depends on THERMAL_OF
	help
	  This is the option for Mediatek thermal software
	  solutions. Please enable corresponding options to
	  get temperature information from thermal sensors or
	  turn on throttle mechaisms for thermal mitigation.

if MTK_THERMAL

config MTK_SOC_THERMAL
	tristate "Temperature sensor driver for mediatek SoCs"
	depends on HAS_IOMEM
	depends on NVMEM
	depends on RESET_CONTROLLER
	help
	  Enable this option if you want to get SoC temperature
	  information for Mediatek platforms. This driver
	  configures thermal controllers to collect temperature
	  via AUXADC interface.

config MTK_SOC_THERMAL_LVTS
        tristate "LVTS (Low voltage thermal sensor) driver for Mediatek SoCs"
        depends on HAS_IOMEM
        depends on NVMEM
        depends on RESET_TI_SYSCON
        help
          Enable this option if you want to get SoC temperature
          information for Mediatek platforms. This driver
          configures LVTS thermal controllers to collect temperatures
          via ASIF interface.

config MTK_BOARD_THERMAL
	tristate "On-board NTC thermistor driver for Mediatek SoCs"
	help
	  Enable this option if you want to get PCB temperature
	  via on-board NTC for Mediatek platforms.
	  This driver reads the voltage value from TIA hardware
	  which is responsible for reading all PMIC AUXADC channels
	  sequentially. The address of TIA register for each channel
	  and temperature convert table should be specified in
	  device tree.

config MTK_PMIC_THERMAL
	tristate "PMIC thermal sensor driver for Mediatek SoCs"
	depends on MT635X_EFUSE
	depends on MEDIATEK_MT635X_AUXADC
	help
	  Enable this option if you want to get PMIC temperature
	  for Mediatek platforms.
	  This driver reads the voltage value from PMIC AUXADC channels,
	  and converts raw value to PMIC temperature via PMIC efuse data.

config MTK_MD_THERMAL
	tristate "Mediatek Modem cooling framework"
	depends on MTK_ECCCI_DRIVER
	help
	  Enable this option to turn on modem throttle mechanisms
	  for Mediatek platforms.
	  This option depends on MTK_ECCCI_DRIVER which is the
	  IPC interface between AP SoC and modem.

config MTK_CHARGER_THERMAL
	tristate "Mediatek charger cooling framework"
	depends on MTK_CHARGER
	help
	  Enable this option to turn on charger throttle mechanisms
	  for Mediatek platforms.
	  This option depends on MTK_CHARGER which is
	  MTK charger driver.

config MTK_BACKLIGHT_THERMAL
	tristate "Mediatek backlight cooling framework"
	depends on LEDS_MTK_PWM || LEDS_MTK_DISP
	help
	  Enable this option to turn on backlight throttle mechanisms
	  for Mediatek platforms.
	  This option depends on LEDS_MTK which is
	  MTK leds driver.

config MTK_THERMAL_TRACE
	tristate "Mediatek thermal ftrace driver"
	depends on FTRACE
	depends on NET
	help
	  Enable this option if you want use ftrace for thermal
	  driver debugging on Mediatek platforms.
	  This driver creates trace points and a periodical timer
	  for network throughput calculation.

config MTK_THERMAL_IPI
	tristate "Mediatek thermal IPI interface driver"
	depends on MTK_TINYSYS_SSPM_SUPPORT || MTK_TINYSYS_MCUPM_SUPPORT
	help
	  Enable this option if you want to use and communicate
	  with tinysys microprocessors for Mediatek platforms.
	  This driver defines thermal ipi commands and provides an
	  API to send a ipi command to tinysys microprocessors.

config MTK_THERMAL_INTERFACE
	tristate "Mediatek thermal interface driver"
	help
	  This driver provides the interface to get:
	  1.CPU/GPU/xPU headroom from uP.
	  2.thermal setting or policy from userspace daemon(ex:thermal policy and TTJ)
	  This driver also offer API to get cpu theraml headroom for other kernel module.

config MTK_THERMAL_JATM
	tristate "Mediatek jank aware thermal management driver"
	depends on MTK_THERMAL_INTERFACE
	help
	  This driver provides a algorithm to fine tune:
	  1. TTJ
	  2. CPU freq
	  to optimize game UX under a proper Tskin control.
	  It will take care of both better user experience and Tskin control.

endif
```
