## drivers/staging/nvshm/Kconfig
```kconfig
config NVSHM
	bool "NV Tegra Baseband Shared Memory Interface"
	depends on ARCH_TEGRA
	depends on TEGRA_BASEBAND
	depends on SUNRPC
	help
	    Say Y here to enable support for high level shared memory interface
	    driver on NVIDIA Tegra integrated baseband

config NVSHM_RPC_RSM
	bool "RPC mechanism for the resource manager"
	default y
	depends on NVSHM
	depends on TEGRA_BBC_PROXY
	help
	    This provides the support for RSM (resource management) via the
	    shared memory interface's RPC (remote procedure call) channel.
```

## drivers/staging/pasr/Kconfig
```kconfig
config ARCH_HAS_PASR
	bool

config PASR
	bool "DDR Partial Array Self-Refresh"
	depends on ARCH_HAS_PASR
	---help---
	  PASR consists on masking the refresh of unused segments or banks
	  when DDR is in self-refresh state.

config PASR_DEBUG
	bool "Add PASR debug prints"
	def_bool n
	depends on PASR
```

## drivers/staging/pn544/Kconfig
```kconfig
#
# Near Field Communication (NFC) devices
#

config ANDROID_NFC_PN544

	tristate "Enable Andorid PN544 NFC device"
	depends on I2C
	depends on ANDROID
	---help---
	   This module adds support for pn544 NFC i2c driver and
	   its designed mainly to work with libnfc android stack
	   If you choose to build this driver as module, choose
	   m here. This module will be called pn544_nfc. If unsure
	   say N.
```

## drivers/staging/prima/Kconfig
```kconfig
comment "Qualcomm Atheros Prima WLAN module"

config PRIMA_WLAN

	tristate "Qualcomm Atheros Prima WLAN module"
	default n
	help
	Add support for the Qualcomm Atheros Prima WLAN module

config PRONTO_WLAN

	tristate "Qualcomm Atheros Pronto WLAN module"
	default n
	help
	Add support for the Qualcomm Atheros Pronto WLAN module


#	depends on WLAN
#	depends on CFG80211
#        depends on WCNSS_CORE

if PRIMA_WLAN != n || PRONTO_WLAN != n

config PRIMA_WLAN_BTAMP
	bool "Enable the Prima WLAN BT-AMP feature"
	default n

config PRIMA_WLAN_LFR
	bool "Enable the Prima WLAN Legacy Fast Roaming feature"
	default n

config PRIMA_WLAN_OKC
	bool "Enable the Prima WLAN Opportunistic Key Caching feature"
	default n

config PRIMA_WLAN_11AC_HIGH_TP
	bool "Enable the Prima WLAN 802.11ac High Throughput option (depends upon kernel support)"
	default n

config WLAN_FEATURE_11W
	bool "Enable the WLAN 802.11w Protected Management Frames feature"
	default n

config QCOM_VOWIFI_11R
	bool "Enable Fast Transition (11r) feature"
	default n

config QCOM_TDLS
	bool "Enable TDLS feature"
	default n

config ENABLE_LINUX_REG
	bool "Enable linux regulatory feature"
	default n

endif # PRIMA_WLAN || PRONTO_WLAN
```

## drivers/staging/qcache/Kconfig
```kconfig
config QCACHE
	tristate "Dynamic compression of clean pagecache pages"
	depends on CLEANCACHE
	select LZO_COMPRESS
	select LZO_DECOMPRESS
	default n
	help
	  Qcache is the backend for fmem
```

## drivers/staging/rtmm/Kconfig
```kconfig
config RTMM
	bool "enable runtime mem optimization"
	select SYSFS
	default n
	help
	  Thie module is created by MIUI to optimize mem performance.
```

## drivers/staging/ste_rmi4/Kconfig
```kconfig
config TOUCHSCREEN_SYNAPTICS_I2C_RMI4_STAGING
	tristate "Synaptics i2c rmi4 touchscreen staging"
	depends on I2C && INPUT
	help
	  Say Y here if you have a Synaptics RMI4 and
	  want to enable support for the built-in touchscreen
	  through staging driver.  Not to be confused with
	  TOUCHSCREEN_SYNAPTICS_I2C_RMI4 in
          drivers/input/touchscreen directory.

	  To compile this driver as a module, choose M here: the
	  module will be called synaptics_rmi4_ts.
```

## drivers/switch/Kconfig
```kconfig
menuconfig SWITCH
	tristate "Switch class support"
	help
	  Say Y here to enable switch class support. This allows
	  monitoring switches by userspace via sysfs and uevent.
```

## drivers/tee/Kconfig
```kconfig
# SPDX-License-Identifier: GPL-2.0-only
# Generic Trusted Execution Environment Configuration
config TEE
	tristate "Trusted Execution Environment support"
	depends on HAVE_ARM_SMCCC || COMPILE_TEST || CPU_SUP_AMD
	select CRYPTO
	select CRYPTO_SHA1
	select DMA_SHARED_BUFFER
	select GENERIC_ALLOCATOR
	help
	  This implements a generic interface towards a Trusted Execution
	  Environment (TEE).

if TEE

menu "TEE drivers"

config MTK_TEE_GP_SUPPORT
	bool "Enable MTK GlobalPlatform support in TEE related modules"
	default n
	depends on (TRUSTONIC_TEE_SUPPORT) || (MICROTRUST_TEE_SUPPORT)
	help
	  GlobalPlatform defines common/consistent APIs and this option
	  enables TEE related modules to use GPAPIs. (depending on
	  Trustonic TEE Support or Microtrust TEE Support or Google Trusty
	  TEE or other 3rd-party TEE)

source "drivers/tee/optee/Kconfig"
source "drivers/tee/amdtee/Kconfig"
source "drivers/tee/teeperf/Kconfig"
source "drivers/tee/gud/Kconfig"
source "drivers/tee/teei/Kconfig"


endmenu

endif
```

## drivers/tee/gpapi/Kconfig
```kconfig
# SPDX-License-Identifier: GPL-2.0-only
config MTK_TEE_GP_COORDINATOR
	tristate "GPAPI support multiple TEE implementations"
	depends on MTK_TEE_GP_SUPPORT
	help
	  Unified GPAPI that support multiple TEE implementations and select one dynamically.
	  Originally, each TEE ko will export one set of GPAPI, and TEE clients (CA) only can
	  link one set at building time. This middle-layer will export GP api for client use,
	  and invoke real GP api by function pointer which registered by each TEE ko.
	  This will remove export GPAPI in each TEE ko implemented by vendors.

config MTK_TEE_GP_TESTS
	tristate "GPAPI coordinator tests"
	depends on MTK_TEE_GP_COORDINATOR
	help
	  This is a test module that test each GP API of gpapi_coorinator if can work rightly.
	  It connects with tee_sanity TA and utilize existed test cases. So must enable one TEE
	  by dts and enable tee_sanity TA and t-driver.
	  To assure gpapi_coordinator work rightly with every TEE implementation, it better to
	  enable TEE implementation by dts one by one.
```

## drivers/tee/gud/510/Kconfig
```kconfig
#
# Trustonic drivers configuration
#
config TRUSTONIC_TEE
	tristate "Trustonic TEE Driver"
	depends on ARM || ARM64
	default y
	help
	  Enable Trustonic TEE Support.
	  This option enables MobiCore Driver which is used to communicate with
	  TEE OS, for things like, setting up log buffers, interrupt pins,
	  and IPC channels.

config TRUSTONIC_TEE_DEBUG
	bool "Trustonic TEE driver debug mode"
	depends on TRUSTONIC_TEE
	default n
	help
	  Enable the debug mode in the Trustonic TEE Driver.
	  Enable Debug mode in the MobiCore Driver.
	  MobiCore Driver has loglevel control thru DEBUG and VERBOSE
	  This option enables MCDRV_DBG() macros to print useful debugging
	  information about mobicore operations.

config TRUSTONIC_TRUSTED_UI
	tristate "Trustonic Trusted UI"
	depends on TRUSTONIC_TEE
	default y
	help
	  Enable Trustonic Trusted User Interface
	  Trustonic TUI features was based on Trustonic TEE mechanism to protect
	  Touch/Display inside TEE, to prevent malicious access of sensitive data
	  used by APPs like Banking.

config TRUSTONIC_TRUSTED_UI_FB_BLANK
	bool "Trustonic Trusted UI with fb_blank"
	depends on TRUSTONIC_TRUSTED_UI
	help
	  Blank the framebuffer before starting a TUI session
	  Trustonic TUI features was based on Trustonic TEE mechanism to protect
	  Touch/Display inside TEE, to prevent malicious access of sensitive data
	  used by APPs like Banking.
```

## drivers/tee/gud/Kconfig
```kconfig
#
# TRUSTONIC TEE configuration
#
config TRUSTONIC_TEE_SUPPORT
	tristate "Enable Trustonic TEE Support"
	select MTK_TEE_SANITY
	help
	  Enable Trustonic TEE Support.
	  This option enables MobiCore Driver which is used to communicate with
	  TEE OS, for things like, setting up log buffers, interrupt pins,
	  and IPC channels.

config TRUSTONIC_TEE_VERSION
	string "TRUSTONIC TEE Version"
	depends on TRUSTONIC_TEE_SUPPORT
	default "500"

config TRUSTONIC_TEE_DEBUG
	bool "Trustonic TEE driver debug mode"
	depends on TRUSTONIC_TEE_SUPPORT
	default n
	help
	  Enable the debug mode in the Trustonic TEE Driver.
	  Unlike MOBICORE_DEBUG and MOBICORE_VERBOSE used in TBASE 302 series,
	  TBASE 311 series use one option to turn on necessary debug logs.
	  Enable this option for debugging and see more detailed driver flow.

config TRUSTONIC_TRUSTED_UI
	tristate "<t-base TUI"
	depends on TRUSTONIC_TEE_SUPPORT
	default n
	help
	  Enable <t-base Trusted User Interface
	  Trustonic TUI features was based on Trustonic TEE mechanism to protect
	  Touch/Display inside TEE, to prevent malicious access of sensitive
	  data used by APPs like Banking.
```

## drivers/tee/mitee/Kconfig
```kconfig
# MI-TEE Trusted Execution Environment Configuration
config MITEE_SUPPORT
	tristate "Enable MITEE Support"
	default y
	help
	  This implements the MI-TEE Trusted Execution Environment (TEE)
	  driver.

config OPTEE_SHM_NUM_PRIV_PAGES
	int "Private Shared Memory Pages"
	default 1
	depends on MITEE_SUPPORT
	help
	  This sets the number of private shared memory pages to be
	  used by MITEE TEE driver.

config OPTEE_BENCHMARK
	bool "MITEE Benchmark (EXPERIMENTAL)"
	depends on MITEE_SUPPORT
	help
	  This enables benchmarking feature in the MITEE Trusted
	  Execution Environment (TEE) driver.
```

## drivers/tee/teei/Kconfig
```kconfig
# Copyright (c) 2015-2020, MICROTRUST Incorporated
# All Rights Reserved.
#
# This program is free software; you can redistribute it and/or
# modify it under the terms of the GNU General Public License
# version 2 as published by the Free Software Foundation.
#
# This program is distributed in the hope that it will be useful,
# but WITHOUT ANY WARRANTY; without even the implied warranty of
# MERCHANTABILITY or FITNESS FOR A PARTICULAR PURPOSE. See the
# GNU General Public License for more details.

config MICROTRUST_TEE_SUPPORT
	bool "Enable Microtrust TEEI Support"
	select DMA_SHARED_BUFFER
	select GENERIC_ALLOCATOR
	select MTK_TEE_SANITY
	default n
	help
	  Enables the support of Microtrust TEE drivers.
	  All Microtrust related TEE drivers will depend on this option.
	  Say Y if you would like to enable this feature.
	  If unsure, say N.

config MICROTRUST_TEE_VERSION
	string "MICROTRUST TEE Version"
	depends on MICROTRUST_TEE_SUPPORT
	default "400"
	help
	  Enables the support of Microtrust new version.
	  All Microtrust related TEE drivers will depend on this option.
	  Say 400 if you would like to enable this feature.
	  If unsure, say 400.

config MICROTRUST_TZ_DRIVER
	tristate "Microtrust TEEI Driver"
	depends on MICROTRUST_TEE_SUPPORT
	default y
	help
	  Enables the support of Microtrust trustzone linux driver.
	  This driver in charge of all initial process, creating
	  communication channels and connections with secure world.
	  Say Y if you would like to enable the driver.
	  If unsure, say Y.

config MICROTRUST_DYNAMIC_CORE
	tristate "Microtrust TEEI Dynamic Core"
	depends on MICROTRUST_TEE_SUPPORT
	default n
	help
	  Enables the support of Microtrust trustzone linux driver.
	  This driver in charge of all initial process, creating
	  communication channels and connections with secure world.
	  Say Y if you would like to enable the driver.
	  If unsure, say Y.

config MICROTRUST_TZ_DRIVER_MTK_BOOTPROF
	bool "Enable MTK bootprof to track boot progress of TEEI"
	depends on MICROTRUST_TZ_DRIVER
	depends on MTPROF
	default y
	help
	  Enables the support of Mediatek bootprof feature in Microtrust
	  tz_driver. This feature is for tracking boot progress by
	  notifying mtk bootprof driver in each check point.
	  Say Y if you would like to enable this feature.
	  If unsure, say Y.

config MICROTRUST_TZ_DRIVER_MTK_TRACING
	bool "Enable MTK tracing to profile TEEI"
	depends on MICROTRUST_TZ_DRIVER
	depends on TRACING
	default n
	help
	  Enables the support of Mediatek tracing feature in Microtrust
	  tz_driver. This feature is for tracking teei thread by MTK
	  tracing mechanism.
	  Say Y if you would like to enable this feature.

config MICROTRUST_VFS_DRIVER
	tristate "Microtrust Virtual File System Driver"
	depends on MICROTRUST_TEE_SUPPORT
	default y
	help
	  Enables the support of Microtrust virtual file system driver.
	  This driver is the proxy of secure world for linux virtual
	  file system access. E.g., access for file system or RPMB.
	  Say Y if you would like to enable the driver.
	  If unsure, say Y.

config MICROTRUST_FP_DRIVER
	tristate "Microtrust Fingerprint Driver"
	depends on MICROTRUST_TEE_SUPPORT
	default y
	help
	  Enables support of Microtrust fingerprint helper driver.
	  This driver provides IOCTL interface for fingerprint HAL or
	  driver to communicate with fingerpirnt trusted application.
	  Say Y if you would like to enable the helper driver.
	  If unsure, say Y.

config MICROTRUST_KEYMASTER_DRIVER
	tristate "Microtrust keymaster Driver"
	depends on MICROTRUST_TEE_SUPPORT
	default y
	help
	  Enables support of Microtrust keymaster helper driver.
	  This driver provides IOCTL interface for keymaster HAL
	  to communicate with keymaster trusted application.
	  Say Y if you would like to enable the helper driver.
	  If unsure, say Y.

config MICROTRUST_DEBUG
	bool "Enable Microtrust Debug Message"
	depends on MICROTRUST_TEE_SUPPORT
	default n
	help
	  Enable debug messages output from Microtrust Linux drivers.
	  More debug information will be directed to console.
	  Say Y if you would like to enable more debug outputs.
	  If unsure, say N.

config MICROTRUST_UNITTEST_SUPPORT
	tristate "Microtrust Unittest Trigger Support"
	depends on MICROTRUST_TEE_SUPPORT
	default n
	help
	  Enable Microtrust unittest trigger driver.
	  This driver will can be trigger from Linux userspace and
	  send a start_test message to TEE unittest service.
	  Say Y if you would like to enable secure world log support.
	  If unsure, say N.

config MICROTRUST_TZ_LOG
	bool "Enable Microtrust TrustZone logger"
	depends on MICROTRUST_TEE_SUPPORT
	default y
	help
	  Enable Microtrust TrustZone logger to dump TEE logs in kernel log buffer.
	  This driver will read out log buffer and direct to console each
	  time a smc call is returned from secure world.
	  Say Y if you would like to enable secure world log support.
	  If unsure, say Y.

config MICROTRUST_TEST_DRIVERS
	tristate "Microtrust Test Drivers"
	depends on MICROTRUST_TEE_SUPPORT
	default n
	help
	  Enables support of Microtrust test driver kernel framework.
	  This framework supports DCIH and GP API test drivers.
	  Say Y if you would like to enable the test framework.
	  If unsure, say N.

config MICROTRUST_TZDRIVER_DYNAMICAL_DEBUG
	tristate "Microtrust tzdriver dynamical debug"
	depends on MICROTRUST_TEE_SUPPORT
	default n
	help
	  Enables support of Microtrust test driver kernel framework.
	  This framework supports DCIH and GP API test drivers.
	  Say Y if you would like to enable the test framework.
	  If unsure, say N.
```

## drivers/tee/teeperf/Kconfig
```kconfig
#
# TEE perf configuration
#
config TEE_PERF_SUPPORT
	tristate "Enable TEE Perf Support"
	help
	  Enable TEE Perf Support.
	  This option enables TEE perf driver which is used to
	  improve TEE performance. The TEE perf driver provides
	  user interface to boost cpu for user application.
```
