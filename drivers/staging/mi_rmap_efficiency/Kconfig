## drivers/unisoc_platform/sched/Kconfig
```kconfig
# SPDX-License-Identifier: GPL-2.0-only
#
# unisoc scheduler based on WALT
#
menu "Unisoc Scheduler Features"

config UNISOC_SCHED
	tristate "Support Unisoc Scheduler Features"
	depends on SMP
	help
	  This is the base of unisoc specifec scheduler, including WALT, EAS, RT,
	  cpufreq governor and so on...

config SCHED_WALT
	tristate "Support Window Assisted Load Tracking"
	depends on UNISOC_SCHED
	help
	  This feature will allow the scheduler to get utilzation for tasks
	  and runqueues based on window assisted load tracking. The util can be
	  used to guide eas/load_balance/rt task placement as well as
	  task frequency requirements for cpufreq governors.

config UNISOC_SCHED_OPTIMIC_ON_A7
	bool "Support scheduler optimization in arm-v7"
	depends on ARM && UNISOC_SCHED
	default n
	help
	  This feature will allow arm-v7 cpus use some scheduler
	  optimization.
	  If you want use unisoc schedutil on v7 chips,
	  set it to be y.

config UNISOC_GROUP_CTL
	bool "Support Unisoc Group Control"
	depends on CGROUP_SCHED && UNISOC_SCHED
	help
	  This feature introduce unisoc group control feature.
	  In Android system, the tasks would be set to be into
	  different groups such as top-app, foreground, background and so on.
	  This feeature can set different scheduler policy for different groups.

choice
	prompt "select how to boost the cpu/task util"
	default UNISOC_GROUP_NO_BOOST

config UNISOC_GROUP_NO_BOOST
	bool "no boost"
	depends on UNISOC_SCHED
	help
	  We have different cpu/task util boost policies,
	  such as stune and transform uclamp to stune.
	  If you can not decide how to boost,
	  choose this.

config UNISOC_GROUP_BOOST
	bool "Using group boost just like schedtune"
	depends on UNISOC_GROUP_CTL
	help
	  This feature is porting from schedtune's boost params. It can boost
	  the task and cpu when setting the val to be bigger than 0. Also It
	  can deboost the task and cpu when setting the val to be smaller than 0.

config UCLAMP_MIN_TO_BOOST
	bool "Transform uclamp_min to schedtune.boost"
	depends on UNISOC_SCHED
	depends on UCLAMP_TASK
	help
	  This feature would transform the uclamp_min to stune.boost.
	  Meantime, add sysctl to let users could disable the feature and using
	  the original uclamp.

endchoice

config UNISOC_ROTATION_TASK
	bool "Unisoc rotation task"
	depends on SMP
	depends on UNISOC_SCHED
	default n
	help
	  This option enables task rotation feature. In ARM big.little cpu
	  topology, benchmark app may start NR_CPUS big tasks to run,
	  rotation task can improve system performance between big core
	  and little core.

config UNISOC_SCHED_VIP_TASK
	bool "Unisoc Sched VIP TASK"
	depends on UNISOC_SCHED
	default n
	help
	This option enables vip-task feature. In android system, there are often
	cfs tasks that need low lentency, but cfs scheduler often treats each task
	fairly, in this case, if the low lentency tasks are frequently preempted
	by other tasks. this case is what we can not stand. On the other hand, the
	introduction of group-scheduler makes tasks between different process
	groups more uncontrollable. To improve the task performance, Introduce
	vip-task feature. user can set the low lentency task tobe vip task, the
	vip task could get priority scheduling to improve performance.

config UNISOC_SCHEDUTIL_GOV
	tristate "Support Unisoc Schedutil Governor"
	depends on CPU_FREQ && SMP
	depends on UNISOC_SCHED
	help
	this cpufreq governor is based on the original kernel schedutil governor,
	and add unisoc specific features like freq_margin and slak_timer.

config UNISOC_HUNG_TASK_ENH
	bool "Unisoc hung task enh"
	depends on UNISOC_SCHED && DETECT_HUNG_TASK
	help
	  This feature uses whitelist/blacklist to enhance D state task detect.
	  In addition, add the detection of iowait state task.
	  If Y, check tasks according to whitelist/blacklist rule. Using whitelist
	  mode will check tasks in the list, blacklist mode will check tasks out
	  of the list.
	  If N, check all tasks.

config UNISOC_RT_TIMEOUT_DETECT_MS
	int "Unisoc long running rt task detect"
	range 0 2000
	default 0
	depends on UNISOC_SCHED
	help
	  This feature is used to detect long running rt task and print warn
	  info.
	  In userdebug version, this feature should be enabled by default,
	  and the default timeout is 800.
	  In user version, user decides whether to open it by sysctl.

config UNISOC_SCHED_PAUSE_CPU
	bool "Support pause cpu feature"
	depends on UNISOC_SCHED
	help
	  Enable pause cpu feature.it would set the cpu as paused and migrate task
	  from the run-queue of the paused cpu to other cpu,to give a chance to the
	  paused cpu to reach quickly an idle state.
	  If y thermal policy would use this feature to let cpu enter into an idle
	  state to lower the temperature of SoC.

config UNISOC_CPU_NETLINK
	bool "Support cpu netlink feature"
	depends on UNISOC_SCHED
	default n
	help
	  Enable cpu netlink feature.
	  When open this feature, scheduler would send some scheduler event to user
	  Using genl ntlink with multicast. User can do some thing when received
	  the message.
	  If you do not use unisoc android framework, or you do not want to receive
	  the messege, turn off it.

config UNISOC_SCHED_DEBUG_ATOMIC
	bool "Support unisoc scheduler debug"
	depends on UNISOC_SCHED && SPRD_DEBUG
	default n
	help
	  Enable unisoc scheduler_bug debug.
	  When open this feature, scheduler would check scheduling in atomic,
	  and then trigger panic.
	  If you do not want to trigger panic,
	  turn it off.

config UNISOC_INPUT_BOOST
	bool "Support input cpufreq boost"
	depends on UNISOC_SCHED && CPU_FREQ
	default n
	help
	  Support input boost feature.
	  If enable this feature, the cpu minimum frequency would be fixed as the
	  user setting when there are input signal from screen touch, and it would
	  restore to the original value after a while.

config UNISOC_WORKAROUND_L3_HANG
	bool "workaround sharkl3 32b cpu hang"
	depends on UNISOC_SCHED && ARM
	default n
	help
	  Enable the l3 cpu hang workaround.
	  Start a timer when boot, when time out, send ipi_rescheduler to other
	  cpus to wake up the cpu.
	  Do not open it except for sharkl3 32b.

config UNISOC_WORKAROUND_VRUNTIME_BIG_GAP
	bool "workaround cfs vruntime gap is too large"
	depends on SCHED_WALT
	default n
	help
	  Enable vruntime's gap too large workaround.
	  Sometimes, the yield task's vruntime is too small, and the waking task's
	  vruntime is too large, as a result, the task is not scheduled.
	  Do not open it unless vruntime issue is confirmed.
endmenu
```

## drivers/unisoc_platform/sprd_bcl/Kconfig
```kconfig
config SPRD_BCL
	tristate "SPRD device battery current limit support"
	help
	  say Y here to support for battery current limit module
```

## drivers/unisoc_platform/sprd_freq_limit/Kconfig
```kconfig
config SPRD_FREQ_LIMIT
	tristate "SPRD device freq limit support"
	help
	  say Y here to support for limiting device freq
```

## drivers/unisoc_platform/sysdump/Kconfig
```kconfig
config SPRD_SYSDUMP
	tristate "Enable UNISOC sysdump handler"
	depends on ARCH_SPRD && !KEXEC_CORE
	help
	  This option enables Spreatrum sysdump which prepare debug info
	  for u-boot to write into mmc storage after kernel panics.

config SPRD_MINI_SYSDUMP
	depends on SPRD_SYSDUMP
	bool "Enable UNISOC mini sysdump handler"
	help
	  This option enables Spreatrum mini sysdump which supplies simple
	  debug info for projects can not support external sd card after
	  system occurs kernel panics.

config SPRD_NATIVE_HANG_MONITOR
	tristate "Enable UNISOC android native hang detect handler"
	help
		This option enables Spreatrum android native hang detect which prepare debug info
		for the case to debug.

config UNISOC_LASTKMSG
	depends on SPRD_SYSDUMP || SPRD_MINI_SYSDUMP
	tristate "Enable UNISOC LASTKMSG handler"
	help
	  This option enables Unisoc LSTKMSG which supplies kernel
	  debug info.
	  1.save task sched info in minidump when panic or cpu hang.
	  2.save runqueue info in minidump when panic or cpu hang.
	  3.save current stack info in minidump when panic or cpu hang.
	  4.save per cpu register and current stack in minidump when
	  panic or cpu hang.
	  5.save per cpu irq stack in minidump when panic or wdh
	  only in 64b system.

config UNISOC_MINIDUMP_FTRACE
	bool "Enable dump ftrace buffer when panic"
	depends on UNISOC_LASTKMSG
	default n
	help
	  This add ftrace buffer to minidump section.
	  When panic, ftrace buffer will be copied to that buffer.
	  This way, ftrace buffer would becomes a part of minidump
	  section.

config UNISOC_MINIDUMP_FTRACE_SIZE_KB
	int "Unisoc minidump per_cpu ftrace size(kb)"
	range 128 2048
	default 256
	depends on UNISOC_MINIDUMP_FTRACE
	help
	  This set the minidump buffer size.

config UNISOC_DUMP_IO
	depends on SPRD_SYSDUMP || SPRD_MINI_SYSDUMP
	tristate "Enable UNISOC dump io handler"
	help
		This option enables dump io which provide all io requests info at that time

config SPRD_CLOSE_CRASH_KEY
	bool "Disable crash_key trigger kernel panic"
	depends on SPRD_SYSDUMP
	default n
	help
		This option disables Spreatrum crash_key which tigger kernel panic
		to debug.

config SPRD_MODULES_NOTIFY
	tristate "monitor every modules loading time"
	depends on ARCH_SPRD && MODULES && ANDROID_KABI_RESERVE
	help
	  Say y here to enable Debug support.
	  When in doubt, say n
	  this is a debug feature that monitor every modules loading time
	  when bootup

config UNISOC_SIGNAL_DEBUG
	bool "SPRD userspace debug: add signal debug"
	depends on ARM64 && SPRD_DEBUG && SPRD_NATIVE_HANG_MONITOR
	help
	  Say y here to enable Debug support.
	  when in doubt, say n.
	  this is a debug feature for tracing signal origins
	  when process is receiving a signal.
```

## drivers/xiaomi/Kconfig
```kconfig
source "drivers/xiaomi/dump_display/Kconfig"
source "drivers/xiaomi/boottime/Kconfig"
source "drivers/xiaomi/mi_stack/Kconfig"
source "drivers/xiaomi/mi_ubt/Kconfig"
source "drivers/xiaomi/printk_enhance/Kconfig"
source "drivers/xiaomi/kshrink_slabd/Kconfig"
source "drivers/xiaomi/lz4asm/Kconfig"
source "drivers/xiaomi/bootmonitor/Kconfig"
source "drivers/xiaomi/mi_trace/Kconfig"
source "drivers/xiaomi/swinfo/Kconfig"
source "drivers/xiaomi/dump_binder/Kconfig"
source "drivers/xiaomi/dio_dma_mapper/Kconfig"
```

## drivers/xiaomi/dio_dma_mapper/Kconfig
```kconfig
# SPDX-License-Identifier: GPL-2.0-only
config DEVICE_MODULES_DIO_DMABUF_MAPPER
	tristate "DMA-BUF mapper for dio"
	depends on DMABUF_HEAPS
	help
	  Choose this option to enable the DirectIO dmabuf mapper.
	  This mapper could mmap the given dmabuf into a vm_area_struct with the
	  capability to be the src or dst buffer of DirectIO.
```

## drivers/xiaomi/dump_binder/Kconfig
```kconfig
# SPDX-License-Identifier: GPL-2.0-only
#
# Mi dump binder
#

config MI_DUMP_BINDER_BUFFER
	tristate "dump binder buffer"
	default m
	help
	This adds support for mi dump binder.
```

## mm/dynamic_readahead/Kconfig
```kconfig
# SPDX-License-Identifier: GPL-2.0-only

config MI_DYNAMIC_READAHEAD
	tristate "dynamic pagecache readahead"
	default n
	help
	  This driver used for dynamically tuning filemap readahead for performance.
```
