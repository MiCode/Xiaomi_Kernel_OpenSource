## drivers/staging/mi_rmap_efficiency/Kconfig
```kconfig
config MI_RMAP_EFFICIENCY
    tristate "support MI_RMAP_EFFICIENCY module"
    default n
    help
        protect high __mapcount pages to reduce CPU load caused by reverse mapping during mem recycling.
```

## drivers/unisoc_platform/Kconfig
```kconfig
#
# UNISOC Display drivers
#
menu "Unisoc SOC drivers"

config SPRD_PMIC_SMPL
	tristate "Spreadtrum PMIC SMPL driver"
	depends on MFD_SC27XX_PMIC || MFD_UMP96XX_PMIC || COMPILE_TEST
        help
          Say Y here to enable smpl module.

config SPRD_PMIC_DUMP
	tristate "Spreadtrum PMIC DUMP driver"
	depends on MFD_SC27XX_PMIC || MFD_UMP96XX_PMIC || COMPILE_TEST
        help
          Say Y here to include support for the UNISOC pmic dump controller.
	  This driver is used to control ordinary rotor motors.

	  To compile this driver as a module, choose M here. The module will
	  be called sprd_pmic_dump.

config SPRD_PMIC_SYSCON
	tristate "Unisoc PMIC global driver"
	depends on MFD_SC27XX_PMIC || MFD_UMP96XX_PMIC || COMPILE_TEST
	help
		Enable this configuration option to enable pmic global driver.

config SPRD_UNISOC_MANUFACTURER_MODULE
        tristate "Spread unisoc manufacturer module driver"
        depends on ARCH_SPRD || COMPILE_TEST
        help
          Say Y here to enable smpl module.

config UNISOC_7SRESET
        tristate "Unisoc PMIC 7s reset driver"
	depends on ARCH_SPRD || COMPILE_TEST
	help
	  This driver support for 7Sreset of PMIC(2731,2730)

config SPRD_MEMDISK
	tristate "SPRD memdisk driver"
	depends on ARCH_SPRD
	default n
	help
		This option can support sprd memdisk driver,
		which can use a block of DDR memory as a disk.
		we can load the android image to this disk when
		mmc driver is not ready, for example in vdk and FPGA platform.

config SPRD_MEMDISK_PARTITION
	tristate "SPRD memdisk partition driver"
	depends on SPRD_MEMDISK
	default y
	help
		This option will divide memdisk
		into multiple partitions,
		used to load different android images
		on the haps platform.

config SPRD_SKYNET
	bool "SPRD Skynet"
	default n
	help
		This option is debug flag for skynet version
		Say y here to enable Debug support.
		When in doubt, say n
		on the all platform.

# NOTE: Keep order __alphabetically__ PLEASE!! #

source "drivers/unisoc_platform/binder/Kconfig"
source "drivers/unisoc_platform/cpufreq/Kconfig"
source "drivers/unisoc_platform/debug/Kconfig"
source "drivers/unisoc_platform/debug_log/Kconfig"
source "drivers/unisoc_platform/dmabufheap/Kconfig"
source "drivers/unisoc_platform/iommu/Kconfig"
source "drivers/unisoc_platform/io/Kconfig"
source "drivers/unisoc_platform/irq_monitor/Kconfig"
source "drivers/unisoc_platform/kts_sync/Kconfig"
source "drivers/unisoc_platform/mm/Kconfig"
source "drivers/unisoc_platform/modem/Kconfig"
source "drivers/unisoc_platform/net/Kconfig"
source "drivers/unisoc_platform/preemptirq_warn/Kconfig"
source "drivers/unisoc_platform/printk_cpuid/Kconfig"
source "drivers/unisoc_platform/pub/Kconfig"
source "drivers/unisoc_platform/sched/Kconfig"
source "drivers/unisoc_platform/sfp/Kconfig"
source "drivers/unisoc_platform/sla/Kconfig"
source "drivers/unisoc_platform/sprd_bcl/Kconfig"
source "drivers/unisoc_platform/sprd_disp/Kconfig"
source "drivers/unisoc_platform/sprd_freq_limit/Kconfig"
source "drivers/unisoc_platform/sprd_gnss/Kconfig"
source "drivers/unisoc_platform/sprd_map/Kconfig"
source "drivers/unisoc_platform/sprd_time_sync/Kconfig"
source "drivers/unisoc_platform/sprdwcn/Kconfig"
source "drivers/unisoc_platform/sysdump/Kconfig"
source "drivers/unisoc_platform/thermal/Kconfig"
source "drivers/unisoc_platform/power/Kconfig"
source "drivers/unisoc_platform/hang_debug/Kconfig"
source "drivers/unisoc_platform/userlog/Kconfig"
source "drivers/unisoc_platform/performance/Kconfig"
source "drivers/unisoc_platform/sprd_coresight/Kconfig"
source "drivers/unisoc_platform/past_record/Kconfig"
source "drivers/unisoc_platform/usbpinmux/Kconfig"
source "drivers/unisoc_platform/sprd_cache_print/Kconfig"
source "drivers/unisoc_platform/autotest/Kconfig"
source "drivers/unisoc_platform/shutdown_detect/Kconfig"
source "drivers/unisoc_platform/cachedump/Kconfig"
source "drivers/unisoc_platform/pur/Kconfig"

endmenu
```

## drivers/unisoc_platform/cachedump/Kconfig
```kconfig
config UNISOC_CACHEDUMP
	tristate "Enable UNISOC cachedump handler"
        depends on SPRD_SYSDUMP && SPRD_DEBUG
	help
	  This option enables Spreatrum cachedump which prepare debug info
	  for u-boot to write into mmc storage after sysdump in userdebug version.
          And use smcc notify sml to save cachedump.
```

## drivers/unisoc_platform/debug/Kconfig
```kconfig
config SPRD_DEBUG
	bool "Spreadtrum debug module"
	depends on ARCH_SPRD || COMPILE_TEST
	help
	  Say y here to enable Debug support.

config SPRD_LOOK_AT
	tristate "Sprdtrum lookat tool support"
	depends on SPRD_DEBUG || COMPILE_TEST
	default n
	help
	  this macro is for lookat driver, lookat is a debug tool that is used to
	  view the content of arm/arm64 of the address space through usb port,
	  such as the register of each module, DDR address space, etc.
	  When in doubt, say n

config SPRD_DEBUG_GIC
	bool "Spreadtrum debug gic"
	depends on ARCH_SPRD
	help
	  Say y here to enable Debug support.
	  When in doubt, say n
	  this is a debug feature that recored gic to handler
	  all irqs

config UNISOC_SYZKALLER_TEST
	bool "UNISOC syzkaller test mask"
	depends on UNISOC_DEBUG
	default n
	help
	  This configuration is to mask the syzkaller test.

	  If you need to configure the syzkaller project for test,
	  please set it to Y. In a normal version of userdebug,
	  please keep the configuration as the default value.

source "drivers/unisoc_platform/debug/busmonitor/Kconfig"
source "drivers/unisoc_platform/debug/data_collector/Kconfig"
source "drivers/unisoc_platform/debug/djtag/Kconfig"
source "drivers/unisoc_platform/debug/dmc_mpu/Kconfig"
source "drivers/unisoc_platform/debug/apb_prot/Kconfig"
source "drivers/unisoc_platform/debug/reg_trace_monitor/Kconfig"
source "drivers/unisoc_platform/debug/userspace_debug/Kconfig"
source "drivers/unisoc_platform/debug/sprd_undef_hook/Kconfig"
```

## drivers/unisoc_platform/debug/data_collector/Kconfig
```kconfig
# SPDX-License-Identifier: GPL-2.0

config SPRD_DATA_COLLECTOR
	bool "Collect system statistic data"
	depends on SPRD_DEBUG && ANDROID_VENDOR_OEM_DATA
	help
	  This config collects some system statistic
	  data and print the info in log periodicly,
	  via exported trace point.
	  In userdebug version set m.
```

## drivers/unisoc_platform/debug/reg_trace_monitor/Kconfig
```kconfig
config UNISOC_REG_TRACE_MONITOR
  tristate "Unisoc Reg Trace Monitor Support"
  depends on SPRD_DEBUG
  help
	this macro is for rtm driver, rtm is a debug tool that
	is used to monitor register access for apb/apb/axi bus,
	then the data pass atb bus to coresight etf or etr. It
	can be captured by debug tools or other commands.
	Say M or Y here to support RTM, say n not.
```

## drivers/unisoc_platform/io/Kconfig
```kconfig
# SPDX-License-Identifier: GPL-2.0-only
#
#

config UNISOC_IODEBUG
	tristate "print io debug log"
	depends on ARCH_SPRD
	help
	Provide IO debug information to trace IO issues.
	Count and print the time required for the request
	from insert to issue, and from issue to complete.
	It will print in kernel log.

config UNISOC_IOWAIT
	tristate "print iowait log"
	depends on ARCH_SPRD
	help
	Provide iowait information to trace IO issues.
	Count the time consumption of processes on iowait
	Only support arch64.
	It will print in kernel log.

config UNISOC_IOLIMIT
	tristate "vfs io limit support"
	depends on BLK_CGROUP
	help
	Provide a blkio policy implementing for io bandwidth while a process
	in the cgroup buffer write.

config UNISOC_FILEMAP_DEBUG
	tristate "print inode info associated with the page"
	depends on ARCH_SPRD
	help
	Provide debug information to track the name of the file
	corresponding to the page during the page_add and page_delete
	processes.
	When the filemap related trace event is enabled, print the file
	name associated with the page.

config UNISOC_IOMONITOR
	tristate "vfs iomonitor support"
	depends on ARCH_SPRD
	help
	Monitor VFS interfaces based on the kprobe to count the IO volume of
	processes, the IO statstics can be obtained by cat io_stat node.
	The function needs to be enabled by manually enabling The
	/proc/io_monitor/enable node.
```

## drivers/unisoc_platform/modem/pcie/Kconfig
```kconfig
config UNISOC_PCIE_EP_DEVICE
	tristate "SPRD PCIE EP device"
	default n
	depends on PCI_MSI
	help
	  SPRD pcie ep device driver in host side for Spreadtrum.
	  This module provides user api to aplly msi interrupt,
	  raise doorbell interrupt,map/ummap pcie memory.
	  Set M or Y for this module if want to use it.

config UNISOC_PCIE_DOORBELL_WORKAROUND
	bool "SPRD PCIE DOORBELL WORKAROUND"
	default n
	depends on PCIE_EPF_SPRD
	help
	  Enable SPRD pcie doorbell workaround.
	  The pcie have a chip defect:
	  when the pcie enter L1.x sleep state(PCIE LOW POWER STATE),
	  the ep can't access to the doorbell register. So the workaroud
	  is that before the ep access to the doorbell register, it must
	  a write action to make PCIE exit L1 state.
```

## drivers/unisoc_platform/power/Kconfig
```kconfig
source "drivers/unisoc_platform/power/power_debug/Kconfig"
source "drivers/unisoc_platform/power/unisoc_pnp/Kconfig"
```

## drivers/unisoc_platform/power/unisoc_pnp/Kconfig
```kconfig
#
# SPRD Soc Pnp drivers
#
menuconfig SPRD_PNP_DEBUG
	tristate "Unisoc PNP debug driver"
	depends on PM_SLEEP && ARCH_SPRD
	default n
	help
		Select this to enable PNP debug driver for sprd soc. This driver
		is only used to cellect working information of pnp.
		these information will heip to analysis pnp issues.
```

## drivers/unisoc_platform/pur/Kconfig
```kconfig
#
# power up reason support
#
config POWERUP_REASON
	tristate "Unisoc power up reason support"
	help
          Support for Unisoc power up reason driver.
	  This option enables support for Unisoc power up reason driver,
	  To compile this driver as a module, choose M here. The module will
	  be called user.
```
