## drivers/gpu/ion/Kconfig
```kconfig
menuconfig ION
	tristate "Ion Memory Manager"
	depends on ARM
	select GENERIC_ALLOCATOR
	select DMA_SHARED_BUFFER
	help
	  Chose this option to enable the ION Memory Manager.

config ION_IOMMU
       bool

config ION_TEGRA
	tristate "Ion for Tegra"
	depends on ARCH_TEGRA && ION
	select TEGRA_IOMMU_SMMU if !ARCH_TEGRA_2x_SOC
	select ION_IOMMU if TEGRA_IOMMU_SMMU
	help
	  Choose this option if you wish to use ion on an nVidia Tegra.
```

## drivers/gpu/mediatek/Kconfig
```kconfig
config MTK_GPU_SUPPORT
	tristate "Support MTK GPU"
	help
	  config supports MTK GPU driver
	  CONFIG_MTK_GPU_SUPPORT defines
	  The gpu driver would be built-in, as kernel module or not supported
	  MTK_GPU_VERSION would define the target HW IP

config MTK_GPU_VERSION
	string "Support MTK GPU Driver Version"
	default ""
	help
	  CONFIG_MTK_GPU_VERSION define which gpu ddk version will be used
	  It has three parts
	  1.vendor name 2.GPU architecture name 3. driver version

config MTK_GPU_COMMON_DVFS_SUPPORT
	bool "Support GPU VSync-Based DVFS Policy"
	default n
	help
	  config supports to enable GPU DVFS policy.
	  It is nice method to save power.
	  It is recommended to enable it when MTK_GPU_SUPPORT is enabled.

config MTK_GPU_R5P0
	bool "Force to use r5p0 driver"
	default n
	help
	  config defines to use r5p0 drivers
	  Choose this option to force r5p0 driver verison

config SW_SYNC64
	bool "Enable SW 64bit sync counter"
	depends on SW_SYNC
	help
	  A sync object driver that uses a 64bit counter to coordinate
	  syncrhronization.  Useful when there is no hardware primitive backing
	  the synchronization.

config MTK_GPU_SPM_DVFS_SUPPORT
	bool "Enable GPU SPM DVFS"
	default n
	help
	  Choose this option to enable a dedicated HW to do GPU DVFS.
	  The feature is still under experiment. Enable only if you know
	  what your are doing.
	  MTK_GPU_COMMON_DVFS_SUPPORT and MTK_GPU_SPM_DVFS_SUPPORT shouldn't
	  exist concurrently.

config MTK_GPU_SWPM_SUPPORT
	bool "Enable GPU SPM DVFS"
	default n
	help
	   config supports to make SWPM enable/disable GPU power model

config MTK_GPU_SWPM_RUN_TIME
	bool "Enable GPU SWPM RUN TIME"
	default n
	help
	   GPU swpm rum time if config enable
	   GPU swpm is initial in ged dvfs

config MTK_TINYSYS_GPUEB_SUPPORT
	tristate "Support MTK GPUEB"
	default n
	help
	  Choose this option to enable dedicated HW for GPU DVFS.
	  CONFIG_MTK_TINYSYS_GPUEB_SUPPORT defines
	  if the gpueb driver should be built, as kernel module or not supported

config MTK_GPUFREQ_V2
	bool "MTK GPUFREQ Version 2"
	default n
	help
	  Support for gpufreq version 2.
	  CONFIG_MTK_GPUFREQ_V2 defines
	  if the gpufreq driver should go to version 2

config MTK_GPU_MT6789_SUPPORT
	tristate "Specify Mediatek GPU Platform is mt6789"
	depends on MTK_GPU_SUPPORT
	help
	  Select MediaTek GPU Platform is mt6789.
	  Set Y or M to select this feature for specific platform-mt6789,
	  and set N to disable.
	  It is additional config to separate platforms.

config MTK_GPU_MT6833_SUPPORT
	tristate "Specify Mediatek GPU Platform is mt6833"
	depends on MTK_GPU_SUPPORT
	help
	  Select MediaTek GPU Platform is mt6833.
	  Set Y or M to select this feature for specific platform-mt6833,
	  and set N to disable.
	  It is additional config to separate platforms.

config MTK_GPU_MT6855_SUPPORT
	tristate "Specify Mediatek GPU Platform is mt6855"
	depends on MTK_GPU_SUPPORT
	help
	  Select MediaTek GPU Platform is mt6855.
	  Set Y or M to select this feature for specific platform-mt6855,
	  and set N to disable.
	  It is additional config to separate platforms.

config MTK_GPU_MT6879_SUPPORT
	tristate "Specify Mediatek GPU Platform is mt6879"
	depends on MTK_GPU_SUPPORT
	help
	  Select MediaTek GPU Platform is mt6879.
	  Set Y or M to select this feature for specific platform-mt6879,
	  and set N to disable.
	  It is additional config to separate platforms.

config MTK_GPU_MT6893_SUPPORT
	tristate "Specify Mediatek GPU Platform is mt6893"
	depends on MTK_GPU_SUPPORT
	help
	  Select MediaTek GPU Platform is mt6893.
	  Set Y or M to select this feature for specific platform-mt6893,
	  and set N to disable.
	  It is additional config to separate platforms.

config MTK_GPU_MT6895_SUPPORT
	tristate "Specify Mediatek GPU Platform is mt6895"
	depends on MTK_GPU_SUPPORT
	help
	  Select MediaTek GPU Platform is mt6895.
	  Set Y or M to select this feature for specific platform-mt6895,
	  and set N to disable.
	  It is additional config to separate platforms.

config MTK_GPU_MT6983_SUPPORT
	tristate "Specify Mediatek GPU Platform is mt6983"
	depends on MTK_GPU_SUPPORT
	help
	  Select MediaTek GPU Platform is mt6983.
	  Set Y or M to select this feature for specific platform-mt6983,
	  and set N to disable.
	  It is additional config to separate platforms.

config MTK_GPU_MT6768_SUPPORT
	tristate "Specify Mediatek GPU Platform is mt6768"
	depends on MTK_GPU_SUPPORT
	help
	  Select MediaTek GPU Platform is mt6768.
	  Set Y or M to select this feature for specific platform-mt6768,
	  and set N to disable.
	  It is additional config to separate platforms.

config MTK_GPU_MT6765_SUPPORT
	tristate "Specify Mediatek GPU Platform is mt6765"
	depends on MTK_GPU_SUPPORT
	help
	  Select MediaTek GPU Platform is mt6765.
	  Set Y or M to select this feature for specific platform-mt6765,
	  and set N to disable.
	  It is additional config to separate platforms.
```

## drivers/gpu/mediatek/gpu_mali/mali_valhall/mali-r32p0/drivers/base/arm/Kconfig
```kconfig
# SPDX-License-Identifier: GPL-2.0
#
# (C) COPYRIGHT 2021 ARM Limited. All rights reserved.
#
# This program is free software and is provided to you under the terms of the
# GNU General Public License version 2 as published by the Free Software
# Foundation, and any use by you of this program is subject to the terms
# of such GNU license.
#
# This program is distributed in the hope that it will be useful,
# but WITHOUT ANY WARRANTY; without even the implied warranty of
# MERCHANTABILITY or FITNESS FOR A PARTICULAR PURPOSE. See the
# GNU General Public License for more details.
#
# You should have received a copy of the GNU General Public License
# along with this program; if not, you can access it online at
# http://www.gnu.org/licenses/gpl-2.0.html.
#
#

menu "Arm GPU extra modules"

menuconfig MALI_BASE_MODULES
	bool "Mali Base extra modules"
	default n
	help
	  Enable this option to build support for a Arm Mali base modules.
	  Those modules provide extra features or debug interfaces and,
	  are optional for the use of the Mali GPU modules.

source "drivers/base/arm/dma_buf_test_exporter/Kconfig"
source "drivers/base/arm/memory_group_manager/Kconfig"
source "drivers/base/arm/protected_memory_allocator/Kconfig"


endmenu
```

## drivers/gpu/mediatek/gpu_mali/mali_valhall/mali-r32p0/drivers/gpu/arm/midgard/tests/Kconfig
```kconfig
# SPDX-License-Identifier: GPL-2.0
#
# (C) COPYRIGHT 2017, 2020-2021 ARM Limited. All rights reserved.
#
# This program is free software and is provided to you under the terms of the
# GNU General Public License version 2 as published by the Free Software
# Foundation, and any use by you of this program is subject to the terms
# of such GNU license.
#
# This program is distributed in the hope that it will be useful,
# but WITHOUT ANY WARRANTY; without even the implied warranty of
# MERCHANTABILITY or FITNESS FOR A PARTICULAR PURPOSE. See the
# GNU General Public License for more details.
#
# You should have received a copy of the GNU General Public License
# along with this program; if not, you can access it online at
# http://www.gnu.org/licenses/gpl-2.0.html.
#
#

menuconfig MALI_KUTF
	bool "Mali Kernel Unit Test Framework"
	depends on MALI_MIDGARD
	default y
	help
	  Enables MALI testing framework. To compile it as a module,
	  choose M here - this will generate a single module called kutf.

config MALI_IRQ_LATENCY
	bool "Mali GPU IRQ latency measurement"
	depends on MALI_MIDGARD && MALI_DEBUG && MALI_KUTF
	default y
	help
	  This option will build a test module mali_kutf_irq_test that
	  can determine the latency of the Mali GPU IRQ on your system.
	  Choosing M here will generate a single module called mali_kutf_irq_test.

config MALI_CLK_RATE_TRACE_PORTAL
	bool "Mali GPU Clock Trace Test portal"
	depends on MALI_MIDGARD && MALI_DEBUG && MALI_KUTF
	default y
	help
	  This option will build a test module mali_kutf_clk_rate_trace_test_portal
	  that can test the clocks integration into the platform and exercise some
	  basic trace test in the system. Choosing M here will generate a single
	  module called mali_kutf_clk_rate_trace_test_portal.

comment "Enable MALI_DEBUG for KUTF modules support"
	depends on MALI_MIDGARD && !MALI_DEBUG && MALI_KUTF
```

## drivers/gpu/msm/Kconfig
```kconfig
config QCOM_KGSL
	tristate "Qualcomm Technologies, Inc. 3D Graphics driver"
	default n
	depends on ARCH_QCOM
	select GENERIC_ALLOCATOR
	select FW_LOADER
	select PM_DEVFREQ
	select DEVFREQ_GOV_SIMPLE_ONDEMAND
	select DEVFREQ_GOV_PERFORMANCE
	select DEVFREQ_GOV_QCOM_ADRENO_TZ
	select DEVFREQ_GOV_QCOM_GPUBW_MON
	---help---
	  3D graphics driver for the Adreno family of GPUs from QTI.
	  Required to use hardware accelerated OpenGL, compute and Vulkan
	  on QTI targets. This includes power management, memory management,
	  and scheduling for the Adreno GPUs.

config QCOM_ADRENO_DEFAULT_GOVERNOR
	string "devfreq governor for the adreno core"
	default "msm-adreno-tz" if DEVFREQ_GOV_QCOM_ADRENO_TZ
	default "simple_ondemand"
	depends on QCOM_KGSL

config QCOM_KGSL_IOMMU
	bool
	default y if QCOM_KGSL && (MSM_IOMMU || ARM_SMMU)
```

## drivers/gud/Kconfig
```kconfig
#
# MobiCore configuration
#
config MOBICORE_DRIVER
    tristate "MobiCore Driver"    
    ---help---
      Enable Linux Kernel MobiCore Support

config MOBICORE_DEBUG
    bool "MobiCore Module debug mode"
    depends on MOBICORE_DRIVER
    ---help---
      Enable Debug mode in the MobiCore Driver.
      It enables printing information about mobicore operations

config MOBICORE_VERBOSE
    bool "MobiCore Module verbose debug mode"
    depends on MOBICORE_DEBUG
    ---help---
      Enable Verbose Debug mode in the MobiCore Driver.
      It enables printing extra information about mobicore operations
      Beware: this is only useful for debuging deep in the driver because
      it prints too much logs

config TRUSTONIC_TRUSTED_UI
    tristate "<t-base TUI"
    depends on MOBICORE_DRIVER
    ---help---
      Enable <t-base Trusted User Interface

config TRUSTONIC_TRUSTED_UI_FB_BLANK
    bool "<t-base TUI with fb_blank"
    depends on TRUSTONIC_TRUSTED_UI
    ---help---
    Blank the framebuffer before starting a TUI session
```

## drivers/halls/Kconfig
```kconfig
menu "Halls"

config HALLS
	bool "Halls"
	default n
	---help---
        it's to handle hall sensors for slide

endmenu
```
