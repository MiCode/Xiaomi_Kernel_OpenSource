## drivers/firmware/cirrus/Kconfig
```kconfig
# SPDX-License-Identifier: GPL-2.0-only

config FW_CS_DSP
	tristate
	default m

config CL_DSP
	tristate
	default n
```

## drivers/firmware/qcom/Kconfig
```kconfig
# SPDX-License-Identifier: GPL-2.0-only
#
# For a description of the syntax of this configuration file,
# see Documentation/kbuild/kconfig-language.rst.
#

source "drivers/firmware/qcom/si_core/Kconfig"
```

## drivers/firmware/qcom/si_core/Kconfig
```kconfig
# SPDX-License-Identifier: GPL-2.0-only

config QCOM_SI_CORE
	tristate "Secure QTEE Communication Support"
	depends on QCOM_SCM
	help
	  Enable SI-CORE driver which supports capability based secure
	  communication between QTEE and VM. Using SI-CORE, kernel can
	  issue	calls to QTEE or TAs to request a service or exposes services
	  to QTEE and TAs. The SI-CORE implements the necessary marshaling of
	  messages with QTEE.

config QCOM_SI_CORE_WQ
	bool "Use direct invocation for RELEASE requests"
	depends on QCOM_SI_CORE
	help
	  Use a kernel thread to issue RELEASE request to QTEE and TAs
	  instead of using asynchronous messages. It may slow down the system
	  and prone to failure as it uses direct invocation which requires
	  extra resources from QTEE.

	  Enable if only QTEE does not support asynchronous message.

config QCOM_SI_CORE_MEM_OBJECT
	tristate "Add support for memory object"
	depends on QCOM_SI_CORE
	depends on QTEE_SHM_BRIDGE
	help
	  Enable support for memory object. This provide an interface
	  to export or sharing memory with QTEE. It allows kernel clients
	  to create memory object and do the necessary mapping and unmapping
	  using QTEE shared memory bridge driver.
```

## drivers/gnss/Kconfig
```kconfig
#
# GNSS receiver configuration
#

menuconfig GNSS
	tristate "GNSS receiver support"
	---help---
	  Say Y here if you have a GNSS receiver (e.g. a GPS receiver).

	  To compile this driver as a module, choose M here: the module will
	  be called gnss.

if GNSS

config GNSS_SERIAL
	tristate

config GNSS_CMDLINE_SERIAL
	tristate "Command line test driver for GNSS"
	depends on SERIAL_DEV_BUS
	select GNSS_SERIAL
	---help---
	  Say Y here if you want to test the GNSS subsystem but do not have a
	  way to communicate a binding through firmware such as DT or ACPI.
	  The correct serdev device and protocol type must be specified on
	  the module command line.

	  To compile this driver as a module, choose M here: the module will
	  be called gnss-cmdline.

	  If unsure, say N.

endif # GNSS
```

## drivers/gnsssirf/Kconfig
```kconfig
#
# SIRF GNSS receiver configuration
#

menu "GNSS SIRF controls"
config GNSS_SIRF
        bool "GNSS SIRF"
        help
          Driver for ports of GNSS SIRF functionality

endmenu
```

## drivers/gps/Kconfig
```kconfig
config BCM_GPS_SPI_DRIVER
tristate "Broadcomm GPS SPI Driver"
	depends on SPI
	help
	  Support for BRCM GPS SPI driver
```

## drivers/gpu/arm/Kconfig
```kconfig
#
# (C) COPYRIGHT 2012 ARM Limited. All rights reserved.
#
# This program is free software and is provided to you under the terms of the
# GNU General Public License version 2 as published by the Free Software
# Foundation, and any use by you of this program is subject to the terms
# of such GNU licence.
#
#

source "drivers/gpu/arm/midgard/Kconfig"
```

## drivers/gpu/drm/mediatek/Kconfig
```kconfig
config DRM_MEDIATEK
	tristate "DRM Support for Mediatek SoCs"
	depends on DRM
	depends on COMMON_CLK
	depends on HAVE_ARM_SMCCC
	depends on OF
	select DRM_GEM_CMA_HELPER
	select DRM_KMS_HELPER
	select DRM_MIPI_DSI
	select DRM_PANEL
	select MEMORY
	select MTK_SMI
        select FONT_SUPPORT
	select GENERIC_PHY
	help
	  Choose this option if you have a Mediatek SoCs.
	  The module will be called mediatek-drm
	  This driver provides kernel mode setting and
	  buffer management to userspace.

config DRM_MEDIATEK_BOMB
	tristate "DRM Support for BOMB Mediatek SoCs"
	help
	  Choose this option if you have a BOMB Mediatek SoCs.

config DRM_MEDIATEK_HDMI
	tristate "DRM HDMI Support for Mediatek SoCs"
	depends on DRM_MEDIATEK
	select SND_SOC_HDMI_CODEC if SND_SOC
	select GENERIC_PHY
	help
	  DRM/KMS HDMI driver for Mediatek SoCs

config MTK_PQ_COLOR_MODE
	string "Config PQ_COLOR_MODE (MDP & DISP COLOR on/off)"
	default "DISP"
	help
	  This control mdp color on/off and disp color on/off
	  if value equals to DISP, only display color is on.
	  if value equals to MDP, only mdp color is on.
	  if value equals to DISP_MDP, mdp and display color are both on.
	  if value equals to OFF, mdp and display color are both off.

config DRM_MTK_SHADOW_REGISTER_SUPPORT
	bool "DRM shadow register Support for Mediatek SoCs"
	depends on DRM_MEDIATEK
	help
	  DRM shadow register Support for Mediatek SoCs.
	  define CONFIG_DRM_MTK_SHADOW_REGISTER_SUPPORT to
	  enable Shadow Register on display.
	  This feature will de-risk configuration time shortage.
	  If you want to use Shadow Register on display,
	  please make sure it is Y in xxx_defconfig.
	  This feature depends on Mediatek SoCs HW spec.
	  If unsure, set N.

config DRM_MTK_DISABLE_AEE_LAYER
	bool "Disable AEE Layer for the customer who don't want to produce AEE"
	help
	  Disable AEE Layer if you do not want to produce AEE.
	  Default Mediatek SoCs will produce AEE when exception occurred.
	  if this value is y, will not produce AEE.
	  if this value is n, will produce AEE.
	  If you do not produce AEE, please set it to Y in xxx_defconfig.

config DRM_DFPS
	bool "Dynamic frame rate switching"
	default n
	help
	  Enable DFPS if you want to dynamic frame rate switching.
	  if this value is y, DFPS is on.
	  if this value is n, DFPS is off.
```

## drivers/gpu/drm/mediatek/mediatek_v2/Kconfig
```kconfig
config DRM_MEDIATEK_V2
	bool "Version 2 of DRM Support for Mediatek SoCs"
	help
	  Choose this option if you have a phone Mediatek
	  SoCs. The module will be called mediatek-drm v2
	  This driver provides kernel mode setting and
	  buffer management to userspace.

config DRM_MTK_DISABLE_AEE_LAYER
	bool "Disable AEE Layer for the customer who don't want to produce AEE"
	help
	  Disable AEE Layer if you do not want to produce AEE.
	  Default Mediatek SoCs will produce AEE when exception occurred.
	  If this value is y, will not produce AEE.
	  If this value is n, will produce AEE.
	  If you do not produce AEE, please set it to Y in xxx_defconfig.

config MTK_AAL_SUPPORT
	bool "Support MTK ambient-light adaptive luma (AAL)"
	help
	  Decide whether to support ambient-light adaptive luma and
	  display visual enhancement.
	  This feature requires the cowork of AAL user-space algorithm process.

config MTK_DRE30_SUPPORT
	bool "Support DRE 30"
	help
	  Decide whether to support ambient-light adaptive luma and
	  display visual enhancement ver.3.
	  This feature requires the cowork of AAL user-space algorithm process.

config MTK_DISP_LOGGER
	bool "Default enable display logger function"
	help
	  Display logger would record display-related event
	  for debug purpose.
	  If this value is Y, display driver would
	  initial display loggger during driver probe
	  stage, but can still manual disable this function
	  through debugfs or procfs.

config MTK_DISP_DEBUG
	bool "Support display debug function, default disable in user load"
	help
	  Used to debug for display module, only needed by developers.
	  The function sould be disabled in user load for security.
```

## drivers/gpu/drm/mediatek/mi_disp/Kconfig
```kconfig
config MI_DISP
	bool "Xiaomi Display Feature support"
	default y
	depends on DRM_MEDIATEK
	help
	  This creates /dev/mi_display/disp_feature.

config MI_DISP_LOG
	bool "Xiaomi Display Feature support"
	default y
	depends on DRM_MEDIATEK
	help
	  This creates /dev/mi_display/disp_feature.

config MI_DISP_DEBUGFS
	bool "Debugfs filesystem support"
	default y
	depends on MI_DISP && DEBUG_FS
	help
	  This enables debugfs for MI_DISP and MI_DISP_LOG at <debugfs>/
	  mi_display, allow to enable/disable mi_disp_print_xxx()/
	  mi_disp_dbg_xx() via debug_log, control log_type (kernel/user)
	  or read log via disp_log.

config MI_DISP_SYSFS
	bool "Sysfs filesystem support"
	default y
	depends on MI_DISP && SYSFS
	help
	  This enables sysfs for MI_DISP at /sys/class/mi_display, the
	  disp-DSI-n subdirectory contains nodes such as disp_param,
	  panel_info, mipi_rw, and wp_info, which can be used to read
	  display informations or control display status.

config MI_DISP_PROCFS
	bool "Procfs filesystem support"
	default y
	depends on MI_DISP && PROC_FS
	help
	  This enables procfs for MI_DISP at /proc/mi_display, allow
	  to execute mipi read/write operatons for both primary and
	  secondary displays.

config MI_DISP_BRIGTHNESS_CLONE_COOLER
	bool "Xiaomi Display Brightness-Clone Cooler support"
	default y
	depends on MI_DISP && THERMAL
	help
	  This register thermal cooling device brightness0-clone.

config MI_DISP_NOTIFIER
	bool "Xiaomi Display Notifier support"
	default y
	depends on MI_DISP
	help
	  This allow other modules (such as TP) to monitor display
	  on/off events.

config MI_DISP_LOG
	bool "Xiaomi Display Log support"
	default y
	depends on MI_DISP
	help
	  This creates /dev/mi_display/disp_log.

config MI_DISP_ESD_CHECK
	bool "Xiaomi Display ESD Check support"
	default n
	depends on MI_DISP
	help
	  Use Xiaomi ESD Check to replace the MTK default scheme.

config MI_DISP_SILKY_BRIGHTNESS_CRC
       bool "Xiaomi Display Panel crc DC support"
       default n
       depends on MI_DISP
       help
         This is used to support the func of panel's crc DC.

config MI_DISP_CABC_REG_OFF
       bool "Xiaomi Display Panel CABC Reg off support"
       default n
       depends on MI_DISP
       help
         This is used to close CABC/ESS reg.

config MI_DISP_INPUT_HANDLER
       bool "Xiaomi Display input event handler"
       default n
       depends on MI_DISP
       help
         This is used to handle input events, such as kick idle for
         cmd mode.

config MI_DISP_BOOST
       bool "Xiaomi Display CPU Boost"
       default n
       depends on MI_DISP
       help
         This is used to boost cpu for some cases, such as kicking idle
         for cmd mode.
config MI_DISP_FOD_SYNC
       bool "Xiaomi Display fod sync"
       default n
       depends on MI_DISP
       help
         This is used to sync fod flag from sf.

config MI_DISP_DSC2712
       bool "Xiaomi Display DSC 2712*1200"
       default n
       depends on MI_DISP
       help
         This is used to DSC 2712*1200.

config MI_DISP_VDO_TO_CMD_AOD
       bool "Xiaomi Display vdo to cmd aod"
       default n
       depends on MI_DISP
       help
         This is used to vdo to cmd mode aod.
```

## drivers/gpu/drm/mediatek/mml/Kconfig
```kconfig
# SPDX-License-Identifier: GPL-2.0-only

config MTK_MML
	tristate "DRM MML Support for Mediatek SoCs"
	help
	  Choose this option if you have a Mediatek SoCs.
	  The module will be called mml in mediatek-drm
	  This driver provides kernel mode setting and
	  buffer management to display driver.

config MTK_MML_DEBUG
	bool "DRM MML Debug Support for Mediatek SoCs"
	help
	  Choose this option if you have a Mediatek SoCs.
	  This driver provides mml driver unit test nodes
	  and mml driver debug feature. Trigger by mml
	  UnitTest binary.

config MTK_MML_LEGACY
	tristate "DRM MML Legacy Support for Mediatek SoCs"
	help
	  Choose this option if you have a Mediatek SoCs.
	  The module will be called mml in mediatek-drm
	  This driver provides kernel mode setting and
	  buffer management to display driver.
```

## drivers/gpu/drm/msm-hyp/Kconfig
```kconfig
#
# Drm MSM hypervisor configuration
#
# This driver provides support for the User Space DRM Masters
#
config DRM_MSM_HYP
	tristate "MSM DRM HYP"
	depends on DRM
	depends on QTI_GVM
	depends on OF
	select SYNC_FILE
	select SW_SYNC
	help
	  DRM/KMS HYP driver for MSM/snapdragon in Guest VM mode. This driver
	  registers with DRM framework to create /dev/dri/card0 path and issue
	  events to User Space listeners.
```

## drivers/gpu/drm/msm-lease/Kconfig
```kconfig
#
# Drm MSM lease configuration
#
# This driver provides support for the User Space DRM Masters
#
config DRM_MSM_LEASE
	tristate "MSM DRM LEASE"
	depends on DRM_MSM
	help
	  DRM/KMS driver for MSM/snapdragon in lease mode. This driver
	  registers with DRM framework and creates virtual DRI cards at
	  /dev/dri/card<n>, n=1,2,..., from DRM object names listed in
	  devicetree. When virtual card is opened, an internal DRM
	  object leasing will take place and return with the lessee FD.
```
