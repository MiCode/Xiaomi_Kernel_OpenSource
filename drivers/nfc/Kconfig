## drivers/nfc/Kconfig
```kconfig
#
# Near Field Communication (NFC) devices
#

menu "Near Field Communication (NFC) devices"
	depends on NFC

config NFC_PN533
	tristate "NXP PN533 USB driver"
	depends on USB
	help
	  NXP PN533 USB driver.
	  This driver provides support for NFC NXP PN533 devices.

	  Say Y here to compile support for PN533 devices into the
	  kernel or say M to compile it as module (pn533).

config NFC_WILINK
	tristate "Texas Instruments NFC WiLink driver"
	depends on TI_ST && NFC_NCI
	help
	  This enables the NFC driver for Texas Instrument's BT/FM/GPS/NFC
	  combo devices. This makes use of shared transport line discipline
	  core driver to communicate with the NFC core of the combo chip.

	  Say Y here to compile support for Texas Instrument's NFC WiLink driver
	  into the kernel or say M to compile it as module.

config NFC_MEI_PHY
	tristate "MEI bus NFC device support"
	depends on INTEL_MEI && NFC_HCI
	help
	  This adds support to use an mei bus nfc device. Select this if you
	  will use an HCI NFC driver for an NFC chip connected behind an
	  Intel's Management Engine chip.

	  If unsure, say N.

source "drivers/nfc/pn544/Kconfig"
source "drivers/nfc/microread/Kconfig"

endmenu

config NFC_QNCI
	bool "Qualcomm NCI based NFC Controller Driver for qca199x"
	depends on I2C
	select CRC_CCITT
	help
	  This enables the NFC driver for QCA199x based devices.
	  This is for i2c connected version. NCI protocol logic
	  resides in the usermode and it has no other NFC dependencies.
```

## drivers/nfc/nxp-i2c/Kconfig
```kconfig
#
# Nxp Nci protocol (I2C) devices
#

config NFC_NXP_I2C
        tristate "NXP NCI based NFC I2C Slave Driver for SNxxx"
        depends on I2C
	help
	  This module adds support for an I2C interface to the NXP NCI
	  chips.
	  Select this if your platform is using the I2C bus.

	  To compile this driver as a module, choose m here. The module will
	  be called nxp_nci_i2c.
	  Say N if unsure.
```

## drivers/nfc/pn548/Kconfig
```kconfig
config NFC_PN548
	tristate "NXP PN548 NFC driver"
	default n
	---help---
	  NXP PN548 core driver.

	  To compile this driver as a module, choose m here. The module will
	  be called pn548.
	  Say N if unsure.
```

## drivers/nfc/pn557/Kconfig
```kconfig
config NXP_NFC_SN1XX
	bool "Nxp NFC sn1xx Controller"
	
config NXP_NFC_PN8XT
	bool "Nxp NFC pn8xt Controller"
```

## drivers/nfc/pn560/Kconfig
```kconfig
#
# near field communication driver configuration
#

config NXP_NFC_I2C
	tristate "NXP NCI based NFC I2C Slave Driver for SNxxx"
	depends on I2C
	help
	  This enables the NFC driver for SNxxx based devices.
	  This is for I2C connected version. NCI protocol logic
	  resides in the usermode and it has no other NFC dependencies.

	  If unsure, say N.

config NXP_COLD_RESET
	tristate "NXP NCI based NFC I2C Slave Driver for SNxxx"
	depends on I2C
	help
	  This enables the NFC driver for SNxxx based devices.
	  This is for I2C connected version. NCI protocol logic
	  resides in the usermode and it has no other NFC dependencies.

	  If unsure, say N.

config NXP_NFC_VBAT_MONITOR
	tristate "NXP NCI based NFC I2C Slave Driver for SNxxx"
	depends on I2C
	help
	  This enables the NFC driver for SNxxx based devices.
	  This is for I2C connected version. NCI protocol logic
	  resides in the usermode and it has no other NFC dependencies.

	  If unsure, say N.
```

## drivers/nfc/samsung/Kconfig
```kconfig
#
# Near Field Communication (NFC) devices
#

menu "Near Field Communication (NFC) devices"
	depends on NFC

config SEC_NFC
	bool "Samsung NFC driver"
	default y
	help
	  SAMSUNG NFC Driver.
	  This driver provides support for SAMSUNG NFC products.
	  You should select your NFC product and interface.

	  Say Y here to compile support for SAMSUNG NFC driver into the
	  kernel.

choice
	prompt "SEC NFC Products"
	depends on SEC_NFC
        default SEC_NFC_PRODUCT_N5
config SEC_NFC_PRODUCT_N3
        bool "RN3"
config SEC_NFC_PRODUCT_N5
        bool "RN5/RNx"
endchoice
choice
	prompt "SEC NFC Interface"
	depends on SEC_NFC
    default SEC_NFC_IF_I2C
config SEC_NFC_IF_UART
	bool "UART"
config SEC_NFC_IF_I2C
	bool "I2C"
config SEC_NFC_IF_I2C_GPIO
        bool "I2C-GPIO (S/W-I2C)"
        select I2C_CHARDEV
        select I2C_MUX
        select I2C_MUX_GPIO
        select I2C_ARB_GPIO_CHALLENGE
        select I2C_ALGOBIT
        select I2C_GPIO
endchoice
config SEC_NFC_GPIO_CLK
        bool "SEC NFC GPIO CLK"
        default n
        help
          SAMSUNG NFC CLR REQ feature.
          This feature provides support for SAMSUNG NFC products.
          You should select this feature if your NFC product uses AP CLK.

          Say Y here to compile support for SAMSUNG NFC CLK REQ feature into the
          kernel.
config SEC_NFC_DEDICATED_CLK
        bool "SEC NFC DEDICATED CLK"
        default n
config SEC_NFC_LDO_EN
        bool "SEC NFC LDO"
        default n
config SEC_NFC_PMIC_LDO
        bool "SEC NFC PMIC LDO"
        default n
endmenu
```

## drivers/nfc/st21nfc/Kconfig
```kconfig
# SPDX-License-Identifier: GPL-2.0-only
config ST21NFC
        tristate "ST Microelectronics ST21NFC/ST54 NFC Controller Driver"
        depends on I2C
        help
        ST Microelectronics ST21NFC Near Field Communication controller support.
```

## drivers/nfc/tmsdrv/Kconfig
```kconfig
#
# TMS devices
#

menu "TMS devices support"

config TMS_NFC_DEVICE
    tristate "TMS NFC Driver"
    depends on I2C
    help
        Say Y here if you have I2C device.

config TMS_GUIDE_DEVICE
    tristate "TMS Guide Driver"
    depends on I2C && TMS_NFC_DEVICE
    help
        Say Y here to compile guidev for guide device register.

config TMS_ESE_DEVICE
    tristate "TMS ESE Driver"
    depends on SPI
    help
        Say Y here if you have SPI device.

endmenu
```

## drivers/ntag/Kconfig
```kconfig
# SPDX-License-Identifier: GPL-2.0-only
#
# NFC Tag devices
#

source "drivers/ntag/fm19511/Kconfig"
```

## drivers/ntag/fm19511/Kconfig
```kconfig
# SPDX-License-Identifier: GPL-2.0-only
config FM_NTAG_I2C
	tristate "I2C Slave Driver for NTAG chip"
	depends on I2C
	help
	  This enables the NTAG driver for FM19511 based devices.

	  If unsure, say N.
```

## drivers/p73-spi/6873/Kconfig
```kconfig
#
# Nxp SPi protocol (SPI) devices
#

config NXP_P73_DEVICES
	bool "Nxp P73 secure element protocol driver (SPI) devices"
	default y
	---help---
	  You'll have to say Y if your computer contains an SPI device that
	  you want to use under Linux.

	  You can say N here if you don't have any SPI connected to your computer.

config BOMB_NFC
        bool "nfc for bomb"
	---help---
```

## drivers/pci/host/Kconfig
```kconfig
#
# PCIE Host Controller Drivers
#
comment "PCIE Host Controller Drivers"

config PCI_TEGRA
        bool "NVIDIA Tegra PCIe controller"
        select PCI
        select TEGRA_USB_SHARED_PAD
        depends on ARCH_TEGRA_HAS_PCIE
        help
          Adds PCIe Host controller driver for tegra based systems
```

## drivers/pci/pcie/Kconfig
```kconfig
#
# PCI Express Port Bus Configuration
#
config PCIEPORTBUS
	bool "PCI Express Port Bus support"
	depends on PCI
	help
	  This automatically enables PCI Express Port Bus support. Users can
	  choose Native Hot-Plug support, Advanced Error Reporting support,
	  Power Management Event support and Virtual Channel support to run
	  on PCI Express Ports (Root or Switch).

#
# Include service Kconfig here
#
config HOTPLUG_PCI_PCIE
	bool "PCI Express Hotplug driver"
	depends on HOTPLUG_PCI && PCIEPORTBUS
	help
	  Say Y here if you have a motherboard that supports PCI Express Native
	  Hotplug

	  When in doubt, say N.

source "drivers/pci/pcie/aer/Kconfig"

#
# PCI Express ASPM
#
config PCIEASPM
	bool "PCI Express ASPM control" if EXPERT
	depends on PCI && PCIEPORTBUS
	default y
	help
	  This enables OS control over PCI Express ASPM (Active State
	  Power Management) and Clock Power Management. ASPM supports
	  state L0/L0s/L1.

	  ASPM is initially set up by the firmware. With this option enabled,
	  Linux can modify this state in order to disable ASPM on known-bad
	  hardware or configurations and enable it when known-safe.

	  ASPM can be disabled or enabled at runtime via
	  /sys/module/pcie_aspm/parameters/policy

	  When in doubt, say Y.
config PCIE_ASPM_LNKSUB
	bool "PCI Express ASPM L1 Sub-States"
	depends on PCIEASPM
	default n
	help
	  This enables the OS control over PCI Express ASPM L1 Sub-states.

	  This feature is initially set up by the firmware. Generally, No
	  need OS support on it. For some special PCIe devices, the power
	  supply may be cut off for power saving which may cause the ASPM
	  L1 Sub-States settings get lost. By enabling this, the OS can
	  save and restore the related settings.

	  when in doubt, say N.
config PCIEASPM_DEBUG
	bool "Debug PCI Express ASPM"
	depends on PCIEASPM
	default n
	help
	  This enables PCI Express ASPM debug support. It will add per-device
	  interface to control ASPM.

choice
	prompt "Default ASPM policy"
	default PCIEASPM_DEFAULT
	depends on PCIEASPM

config PCIEASPM_DEFAULT
        bool "BIOS default"
	depends on PCIEASPM
	help
	  Use the BIOS defaults for PCI Express ASPM.

config PCIEASPM_POWERSAVE
        bool "Powersave"
	depends on PCIEASPM
	help
	  Enable PCI Express ASPM L0s and L1 where possible, even if the
	  BIOS did not.

config PCIEASPM_PERFORMANCE
        bool "Performance"
	depends on PCIEASPM
	help
	  Disable PCI Express ASPM L0s and L1, even if the BIOS enabled them.
endchoice

config PCIE_PME
	def_bool y
	depends on PCIEPORTBUS && PM_RUNTIME
```

## drivers/pci/switch/Kconfig
```kconfig
# SPDX-License-Identifier: GPL-2.0

menu "PCI switch controller drivers"
	depends on PCI

config PCI_SW_SWITCHTEC
	tristate "MicroSemi Switchtec PCIe Switch Management Driver"
	help
	 Enables support for the management interface for the MicroSemi
	 Switchtec series of PCIe switches. Supports userspace access
	 to submit MRPC commands to the switch via /dev/switchtecX
	 devices. See <file:Documentation/driver-api/switchtec.rst> for more
	 information.

config PCI_SW_QCOM_SWITCH
	depends on ARCH_QCOM
	tristate "Qualcomm Technologies, Inc. PCIe Switch Management Driver"
	help
	 Enables support for switches connected to Qualcomm Technologies, Inc.
	 PCIe Rootport. Switches that require erratas can bind with this driver
	 and run errata for the corresponding port. Values can be saved and
	 restored using this driver during suspend and resume.

endmenu
```

## drivers/perf/Kconfig
```kconfig
#
# Performance Monitor Drivers
#

menu "Performance monitor support"

config ARM_PMU
	depends on PERF_EVENTS && (ARM || ARM64)
	bool "ARM PMU framework"
	default y
	help
	  Say y if you want to use CPU performance monitors on ARM-based
	  systems.

config XGENE_PMU
        depends on PERF_EVENTS && ARCH_XGENE
        bool "APM X-Gene SoC PMU"
        default n
        help
          Say y if you want to use APM X-Gene SoC performance monitors.

config ARM_DSU_PMU
	tristate "ARM DynamIQ Shared Unit (DSU) PMU"
	depends on ARM64 && PERF_EVENTS
	help
	  Provides support for performance monitor unit in ARM DynamIQ Shared
	  Unit (DSU). The DSU integrates one or more cores  with an L3 memory
	  system, control logic. The PMU allows counting various events related
	  to DSU.

endmenu
```

## drivers/phy/Kconfig
```kconfig
#
# PHY
#

menu "PHY Subsystem"

config GENERIC_PHY
	tristate "PHY Core"
	help
	  Generic PHY support.

	  This framework is designed to provide a generic interface for PHY
	  devices present in the kernel. This layer will have the generic
	  API by which phy drivers can create PHY using the phy framework and
	  phy users can obtain reference to the PHY. All the users of this
	  framework should select this config.

config PHY_MSM_SATA
	tristate "MSM SoC SATA 6Gbps PHY driver"
	depends on OF && ARCH_MSM
	select GENERIC_PHY
	help
	  Support for 6Gbps SATA PHY on MSM chipsets.
endmenu
```

## drivers/phy/mediatek/Kconfig
```kconfig
#
# Phy drivers for Mediatek devices
#
config PHY_MTK_TPHY
	tristate "MediaTek T-PHY Driver"
	depends on ARCH_MEDIATEK && OF
	select GENERIC_PHY
	help
	  Say 'Y' here to add support for MediaTek T-PHY driver,
	  it supports multiple usb2.0, usb3.0 ports, PCIe and
	  SATA, and meanwhile supports two version T-PHY which have
	  different banks layout, the T-PHY with shared banks between
	  multi-ports is first version, otherwise is second veriosn,
	  so you can easily distinguish them by banks layout.

config PHY_MTK_USB
	bool "Mediatek usb phy"
	depends on MEDIATEK_SOLUTION
	select GENERIC_PHY
	help
	  Say Y here if your system using in-circuit Mediatek USB PHY.
	  If unsure, say N.
	  Enables support for ASIC PHY.
	  This driver provides interface to interact with USB 2.0 and
	  USB 3.0 PHY that is part of the Mediatek SOC.

config PHY_MTK_FPGAPHY
	tristate "MediaTek FPGA-PHY Driver"
	select GENERIC_PHY
	help
	  Enable this to support A60931/A60810 FPGA PHY.
```
