## drivers/pinctrl/sprd/Kconfig
```kconfig
# SPDX-License-Identifier: GPL-2.0-only
#
# Spreadtrum pin control drivers
#

config PINCTRL_SPRD
	tristate
	select PINMUX
	select PINCONF
	select GENERIC_PINCONF
	select GENERIC_PINMUX_FUNCTIONS
	help
	  Say Y here to enable Spreadtrum pinctrl driver
	  PINCTRL_SPRD=y for buildin
	  PINCTRL_SPRD=m for KO
	  PINCTRL_SPRD is not set for no building

config PINCTRL_SPRD_SC9860
	tristate "Spreadtrum SC9860 pinctrl driver"
	depends on OF
	depends on ARCH_SPRD || COMPILE_TEST
	select PINCTRL_SPRD
	help
	  Say Y here to enable Spreadtrum SC9860 pinctrl driver
	  PINCTRL_SPRD_SC9860=y for buildin
	  PINCTRL_SPRD_SC9860=m for KO
	  PINCTRL_SPRD_SC9860 is not set for no building

config PINCTRL_SPRD_SHARKL3
	tristate "Spreadtrum sharkl3 pinctrl driver"
	depends on OF
	depends on ARCH_SPRD || COMPILE_TEST
	select PINCTRL_SPRD
	help
	  Say Y here to enable Spreadtrum sharkl3 pinctrl driver
	  PINCTRL_SPRD_SHARKL3=y for buildin
	  PINCTRL_SPRD_SHARKL3=m for KO
	  PINCTRL_SPRD_SHARKL3 is not set for no building

config PINCTRL_SPRD_SHARKL5
        tristate "Spreadtrum sharkl5 pinctrl driver"
        depends on OF
        depends on ARCH_SPRD || COMPILE_TEST
        select PINCTRL_SPRD
        help
	  Say Y here to enable Spreadtrum sharkl5 pinctrl driver
	  PINCTRL_SPRD_SHARKL5=y for buildin
	  PINCTRL_SPRD_SHARKL5=m for KO
	  PINCTRL_SPRD_SHARKL5 is not set for no building

config PINCTRL_SPRD_SHARKL5PRO
	tristate "Spreadtrum sharkl5pro pinctrl driver"
	depends on OF
	depends on ARCH_SPRD || COMPILE_TEST
	select PINCTRL_SPRD
	help
	  Say Y here to enable Spreadtrum sharkl5pro pinctrl driver
	  PINCTRL_SPRD_SHARKL5PRO=y for buildin
	  PINCTRL_SPRD_SHARKL5PRO=m for KO
	  PINCTRL_SPRD_SHARKL5PRO is not set for no building

config PINCTRL_SPRD_PIKE2
	tristate "Spreadtrum pike2 pinctrl driver"
	depends on OF
	depends on (ARM && ARCH_SPRD) || COMPILE_TEST
	select PINCTRL_SPRD
	help
	  Say Y here to enable Spreadtrum pike2 pinctrl driver
	  PINCTRL_SPRD_PIKE2=y for buildin
	  PINCTRL_SPRD_PIKE2=m for KO
	  PINCTRL_SPRD_PIKE2 is not set for no building

config PINCTRL_SPRD_SHARKLE
	tristate "Spreadtrum sharkle pinctrl driver"
	depends on OF
	depends on (ARM && ARCH_SPRD) || COMPILE_TEST
	select PINCTRL_SPRD
	help
	  Say Y here to enable Spreadtrum sharkle pinctrl driver
	  PINCTRL_SPRD_SHARKLE=y for buildin
	  PINCTRL_SPRD_SHARKLE=m for KO
	  PINCTRL_SPRD_SHARKLE is not set for no building

config PINCTRL_SPRD_QOGIRL6
	tristate "Spreadtrum qogirl6 pinctrl driver"
	depends on OF
	depends on ARCH_SPRD || COMPILE_TEST
	select PINCTRL_SPRD
	help
	  Say Y here to enable Spreadtrum qogirl6 pinctrl driver
	  PINCTRL_SPRD_QOGIRL6=y for buildin
	  PINCTRL_SPRD_QOGIRL6=m for KO
	  PINCTRL_SPRD_QOGIRL6 is not set for no building

config PINCTRL_SPRD_QOGIRL6PRO
	tristate "Spreadtrum qogirl6pro pinctrl driver"
	depends on OF
	depends on ARCH_SPRD || COMPILE_TEST
	select PINCTRL_SPRD
	help
	  Say Y here to enable Spreadtrum qogirl6pro pinctrl driver
	  PINCTRL_SPRD_QOGIRL6PRO=y for buildin
	  PINCTRL_SPRD_QOGIRL6PRO=m for KO
	  PINCTRL_SPRD_QOGIRL6PRO is not set for no building

config PINCTRL_SPRD_QOGIRN6LITE
	tristate "Spreadtrum qogirn6lite pinctrl driver"
	depends on OF
	depends on ARCH_SPRD || COMPILE_TEST
	select PINCTRL_SPRD
	help
	  Say Y here to enable Spreadtrum qogirn6lite pinctrl driver
	  PINCTRL_SPRD_QOGIRN6LITE=y for buildin
	  PINCTRL_SPRD_QOGIRN6LITE=m for KO
	  PINCTRL_SPRD_QOGIRN6LITE is not set for no building
```

## drivers/platform/Kconfig
```kconfig
if X86
source "drivers/platform/x86/Kconfig"
endif
source "drivers/platform/goldfish/Kconfig"

source "drivers/platform/chrome/Kconfig"
```

## drivers/platform/msm/Kconfig
```kconfig
# SPDX-License-Identifier: GPL-2.0-only

menu "Qualcomm technologies inc. MSM specific device drivers"
	depends on ARCH_QCOM

config MSM_EXT_DISPLAY
	bool "MSM External Display Driver"
	depends on DRM && QGKI
	help
	  Enabling this option adds MSM External Display Driver.
	  External Display driver was added to support the communication
	  between external display driver and its counterparts.
	  This should be enabled to support audio & video over HDMI or
	  DP for hot pluggable sink devices.

config SPS
	tristate "SPS support"
	select GENERIC_ALLOCATOR
	help
	  The SPS (Smart Peripheral Switch) is a DMA engine.
	  It can move data in the following modes:
		1. Peripheral-to-Peripheral.
		2. Peripheral-to-Memory.
		3. Memory-to-Memory.

config SPS_SUPPORT_BAMDMA
	bool "SPS supports BAM DMA"
	depends on SPS
	help
	  The BAM-DMA is used for Memory-to-Memory transfers.
	  The main use cases is RPC between processors.
	  The BAM-DMA hardware has 2 registers sets:
		1. A BAM HW like all the peripherals.
		2. A DMA channel configuration (i.e. channel priority).

config SPS_SUPPORT_NDP_BAM
	bool "SPS supports NDP BAM"
	depends on SPS
	help
	  No-Data-Path BAM is used to improve BAM performance.
	  NDP BAMs enables peripherals with fast fabric connectivity
	  to do the actual data transfer themselves, instead of the
	  BAM.

config EP_PCIE
	bool "PCIe Endpoint mode support"
	select GENERIC_ALLOCATOR
	help
	  PCIe controller is in endpoint mode.
	  It supports the APIs to clients as a service layer, and allows
	  clients to enable/disable PCIe link, configure the address
	  mapping for the access to host memory, trigger wake interrupt
	  on host side to wake up host, and trigger MSI to host side.

config EP_PCIE_HW
	bool "PCIe Endpoint HW driver"
	depends on EP_PCIE
	help
	  PCIe endpoint HW specific implementation.
	  It supports:
		1. link training with Root Complex.
		2. Address mapping.
		3. Sideband signaling.
		4. Power management.

config MSM_MHI_DEV
        tristate "Modem Device Interface Driver"
	depends on EP_PCIE && IPA3
        help
          This kernel module is used to interact with PCIe Root complex
          supporting MHI protocol. MHI is a data transmission protocol
          involving communication between a host and a device over shared
          memory. MHI interacts with the IPA for supporting transfers
	  on the HW accelerated channels between Host and device.

config IPA3
	tristate "IPA3 support"
	depends on NET
	help
	  This framework supports the Internet Packet Accelerator (IPA3) core.
	  IPA is a programmable protocol processor HW block.
	  It is designed to support generic HW processing of UL/DL IP packets
	  for various use cases independent of radio technology.
	  The driver support client connection and configuration
	  for the IPA core.
	  Kernel and user-space processes can call the IPA driver
	  to configure IPA core.

config IPA_WDI_UNIFIED_API
	bool "IPA WDI unified API support"
	depends on IPA3
	help
	  This driver supports IPA WDI unified API.
	  WDI is the interface between IPA micro controller and WLAN chipset.
	  It is designed to support IPA HW accelerating path for WLAN use case.
	  The IPA WDI unified API supports all WDI versions through a unified
	  interface.

config VETH_IPA
        tristate "VETH_IPA Network Interface Driver Support"
        depends on MSM_HAB
        help
          Enables EMAC Ethernet Front end driver.
          Register net device and configure VETH0 iface. This driver will
          configure EMAC IPA offload channels with help of a backend driver
          running on GVM Host.

config USB_BAM
	tristate "USB BAM Driver"
	depends on SPS && USB_GADGET
	help
	  Enabling this option adds USB BAM Driver.
	  USB BAM driver was added to supports Smart Peripheral Subsystem
	  Peripheral-to-Peripheral transfers between the USB and other
	  peripheral.

config MSM_GENI_SE
	tristate "QCOM GENI Serial Engine Driver"
	help
	  This module is used to interact with GENI based Serial Engines on
	  Qualcomm Technologies, Inc. Universal Peripheral(QUPv3). This
	  module is used to configure and read the configuration from the
	  Serial Engines.

config QPNP_REVID
	tristate "QPNP Revision ID Peripheral"
	depends on SPMI
	help
	  Say 'y' here to include support for the Qualcomm Technologies, Inc.
	  QPNP REVID peripheral. REVID prints out the PMIC type and revision
	  numbers in the kernel log along with the PMIC option status. The PMIC
	  type is mapped to a QTI chip part number and logged as well.

config MSM_11AD
	tristate "Platform driver for 11ad chip"
	depends on PCI
	depends on PCI_MSM
	help
	  This module adds required platform support for wireless adapter based on
	  Qualcomm Technologies, Inc. 11ad chip, integrated into MSM platform

	  If you choose to build it as a module, it will be called
	  msm_11ad_proxy.

# Ethernet configuration options

config IOSS
	tristate "IPA Offload Sub-system v2"
	depends on IPA3
	help
	  IPA Offload Sub-system is a generic kernel framework that enables a
	  third-party ethernet driver to attach an ethernet peripheral to IPA
	  for hardware offloading of tethered data paths. The framework
	  provides a generic API interface that ethernet drivers can use to
	  register their hardware functionality with the sub-system in order
	  to enable IPA offload.

	  To compile this driver as a module, choose M here. Module will be
	  called ioss.

config R8125
	tristate "Realtek R8125 driver"
	depends on PCI
	help
	  This is a 2.5Gbps ethernet driver for the PCI network cards based on
	  the Realtek 8125B chip. If you have one of those, say Y here.

	  To compile this driver as a module, choose M here: the module
	  will be called r8125.

config R8125_IOSS
	tristate "Realtek R8125 IOSS glue driver"
	depends on R8125
	depends on IOSS
	help
	  Enables IPA Ethernet Offload path on Realtek R8125 NIC. It is
	  designed to support generic HW processing of UL/DL IP packets for
	  various use cases to reduce the CPU load during E2E IP traffic.

	  To compile this driver as a module, choose M here. Module will be
	  called r8125_ioss. If unsure, say N.

config AQFWD_IOSS
	tristate "AQC glue driver for IOSS v2"
	depends on AQFWD
	depends on IOSS
	select ATLFWD_FWD
	help
	  Enables IPA Ethernet Offload path on atlantic-fwd driver. It is
	  designed to support generic HW processing of UL/DL IP packets for
	  various use cases to reduce the cpu load during E2E IP traffic.
	  When this is disabled, atlantic-fwd driver switches to embedded software path.

	  To compile this driver as a module, choose M here. Module will be called
	  aqc_ioss.
	  If unsure, say N.

endmenu
```

## drivers/platform/msm/ipa/ipa_v3/ethernet/aquantia/Kconfig
```kconfig
config AQC_IPA
	tristate "Aquantia IPA Ethernet Offload Driver"
	depends on IPA_ETH
	help
	  This driver supports offloading to IPA, data that is
	  tethered over Aquantia ethernet interfaces. The driver
	  require a compatible Aquantia network driver to be
	  registered with IPA Offload Sub-System.
	  If unsure, say N.

choice
	prompt "Default Rx Interrupt Proxy Method"
	depends on AQC_IPA
	default AQC_IPA_PROXY_HOST

config AQC_IPA_PROXY_UC
	bool "via IPA uC"
	help
	  IPA uC acts as a proxy for AQC Rx interrupt, receiving the
	  MSI and forwarding the indication to an IPA GSI doorbell
	  either with a monotonically increasing counter or the Rx
	  ring descriptor address at AQC tail pointer. IPA uC need to
	  have support for AQC protocol in its firmware.

config AQC_IPA_PROXY_HOST
	bool "via Host/Linux"
	help
	  Host/Linux acts as proxy for AQC Rx interrupt, receiving the
	  MSI and forwarding the indication to an IPA GSI doorbell  with
	  the Rx ring descriptor address at AQC tail pointer. A host SPI
	  need to be available and configured to receive the MSI.

endchoice

config AQC_IPA_DEBUG
	bool "Aquantia IPA Ethernet Offload Driver Debugging Support"
	depends on AQC_IPA
	help
	  Enable various debug features provided by Aquantia IPA
	  offload driver. Using this feature may add a lot of
	  additional log messages and panic on bugs. Enable this
	  option with caution.
	  If unsure, say N.
```

## drivers/platform/msm/qcn/Kconfig
```kconfig
config SDIO_QCN
	tristate "Qualcomm Technologies, Inc SDIO Function 1 Driver"
	depends on MMC
	default n
	help
	  This module adds the support for SDIO based Wi-Fi devices with QCN7605
	  chipsets. This module interfaces the diag, IPC router, Qsahara and
	  WLAN driver with the external sdio based soc.
```

## drivers/platform/msm/spmi/Kconfig
```kconfig
#
# SPMI driver configuration
#
menuconfig MSM_SPMI
	bool "SPMI support"
	help
	  SPMI (System Power Management Interface) is a two-wire
	  serial interface between baseband and application processors
	  and Power Management Integrated Circuits (PMIC).

if MSM_SPMI
config MSM_SPMI_PMIC_ARB
	tristate "Qualcomm MSM SPMI Controller (PMIC Arbiter)"
	help
	  If you say yes to this option, support will be included for the
	  built-in SPMI PMIC Arbiter interface on Qualcomm MSM family
	  processors.

	  This is required for communicating with Qualcomm PMICs and
	  other devices that have the SPMI interface.

config MSM_QPNP_INT
	depends on SPARSE_IRQ
	depends on MSM_SPMI
	depends on OF_SPMI
	bool "MSM QPNP INT"
	help
	  Say 'y' here to include support for the Qualcomm QPNP interrupt
	  support. QPNP is a SPMI based PMIC implementation.
endif
```
