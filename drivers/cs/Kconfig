## drivers/cs/Kconfig
```kconfig
config MSM_QDSS
	bool "CoreSight tracing"
	help
	  Enables support for CoreSight tracing. This uses CoreSight trace
	  components and buses to support both hardware (eg. processor ETM)
	  and hardware assisted software instrumentation based (eg. STM)
	  tracing.

	  For production builds, you should probably say 'N' here to avoid
	  potential power, performance and memory penalty.

config MSM_QDSS_STM_DEFAULT_ENABLE
	bool "Turn on CoreSight STM tracing by default"
	depends on MSM_QDSS
	help
	  Turns on CoreSight STM tracing (hardware assisted software
	  instrumentation based tracing) by default. Otherwise, tracing is
	  disabled by default but can be enabled via sysfs.

	  For production builds, you should probably say 'N' here to avoid
	  potential power, performance and memory penalty.

config MSM_QDSS_ETM_DEFAULT_ENABLE
	bool "Turn on CoreSight ETM tracing by default"
	depends on MSM_QDSS
	help
	  Turns on CoreSight ETM tracing (processor tracing) by default.
	  Otherwise, tracing is disabled by default but can be enabled via
	  sysfs.

	  For production builds, you should probably say 'N' here to avoid
	  potential power, performance and memory penalty.
```

## drivers/devfreq/Kconfig
```kconfig
# SPDX-License-Identifier: GPL-2.0-only
menuconfig PM_DEVFREQ
	bool "Generic Dynamic Voltage and Frequency Scaling (DVFS) support"
	select SRCU
	select PM_OPP
	help
	  A device may have a list of frequencies and voltages available.
	  devfreq, a generic DVFS framework can be registered for a device
	  in order to let the governor provided to devfreq choose an
	  operating frequency based on the device driver's policy.

	  Each device may have its own governor and policy. Devfreq can
	  reevaluate the device state periodically and/or based on the
	  notification to "nb", a notifier block, of devfreq.

	  Like some CPUs with CPUfreq, a device may have multiple clocks.
	  However, because the clock frequencies of a single device are
	  determined by the single device's state, an instance of devfreq
	  is attached to a single device and returns a "representative"
	  clock frequency of the device, which is also attached
	  to a device by 1-to-1. The device registering devfreq takes the
	  responsibility to "interpret" the representative frequency and
	  to set its every clock accordingly with the "target" callback
	  given to devfreq.

	  When OPP is used with the devfreq device, it is recommended to
	  register devfreq's nb to the OPP's notifier head.  If OPP is
	  used with the devfreq device, you may use OPP helper
	  functions defined in devfreq.h.

if PM_DEVFREQ

comment "DEVFREQ Governors"

config DEVFREQ_GOV_SIMPLE_ONDEMAND
	tristate "Simple Ondemand"
	help
	  Chooses frequency based on the recent load on the device. Works
	  similar as ONDEMAND governor of CPUFREQ does. A device with
	  Simple-Ondemand should be able to provide busy/total counter
	  values that imply the usage rate. A device may provide tuned
	  values to the governor with data field at devfreq_add_device().

config SPRD_HW_DEVICE_DVFS_CP
	tristate "Unisoc CP dvfs driver"
	depends on SPRD_SIPC || UNISOC_SIPC
	help
	  This driver supports dvfs interfaces for MODEM subsystem.
	  It set MODEM DVFS controller register to adjust frequency and voltage.

config DEVFREQ_GOV_PERFORMANCE
	tristate "Performance"
	help
	  Sets the frequency at the maximum available frequency.
	  This governor always returns UINT_MAX as frequency so that
	  the DEVFREQ framework returns the highest frequency available
	  at any time.

config DEVFREQ_GOV_POWERSAVE
	tristate "Powersave"
	help
	  Sets the frequency at the minimum available frequency.
	  This governor always returns 0 as frequency so that
	  the DEVFREQ framework returns the lowest frequency available
	  at any time.

config DEVFREQ_GOV_USERSPACE
	tristate "Userspace"
	help
	  Sets the frequency at the user specified one.
	  This governor returns the user configured frequency if there
	  has been an input to /sys/devices/.../userspace/set_freq.
	  Otherwise, the governor does not change the frequency
	  given at the initialization.

config DEVFREQ_GOV_PASSIVE
	tristate "Passive"
	help
	  Sets the frequency based on the frequency of its parent devfreq
	  device. This governor does not change the frequency by itself
	  through sysfs entries. The passive governor recommends that
	  devfreq device uses the OPP table to get the frequency/voltage.

config DEVFREQ_GOV_SPRD_VOTE
	tristate "Sprd vote set from userspace"
	depends on DEVFREQ_SPRD_DDR_DVFS
	help
	  Sprd govanor can selected by Sprd_ddr_dvfs driver.
	  Userspace write sysfs nodes of this  governor to set freq&vol
	  Then the govnor send request to driver.

comment "DEVFREQ Drivers"

config DEVFREQ_SPRD_DDR_DVFS
	tristate "Sprd ddr dvfs"
	help
	  Sets frequency as user specidied or scenarios.
	  This driver used on sprd ddrcv1 and after versions, can select
	  governors.
	  This driver send SIPC request to DFS core to change freq.

choice
	prompt "SPRD DVFS vote of each asic design"
	depends on DEVFREQ_SPRD_DDR_DVFS && UNISOC_SIPC
	help
	  Vote registers on pub has several different design

config DEVFREQ_SPRD_DDR_DVFS_SP
	tristate "Sprd ddr dvfs control SP driver"
	help
          dvfs registers control by sp.

endchoice

config SPRD_DDR_DVFS_GLP
	bool "GLP global config for ddr dvfs"
	depends on DEVFREQ_SPRD_DDR_DVFS
	default n
	help
          GLP global config for ddr dvfs.
          This configuration is only used for
          SPRD GLP branch.
          It should be turned off when using other branches.

config ARM_EXYNOS_BUS_DEVFREQ
	tristate "ARM Exynos Generic Memory Bus DEVFREQ Driver"
	depends on ARCH_EXYNOS || COMPILE_TEST
	select DEVFREQ_GOV_SIMPLE_ONDEMAND
	select DEVFREQ_GOV_PASSIVE
	select DEVFREQ_EVENT_EXYNOS_PPMU
	select PM_DEVFREQ_EVENT
	help
	  This adds the common DEVFREQ driver for Exynos Memory bus. Exynos
	  Memory bus has one more group of memory bus (e.g, MIF and INT block).
	  Each memory bus group could contain many memoby bus block. It reads
	  PPMU counters of memory controllers by using DEVFREQ-event device
	  and adjusts the operating frequencies and voltages with OPP support.
	  This does not yet operate with optimal voltages.

config ARM_IMX_BUS_DEVFREQ
	tristate "i.MX Generic Bus DEVFREQ Driver"
	depends on ARCH_MXC || COMPILE_TEST
	select DEVFREQ_GOV_USERSPACE
	help
	  This adds the generic DEVFREQ driver for i.MX interconnects. It
	  allows adjusting NIC/NOC frequency.

config ARM_IMX8M_DDRC_DEVFREQ
	tristate "i.MX8M DDRC DEVFREQ Driver"
	depends on (ARCH_MXC && HAVE_ARM_SMCCC) || \
		(COMPILE_TEST && HAVE_ARM_SMCCC)
	select DEVFREQ_GOV_USERSPACE
	help
	  This adds the DEVFREQ driver for the i.MX8M DDR Controller. It allows
	  adjusting DRAM frequency.

config ARM_TEGRA_DEVFREQ
	tristate "NVIDIA Tegra30/114/124/210 DEVFREQ Driver"
	depends on ARCH_TEGRA_3x_SOC || ARCH_TEGRA_114_SOC || \
		ARCH_TEGRA_132_SOC || ARCH_TEGRA_124_SOC || \
		ARCH_TEGRA_210_SOC || \
		COMPILE_TEST
	depends on COMMON_CLK
	help
	  This adds the DEVFREQ driver for the Tegra family of SoCs.
	  It reads ACTMON counters of memory controllers and adjusts the
	  operating frequencies and voltages with OPP support.

config ARM_RK3399_DMC_DEVFREQ
	tristate "ARM RK3399 DMC DEVFREQ Driver"
	depends on (ARCH_ROCKCHIP && HAVE_ARM_SMCCC) || \
		(COMPILE_TEST && HAVE_ARM_SMCCC)
	select DEVFREQ_EVENT_ROCKCHIP_DFI
	select DEVFREQ_GOV_SIMPLE_ONDEMAND
	select PM_DEVFREQ_EVENT
	help
	  This adds the DEVFREQ driver for the RK3399 DMC(Dynamic Memory Controller).
	  It sets the frequency for the memory controller and reads the usage counts
	  from hardware.

config DVFS_APSYS_SPRD
	tristate "Sprd DVFS APSYS DEVFREQ Driver"
	depends on SPRD_SOCID
	default n
	help
	  This function is to support the apsys dvfs function.

config DRM_SPRD_GSP_DVFS
	bool "SPRD DRM GSP dvfs driver"
	depends on DVFS_APSYS_SPRD
	help
	  This function is to support the dvfs function.

config DVFS_APSYS_VDSP
	bool "SPRD APSYS VDSP dvfs driver"
	depends on DVFS_APSYS_SPRD
	help
	  This function is to support the vdsp dvfs function.
	  Vdsp dvfs is for change vdsp frequency&voltage.
	  In sharkL5Pro vdsp power is from ap system.
	  Others qogirN6pro vdsp power is from mm system.
	  So this config is use on different hardware.

source "drivers/devfreq/event/Kconfig"

endif # PM_DEVFREQ
```

## drivers/dma-buf/Kconfig
```kconfig
# SPDX-License-Identifier: GPL-2.0-only
menu "DMABUF options"

config SYNC_FILE
	bool "Explicit Synchronization Framework"
	default n
	select DMA_SHARED_BUFFER
	---help---
	  The Sync File Framework adds explicit syncronization via
	  userspace. It enables send/receive 'struct dma_fence' objects to/from
	  userspace via Sync File fds for synchronization between drivers via
	  userspace components. It has been ported from Android.

	  The first and main user for this is graphics in which a fence is
	  associated with a buffer. When a job is submitted to the GPU a fence
	  is attached to the buffer and is transferred via userspace, using Sync
	  Files fds, to the DRM driver for example. More details at
	  Documentation/driver-api/sync_file.rst.

config SW_SYNC
	bool "Sync File Validation Framework"
	default n
	depends on SYNC_FILE
	depends on DEBUG_FS
	---help---
	  A sync object driver that uses a 32bit counter to coordinate
	  synchronization.  Useful when there is no hardware primitive backing
	  the synchronization.

	  WARNING: improper use of this can result in deadlocking kernel
	  drivers from userspace. Intended for test and debug only.

config DEBUG_DMA_BUF_REF
	bool "DEBUG Reference Count"
	depends on STACKDEPOT
	depends on DMA_SHARED_BUFFER
	default n
	help
	  Save stack traces for every call to dma_buf_get and dma_buf_put, to
	  help debug memory leaks. Potential leaks may be found by manually
	  matching the get/put call stacks.  This feature consumes extra memory
	  in order to save the stack traces using STACKDEPOT.

config DMABUF_DESTRUCTOR_SUPPORT
	bool "dmabuf destructor support"
	default n
	depends on DMA_SHARED_BUFFER
	depends on QGKI
	help
	  dma-buf destructor support is useful as it allows clients an
	  opportunity to undo any attributes, such as security attributes,
	  they have applied to the dma-buf's memory.

	  The destructor is called when the dma-buf is freed, if the destructor
	  returns an error the dma-buf's exporter release function is not
	  called in order to ensure that memory which has not been properly
	  cleaned up isn't returned to the system

config UDMABUF
	bool "userspace dmabuf misc driver"
	default n
	depends on DMA_SHARED_BUFFER
	depends on MEMFD_CREATE || COMPILE_TEST
	help
	  A driver to let userspace turn memfd regions into dma-bufs.
	  Qemu can use this to create host dmabufs for guest framebuffers.

config DMABUF_SELFTESTS
	tristate "Selftests for the dma-buf interfaces"
	default n
	depends on DMA_SHARED_BUFFER

endmenu
```

## drivers/dma-buf/heaps/Kconfig
```kconfig
config DMABUF_HEAPS_SYSTEM
	tristate "DMA-BUF System Heap"
	depends on DMABUF_HEAPS
	help
	  Choose this option to enable the system dmabuf heap. The system heap
	  is backed by pages from the buddy allocator. If in doubt, say Y.

config DMABUF_HEAPS_DEBUG
	tristate "DMA-BUF debug Heap"
	depends on DMABUF_HEAPS_SYSTEM
	help
	  Choose this option to enable the mtk debug heap.
	  This debug tool can be use to dump dmabuf usage for users
	  If you want use it, say Y if you are not using GKI
	  say m and add ko into your system for GKI.

config DMABUF_HEAPS_CMA
	tristate "DMA-BUF CMA Heap"
	depends on DMABUF_HEAPS && DMA_CMA
	help
	  Choose this option to enable dma-buf CMA heap. This heap is backed
	  by the Contiguous Memory Allocator (CMA). If your system has these
	  regions, you should say Y here.
```

## drivers/dma/mediatek/Kconfig
```kconfig
# SPDX-License-Identifier: GPL-2.0-only

config MEDIATEK_CQDMA
	tristate "MediaTek Command-Queue DMA controller support"
	select DMA_ENGINE
	select DMA_VIRTUAL_CHANNELS
	select ASYNC_TX_ENABLE_CHANNEL_SWITCH
	help
	  Enable support for Command-Queue DMA controller on MediaTek
	  SoCs.

	  This controller provides the channels which is dedicated to
	  memory-to-memory transfer to offload from CPU.
```

## drivers/dma/qcom/Kconfig
```kconfig
config QCOM_BAM_DMA
	tristate "QCOM BAM DMA support"
	depends on ARCH_QCOM || (COMPILE_TEST && OF && ARM)
	select DMA_ENGINE
	select DMA_VIRTUAL_CHANNELS
	---help---
	  Enable support for the QCOM BAM DMA controller.  This controller
	  provides DMA capabilities for a variety of on-chip devices.

config QCOM_HIDMA_MGMT
	tristate "Qualcomm Technologies HIDMA Management support"
	select DMA_ENGINE
	help
	  Enable support for the Qualcomm Technologies HIDMA Management.
	  Each DMA device requires one management interface driver
	  for basic initialization before QCOM_HIDMA channel driver can
	  start managing the channels. In a virtualized environment,
	  the guest OS would run QCOM_HIDMA channel driver and the
	  host would run the QCOM_HIDMA_MGMT management driver.

config QCOM_HIDMA
	tristate "Qualcomm Technologies HIDMA Channel support"
	select DMA_ENGINE
	help
	  Enable support for the Qualcomm Technologies HIDMA controller.
	  The HIDMA controller supports optimized buffer copies
	  (user to kernel, kernel to kernel, etc.).  It only supports
	  memcpy interface. The core is not intended for general
	  purpose slave DMA.

config QCOM_GPI_DMA
	tristate "Qualcomm Technologies Inc GPI DMA support"
	depends on ARCH_QCOM
	select DMA_ENGINE
	select DMA_VIRTUAL_CHANNELS
	help
	  Enable support for the QCOM GPI DMA controller. This controller
	  provides DMA capabilities for a variety of peripheral buses such
	  as I2C, UART, and SPI. By using GPI dmaengine driver, bus drivers
	  can use a standardize interface that is protocol independent to
	  transfer data between DDR and peripheral.

config QCOM_GPI_DMA_DEBUG
	bool "Qualcomm Technologies Inc GPI debug support"
	depends on QCOM_GPI_DMA
	help
	  Enable detailed logging for QCOM GPI driver. Extra logging will be
	  helpful when debugging critical issues.
```

## drivers/edp/Kconfig
```kconfig
menu "EDP Framework"

config EDP_FRAMEWORK
	bool "EDP framework"
	default n
	help
	  EDP-framework implements peak current management
endmenu

menu "SYSEDP Framework"

config SYSEDP_FRAMEWORK
	bool "System EDP framework"
	default n
	help
	  SYSEDP-framework implements system peak current management
	depends on !EDP_FRAMEWORK
endmenu
```
