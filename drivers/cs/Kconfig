## drivers/esoc/Kconfig
```kconfig
#
# External soc control infrastructure and drivers
#
menuconfig ESOC
	bool "External SOCs Control"
	help
	  External SOCs can be powered on and monitored by user
	  space or kernel drivers. Additionally they can be controlled
	  to respond to control commands. This framework provides an
	  interface to track events related to the external slave socs.

if ESOC

config ESOC_DEV
	bool "ESOC userspace interface"
	help
	  Say yes here to enable a userspace representation of the control
	  link. Userspace can register a request engine or a command engine
	  for the external soc. It can receive event notifications from the
	  control link.

config ESOC_CLIENT
	bool "ESOC client interface"
	depends on OF
	help
	  Say yes here to enable client interface for external socs.
	  Clients can specify the external soc that they are interested in
	  by using device tree phandles. Based on this, clients can register
	  for notifications from a specific soc.

config ESOC_DEBUG
	bool "ESOC debug support"
	help
	  Say yes here to enable debugging support in the ESOC framework
	  and individual esoc drivers. The config basically adds extra
	  logging information such that, in the event of a bug, this
	  logging information could be helpful to trace it.

config ESOC_MDM_4x
	bool "Add support for external modems"
	help
	  In some qualcomm boards, an external modem such as mdm9x55 or sdx50m
	  is connected to a primary msm. The primary soc can control/monitor
	  the modem via gpios. The data communication with such modems can
	  occur over PCIE or HSIC.

config ESOC_MDM_DRV
	tristate "Command engine for 4x series external modems"
	help
	  Provides a command engine to control the behavior of an external
	  modems (such as mdm9x55 or sdx50m). That is, it extends the SSR
	  framework to power-off, power-on or handle crash scenarios. It
	  also listens for events on the external modem.

config ESOC_MDM_DBG_ENG
	tristate "debug engine for 4x series external modems"
	depends on ESOC_MDM_DRV
	help
	  Mainly used as a debug interface to probe the modem against various
	  scenarios. It basically provides a user interface to mask out certain
	  commands sent by command engine to the external modem. It also allows
	  masking of certain notifications being sent to the external modem.

config MDM_DBG_REQ_ENG
	tristate "manual request engine for 4x series external modems"
	depends on ESOC_MDM_DBG_ENG
	help
	  Provides a user interface to handle incoming requests from
	  the external modem. Allows for debugging of IPC mechanism
	  between the external modem and the primary soc.

endif
```

## drivers/extcon/Kconfig
```kconfig
menuconfig EXTCON
	tristate "External Connector Class (extcon) support"
	help
	  Say Y here to enable external connector class (extcon) support.
	  This allows monitoring external connectors by userspace
	  via sysfs and uevent and supports external connectors with
	  multiple states; i.e., an extcon that may have multiple
	  cables attached. For example, an external connector of a device
	  may be used to connect an HDMI cable and a AC adaptor, and to
	  host USB ports. Many of 30-pin connectors including PDMI are
	  also good examples.

if EXTCON

comment "Extcon Device Drivers"

config EXTCON_MAX77665
	tristate "MAX77665 EXTCON Support"
	depends on MFD_MAX77665 && EXTCON
	help
	 If you say yes here you get support for the MUIC device of
	 Maxim MAX77665 PMIC.

config EXTCON_PALMAS
	tristate "PALMAS EXTCON Support"
	depends on MFD_PALMAS
	help
	 If you say yes here you get support for the VBUS detection and notification
	 through extcon framework from Palmas PMIC.

endif # MULTISTATE_SWITCH
```

## drivers/extcon/mediatek/Kconfig
```kconfig
config USB_MTK_EXTCON
	bool "MediaTek USB EXTCON Support"
	default n
	---help---
	  Enable Mediatek USB extcon class support.
	  It integrates the USB Dual role information.
	  and can notify information to register user.
	  If unsure, say N.

config USB_MTK_IDDIG
	bool "MediaTek OTG IDDIG Support"
	default n
	---help---
	  Enable Mediatek USB Host OTG detection mechanism
	  IDDIG - OTG micro-B cable attachment detection.
	  Say Y here if your system support OTG IDDIG detection.
	  If unsure, say N.
```

## drivers/external_drivers/Kconfig
```kconfig
menuconfig EXTERNAL_DRIVERS
	bool "Enable support to external drivers"
	depends on X86
	default y
	help
	  External drivers are drivers located outside this kernel tree
	  but allowed to be configured as builtin.
	  External drivers directories will behave as a regular directory
	  inside kernel tree.

if EXTERNAL_DRIVERS

menuconfig EXTERNAL_CAMERA
        bool "Enable support to Intel camera drivers"
        depends on EXTERNAL_DRIVERS
        default y
        help
          Enable support to external Intel camera drivers.

if EXTERNAL_CAMERA
source "drivers/external_drivers/camera/Kconfig"
endif

endif
```

## drivers/external_drivers/camera/drivers/media/Kconfig
```kconfig
#
# Kconfig for Camera drivers
#
source drivers/external_drivers/camera/drivers/media/pci/Kconfig
source drivers/external_drivers/camera/drivers/media/i2c/Kconfig
```

## drivers/external_drivers/camera/drivers/media/i2c/Kconfig
```kconfig
#
# Kconfig for sensor drivers
#

source "drivers/external_drivers/camera/drivers/media/i2c/mt9e013/Kconfig"
source "drivers/external_drivers/camera/drivers/media/i2c/ov5693/Kconfig"
source "drivers/external_drivers/camera/drivers/media/i2c/imx/Kconfig"
source "drivers/external_drivers/camera/drivers/media/i2c/imx135VB/Kconfig"
source "drivers/external_drivers/camera/drivers/media/i2c/micam/Kconfig"

config VIDEO_OV9724
       tristate "OVT ov9724 sensor support"
       depends on I2C && VIDEO_V4L2
       ---help---
         This is a Video4Linux2 sensor-level driver for the OVT
         OV9724 raw camera.

         OVT is a 720P raw sensor.

         It currently only works with the atomisp driver.

config VIDEO_OV2685
        tristate "OVT ov2685 sensor support"
        depends on I2C && VIDEO_V4L2
        ---help---
          This is a Video4Linux2 sensor-level driver for the OVT
          OV2685 soc camera.

          OVT is a 2M soc sensor.

          It currently only works with the atomisp driver.
config VIDEO_OV2722
       tristate "OVT ov2722 sensor support"
       depends on I2C && VIDEO_V4L2
       ---help---
         This is a Video4Linux2 sensor-level driver for the OVT
         OV2722 raw camera.

         OVT is a 2M raw sensor.

         It currently only works with the atomisp driver.

config VIDEO_M10MO
	tristate "Fujitsu M10MO driver"
	depends on I2C && VIDEO_V4L2
	---help---
	  This is a Video4Linux2 isp driver for the Fujitsu.

	  It currently depends on internal V4L2 extensions defined in
	  atomisp driver.

          It currently only works with the atomisp driver.

config VIDEO_M10MO_FAKE_SFI_TABLE
	bool "Add fake SFI entry for Fujitsu M10MO on VV board + AOB"
	depends on VIDEO_M10MO
	---help---
	  Enable this when working with VV board with Fujitsu AOB.

	  This is FAKE SFI table.

	  Please note:

	  Not needed if device IFWI already has M10MO in the SFI table.

config VIDEO_GC2235
       tristate "Galaxy gc2235 sensor support"
       depends on I2C && VIDEO_V4L2
       ---help---
         This is a Video4Linux2 sensor-level driver for the OVT
         GC2235 raw camera.

         GC2235 is a 2M raw sensor.

         It currently only works with the atomisp driver.

config VIDEO_OV8830
       tristate "Omnivision ov8830 sensor support"
       depends on I2C && VIDEO_V4L2 && VIDEO_ATOMISP
       ---help---
         This is a Video4Linux2 sensor-level driver for the Omnivision
         ov8830 RAW sensor.

	 OV8830 is a 8M raw sensor.

         It currently only works with the atomisp driver.

config VIDEO_OV8858
       tristate "Omnivision ov8858 sensor support"
       depends on I2C && VIDEO_V4L2 && VIDEO_ATOMISP
       ---help---
         This is a Video4Linux2 sensor-level driver for the Omnivision
         ov8858 RAW sensor.

	 OV8858 is a 8M raw sensor.

         It currently only works with the atomisp driver.

config VIDEO_CSI_XACTOR
        tristate "csi xactor"
        depends on I2C && VIDEO_V4L2 && VIDEO_ATOMISP
        ---help---
          Use this if you need to send data through external csi data
	  generator.

	  CSI Xactor module.

          To compile this driver as a module, choose M here.

config VIDEO_MSRLIST_HELPER
       tristate "Helper library to load, parse and apply large register lists."
       depends on I2C
       ---help---
         This is a helper library to be used from a sensor driver to load, parse
         and apply large register lists.

         To compile this driver as a module, choose M here: the
         module will be called libmsrlisthelper.

config VIDEO_S5K8AAY
       tristate "Samsung S5K8AAY (EVT1) sensor support"
       depends on I2C && VIDEO_V4L2 && VIDEO_ATOMISP && VIDEO_MSRLIST_HELPER
       ---help---
         This is a Video4Linux2 sensor-level driver for the Samsung
         S5K8AAY (EVT1) 1/8" 1.2MP SoC sensor.

         It currently only works with the atomisp driver.

config VIDEO_S5K6B2YX
       tristate "Samsung S5K6B2YX (VS) sensor support"
       depends on I2C && VIDEO_V4L2 && VIDEO_ATOMISP && VIDEO_MSRLIST_HELPER
       ---help---
         This is a Video4Linux2 sensor-level driver for the Samsung
         S5K6B2YX (VS) 1/6" 2MP RAW sensor.

         It currently only works with the atomisp driver.

config VIDEO_MT9D113
       tristate "Aptina mt9d113 sensor support"
       depends on I2C && VIDEO_V4L2
       ---help---
         This is a Video4Linux2 sensor-level driver for the Micron
         mt9d113 2M camera.

         mt9d113 is video camera sensor.

         It currently only works with the atomisp driver.
config VIDEO_MT9M114
       tristate "Aptina mt9m114 sensor support"
       depends on I2C && VIDEO_V4L2
       ---help---
         This is a Video4Linux2 sensor-level driver for the Micron
         mt9m114 1.3 Mpixel camera.

         mt9m114 is video camrea sensor.

         It currently only works with the atomisp driver.
config VIDEO_MT9V113
       tristate "Aptina mt9v113 sensor support"
       depends on I2C && VIDEO_V4L2
       ---help---
         This is a Video4Linux2 sensor-level driver for the Micron
         mt9v113 vga camera.

         mt9v113 is video camerea sensor.

         It currently only works with the atomisp driver.

config VIDEO_OV5640
       tristate "Omnivision ov5640 sensor support"
       depends on I2C && VIDEO_V4L2
       ---help---
         This is a Video4Linux2 sensor-level driver for the Micron
         ov5640 5 Mpixel camera.

         ov5640 is video camrea sensor.

         It currently only works with the atomisp driver.

config VIDEO_AP1302
       tristate "AP1302 external ISP support"
       depends on I2C && VIDEO_V4L2
       ---help---
         This is a Video4Linux2 sensor-level driver for the external
         ISP AP1302.

         AP1302 is an exteral ISP.

         It currently only works with the atomisp driver.

config VIDEO_PIXTER
       tristate "Pixter 2+ MIPI CSI simulator"
       depends on I2C && VIDEO_V4L2
       ---help---
         This is a Video4Linux2 sensor-level driver for Pixter2+.

	 Pixter 2+ MIPI CSI simulator.

         Pixter 2+ is a MIPI CSI simulator.

         It currently only works with the atomisp driver.

config VIDEO_OV680
       tristate "OV680 external ISP support"
       depends on I2C && VIDEO_V4L2
       ---help---
         This is a Video4Linux2 sensor-level driver for the external
         ISP OV680.

         OV680 is an external ISP.

         It currently only works with the atomisp driver.

#
# Kconfig for flash drivers
#

config VIDEO_LM3554
       tristate "LM3554 flash light driver"
       depends on VIDEO_V4L2 && I2C
       ---help---
         This is a Video4Linux2 sub-dev driver for the LM3554
         flash light driver.

         To compile this driver as a module, choose M here: the
         module will be called lm3554

config VIDEO_LM3642
       tristate "LM3642 flash light driver"
       depends on VIDEO_V4L2 && I2C
       ---help---
         This is a Video4Linux2 sub-dev driver for the LM3642
         flash light driver.

         To compile this driver as a module, choose M here: the
         module will be called lm3642


config VIDEO_LM3559
       tristate "LM3559 flash light driver"
       depends on VIDEO_V4L2 && I2C
       ---help---
         This is a Video4Linux2 sub-dev driver for the LM3559
         flash light driver.

         To compile this driver as a module, choose M here: the
         module will be called lm3559
```

## drivers/external_drivers/camera/drivers/media/i2c/imx135VB/Kconfig
```kconfig
config VIDEO_IMXVB
	tristate "sony imx sensor support"
	depends on I2C && VIDEO_V4L2
	---help---
	  This is a Video4Linux2 sensor-level driver for the Sony
	  IMX RAW sensor.

	  It currently depends on internal V4L2 extensions defined in
	  atomisp driver.
```

## drivers/external_drivers/camera/drivers/media/i2c/micam/Kconfig
```kconfig
config VIDEO_S5K4H8
	tristate "Samsung S5K4H8 sensor support"
	depends on I2C && VIDEO_V4L2
	---help---
	  This is a Video4Linux2 sensor-level driver for the Samsung
	  S5K4H8 8 Mpixel camera.

	  S5K4H8 is video camera sensor.

	  It currently only works with the atomisp driver.

config VIDEO_T4KA3
	tristate "TOSHIBA T4KA3 sensor support"
	depends on I2C && VIDEO_V4L2
	---help---
	  This is a Video4Linux2 sensor-level driver for the TOSHIBA
	  T4KA3 8 Mpixel camera.

	  T4KA3 is video camera sensor.

	  It currently only works with the atomisp driver.

config VIDEO_OV5693
	tristate "Omnivision OV5693 sensor support"
	depends on I2C && VIDEO_V4L2
	---help---
	  This is a Video4Linux2 sensor-level driver for the Omnivision
	  OV5693 5 Mpixel camera.

	  OV5693 is video camera sensor.

	  It currently only works with the atomisp driver.
```

## drivers/external_drivers/camera/drivers/media/i2c/mt9e013/Kconfig
```kconfig
config VIDEO_MT9E013
	tristate "Micron mt9e013 sensor support"
	depends on I2C && VIDEO_V4L2
	---help---
	  This is a Video4Linux2 sensor-level driver for the Aptina
	  MT9E013 8MP RAW sensor.

	  It currently depends on internal V4L2 extensions defined in
	  atomisp driver.

choice
	prompt "Select sensor settings"
	depends on VIDEO_MT9E013

config VIDEO_MT9E013_BLACKBAY
	bool "MT9E013 settings for Blackbay"
	---help---
	  Default mt9e013 sensor settings for Blackbay
config VIDEO_MT9E013_LEXINGTON
	bool "MT9E013 settings for Lexington"
	---help---
	  Default mt9e013 sensor settings for Lexington
config VIDEO_MT9E013_ENZO
	bool "MT9E013 settings for Enzo"
	---help---
	  Default mt9e013 sensor settings for Enzo
endchoice
```

## drivers/fingerprint/Kconfig
```kconfig
config FINGERPRINT
	tristate "Fingerprint driver support"
	help
	  Say Y here to enable goodix fingerprint driver support!
source "drivers/fingerprint/fpc/Kconfig"
source "drivers/fingerprint/goodix/Kconfig"
```

## drivers/fingerprint/fpc/Kconfig
```kconfig
config FINGERPRINT_FPC1020
	tristate "FingerPrint Cards fingerprint drvier support"
	depends on FINGERPRINT
	help
	  Say Y here to enable goodix fingerprint driver support!
```

## drivers/fingerprint/goodix/Kconfig
```kconfig
config FINGERPRINT_GOODIX_GF3208
	tristate "Goodix GF3208 fingerprint drvier support"
	depends on FINGERPRINT
	help
	  Say Y here to enable goodix fingerprint driver support!
```

## drivers/fingerprintrosy/Kconfig
```kconfig
config FINGERPRINT_ROSY
	tristate "ROSY Fingerprint driver support"
	help
	 Say Y here to enable goodix fingerprint driver support!

source "drivers/fingerprintrosy/goodixrosy/Kconfig"
source "drivers/fingerprintrosy/fpcrosy/Kconfig"
```

## drivers/fingerprintrosy/fpcrosy/Kconfig
```kconfig
config FINGERPRINT_FPC1020_ROSY
	tristate "FingerPrint Cards fingerprint drvier support"
	depends on FINGERPRINT_ROSY
	help
	 Say Y here to enable goodix fingerprint driver support!
```
