## drivers/soc/qcom/wcnss/Kconfig
```kconfig
config WCNSS_CORE
	tristate "Qualcomm Technologies Inc. WCNSS CORE driver"
	select WIRELESS_EXT
	select WEXT_PRIV
	select WEXT_CORE
	select WEXT_SPY
	help
	  This module adds support for WLAN connectivity subsystem
	  This module is responsible for communicating WLAN on/off
	  Core driver for the Qualcomm Technologies Inc. WCNSS triple play
	  connectivity subsystem, Enable WCNSS core platform driver
	  for WLAN.

config WCNSS_CORE_PRONTO
	tristate "Qualcomm Technologies Inc. WCNSS Pronto Support"
	depends on WCNSS_CORE
	help
	  Pronto Support for the Qualcomm Technologies Inc. WCNSS triple
	  play connectivity subsystem, Enable WCNSS core platform driver
	  for WLAN. This module adds support for WLAN connectivity subsystem
	  This module is responsible for communicating WLAN on/off

config WCNSS_REGISTER_DUMP_ON_BITE
	bool "Enable/disable WCNSS register dump when there is a WCNSS bite"
	depends on WCNSS_CORE_PRONTO
	help
	 When Apps receives a WDOG bite from WCNSS, collecting a register dump
	 of WCNSS is helpful to root cause the failure. WCNSS may not be
	 properly clocked in some WCNSS bite cases, and that may cause unclocked
	 register access failures. So this feature is to enable/disable the
	 register dump on WCNSS WDOG bite.

config CNSS_CRYPTO
	tristate "Enable CNSS crypto support"
	help
	  Add crypto support for the WLAN  driver module.
	  This feature enable wlan driver to use the crypto APIs exported
	  from cnss platform driver. This crypto APIs used to generate cipher
	  key and add support for the WLAN driver module security protocol.
```

## drivers/soc/qti/Kconfig
```kconfig
config MSM_QDSP6_APRV3
	bool "Audio QDSP6 APRv3 support"
	depends on MSM_SMD
	help
	  Enable APRv2 IPC protocol support between
	  application processor and QDSP6. APR is
	  used by audio driver to configure QDSP6v2's
	  ASM, ADM and AFE.

config MSM_QDSP6_APRV2
	bool "Audio QDSP6 APRv2 support"
	depends on MSM_SMD
	help
	  Enable APRv2 IPC protocol support between
	  application processor and QDSP6. APR is
	  used by audio driver to configure QDSP6's
	  ASM, ADM and AFE.

config MSM_ADSP_LOADER
	tristate "ADSP loader support"
	select SND_SOC_MSM_APRV2_INTF
	depends on MSM_QDSP6_APRV2 || MSM_QDSP6_APRV3
	help
	  Enable ADSP image loader.
	  The ADSP loader brings ADSP out of reset
	  for the platforms that use APRv2.
	  Say M if you want to enable this module.
```

## drivers/soc/sprd/Kconfig
```kconfig
# SPDX-License-Identifier: GPL-2.0-only
config SPRD_PIKE2_SLEEP
        bool "Spreadtrum light sleep driver for pike2 processors"
        depends on ARM_SPRD_CPUIDLE

        help
        Select this to enable light sleep function for pike2 soc.

source "drivers/soc/sprd/domain/Kconfig"
```

## drivers/soc/sprd/domain/Kconfig
```kconfig
# SPDX-License-Identifier: GPL-2.0
config SPRD_DISP_PM_DOMAIN_SHARKL3
	tristate "SPRD Display PM Generic Domain for SharkL3"
	default m
	depends on ARCH_SPRD || COMPILE_TEST
	select PM_GENERIC_DOMAINS if PM
	help
	  When you select this feature, it will enable the pm generic
	  power domain for SharkL3 display module.
```

## drivers/soundwire/Kconfig
```kconfig
#
# SOUNDWIRE driver configuration
#
menuconfig SOUNDWIRE
	bool "Soundwire support"
	help
	  Soundwire is a two wire interface for audio to connect
	  simple peripheral components in mobile devices.

if SOUNDWIRE
config SOUNDWIRE_WCD_CTRL
	depends on WCD9335_CODEC
	tristate "QTI WCD CODEC Soundwire controller"
	default n
	help
	  Select driver for QTI's Soundwire Master Component.
endif
```

## drivers/spi/mediatek/Kconfig
```kconfig
config MTK_SPI
	tristate "MediaTek SPI controller"
	---help---
	  This selects the MediaTek(R) SPI bus driver.
	  If you want to use MediaTek(R) SPI interface, say Y or M here.
```

## drivers/spmi/Kconfig
```kconfig
#
# SPMI driver configuration
#
menuconfig SPMI
	tristate "SPMI support"
	help
	  SPMI (System Power Management Interface) is a two-wire
	  serial interface between baseband and application processors
	  and Power Management Integrated Circuits (PMIC).

if SPMI

config SPMI_MSM_PMIC_ARB
	tristate "Qualcomm MSM SPMI Controller (PMIC Arbiter)"
	select IRQ_DOMAIN
	depends on ARCH_QCOM || COMPILE_TEST
	depends on HAS_IOMEM
	default ARCH_QCOM
	help
	  If you say yes to this option, support will be included for the
	  built-in SPMI PMIC Arbiter interface on Qualcomm MSM family
	  processors.

	  This is required for communicating with Qualcomm PMICs and
	  other devices that have the SPMI interface.

config SPMI_MSM_PMIC_ARB_DEBUG
	tristate "QTI SPMI Debug Controller (PMIC Arbiter)"
	depends on ARCH_QCOM || COMPILE_TEST
	depends on HAS_IOMEM
	help
	  If you say yes to this option, support will be included for the
	  built-in SPMI PMIC Arbiter debug interface on Qualcomm Technologies,
	  Inc. (QTI) MSM family processors.  This feature is available on chips
	  with PMIC arbiter version 5 and above.

endif
```

## drivers/spmi/simulator/Kconfig
```kconfig
#
# SPMI Simulator driver configuration
#
menuconfig SPMI_SIMULATOR
	tristate "SPMI Controller Simulator"
	help
	  The SPMI Controller Simulator provides a means to simulate registers
	  within the SPMI address space.  Each register can be read and written.
	  Additionally, callback functions can be defined per register by
	  other drivers which simulate the behavior of PMIC peripherals.

if SPMI_SIMULATOR

config PM8150_PMIC_SIMULATOR
	tristate "Qualcomm Technologies, Inc. PM8150 PMIC Simulator"
	help
	  The PM8150 PMIC Simulator configures the read/write permissions of all
	  PM8150 SPMI registers and loads default register values.  It is used
	  in conjunction with the SPMI Controller Simulator to help test PMIC
	  peripheral drivers before physical PMIC chips are available.

config PM8150B_PMIC_SIMULATOR
	tristate "Qualcomm Technologies, Inc. PM8150B PMIC Simulator"
	help
	  The PM8150B PMIC Simulator configures the read/write permissions of all
	  PM8150B SPMI registers and loads default register values.  It is used
	  in conjunction with the SPMI Controller Simulator to help test PMIC
	  peripheral drivers before physical PMIC chips are available.

config PM8150L_PMIC_SIMULATOR
	tristate "Qualcomm Technologies, Inc. PM8150L PMIC Simulator"
	help
	  The PM8150L PMIC Simulator configures the read/write permissions of all
	  PM8150L SPMI registers and loads default register values.  It is used
	  in conjunction with the SPMI Controller Simulator to help test PMIC
	  peripheral drivers before physical PMIC chips are available.

endif
```

## drivers/staging/android/Kconfig
```kconfig
menu "Android"

if ANDROID

config ASHMEM
	bool "Enable the Anonymous Shared Memory Subsystem"
	default n
	depends on SHMEM
	---help---
	  The ashmem subsystem is a new shared memory allocator, similar to
	  POSIX SHM but with different behavior and sporting a simpler
	  file-based API.

	  It is, in theory, a good memory allocator for low-memory devices,
	  because it can discard shared memory units when under memory pressure.

config ANDROID_VSOC
	tristate "Android Virtual SoC support"
	default n
	depends on PCI_MSI
	---help---
	  This option adds support for the Virtual SoC driver needed to boot
	  a 'cuttlefish' Android image inside QEmu. The driver interacts with
	  a QEmu ivshmem device. If built as a module, it will be called vsoc.

config ANDROID_INTF_ALARM_DEV
	bool "Android alarm driver"
	depends on RTC_CLASS
	default n
	---help---
	  Provides non-wakeup and rtc backed wakeup alarms based on rtc or
	  elapsed realtime, and a non-wakeup alarm on the monotonic clock.
	  Espically for wake up alarm ioctl.
	  Also exports the alarm interface to user-space.

config MTK_GMO_RAM_OPTIMIZE
	bool "MTK ram optimize"
	default n
	select MTK_ENABLE_GMO
	select MTK_ENABLE_AGO
	---help---
	  Provide for phone to use memory efficiently.
	  it will select MTK_ENABLE_GMO
	  and MTK_ENABLE_AGO
	  default.

config MTK_ENABLE_GMO
	bool "Enable/Disable GMO related feautre"
	default n
	select CC_OPTIMIZE_FOR_SIZE
	select CRYPTO_LZ4K
	---help---
	  Enable/Disable GMO related feautre
	  Do not use this options in Kernel directly
	  this is a group kernel setting of GMO
	  must set CONFIG_LOG_BUF_SHIFT=17 manually

config MTK_ENABLE_AGO
	bool "Enable/Disable A-Go related feautre"
	default n
	select SWAP
	select ZRAM
	select ZRAM_WRITEBACK
	select CRYPTO_LZ4
	select MEMCG
	select MEMCG_SWAP
	select HZ_300
	select UID_CPUTIME
	select SDCARD_FS
	select F2FS_FS
	select F2FS_FS_SECURITY
	select F2FS_FS_ENCRYPTION
	select DM_VERITY_FEC if (MD && DM_VERITY)
	select DM_ANDROID_VERITY_AT_MOST_ONCE_DEFAULT_ENABLED if (MD && DM_VERITY)
	select PGTABLE_MAPPING if ZSMALLOC && (ARM || ARM64)
	select PSI
	---help---
	  Enable/Disable GMO related feautre
	  Do not use this options in Kernel
	  directly.
	  this is a group kernel setting of AGO

source "drivers/staging/android/ion/Kconfig"

endif # if ANDROID

endmenu
```

## drivers/staging/android/ion/Kconfig
```kconfig
# SPDX-License-Identifier: GPL-2.0
menuconfig ION
	bool "Ion Memory Manager"
	depends on HAS_DMA && MMU
	select GENERIC_ALLOCATOR
	select DMA_SHARED_BUFFER
	help
	  Choose this option to enable the ION Memory Manager,
	  used by Android to efficiently allocate buffers
	  from userspace that can be shared between drivers.
	  If you're not using Android its probably safe to
	  say N here.

config ION_SPRD
	tristate "SPRD ion support"
	#default m
	depends on ION
	help
	  Choose this option to enable sprd ion support.

source "drivers/staging/android/ion/heaps/Kconfig"
```

## drivers/staging/android/ion/heaps/Kconfig
```kconfig
# SPDX-License-Identifier: GPL-2.0
config ION_SYSTEM_HEAP
	tristate "Ion system heap"
	depends on ION
	help
	  Choose this option to enable the Ion system heap. The system heap
	  is backed by pages from the buddy allocator. If in doubt, say Y.

config ION_CARVEOUT_HEAP
	bool "Ion carveout heap support"
	depends on ION
	help
	  Choose this option to enable carveout heaps with Ion. Carveout heaps
	  are backed by memory reserved from the system. Allocation times are
	  typically faster at the cost of memory not being used. Unless you
	  know your system has these regions, you should say N here.

config ION_CMA_HEAP
	tristate "Ion CMA heap support"
	depends on ION && DMA_CMA
	help
	  Choose this option to enable CMA heaps with Ion. This heap is backed
	  by the Contiguous Memory Allocator (CMA). If your system has these
	  regions, you should say Y here.

config ION_MSM_HEAPS
	tristate "MSM platform-based Ion heaps support"
	depends on ION
	help
	  Enable this option to enable platform-based Ion heaps. The heaps
          will register with the Ion core framework, at which point userspace
          clients can allocate different types of memory (e.g. secure, cached,
          and uncached) from the different types of heaps. The MSM heaps
          allow Ion buffers to be shared through the shared DMA buffer framework
          and the heaps implement their own cache maintenance operations.
          If you're not sure, enable here.

config ION_FORCE_DMA_SYNC
	bool "Force ION to always DMA sync buffer memory"
	depends on ION
	help
	  Force ION to DMA sync buffer memory when it is allocated and to
	  always DMA sync the buffer memory on calls to begin/end cpu
	  access. This makes ION DMA sync behavior similar to that of the
	  older version of ION.
	  We generally don't want to enable this config as it breaks the
	  cache maintenance model.
	  If you're not sure say N here.

config ION_DEFER_FREE_NO_SCHED_IDLE
	bool "Increases the priority of ION defer free thread"
	depends on ION
	help
	  Certain heaps such as the system heaps make use of a low priority
	  thread to help free buffer allocations back to the pool which might
	  result in future allocations requests going to the buddy instead of
	  the pool when there is a high buffer allocation rate.
	  Choose this option to remove the SCHED_IDLE flag in case of defer
	  free thereby increasing the priority of defer free thread.
	  if you're not sure say Y here.

config ION_POOL_AUTO_REFILL
	bool "Refill the ION heap pools automatically"
	depends on ION && QGKI && ION_MSM_HEAPS=y
	help
	  Choose this option to refill the ION system heap pools (non-secure)
	  automatically when the pool pages count becomes lower than a set low mark.
	  This refilling is done by worker thread which is invoked asynchronously
	  when the pool count reaches below low mark.
	  if you're not sure say Y here.

config ION_POOL_FILL_MARK
	int "ion pool fillmark size in MB"
	depends on ION_POOL_AUTO_REFILL
	range 16 256
	default 100
	help
	  Set the fillmark of the pool in terms of mega bytes and the lowmark is
	  ION_POOL_LOW_MARK_PERCENT of fillmark value.

config PANIC_ON_MSM_ION_HEAPS_FAILURE
	bool "Trigger kernel panic when msm ion heap probe fails"
	help
	This is a debug feature where a kernel panic is triggered when
	msm ion heap probe fails. This can happen when any invalid heap id,
	heap types are added in device tree. Panic ensures early detection
	of such changes.
```
