## drivers/soc/mediatek/devmpu/Kconfig
```kconfig
config MTK_DEVMPU
	bool "Enable MTK Device MPU driver"
	help
	  Device MPU is a kernel driver providing
	  non-continuous memory protection in the
	  2MB granularity. Note that the protection
	  is conducted in parallel with EMI MPU.

config MTK_DEVMPU_EMI
	bool "Enable MTK Device MPU with EMI MPU"
	select MTK_DEVMPU
	help
	  Device MPU hardware will receive the violation
	  from EMI MPU hardware. Device MPU driver will
	  receive violation via call-back function of
	  EMI MPU.

config DEVMPU_MT6779
	bool "Mediatek MT6779 Device MPU driver"
	depends on ARCH_MEDIATEK
	select MTK_DEVMPU if (MTK_EMI || MEDIATEK_EMI)
	select MTK_DEVMPU_EMI if (MTK_EMI || MEDIATEK_EMI)
	help
	  Say yes here to enable support Mediatek MT6885
	  Device MPU driver. This driver is combined with
	  SUB, ACP and EMI features of Device MPU in
	  MT6779 platfom.

config DEVMPU_MT6781
	bool "Mediatek MT6781 Device MPU driver"
	depends on ARCH_MEDIATEK
	select MTK_DEVMPU
	help
	  Say yes here to enable support Mediatek MT6781
	  Device MPU driver. This driver is combined with
	  SUB, ACP and EMI features of Device MPU in
	  MT6781 platfom.
```

## drivers/soc/msm/Kconfig
```kconfig
# When adding new entries keep the list in alphabetical order

if ARCH_MSM

config MSM_SMEM
	depends on REMOTE_SPINLOCK_MSM
	bool "MSM Shared Memory (SMEM)"
	help
	  Support for the shared memory interface between the various
	  processors in the System on a Chip (SoC) which allows basic
	  inter-processor communication.

endif # ARCH_MSM
```

## drivers/soc/qcom/dcvs/Kconfig
```kconfig
# SPDX-License-Identifier: GPL-2.0-only
#
# QCOM DCVS drivers
#
config QCOM_PMU_LIB
	tristate "QCOM PMU Driver"
	depends on ARCH_QCOM
	default n
	help
	  This enables the QCOM PMU driver which manages and maintains
	  per-CPU performance counters that are available on some
	  Qualcomm Technologies, Inc. (QTI) chipsets. This includes
	  preserving them across CPU idle and hotplug events.

config QCOM_DCVS_FP
	tristate "Enable QCOM DCVS Fast Path Interface"
	depends on ARCH_QCOM && QCOM_RPMH
	default n
	help
	  This enables the QCOM DCVS FP (Fast Path) driver which relies on
	  certain "fast path" APIs from QCOM_RPMH to vote for various DCVS HW
	  blocks in a faster scheme than standard voting paths. This requires a
	  Qualcomm Technologies, Inc. (QTI) chipset that supports this feature.

config QCOM_DCVS
	tristate "QCOM DCVS Driver"
	select QCOM_DCVS_FP
	select INTERCONNECT
	default n
	help
	  This enables the main QCOM DCVS framework which supports various
	  DCVS HW blocks and voting interfaces that are supported on some
	  Qualcomm Technologies, Inc. (QTI) chipsets. This includes voting
	  interfaces from both QCOM_DCVS_FP and INTERCONNECT.

config QCOM_MEMLAT
	tristate "QCOM Memlat Driver"
	depends on QCOM_DCVS && QCOM_PMU_LIB
	default n
	help
	  This enables the QCOM Memlat driver which monitors CPU performance
	  counters to identify memory latency bound workloads and vote for
	  DCVS HW (memory) frequencies through the QCOM DCVS framework.

config QCOM_BWMON
	tristate "QCOM BWMON Driver"
	depends on QCOM_DCVS
	default n
	help
	  This enables the QCOM BWMON driver which monitors bandwidth counters
	  to identify memory bandwidth bound workloads and vote for DCVS HW
	  (memory) frequencies through the QCOM DCVS framework.

config QCOM_BWPROF
	tristate "QCOM BWPROF Driver"
	depends on ARCH_QCOM
	default n
	help
	  This enables the QCOM BWPROF driver which monitors bandwidth counters
	  and provides them to userspace clients at modest time intervals for
	  the intention of bandwidth profiling and DDR frequency monitoring. The
	  purpose of the driver is to enable the monitoring of the bandwidth usage
	  at regular intervals, providing the userspace clients with a detailed
	  view of the current state of the system.

config QTI_HW_MEMLAT_SCMI_CLIENT
	tristate "Qualcomm Technologies Inc. SCMI client driver for HW MEMLAT"
	depends on QCOM_MEMLAT && QTI_SCMI_MEMLAT_PROTOCOL
	default n
	help
	  SCMI client driver registers itself with SCMI framework for memlat
	  vendor protocol, and also registers with the memlat interface
	  driver.

	  This driver delivers the memlat vendor protocol handle to interface
	  driver, and interface driver will use this handle to communicate with
	  memlat HW.


config QTI_PMU_SCMI_CLIENT
	tristate "Qualcomm Technologies Inc. SCMI client driver for PMU"
	depends on QTI_SCMI_PMU_PROTOCOL && QCOM_PMU_LIB
	default n
	help
	  SCMI client driver registers itself with SCMI framework for pmu
	  vendor protocol.

	  This driver delivers the pmu vendor protocol handle to interface
	  driver, and interface driver will use this handle to communicate with
	  rimps.

config QTI_C1DCVS_SCMI_CLIENT
	tristate "Qualcomm Technologies Inc. SCMI client driver for cpudcvs"
	depends on QTI_SCMI_C1DCVS_PROTOCOL
	default n
	help
	  SCMI client driver registers itself with SCMI framework for c1dcvs
	  vendor protocol.

	  This driver delivers the cpudcvs protocol handle to interface
	  driver, and interface driver will use this handle to communicate with
	  cpucp.

config QTI_CPUFREQ_STATS_SCMI_CLIENT
	tristate "Qualcomm Technologies Inc. SCMI client driver for cpufreq stats"
	depends on QTI_SCMI_CPUFREQ_STATS_PROTOCOL
	default n
	help
	  SCMI client driver registers itself with SCMI framework for cpufreq stats
	  vendor protocol.

	  This driver delivers the cpufreq stats protocol handle to interface
	  driver, and interface driver will use this handle to communicate with
	  cpucp.
```

## drivers/soc/qcom/gnsssirf/Kconfig
```kconfig
# SPDX-License-Identifier: GPL-2.0-only
#
# SIRF GNSS receiver configuration
#

menu "GNSS SIRF controls"

config GNSS_SIRF
	tristate "GNSS SIRF"
	help
	  The GNSS SIRF driver enables SiRFStarV GNSS chipset.

	  The purpose of the driver to provide location information over UART.
	  The location information contains position reports and Satellite info.
	  The Chipset is interface over UART and controlled using Power enable
	  and reset GPIO. To compile this driver as a module, choose M here:
	  the module will be called GNSS SIRF.

endmenu
```

## drivers/soc/qcom/hab/Kconfig
```kconfig
# SPDX-License-Identifier: GPL-2.0-only
#
# HAB configuration
#
config MSM_HAB
	bool "Enable Hypervisor ABstraction Layer"
	select WANT_DEV_COREDUMP
	help
	  HAB(Hypervisor ABstraction) driver can provide the message
	  transmission and memory sharing services among different OSes.
	  Internally, HAB makes use of some specific communication mechanism
	  provided by the underlying hypervisor.
	  It is required by the virtualization support for some multimedia
	  and platform devices in MSM devices.

config MSM_HAB_DEFAULT_VMID
	int
	default 2
	help
	  The default HAB VMID.
	  It will not be used when there are some other configuration sources,
	  e.g., device tree.
```

## drivers/soc/qcom/hgsl/Kconfig
```kconfig
# SPDX-License-Identifier: GPL-2.0-only
#
# Hypervisor graphics system layer configuration
#
config QCOM_HGSL
	bool "Graphics driver for Hypervisor"
	depends on QTI_QUIN_GVM
	help
	  This driver could help commands submmitting functions for
	  hypervisor Linux. With HFI feature provided by A6x, it
	  could submit commands directly to hardware without passing
	  them to host system.

config QCOM_HGSL_TCSR_SIGNAL
	bool "TCSR signal for Hypervisor GSL"
	depends on MFD_SYSCON && QCOM_HGSL
	help
	  The TCSR compute signal module provides hgsl driver
	  in hypervisor Linux a way to send/receive signals
	  to/from A6x GPU hardware directly, without going
	  through host system.
```

## drivers/soc/qcom/icnss2/Kconfig
```kconfig
# SPDX-License-Identifier: GPL-2.0-only
config ICNSS2
	tristate "Platform driver for Wi-Fi Module module"
	select CNSS_UTILS
	help
	  This module adds support for Q6 integrated WLAN connectivity
	  subsystem with iWCN architecture. This module is responsible for
	  communicating WLAN on/off control messages to FW over QMI channel.
	  It is also responsible for handling WLAN PD restart notifications.

config ICNSS2_DEBUG
	bool "ICNSS2 Platform Driver Debug Support"
	depends on ICNSS2
	help
	  Say 'Y' here to enable ICNSS driver debug support. Debug support
	  primarily consists of logs consisting of information related to
	  hardware register access and enabling BUG_ON for certain cases to aid
	  the debugging.

config ICNSS2_QMI
	bool "ICNSS2 Platform Driver QMI support"
	select CNSS_QMI_SVC
	depends on ICNSS2
	help
	  Say 'Y' here to enable ICNSS QMI support. ICNSS driver will use
	  QMI framework to communicate with WLAN FW. It will send coldboot
	  handshake messages to WLAN FW, which includes hardware capabilities
	  and configurations. It also send WLAN on/off control message to FW
	  over QMI channel.

config CNSS_QCA6750
	bool "Enable ICNSS QCA6750 chipset specific changes"
	depends on ICNSS2
	help
	  This enables the changes from WLAN host driver that are specific to
	  CNSS QCA6750 chipset.
	  These changes are needed to support the new hardware architecture
	  for CNSS QCA6750 chipset.
```

## drivers/soc/qcom/mem_buf/Kconfig
```kconfig
# SPDX-License-Identifier: GPL-2.0-only

config QCOM_MEM_BUF
	tristate "Qualcomm Technologies, Inc. Memory Buffer Sharing Driver"
	select QCOM_MEM_BUF_DEV
	help
	  Add support for lending memory from one virtual machine to another.
	  This driver communicates with the hypervisor, as well as other
	  virtual machines, to request and lend memory from and to VMs
	  respectively.
	  If unsure, say N

config QCOM_MEM_BUF_GH
	bool "Qualcomm Technologies, Inc. Memory Buffer Gunyah Hypervisor Support"
	depends on GH_RM_DRV
	select QCOM_MEM_BUF_DEV_GH
	help
	  Enables additional support for sharing memory with VMs that have their own
	  operating systems, as opposed to peripheral VMs, which do not have their
	  own operating systems. These VMs are managed by the Gunyah Hypervisor, and thus
	  sharing memory with them requires interacting with the Gunyah Hypervisor.
	  If unsure, say N.

config QCOM_MEM_BUF_DEV
	tristate

config QCOM_MEM_BUF_DEV_GH
	bool

config QCOM_MEM_BUF_MSGQ
	tristate "Qualcomm Technologies, Inc. Memory Buffer Message Queue Support"
	depends on GH_MSGQ && QCOM_MEM_BUF_DEV_GH
	help
	  Enables support for communicating with VMs over message queues. The communication
	  with the VMs follows a specific communication format that is defined by the mem-buf
	  message queue protocol. The protocol allows for allocation requests to be submitted
	  between VMs, and relinquished when a VM is finished with the memory that it
	  requested from another VM.
	  If unsure, say N.

config QCOM_MEM_BUF_IPA_RESERVE
	bool "Reserve IPA space of certain size from Hypervisor"
	depends on QCOM_MEM_BUF_GH
	help
	  Reserve an IPA space of certain size and range from the
	  Hypervisor which can be used for accepting memory donated
	  by the Primary VM. This IPA space can be used for accepting
	  dmabuf buffers as well.
	  This Kconfig is not needed once required symbols are exported from ACK.
	  If unsure, say N.
```

## drivers/soc/qcom/memshare/Kconfig
```kconfig
# SPDX-License-Identifier: GPL-2.0-only
#
# Shared Heap for external processors
#
config MEM_SHARE_QMI_SERVICE
       depends on QCOM_QMI_HELPERS
       bool "Shared Heap for external processors"
       help
		Memory Share Kernel QTI Messaging Interface Service
		receives requests from Modem Processor Sub System
		for heap alloc/free from Application Processor
		Sub System and send a response back to client with
		proper handle/address.
```

## drivers/soc/qcom/mpam/Kconfig
```kconfig
# SPDX-License-Identifier: GPL-2.0-only
#
# QCOM MPAM drivers
#

config QTI_MPAM
	tristate "Qualcomm Technologies Inc. MPAM Interface Driver"
	depends on QTI_SCMI_VENDOR_PROTOCOL
	default n
	help
	  This driver exports all the available APIs to config MPAM
	  parameters. These APIs will relay the configurations to
	  CPUCP via SCMI communication. It is intended to be used by
	  clients familiar with modifying the MPAM configuration
	  settings.

config QTI_CPU_MPAM_INTERFACE
	tristate "Enable QCOM CPU MPAM configfs support"
	depends on QTI_MPAM && CONFIGFS_FS
	default n
	help
	  This enables QCOM CPU MPAM configfs interface support. User
	  can config CPU MPAM feature inlcuding CMAX, CPBM, PRIO and
	  tasks in a partition. Monitors inlcuding CSU and MBWU are
	  also available. Configfs interface allows user to create and
	  remove MPAM partition according to use cases.

config QTI_PLATFORM_MPAM_INTERFACE
	tristate "Enable QCOM Platform MPAM configfs support"
	depends on QTI_MPAM && CONFIGFS_FS
	default n
	help
	  This enables QCOM Platform MPAM configfs interface support.
	  User can config Platform MPAM gear for NOC bandwidth control.
	  Byte count monitors are also available to help to the
	  setting.

config QTI_MPAM_MSC
	tristate "Enable QCOM MSC parent driver"
	depends on QTI_MPAM
	default n
	help
	MSC parent driver to support generic API for MPAM functionality
	to configure Gears, monitor the allocations, read misses etc.
	Also enable abstraction of different MSC device and can child
	nodes can use the top layer API abstraction to implement MAPM
	functionality.

config QTI_MPAM_MSC_SLC
	tristate "Enable QCOM MSC SLC driver"
	depends on QTI_MPAM && QTI_MPAM_MSC
	default n
	help
	MSC driver support for SLC MPAM functionality. Enables SLC
	gear configuration support and configuration support for
	generic SLC cache monitors like Capacity, read miss, etc.
	Also module take care of getting device SLC gear config
	capability from device by querying and take care of reset
	the settings on module removal.

config QTI_SLC_MPAM_INTERFACE
	tristate "Enable QCOM SLC MPAM configfs support"
	depends on QTI_MPAM_MSC_SLC && CONFIGFS_FS
	default n
	help
	  This enables QCOM SLC MPAM configfs interface support.
	  User can config SLC MPAM gear for SLC size control.
	  Miss count and capacity monitors are also available to
	  help to the setting.
```

## drivers/soc/qcom/rmnet_ctl/Kconfig
```kconfig
# SPDX-License-Identifier: GPL-2.0-only
#
# RMNET CTL driver
#

menuconfig RMNET_CTL
	tristate "RmNet Control driver"
	depends on MHI_BUS
	help
	  Enable the RMNET CTL module which is used for communicating with
	  device via map command protocol. This module will receive QMAP
	  control commands via MHI.

menuconfig RMNET_CTL_DEBUG
	bool "RmNet Control debug"
	depends on RMNET_CTL
	help
	  Enable RMNET CTL IPC debug loggings.
```

## drivers/soc/qcom/sync_fence/Kconfig
```kconfig
# SPDX-License-Identifier: GPL-2.0-only
#
# Sync fence drivers
#
config QCOM_SPEC_SYNC
	tristate "Qualcomm Technologies, Inc. Speculative sync driver"
	depends on SYNC_FILE
	default m if SYNC_FILE
	help
	  This option allows to enable a speculative fence driver which
	  can help to create an early fence for the clients, that can
	  be binded with an actual fence at a later point in the timeline.
```

## drivers/soc/qcom/tmecom/Kconfig
```kconfig
# SPDX-License-Identifier: GPL-2.0-only
#
# QCOM TMECOM driver

config MSM_TMECOM_QMP
	tristate "TMECom QMP interface"
	select MSM_QMP
	help
	  Set to enable TMECom interface over QTI Mailbox Protocol (QMP)
	  for HWKM master on MSM platform. This interface helps to
	  communicate with TME mainly for HWKM functionality and also
	  for enabling TME logging support in userspace.
```
