## drivers/virt/haven/Kconfig
```kconfig
# SPDX-License-Identifier: GPL-2.0-only

menuconfig HAVEN_DRIVERS
	bool "Haven Virtualization drivers"
	depends on ARM64
	help
	  The Haven drivers are the helper interfaces that runs on the
	  virtual machines that provides support such as memory/device
	  sharing, IRQ sharing, IPC/signalling mechanisms, and so on.

	  Say Y here to enable the drivers needed to work on Haven
	  virtualization environment.

	  If you say N, all options in this submenu will be skipped and disabled.

if HAVEN_DRIVERS

config HH_CTRL
	tristate "Create Haven entries under /sys/hypervisor"
	depends on SYSFS
	select SYS_HYPERVISOR
	help
	  Create entries under /sys/hypervisor for the Haven hypervisor.
	  The driver also provides a facility for controlling
	  hypervisor debug features.
	  See Documentation/ABI/testing/sysfs-hypervisor-haven for more details.

config HH_MSGQ
	tristate "Haven Message Queue driver"
	help
	  Haven offers message-queues as one of the IPC mechanisms to
	  communicate among the Virtual Machines. The message queue drivers
	  runs on the Virtual machines to provide an interface to the clients
	  who wish to communicate to other clients on a different VM. Currently,
	  the services offered by the drivers is simply to send and receive
	  messages in a blocking manner.

config HH_RM_DRV
	tristate "Haven Resource Manager driver"
	help
	  The Haven Resource Manager driver is used to communicate with the
	  Resource Manager Virtual Machine (RM-VM). The RM-VM acts as a mediator
	  and provides numerous services to the other VMs running in the system,
	  such as notifying when a particular VM is up, resource (IRQ/device)
	  sharing between VMs, information about the IPC mechanisms, and so on.

	  The Resource Manager driver runs on the Virtual Machine and acts as an
	  interface to other driver in order to obtain the services provided by
	  the RM-VM.

config HH_DBL
	tristate "Haven Doorbell driver"
	help
	  Haven offers a simple inter VMs(Virtual Machines) communication
	  through the use of doorbell interrupts. A single doorbell instance
	  provides an unidirectional communication between two VMs and it acts
	  like either a source(Tx) or generate(Rx). Individual VMs make use of
	  these doorbells by calling send and/or a receive primitives exposed by
	  driver and trigger an interrupt to each other and exchange the data.

config HH_IRQ_LEND
	tristate "Haven IRQ Lending Framework"
	depends on HH_RM_DRV
	help
	  Haven Resource Manager permits interrupts to be shared between
	  virtual machines. This config enables a framework which
	  supports sharing these interrupts. The follows RM recommended
	  protocol.

config HH_MEM_NOTIFIER
	tristate "Haven Memory Resource Notification Framework"
	depends on HH_RM_DRV
	help
	  The Haven Resource Manager allows for different memory resources
	  to be transferred across virtual machines with different notification
	  labels assigned to each resource to aid in distinguishing them.
	  Enabling the Haven Memory Resource Notification Framework provides an
	  interface for clients to transmit memory resources between virtual
	  machines, and register callbacks that get invoked only when
	  notifications pertaining to their memory resources arrive.

config HH_VIRT_WATCHDOG
	tristate "Haven Virtual Watchdog Driver"
	depends on QCOM_WDT_CORE
	help
	  This enables the Qualcomm Technologies, Inc. watchdog module for
	  the Haven hypervisor. It provides an interface to perform watchdog
	  actions such as setting the bark/bite time and also petting the
	  watchdog in the hypervisor.

endif
```

## drivers/vservices/Kconfig
```kconfig
#
# OKL4 Virtual Services framework
#

menuconfig VSERVICES_SUPPORT
	tristate "OKL4 Virtual Services support"
	default OKL4_GUEST || OKL4_VIRTUALISATION
	select HOTPLUG
	help
	  This option adds core support for OKL4 Virtual Services. The Virtual
	  Services framework is an inter-OS device/service sharing
	  protocol which is supported on OKL4 Microvisor virtualization
	  platforms. You will also need drivers from the following menu in
	  order to make use of it.

if VSERVICES_SUPPORT

config VSERVICES_CHAR_DEV
	bool "Virtual Services user-space service API"
	default y
	help
	  Select this if you want to use user-space service drivers. You will
	  also need udev rules that create device nodes, and protocol code
	  generated by the OK Mill tool.

config VSERVICES_DEBUG
	bool "Virtual Services debugging support"
	help
	  Select this if you want to enable Virtual Services core framework
	  debugging. The debug messages for various components of the Virtual
	  Services core framework can be toggled at runtime on a per-session
	  basis via sysfs. When Virtual Services debugging is enabled here,
	  but disabled at runtime it has a minimal performance impact.

config VSERVICES_LOCK_DEBUG
	bool "Debug Virtual Services state locks"
	default DEBUG_KERNEL
	help
	  This option enables some runtime checks that Virtual Services
	  state lock functions are used correctly in service drivers.

config VSERVICES_SERVER
	tristate "Virtual Services server support"
	depends on SYSFS
	default y
	help
	  This option adds support for Virtual Services servers, which allows
	  exporting of services from this Linux to other environments. Servers
	  are created at runtime by writing to files in
	  /sys/bus/vservices-server.

config VSERVICES_CLIENT
	tristate "Virtual Services client support"
	default y
	help
	  This option adds support for Virtual Services clients, which allows
	  connecting to services exported from other environments.

config VSERVICES_SKELETON_DRIVER
	tristate "Virtual Services skeleton driver"
	depends on VSERVICES_SERVER || VSERVICES_CLIENT
	default n
	help
	  This option adds support for a skeleton virtual service driver. This
	  driver can be used for templating or testing of virtual service
	  drivers. If unsure say N.

config VSERVICES_NAMED_DEVICE
	bool "Virtual Services use named device node in /dev"
	default n
	help
	  Select this if you want to use a named device name over a numeric
	  device name in /dev

source "drivers/vservices/transport/Kconfig"

source "drivers/vservices/protocol/Kconfig"

source "drivers/vservices/Kconfig.stacks"

endif # VSERVICES_SUPPORT
```

## drivers/vservices/Kconfig.stacks
```kconfig
#
# vServices drivers configuration
#

menu "Client and Server drivers"

endmenu
```

## drivers/vservices/protocol/Kconfig
```kconfig
#
# vServices protocol drivers configuration
#

if VSERVICES_SERVER || VSERVICES_CLIENT

menu "Protocol drivers"
config VSERVICES_PROTOCOL_SERIAL
	bool

config VSERVICES_PROTOCOL_SERIAL_SERVER
	tristate "Serial server protocol"
	depends on VSERVICES_SUPPORT && VSERVICES_SERVER
	select VSERVICES_PROTOCOL_SERIAL
	help
	  This option adds support for Virtual Services serial protocol server.

config VSERVICES_PROTOCOL_SERIAL_CLIENT
	tristate "Serial client protocol"
	depends on VSERVICES_SUPPORT && VSERVICES_CLIENT
	select VSERVICES_PROTOCOL_SERIAL
	help
	  This option adds support for Virtual Services serial protocol client.

endmenu

endif # VSERVICES_SERVER || VSERVICES_CLIENT
```

## drivers/vservices/transport/Kconfig
```kconfig
#
# vServices Transport driver configuration
#

menu "Transport drivers"

config VSERVICES_OKL4_AXON
	tristate "OKL4 Microvisor Axon driver"
	depends on VSERVICES_SUPPORT && OKL4_GUEST
	default y
	help
	  This option adds support for Virtual Services sessions using an OKL4
	  Microvisor Axon object as a transport.

	  If this driver is to be used in a Cell that has multiple
	  discontiguous regions in its physical memory pool, the
	  CONFIG_DMA_CMA option must also be selected (or CONFIG_CMA
	  in older kernels that do not have CONFIG_DMA_CMA).

endmenu
```

## drivers/watchdog/mediatek/wdt/Kconfig
```kconfig
config MTK_WATCHDOG
	tristate "Enable MTK watchDog"
	default y
	help
	  MTK watchdog driver enable/disable in the kernel.

	  Say Y here if you want to use Mediatek watchdog driver.

	  Please note that Mediatek watchdog driver doesn't use
	  watchdog core defined by WATCHDOG_CORE.

config MTK_WATCHDOG_COMMON
	bool "Use MTK watchdog common driver"
	help
	  Use Mediatek watchdog common driver. Common driver
	  version may be different on different platforms and shall
	  be seleted by proper kernel option.

	  Say Y here if you want to use Mediatek watchdog common driver.
	  Please note that driver version shall be properly selected in
	  below menu as well.

choice
	prompt "MTK watchdog common driver version"
	depends on MTK_WATCHDOG_COMMON
	help
	  Select Mediatek watchdog common driver version.

	config MTK_WATCHDOG_COMMON_V1
		bool "Use MTK watchdog common driver v1"

	config MTK_WATCHDOG_COMMON_V2
		bool "Use MTK watchdog common driver v2"
endchoice

config MTK_WD_KICKER
	tristate "Enable MTK watchdog kicker"
	default y
	help
	  Medaitek watchdog kicker is a kernel module to detect possible hang
	  issue.

	  Say Y here if you want to enable Mediatek watchdog kicker.
```

## drivers/wt_sys/Kconfig
```kconfig
config WT_SYSTEM
	tristate "CONFIG_WT_SYSTEM"
	default n

config WT_BOOTLOADER_LOG
	tristate "CONFIG_WT_BOOTLOADER_LOG"
	default n

config WT_BOOT_REASON
	tristate "CONFIG_WT_BOOT_REASON"
	default n
```

## drivers/xiaomi/bootmonitor/Kconfig
```kconfig
# SPDX-License-Identifier: GPL-2.0-only
#
# Mi boot monitor
#

config MI_BOOT_MONITOR
	tristate "boot monitor"
	default n
	help
	This adds support for mi boot monitor.
```

## drivers/xiaomi/boottime/Kconfig
```kconfig
# SPDX-License-Identifier: GPL-2.0-only
#
# Mi boot time
#

config MI_BOOT_TIME
	tristate "boot time record"
	default n
	help
	This adds support for mi boot time.
```

## drivers/xiaomi/dump_display/Kconfig
```kconfig
# SPDX-License-Identifier: GPL-2.0-only
#
# Mi dump display
#

config MI_DUMP_DISPLAY
	tristate "dump backtrace display"
	default n
	help
	This adds support for mi dump display.
```

## drivers/xiaomi/kshrink_slabd/Kconfig
```kconfig
config KSHRINK_SLABD
       tristate "Allow asynchronous shrink slab"
       default n
       help
         Asynchronous shrink slab memload optimization feature
```

## drivers/xiaomi/lz4asm/Kconfig
```kconfig
config LZ4ASM
       tristate "lz4asm support"
       depends on ARM64 && KERNEL_MODE_NEON && CFI_CLANG
       default n
       help
       LZ4 decompression optimization based on arm64 NEON instruction
```

## drivers/xiaomi/mi_stack/Kconfig
```kconfig
# SPDX-License-Identifier: GPL-2.0-only

config MI_STACK
	tristate "mi_stack support"
	default n
	help
		mi stack will show kernel stacktrace of the specified task.
```
