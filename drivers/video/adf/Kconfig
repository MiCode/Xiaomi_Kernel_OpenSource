## drivers/video/adf/Kconfig
```kconfig
menuconfig ADF
	depends on SYNC
	depends on DMA_SHARED_BUFFER
	tristate "Atomic Display Framework (ADF)"
	help
	  Enable support for Atomic display framework.

config ADF_FBDEV
	depends on ADF
	depends on FB
	tristate "ADF fbdev helper"
	help
	  Enable ADF framebuffer driver helpere.

config ADF_MEMBLOCK
	depends on ADF
	depends on HAVE_MEMBLOCK
	tristate "ADF memblock helpers"
	help
	  Enable ADF memory block helpers

config ADF_INTEL
	depends on ADF
	tristate "Intel Display Driver"
	help
	  Enable ADF compatible Intel display driver.

config ADF_INTEL_VLV
	bool "Valleyview/Cherryview"
	depends on ADF_INTEL
	default y
	help
	  Choose this option for common code on VLV/CHT platforms.

	  Google has come up with a new display framework called ADF. Intel
	  linux display team has come up with a new driver based on the ADF
	  framework. This options is for commond code for VLV/CHT in the ADF
	  compliant driver.

config ADF_INTEL_CHV
	bool "Only Cherryview specific"
	depends on ADF_INTEL_VLV
	help
	  Choose this option for specific code required for CHT platform.

	  Google has come up with a new display framework called ADF. Intel
	  linux display team has come up with a new driver based on the ADF
	  framework. This options is for specific code for CHT in the ADF
	  compliant driver.

config ADF_INTEL_FBDEV
	depends on ADF_INTEL && ADF_FBDEV
	tristate "Intel FBDEV Driver "
	help
	  Enable ADF based framebuffer driver for Intel displays.
```

## drivers/video/fbdev/msm/Kconfig
```kconfig
# SPDX-License-Identifier: GPL-2.0-only
source "drivers/video/fbdev/msm/msm_dba/Kconfig"

if FB_MSM

config FB_MSM_MDSS_COMMON
	bool

choice
	prompt "MDP HW version"
	default FB_MSM_MDP
	help
	The Mobile Display Processor (MDP) hardware version used in
	the chipset. The hardware version varies across multiple
	chipsets.

	Support for MDP HW.

config FB_MSM_MDP
	bool "MDP HW"
	select FB_MSM_MDP_HW
	help
	The Mobile Display Processor (MDP) driver support devices which
	contain MDP hardware block.

	Support for MSM MDP HW revision 2.2.
	Say Y here if this is msm7201 variant platform.

config FB_MSM_MDSS
	bool "MDSS HW"
	select SYNC_FILE
	select FB_MSM_MDSS_COMMON
	help
	The Mobile Display Sub System (MDSS) driver supports devices which
	contain MDSS hardware block.

	The MDSS driver implements frame buffer interface to provide access to
	the display hardware and provide a way for users to display graphics
	on connected display panels.

config FB_MSM_MDP_NONE
	bool "MDP HW None"
	help
	This is used for platforms without Mobile Display Sub System (MDSS).
	mdm platform don't have MDSS hardware block.

	Say Y here if this is mdm platform.

endchoice

config FB_MSM_QPIC
	bool
	select FB_MSM_MDSS_COMMON

config FB_MSM_QPIC_ILI_QVGA_PANEL
	bool "Qpic MIPI ILI QVGA Panel"
	select FB_MSM_QPIC
	---help---
	Support for MIPI ILI QVGA (240x320) panel ILI TECHNOLOGY 9341
	with on-chip full display RAM use parallel interface.

config FB_MSM_QPIC_PANEL_DETECT
	bool "Qpic Panel Detect"
	select FB_MSM_QPIC_ILI_QVGA_PANEL
	---help---
	Support for Qpic panel auto detect.

config FB_MSM_MDSS_WRITEBACK
	bool "MDSS Writeback Panel"
	---help---
	The MDSS Writeback Panel provides support for routing the output of
	MDSS frame buffer driver and MDP processing to memory.

config FB_MSM_MDSS_HDMI_PANEL
	bool "MDSS HDMI Tx Panel"
	depends on FB_MSM_MDSS
	select MSM_EXT_DISPLAY
	default n
	---help---
	The MDSS HDMI Panel provides support for transmitting TMDS signals of
	MDSS frame buffer data to connected hdmi compliant TVs, monitors etc.

config FB_MSM_MDSS_HDMI_MHL_SII8334
	depends on FB_MSM_MDSS_HDMI_PANEL
	bool 'MHL SII8334 support '
	default n
	---help---
	Support the HDMI to MHL conversion.
	MHL (Mobile High-Definition Link) technology
	uses USB connector to output HDMI content

config FB_MSM_MDSS_SPI_PANEL
	depends on SPI_QUP
	bool "Support SPI panel feature"
	---help---
	The MDSS SPI Panel provides support for transmittimg SPI signals of
	MDSS frame buffer data to connected panel. Limited by SPI clock rate,
	the current max fps only reach to ~30 fps with 240x240 resolution, and
	limited by MDP hardware architecture only supply GPU compostition.

config FB_MSM_MDSS_RGB_PANEL
	depends on FB_MSM_MDSS
	bool "Support RGB panel feature"
	---help---
	The MDSS RGB Panel provides support for transmitting
	MDSS frame buffer data over RGB parallel interface
	connected to RGB panel. Panel on/off sequence commands
	are sent to RGB Panel through an SPI interface.

config FB_MSM_MDSS_MHL3
	depends on FB_MSM_MDSS_HDMI_PANEL
	bool "MHL3 SII8620 Support"
	default n
	---help---
	Support the SiliconImage 8620 MHL Tx transmitter that uses
	USB connector to output HDMI content. Transmitter is an
	i2c device acting as an HDMI to MHL bridge. Chip supports
	MHL 3.0 standard.

config FB_MSM_MDSS_DSI_CTRL_STATUS
	tristate "DSI controller status check feature"
	---help---
	Check DSI controller status periodically (default period is 5
	seconds) by sending Bus-Turn-Around (BTA) command. If DSI controller
	fails to acknowledge the BTA command, it sends PANEL_ALIVE=0 status
	to HAL layer to reset the controller.

config FB_MSM_MDSS_DP_PANEL
        depends on FB_MSM_MDSS
        select MSM_EXT_DISPLAY
        bool "MDSS DP Panel"
        ---help---
	The MDSS DP Panel provides support for DP host controller driver
	which runs in Video mode only and is responsible for transmitting
	frame buffer from host SOC to DP display panel.

	support for DP display panel.

config FB_MSM_MDSS_EDP_PANEL
	depends on FB_MSM_MDSS
	bool "MDSS eDP Panel"
	---help---
	The MDSS eDP Panel provides support for eDP host controller driver.
	Which runs in Video mode only and is responsible for transmitting
	frame buffer from host SOC to eDP display panel.

config FB_MSM_MDSS_MDP3
	depends on FB_MSM_MDSS
	bool "MDP3 display controller"
	---help---
	The MDP3 provides support for an older version display controller.
	Included in latest display sub-system, known as MDSS.

config FB_MSM_MDSS_XLOG_DEBUG
	depends on FB_MSM_MDSS
	bool "Enable MDSS debugging"
	---help---
	The MDSS debugging provides support to enable display debugging
	features to: Dump MDSS registers during driver errors, panic
	driver during fatal errors and enable some display-driver logging
	into an internal buffer (this avoids logging overhead).

config FB_MSM_MDSS_FRC_DEBUG
	depends on DEBUG_FS && FB_MSM_MDSS
	bool "Enable Video FRC debugging"
	default n
	---help---
	The MDSS FRC debugging provides support to enable the deterministic
	frame rate control (FRC) debugging features to: Collect video frame
	statistics and check whether its output pattern matches expected
	cadence.

endif
```

## drivers/video/fbdev/msm/mhl3/sii6031/Kconfig
```kconfig
comment "Driver for Silicon Image SiI6031 MHL/USB switch (Stark)"

config SII6031_MHL_SWITCH
	bool "SIMG GPIO support"
	depends on GPIOLIB
	default y
	help
          yes links this driver.
          This driver is required by Qualcomm APQ8074 platform
          with modified usb otg driver (msm_otg.c) for SiI6031 switch.

          If unsure, say N.
```

## drivers/video/msm/Kconfig
```kconfig
source "drivers/video/msm/ba/Kconfig"
source "drivers/video/msm/msm_dba/Kconfig"

if FB_MSM
config FB_MSM_MDSS_COMMON
	bool

choice
	prompt "MDP HW version"
	default FB_MSM_MDP

config FB_MSM_MDP
	bool "MDP HW"
	---help---
	  Support for MSM MDP HW revision 2.2
	  Say Y here if this is msm7201 variant platform.

config FB_MSM_MDSS
	bool "MDSS HW"
	select SYNC
	select SW_SYNC
	select FB_MSM_MDSS_COMMON
	---help---
	The Mobile Display Sub System (MDSS) driver supports devices which
	contain MDSS hardware block.

	The MDSS driver implements frame buffer interface to provide access to
	the display hardware and provide a way for users to display graphics
	on connected display panels.

config FB_MSM_MDP_NONE
	bool "MDP HW None"
	---help---
	  Say Y here if this is mdm platform.

endchoice

config FB_MSM_QPIC
	bool
	select FB_MSM_MDSS_COMMON

config FB_MSM_QPIC_ILI_QVGA_PANEL
	bool "Qpic MIPI ILI QVGA Panel"
	select FB_MSM_QPIC
	---help---
	  Support for MIPI ILI QVGA (240x320) panel
	  ILI TECHNOLOGY 9341
	  with on-chip full display RAM
	  use parallel interface

config FB_MSM_QPIC_PANEL_DETECT
	bool "Qpic Panel Detect"
	select FB_MSM_QPIC_ILI_QVGA_PANEL
	---help---
	  Support for Qpic panel auto detect

config ENABLE_PM_TP_SUSPEND_RESUME
	bool "ENABLE PM TP SUSPEND/RESUME"
	---help---
	  Say Y here if you want to know whether it is running in ffbm mode.

if FB_MSM_MDSS
	source "drivers/video/msm/mdss/Kconfig"
endif
endif
```

## drivers/video/msm/ba/Kconfig
```kconfig
#
# MSM BA V4L2
#

config MSM_BA_V4L2
   tristate "Qualcomm technologies Inc MSM V4L2 based BA driver"
   depends on VIDEO_V4L2
   select FB_CFB_FILLRECT
   select FB_CFB_COPYAREA
   select FB_CFB_IMAGEBLIT
	---help---
	  Enables support for the MSM V4L2 bridge abstraction
```

## drivers/video/msm/mdss/Kconfig
```kconfig
config FB_MSM_MDSS_WRITEBACK
	bool "MDSS Writeback Panel"
	---help---
	The MDSS Writeback Panel provides support for routing the output of
	MDSS frame buffer driver and MDP processing to memory.

config FB_MSM_MDSS_HDMI_PANEL
	depends on FB_MSM_MDSS
	bool "MDSS HDMI Tx Panel"
	default n
	---help---
	The MDSS HDMI Panel provides support for transmitting TMDS signals of
	MDSS frame buffer data to connected hdmi compliant TVs, monitors etc.

config FB_MSM_MDSS_HDMI_MHL_SII8334
	depends on FB_MSM_MDSS_HDMI_PANEL
	bool 'MHL SII8334 support '
	default n
	---help---
	  Support the HDMI to MHL conversion.
	  MHL (Mobile High-Definition Link) technology
	  uses USB connector to output HDMI content

config FB_MSM_MDSS_MHL3
	depends on FB_MSM_MDSS_HDMI_PANEL
	bool "MHL3 SII8620 Support"
	default n
	---help---
	  Support the SiliconImage 8620 MHL Tx transmitter that uses
	  USB connector to output HDMI content. Transmitter is an
	  i2c device acting as an HDMI to MHL bridge. Chip supports
	  MHL 3.0 standard.

config FB_MSM_MDSS_DSI_CTRL_STATUS
	tristate "DSI controller status check feature"
	---help---
	  Check DSI controller status periodically (default period is 5
	  seconds) by sending Bus-Turn-Around (BTA) command. If DSI controller
	  fails to acknowledge the BTA command, it sends PANEL_ALIVE=0 status
	  to HAL layer to reset the controller.

config FB_MSM_MDSS_EDP_PANEL
	depends on FB_MSM_MDSS
	bool "MDSS eDP Panel"
	---help---
	The MDSS eDP Panel provides support for eDP host controller driver
	which runs in Video mode only and is responsible for transmitting
	frame buffer from host SOC to eDP display panel.

config FB_MSM_MDSS_MDP3
	depends on FB_MSM_MDSS
	bool "MDP3 display controller"
	---help---
	The MDP3 provides support for an older version display controller
	included in latest display sub-system, known as MDSS.

config FB_MSM_MDSS_XLOG_DEBUG
	depends on FB_MSM_MDSS
	bool "Enable MDSS debugging"
	---help---
	The MDSS debugging provides support to enable display debugging
	features to: Dump MDSS registers during driver errors, panic
	driver during fatal errors and enable some display-driver logging
	into an internal buffer (this avoids logging overhead).

config FB_MSM_MDSS_FRC_DEBUG
	depends on DEBUG_FS && FB_MSM_MDSS
	bool "Enable Video FRC debugging"
	default n
	---help---
	The MDSS FRC debugging provides support to enable the deterministic
	frame rate control (FRC) debugging features to: Collect video frame
	statistics and check whether its output pattern matches expected
	cadence.
```

## drivers/video/msm/mdss/mhl3/Kconfig
```kconfig
config MEDIA_DATA_TUNNEL_SUPPORT
	bool
	prompt "MHL Media Data Tunneling Support"
	default n
	---help---
	  This option controls whether or not Silicon Image MHL transmitter
	  drivers include support for Media Data Tunneling (MDT).  MDT
	  support enables HID events generated by HID devices attached to
	  an MDT capable MHL sink to be passed over the MHL connection
	  to the system.

config SII8620_MHL_TX
	tristate 
	prompt "Silicon Image 8620 HDMI to MHL Tx"
	depends on I2C
	default n
```

## drivers/video/msm/msm_dba/Kconfig
```kconfig
#
# MSM DBA
#

config MSM_DBA
	bool "MSM Display Bridge Abstraction support"
	depends on ARM || ARM64
	---help---
	  Support for MSM display bridge abstraction interface. MSM display
	  drivers can use the same interface to interact with different third
	  party bridge chips. Drivers implemented for third party bridge chips
	  should support this interface to allow display driver to control the
	  bridge chip. The MSM DBA driver maintains a list of devices supported
	  on the platform and allow clients to register and access these
	  devices.

config MSM_DBA_ADV7533
	bool "ADV7533 driver support through MSM DBA interface"
	depends on MSM_DBA
	default n
	---help---
	  Support for ADV7533 DSI to HDMI display bridge driver. The driver
	  controls the ADV7533 HW through the I2C interface and configures
	  the DSi input and HDMI output video format.
```

## drivers/video/msm/vidc/Kconfig
```kconfig
#
# VIDEO CORE
#
menuconfig MSM_VIDC
	bool "Video Core Driver"
	depends on ARCH_MSM8X60 || ARCH_MSM7X30 || ARCH_MSM8960
	default y
	---help---
	Say Y here to see options for video device drivers.
	If you say N, all options in this submenu will be skipped and disabled.

config MSM_VIDC_720P
	bool "720P Video Core"
	depends on MSM_VIDC && ARCH_MSM7X30
	default y
	help
	This option enables support for Video core.

config MSM_VIDC_1080P
	bool "1080P Video Core"
	depends on MSM_VIDC && (ARCH_MSM8X60 || ARCH_MSM8960)
	default y
	help
	This option enables support for Video core.

config MSM_VIDC_VENC
	tristate "Video encoder"
	depends on MSM_VIDC
	default y
	help
	This option enables support for Video encoder.

config MSM_VIDC_VDEC
	tristate "Video decoder"
	depends on MSM_VIDC
	default y
	help
	This option enables support for Video decoder.

config MSM_VIDC_CONTENT_PROTECTION
	bool "Enable Content Protection"
	help
	  Enable content protection feature for Video.
```
