## drivers/power/supply/mediatek/battery/Kconfig
```kconfig
 menuconfig MEDIATEK_BATTERY_SOLUTION
	bool "MediaTek Propritary Configuration for Battery"
	help
	  Check this to enable MediaTek Battery configuration.

config MTK_GAUGE_VERSION
	int "MediaTek Fuel Gauge version"
	default 20
	help
	  Select MTK Gauge Master version
	  30: Gauge Master 3.0

config MTK_DISABLE_GAUGE
	bool "disable Gauge Master 3.0"
	default n
	help
	  Set Yes to disable Gauge Master 3.0
	  under new MTK Charger Framework
	  Set No to enable Gauge Master 3.0
	  under new MTK Charger Framework

config MTK_ADDITIONAL_BATTERY_TABLE
	bool "Enable the fifth battery table"
	default y
	help
	  Set Yes to enable the fifth battery table
	  Table number is five.
	  Set No to disable the fifth battery table
	  Table number is four.
```

## drivers/power/supply/mediatek/charger/Kconfig
```kconfig
config MTK_CHARGER
	bool "MediaTek Charging Driver"
	depends on MEDIATEK_SOLUTION
	help
	  Say yes here to enable MediaTek charging driver.
	  This driver contains charging control flow and
	  maintains charging status.
	  Say no if not using MediaTek charging driver.

config POWER_EXT
	bool "MediaTek Power Ext"
	help
	  Check this if the device is not powered by battery.
	  For example, if the device is powered by AC adapter.
	  Select No if the device needs info about
	  battery voltage, temperature, etc.

config MTK_SWCHR_SUPPORT
	bool "MediaTek switch charger"
	depends on MTK_CHARGER
	help
	  This is to enable switching charger control flow.
	  switching charger has better performance than pulse charger
	  Set to yes if switching charger is used.
	  Set to no if pmic pulse charger is used.

config MTK_KERNEL_POWER_OFF_CHARGING
	bool "MTK kernel power off charging"
	depends on MTK_CHARGER
	help
	  yes : support KPOC feature, power off charging would running by
	  kernel and charging animation by kpoc service. no: not support KPOC
	  feature.
	  device won't enter charging mode if config is no.

config MTK_PUMP_EXPRESS_PLUS_SUPPORT
	bool "MediaTek PUMP EXPRESS PLUS"
	depends on MTK_CHARGER
	help
	  Fast charging technology using switch charger and current pattern
	  to achive better charging ability.
	  Set Yes to enable PE+
	  Set No to disable PE+

config MTK_PUMP_EXPRESS_PLUS_20_SUPPORT
	bool "MediaTek PUMP EXPRESS PLUS 2.0"
	depends on MTK_CHARGER
	help
	  Fast charging technology using switch charger and current pattern
	  to achive better charging ability. It has higher charging efficiency
	  and has better thermal performance than PE+.
	  Set Yes to enable PE+2.0
	  Set No to disable PE+2.0

config MTK_DUAL_CHARGER_SUPPORT
	bool "MediaTek dual charger support"
	depends on MTK_CHARGER
	help
	  Use two charging ICs (master and slave) to charge the system.
	  The master IC is connected to VBUS, VSYS, and VBAT, the slave
	  IC is conneceted to PMID pin from the master and VBAT.
	  Say Yes to enable dual charger support.

config SWCHR_POWER_PATH
	bool "External charger IC supports powerpath"
	depends on MTK_CHARGER
	help
	  Set Yes if the external charger IC
	  supports power path function.
	  This affects setting of auxadc channels
	  used to representing voltage of system
	  or battery.

config CHARGER_RT9465
	bool "Charger Driver for Richtek RT9465 Charger IC"
	depends on MTK_CHARGER
	help
	  Say Yes to enable Richtek RT9465 driver.
	  It is mainly used as slave IC for dual charger
	  application.
	  It depends on config MTK_CHARGER.

config CHARGER_RT9458
	bool "Charger Driver for Richtek RT9458 Charger IC"
	depends on MTK_SWCHR_SUPPORT
	help
	  Say Y to enable
	  Richtek RT9458 driver.
	  It depends on
	  the config MTK_SWCHR_SUPPORT.

config CHARGER_RT9466
	bool "Charger Driver for Richtek RT9466 Charger IC"
	depends on MTK_CHARGER
	help
	  Say Yes to enable Richtek RT9466 driver.
	  It is mainly used as slave IC for dual charger
	  application.
	  It depends on config MTK_CHARGER.

config CHARGER_RT9467
	bool "Charger Driver for Richtek RT9467 Charger IC"
	depends on MTK_CHARGER
	help
	  Say Yes to enable Richtek RT9467 driver.
	  It is mainly used as slave IC for dual charger
	  application.
	  It depends on config MTK_CHARGER.

config CHARGER_RT9471
	bool "Charger Driver for Richtek RT9471 Charger IC"
	depends on MTK_CHARGER
	help
	  Say Yes to enable Richtek RT9471 driver.
	  It supports RT9470/RT9470D/RT9471/RT9471D,
	  which RT9470D and RT9471D support BC1.2
	  It depends on config MTK_CHARGER.

config MTK_CHARGER_UNLIMITED
	bool "MediaTek Charger Unlimited"
	depends on MTK_CHARGER
	help
	  Say Yes to release charging current restrictions.
	  Say No to not release charging current restrictions.
	  It is mainly used for long-term tests.
	  It depends on config MTK_CHARGER.
```

## drivers/power/supply/mediatek/charger_begonia/Kconfig
```kconfig
config MTK_CHARGER
	bool "MediaTek Charging Driver"
	depends on MEDIATEK_SOLUTION
	default n
	help
	  Say yes here to enable MediaTek charging driver.
	  This driver contains charging control flow and
	  maintains charging status.
	  Say no if not using MediaTek charging driver.

config POWER_EXT
	bool "MediaTek Power Ext"
	default n
	help
	  Check this if the device is not powered by battery.
	  For example, if the device is powered by AC adapter.
	  Select No if the device needs info about
	  battery voltage, temperature, etc.

config MTK_SWCHR_SUPPORT
	bool "MediaTek switch charger"
	default n
	depends on MTK_CHARGER
	help
	  This is to enable switching charger control flow.
	  switching charger has better performance than pulse charger
	  Set to yes if switching charger is used.
	  Set to no if pmic pulse charger is used.

config MTK_KERNEL_POWER_OFF_CHARGING
	bool "MTK kernel power off charging"
	default n
	depends on MTK_CHARGER
	help
	  yes : support KPOC feature, power off charging would running by
	  kernel and charging animation by kpoc service. no: not support KPOC
	  feature.
	  device won't enter charging mode if config is no.

config MTK_PUMP_EXPRESS_PLUS_SUPPORT
	bool "MediaTek PUMP EXPRESS PLUS"
	default n
	depends on MTK_CHARGER
	help
	  Fast charging technology using switch charger and current pattern
	  to achive better charging ability.
	  Set Yes to enable PE+
	  Set No to disable PE+

config MTK_PUMP_EXPRESS_PLUS_20_SUPPORT
	bool "MediaTek PUMP EXPRESS PLUS 2.0"
	default n
	depends on MTK_CHARGER
	help
	  Fast charging technology using switch charger and current pattern
	  to achive better charging ability. It has higher charging efficiency
	  and has better thermal performance than PE+.
	  Set Yes to enable PE+2.0
	  Set No to disable PE+2.0

config MTK_DUAL_CHARGER_SUPPORT
	bool "MediaTek dual charger support"
	default n
	depends on MTK_CHARGER
	help
	  Use two charging ICs (master and slave) to charge the system.
	  The master IC is connected to VBUS, VSYS, and VBAT, the slave
	  IC is conneceted to PMID pin from the master and VBAT.
	  Say Yes to enable dual charger support.

config SWCHR_POWER_PATH
	bool "External charger IC supports powerpath"
	default n
	depends on MTK_CHARGER
	help
	  Set Yes if the external charger IC
	  supports power path function.
	  This affects setting of auxadc channels
	  used to representing voltage of system
	  or battery.

config MTK_BQ24196_SUPPORT
	bool "MediaTek Battery driver for TI BQ24196 charger IC"
	help
	  BQ24196 charger IC support
	  This is to enable MediaTek supports to BQ24196.
	  It depends on config MTK_SMART_BATTERY
	  and config MTK_SWCHR_SUPPORT
	  Set to Yes if BQ24196 is used.

config MTK_BQ24296_SUPPORT
	bool "MediaTek Battery driver for TI BQ24296 charger IC"
	help
	  This is to enable MediaTek supports to BQ24296 Charger IC.
	  It depends on config MTK_SMART_BATTERY
	  and config MTK_SWCHR_SUPPORT
	  Set to Yes if BQ24296 is used.

config CHARGER_RT9465
	bool "Charger Driver for Richtek RT9465 Charger IC"
	default n
	depends on MTK_CHARGER
	help
	  Say Yes to enable Richtek RT9465 driver.
	  It is mainly used as slave IC for dual charger
	  application.
	  It depends on config MTK_CHARGER.

config CHARGER_RT9458
	bool "Charger Driver for Richtek RT9458 Charger IC"
	default n
	depends on MTK_SWCHR_SUPPORT
	help
	  Say Y to enable
	  Richtek RT9458 driver.
	  It depends on
	  the config MTK_SWCHR_SUPPORT.

config SMB1351_USB_CHARGER
	bool "Charger Driver for SMB1351  Charger IC"
	default n
	depends on MTK_CHARGER
	help
	  Say Yes to enable SMB1351 driver.
          It is mainly used as slave IC for dual charger
          application.
          It depends on config MTK_CHARGER.

config CHARGER_RT9467
	bool "Charger Driver for Richtek RT9467 Charger IC"
	default n
	depends on MTK_CHARGER
	help
	  Say Yes to enable Richtek RT9467 driver.
	  It is mainly used as slave IC for dual charger
	  application.
	  It depends on config MTK_CHARGER.

config CHARGER_RT9471
	bool "Charger Driver for Richtek RT9471 Charger IC"
	default n
	depends on MTK_CHARGER
	help
	  Say Yes to enable Richtek RT9471 driver.
	  It supports RT9470/RT9470D/RT9471/RT9471D,
	  which RT9470D and RT9471D support BC1.2
	  It depends on config MTK_CHARGER.

config MTK_CHARGER_UNLIMITED
	bool "MediaTek Charger Unlimited"
	default n
	depends on MTK_CHARGER
	help
	  Say Yes to release charging current restrictions.
	  Say No to not release charging current restrictions.
	  It is mainly used for long-term tests.
	  It depends on config MTK_CHARGER.

config CHARGER_HL7005
	bool "Charger Driver for Halo HL7005 Charger IC"
	depends on MTK_SWCHR_SUPPORT
	help
	  Say Y to enable
	  Halo HL7005 driver.
	  It depends on config MTK_SWCHR_SUPPORT.

config CHARGER_BQ25601
	bool "CHARGER_BQ25601"
	help
	  This is to enable MediaTek supports to BQ25601.
	  It depends on config MTK_SMART_BATTERY
	  and config MTK_SWCHR_SUPPORT
	  Set to Yes if BQ25601 is used.
```

## drivers/power/supply/nopmi/Kconfig
```kconfig
# SPDX-License-Identifier: GPL-2.0-only

menu "No PMI Technologies, Inc. Charger and Fuel Gauge support"

config BQ2589X_CHARGER
	tristate "TI BQ2589X Battery Charger"
	depends on I2C
	help
	  Say Y to include support for BQ2589X Battery Charger.

config SH36610X_BATTERY
	tristate "SH36610x battery driver"
	depends on I2C
	help
		Say Y to enable support of SH36610x Battery Charger.

config QCOM_PMIC_VOTER
	tristate "QCOM pmic voter driver"
	help
	  Say Y to include support for QCOM pmic voter driver.

endmenu
```

## drivers/power/supply/pogoChg/Kconfig
```kconfig
# SPDX-License-Identifier: GPL-2.0-only

config  PD_RT17XX
	tristate "RT17XX PDPHY"
	depends on I2C
	default n
	help
	  Say Y to enable support for rt17xx pdphy.

config  WEINA_MCU8850
	tristate "WEINA 8850 SYNC"
	depends on SPI
	default n
	help
	  Say Y or N to enable support for wena 8850 sync.
```

## drivers/power/supply/qcom/Kconfig
```kconfig
# SPDX-License-Identifier: GPL-2.0-only

menuconfig QCOM_POWER_SUPPLY
	bool "Support for Qualcomm Technologies, Inc. power supply"
	depends on ARCH_QCOM
	help
	  Say Y here to enable Qualcomm Technologies, Inc. specific
	  power supply drivers. This allows adding support for various
	  charging peripherals and battery management features.
	  (if selected below).

if QCOM_POWER_SUPPLY

config QPNP_SMB5
	tristate "SMB5 Battery Charger"
	depends on MFD_SPMI_PMIC && IIO && TYPEC
	help
	  Say Y to enables support for the SMB5 charging peripheral.
	  The QPNP SMB5 charger driver supports the charger peripheral
	  present in the chip.
	  The power supply and iio frameworks are used to communicate battery
	  and usb properties to userspace and other driver consumers such
	  as fuel gauge, USB, and USB-PD.
	  VBUS and VCONN regulators are registered for supporting OTG,
	  and powered Type-C cables respectively.

	  To compile this driver as a module, choose M here: the
	  module will be called qpnp-smb5-main.

config QPNP_SMBLITE
	tristate "SMBLITE Battery Charger"
	depends on MFD_SPMI_PMIC
	help
	 Say Y to enable support for the SMBLITE charging peripheral.
	 The QPNP SMBLITE charger driver supports the charger peripheral
	 present in the chip.
	 The power supply framework is used to communicate battery and
	 usb properties to userspace and other driver consumers such
	 as fuel gauge and USB.
	 VBUS regulator is registered for supporting OTG.

config QTI_QBG
        tristate "QTI Battery Gauge"
        depends on MFD_SPMI_PMIC && IIO
        help
          Say Y here to enable the Qualcomm Technologies, Inc. Battery Gauge
          driver which uses the periodic samples of the battery voltage and
          current to determine the battery state-of-charge (SOC) and supports
          other battery management features.

          To compile this driver as a module, choose M here: the
          module will be called qti-qbg-main.
endif
```

## drivers/power/supply/ti/Kconfig
```kconfig
menu "TI Technologies, Inc. Charger support"

config BQ2597X_CHARGE_PUMP
	tristate "BQ2597X power supply framework based driver"
	depends on I2C
	help
	  Say Y to include support for BQ2597X Charge Pump driver based on
	  power supply framework.
	  BQ2597X is a div2 charge pump capable of delivering 8A charge current
	  with very high efficiency.

config CHARGER_LN8000
	tristate "LionSemi LN8000 Battery Charger"
	depends on I2C
	select REGMAP_I2C
	help
	  Say Y to enable support for the LN8000 charger

endmenu
```

## drivers/power/supply/ti_ares/Kconfig
```kconfig
menu "TI Technologies, Inc. Charger support"

config BQ2597X_CHARGE_PUMP
	tristate "BQ2597X power supply framework based driver"
	depends on I2C
	help
	  Say Y to include support for BQ2597X Charge Pump driver based on
	  power supply framework.
	  BQ2597X is a div2 charge pump capable of delivering 8A charge current
	  with very high efficiency.

endmenu
```

## drivers/power/supply/xiaomi/Kconfig
```kconfig
# SPDX-License-Identifier: GPL-2.0-only

config  PD_RT17XX
	tristate "RT17XX PDPHY"
	depends on I2C
	default n
	help
	  Say Y to enable support for rt17xx pdphy.

config  CHARGER_SYV690D
	tristate "SYV690D Charger"
	depends on I2C
	default n
	help
	  Say Y to enable support for syv690d Charger.

config  FUEL_GAUGE_BQ27Z561
	tristate "BQ27z561 fuel gauge driver"
	depends on I2C
	default n
	help
	  Say Y to enable support for bq27z561 fuel gauge driver

config  CHARGER_PUMP_SC8551A
	tristate "SC8551 Divider Charger Driver"
	depends on I2C
	default n
	help
	  Say Y to enable support for sc8551a charger pump driver

config  CHARGER_PUMP_LN8000
	tristate "LN8000 Divider Charger Driver"
	depends on I2C
	default n
	help
	  Say Y to enable support for ln8000 charger pump driver
```

## drivers/power/supply_K7B/ti/Kconfig
```kconfig
menu "TI Technologies, Inc. Charger support"

config BQ2597X_CHARGE_PUMP
	tristate "BQ2597X power supply framework based driver"
	depends on I2C
	help
	  Say Y to include support for BQ2597X Charge Pump driver based on
	  power supply framework.
	  BQ2597X is a div2 charge pump capable of delivering 8A charge current
	  with very high efficiency.

config LN8000_CHARGE_PUMP
	tristate "LN8000 power supply framework based driver"
	depends on I2C
	help
	  Say Y to include support for LN8000 Charge Pump driver based on
	  power supply framework.
	  LN8000 is a div2 charge pump capable of delivering 8A charge current
	  with very high efficiency.

endmenu
```
