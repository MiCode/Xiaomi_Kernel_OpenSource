## drivers/power/supply_mtk/mediatek/charger/Kconfig
```kconfig
config MTK_CHARGER
	bool "MediaTek Charging Driver"
	depends on MEDIATEK_SOLUTION
	help
	  Say yes here to enable MediaTek charging driver.
	  This driver contains charging control flow and
	  maintains charging status.
	  Say no if not using MediaTek charging driver.

config POWER_EXT
	bool "MediaTek Power Ext"
	help
	  Check this if the device is not powered by battery.
	  For example, if the device is powered by AC adapter.
	  Select No if the device needs info about
	  battery voltage, temperature, etc.

config MTK_SWCHR_SUPPORT
	bool "MediaTek switch charger"
	depends on MTK_CHARGER
	help
	  This is to enable switching charger control flow.
	  switching charger has better performance than pulse charger
	  Set to yes if switching charger is used.
	  Set to no if pmic pulse charger is used.

config MTK_KERNEL_POWER_OFF_CHARGING
	bool "MTK kernel power off charging"
	depends on MTK_CHARGER
	help
	  yes : support KPOC feature, power off charging would running by
	  kernel and charging animation by kpoc service. no: not support KPOC
	  feature.
	  device won't enter charging mode if config is no.

config MTK_PUMP_EXPRESS_PLUS_SUPPORT
	bool "MediaTek PUMP EXPRESS PLUS"
	depends on MTK_CHARGER
	help
	  Fast charging technology using switch charger and current pattern
	  to achive better charging ability.
	  Set Yes to enable PE+
	  Set No to disable PE+

config MTK_PUMP_EXPRESS_PLUS_20_SUPPORT
	bool "MediaTek PUMP EXPRESS PLUS 2.0"
	depends on MTK_CHARGER
	help
	  Fast charging technology using switch charger and current pattern
	  to achive better charging ability. It has higher charging efficiency
	  and has better thermal performance than PE+.
	  Set Yes to enable PE+2.0
	  Set No to disable PE+2.0

config MTK_PUMP_EXPRESS_50_SUPPORT
	bool "Mediatek Pump Express 5.0"
	select RT_PROP_CHGALGO
	depends on MTK_CHARGER
	help
	  Fast charging technology using divider charger to achieve better
	  charging ability. It has higher charging efficiency and better
	  thermal performance than using switching charger.
	  Set Yes to enable PE5.0
	  Set No to disable PE5.0

config MTK_DUAL_CHARGER_SUPPORT
	bool "MediaTek dual charger support"
	depends on MTK_CHARGER
	help
	  Use two charging ICs (master and slave) to charge the system.
	  The master IC is connected to VBUS, VSYS, and VBAT, the slave
	  IC is conneceted to PMID pin from the master and VBAT.
	  Say Yes to enable dual charger support.

config SWCHR_POWER_PATH
	bool "External charger IC supports powerpath"
	depends on MTK_CHARGER
	help
	  Set Yes if the external charger IC
	  supports power path function.
	  This affects setting of auxadc channels
	  used to representing voltage of system
	  or battery.

config MTK_BQ24196_SUPPORT
	bool "MediaTek Battery driver for TI BQ24196 charger IC"
	help
	  BQ24196 charger IC support
	  This is to enable MediaTek supports to BQ24196.
	  It depends on config MTK_SMART_BATTERY
	  and config MTK_SWCHR_SUPPORT
	  Set to Yes if BQ24196 is used.

config MTK_BQ24296_SUPPORT
	bool "MediaTek Battery driver for TI BQ24296 charger IC"
	help
	  This is to enable MediaTek supports to BQ24296 Charger IC.
	  It depends on config MTK_SMART_BATTERY
	  and config MTK_SWCHR_SUPPORT
	  Set to Yes if BQ24296 is used.

config CHARGER_MT6362
	tristate "MT6362 SPMI CHG driver"
	depends on MFD_MT6362
	help
	  Say yes here to have support for the MT6362 CHG
	  It supports BC1.2 and OTG boost.
	  The driver can also be build as a module.
	  If so, the module will be called mt6362_chg

config CHARGER_RT9465
	bool "Charger Driver for Richtek RT9465 Charger IC"
	depends on MTK_CHARGER
	help
	  Say Yes to enable Richtek RT9465 driver.
	  It is mainly used as slave IC for dual charger
	  application.
	  It depends on config MTK_CHARGER.

config CHARGER_RT9458
	bool "Charger Driver for Richtek RT9458 Charger IC"
	depends on MTK_SWCHR_SUPPORT
	help
	  Say Y to enable
	  Richtek RT9458 driver.
	  It depends on
	  the config MTK_SWCHR_SUPPORT.

config CHARGER_RT9466
	bool "Charger Driver for Richtek RT9466 Charger IC"
	default n
	depends on MTK_SWCHR_SUPPORT
	help
	  Say Yes to enable
	  Say No to disable
	  Richtek RT9466 driver.
	  It depends on config  MTK_SWCHR_SUPPORT.

config CHARGER_RT9467
	bool "Charger Driver for Richtek RT9467 Charger IC"
	depends on MTK_CHARGER
	help
	  Say Yes to enable Richtek RT9467 driver.
	  It is mainly used as slave IC for dual charger
	  application.
	  It depends on config MTK_CHARGER.

config CHARGER_RT9471
	bool "Charger Driver for Richtek RT9471 Charger IC"
	depends on MTK_CHARGER
	help
	  Say Yes to enable Richtek RT9471 charger driver.
	  It supports RT9470/RT9470D/RT9471/RT9471D/RT9472/RT9472D,
	  which RT9470D, RT9471D and RT9472D support BC1.2
	  It depends on config MTK_CHARGER.

config CHARGER_RT9759
	bool "Richtek RT9759 Divider Charger Driver"
	depends on MTK_CHARGER
	help
	  Say Y here to enable support of rt9759 divider charger
	  It is mainly used as divider charger for
	  direct charge
	  It depends on config MTK_CHARGER

config RT_PROP_CHGALGO
	bool "Richtek Proprietary Charging Algorithm"
	help
	  Say Y to enable
	  Richtek Proprietary charging algorithm
	  Say N to disable
	  Richtek Proprietary charging algorithm

config MTK_CHARGER_UNLIMITED
	bool "MediaTek Charger Unlimited"
	depends on MTK_CHARGER
	help
	  Say Yes to release charging current restrictions.
	  Say No to not release charging current restrictions.
	  It is mainly used for long-term tests.
	  It depends on config MTK_CHARGER.

config CHARGER_HL7005
	bool "Charger Driver for Halo HL7005 Charger IC"
	depends on MTK_SWCHR_SUPPORT
	help
	  Say Y to enable
	  Halo HL7005 driver.
	  It depends on config MTK_SWCHR_SUPPORT.

config CHARGER_BQ25601
	bool "CHARGER_BQ25601"
	help
	  This is to enable MediaTek supports to BQ25601.
	  It depends on config MTK_SMART_BATTERY
	  and config MTK_SWCHR_SUPPORT
	  Set to Yes if BQ25601 is used.

config LOAD_SWITCH_RT9750
	bool "Load Switch Driver for Richtek RT9750"
	depends on MTK_CHARGER
	help
	  Say Yes to enable Richtek RT9750 driver.
	  It is a load switch,
	  which is good for direct charge.
	  It depends on config MTK_CHARGER.
```

## drivers/power/xm_charge/Kconfig
```kconfig
config CHARGE_PROJECT
	string "CHARGE_PROJECT"
	help
	  Usually use to identify co-package.
```

## drivers/power/xm_power/Kconfig
```kconfig
config XM_POWER
	tristate "XM Power Debug Feature"
	default n
	help
	  XM Power Feature
```

## drivers/power/xm_power_debug/Kconfig
```kconfig
config XM_POWER_DEBUG
	tristate "XM Power Debug Feature"
	default n
	help
	  XM Power Debug Feature
```
