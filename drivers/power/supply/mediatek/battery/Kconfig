## drivers/scsi/ufs/vendor/Kconfig
```kconfig
config UFSFEATURE
	bool "UFS feature activate"
	depends on SCSI_UFSHCD
	help
	  UFS feature activate such as hpb, tw and etc.

config UFSSHPB
	bool "UFS Samsung Host Performance Booster support"
	depends on SCSI_UFSHCD && UFSFEATURE
	help
	  UFS HPB Feature Enable

config HPB_DEBUG
	bool "HPB Debug Log Enable"
	depends on SCSI_UFSHCD && UFSFEATURE && UFSSHPB
	default n
	help
	  UFS HPB Debug Enable (dmesg log[=if set debug sysfs] & BLK_TRACE msg)

config HPB_DEBUG_SYSFS
	bool "HPB Debug sysfs"
	depends on SCSI_UFSHCD && UFSFEATURE && UFSSHPB
	default n
	help
	  UFS HPB Debug Sysfs Enable

config HPB_ERR_INJECTION
	bool "HPB ERROR INJECTION"
	depends on SCSI_UFSHCD && UFSFEATURE && UFSSHPB
	help
	  error injection for checking HPB entry integrity

config UFSTW
	bool "UFS Turbo Write support"
	depends on SCSI_UFSHCD && UFSFEATURE
	help
	  UFS TW Feature Enable

config UFSTW_IGNORE_GUARANTEE_BIT
	bool "Ignore UFS Turbo Write Life Time Guarantee bit for POC"
	default n
	depends on SCSI_UFSHCD && UFSFEATURE && UFSTW
	help
	  ignore the guarantee bit[31] of dTurboWriteBufferLifeTimeEst for PoC

config UFSTW_BOOT_ENABLED
	bool "Turbo Write enabled at boot time"
	default y
	depends on SCSI_UFSHCD && UFSFEATURE && UFSTW
	help
	  fTurboWriteEn and fTurboWriteBufferFlushDuringHibnerEnter flags
	  are enabled at boot time.

config UFSHID
	bool "UFS Host Initiated Defrag support"
	depends on SCSI_UFSHCD && UFSFEATURE
	help
	  UFS HID Feature Enable

config UFSHID_POC
	bool "UFSHID_POC test"
	depends on SCSI_UFSHCD && UFSFEATURE && UFSHID
	help
	  UFS HID POC test
	  1. block to enter suspend state
	  2. auto_hibern8 enable/disable (HCI)
	  3. set flag bDefragOperation
	  4. debug msg enable (default : disable)

config UFSHID_DEBUG
	bool "HID Debug Enable"
	depends on SCSI_UFSHCD && UFSFEATURE && UFSHID
	default n
	help
	  UFS HID Debug Enable (for check io stat during trigger)

config UFSRINGBUF
	bool "UFS RingBuffer support"
	depends on SCSI_UFSHCD && UFSFEATURE
	help
	  UFS RingBuffer Feature Enable

config UFSRINGBUF_POC
	bool "UFS RingBuffer POC test"
	depends on SCSI_UFSHCD && UFSFEATURE && UFSRINGBUF
	help
	  UFS RingBuffer POC test
	  1. set default vendor_signature & vendor_parameter for test
	  2. Set custom vender_parameter

config UFS_MEDIATEK_INTERNAL
	bool "Mediatek UFS Internal Features"
	help
	  UFS features or code block that is kept available internally
	  and should not be upstreamed.
```

## drivers/sensors/Kconfig
```kconfig
config SENSORS
	bool "Sensors Class Support"
	help
	  This option enables the sensor sysfs class in /sys/class/sensors.
	  You'll need this to do anything useful with sensors. If unsure, say N.

config SENSORS_SSC
	bool "Enable Sensors Driver Support for SSC"
	help
	  Add support for sensors SSC driver.
	  This driver is used for exercising sensors use case,
	  time syncing with ADSP clock.
```

## drivers/sldriver/Kconfig
```kconfig
menu "Silent Lake drivers"
config VIDT
    tristate "Virtual Interrupt Descriptor Table"
    help
    VIDT driver
endmenu
```

## drivers/slimbus/Kconfig
```kconfig
# SPDX-License-Identifier: GPL-2.0
#
# SLIMbus driver configuration
#
menuconfig SLIMBUS
	tristate "SLIMbus support"
	depends on HAS_IOMEM
	help
	  Slimbus is standard interface between baseband and
	  application processors and peripheral components in mobile
	  terminals.

if SLIMBUS

# SLIMbus controllers
config SLIM_QCOM_CTRL
	tristate "Qualcomm SLIMbus Manager Component"
	depends on HAS_IOMEM
	help
	  Select driver if Qualcomm's SLIMbus Manager Component is
	  programmed using Linux kernel.

config SLIM_QCOM_NGD_CTRL
	tristate "Qualcomm SLIMbus Satellite Non-Generic Device Component"
	depends on HAS_IOMEM && DMA_ENGINE && NET
	depends on ARCH_QCOM || COMPILE_TEST
	select QCOM_QMI_HELPERS
	help
	  Select driver if Qualcomm's SLIMbus Satellite Non-Generic Device
	  Component is programmed using Linux kernel.
	  This is light-weight slimbus controller driver responsible for
	  communicating with slave HW directly over the bus using messaging
	  interface, and communicating with master component residing on ADSP
	  for bandwidth and data-channel management.

config SLIMBUS_MSM_CTRL
	tristate "QTI SLIMbus Master Component"
	help
	  Select driver for Qualcomm Technologies, Inc. (QTI) Slimbus
	  Master Component. This driver is responsible for configuring
	  SLIMbus and performing bus administration, administration of
	  components on the bus and dynamic channel allocation.

config SLIMBUS_MSM_NGD
	tristate "QTI Slimbus Satellite Component"
	help
	  Select driver for Qualcomm Technologies, Inc. (QTI) Slimbus
	  Satellite Component. This is light-weight slimbus controller
	  driver responsible for communicating with slave HW directly over
	  the bus using messaging interface, and communicating with master
	  component residing on ADSP for bandwidth and data-channel
	  management.

endif
```

## drivers/soc/mediatek/Kconfig
```kconfig
# SPDX-License-Identifier: GPL-2.0-only
#
# MediaTek SoC drivers
#
menu "MediaTek SoC drivers"
	depends on ARCH_MEDIATEK || COMPILE_TEST

config MTK_CMDQ
	tristate "MediaTek CMDQ Support"
	depends on ARCH_MEDIATEK || COMPILE_TEST
	select MAILBOX
	select MTK_CMDQ_MBOX
	select MTK_INFRACFG
	help
	  Say yes here to add support for the MediaTek Command Queue (CMDQ)
	  driver. The CMDQ is used to help read/write registers with critical
	  time limitation, such as updating display configuration during the
	  vblank.

config MTK_DVFSRC
	tristate "MediaTek DVFSRC Support"
	depends on ARCH_MEDIATEK
	select MTK_INFRACFG
	select PM_GENERIC_DOMAINS if PM
	depends on MTK_SCPSYS
	help
	  Say yes here to add support for the MediaTek DVFSRC (dynamic voltage
	  and frequency scaling resource collector) found
	  on different MediaTek SoCs. The DVFSRC is a proprietary
	  hardware which is used to collect all the requests from
	  system and turn into the decision of minimum Vcore voltage
	  and minimum DRAM frequency to fulfill those requests.

config MTK_DEVAPC
	tristate "Mediatek Device APC Support"
	help
	  Say yes here to enable support for Mediatek Device APC driver.
	  This driver is mainly used to handle the violation which catches
	  unexpected transaction.
	  The violation information is logged for further analysis or
	  countermeasures.

config MTK_INFRACFG
	bool "MediaTek INFRACFG Support"
	select REGMAP
	help
	  Say yes here to add support for the MediaTek INFRACFG controller. The
	  INFRACFG controller contains various infrastructure registers not
	  directly associated to any device.

config MTK_PMIC_WRAP
	tristate "MediaTek PMIC Wrapper Support"
	depends on RESET_CONTROLLER
	select REGMAP
	help
	  Say yes here to add support for MediaTek PMIC Wrapper found
	  on different MediaTek SoCs. The PMIC wrapper is a proprietary
	  hardware to connect the PMIC.

config MTK_SCPSYS
	tristate "MediaTek SCPSYS Support"
	default ARCH_MEDIATEK
	select REGMAP
	select PM_GENERIC_DOMAINS if PM
	help
	  Say yes here to add support for the MediaTek SCPSYS power domain
	  driver.

config MTK_SCPSYS_PM_DOMAINS
	tristate "MediaTek SCPSYS generic power domain"
	default ARCH_MEDIATEK
	depends on PM
	select PM_GENERIC_DOMAINS
	select REGMAP
	help
	  Say y here to enable power domain support.
	  In order to meet high performance and low power requirements, the System
	  Control Processor System (SCPSYS) has several power management related
	  tasks in the system.

config MTK_MMSYS
	tristate "MediaTek MMSYS Support"
	default ARCH_MEDIATEK
	depends on HAS_IOMEM
	help
	  Say yes here to add support for the MediaTek Multimedia
	  Subsystem (MMSYS).

config MTK_MMDVFS
	tristate "MediaTek MMDVFS Support"
	depends on ARCH_MEDIATEK || COMPILE_TEST
	depends on REGULATOR_MTK_DVFSRC
	help
	  Say yes here to add support for the MediaTek Multimedia DVFS (MMDVFS)
	  driver. The MMDVFS is used to set clk for Mediatek multimedia hardwares
	  , such as display, camera, mdp and video codec. Say no if your device
	  does not need to do DVFS for Multimedia hardwares.

config MTK_IPI
	tristate "MediaTek IPI Support"
	depends on RPMSG_MTK
	help
	  Say yes here to add support for the MediaTek IPI between tinysys.
	  MTK IPI consists of APIs to do Linux to/from uP/DSP communication
	  based on rpmsg. Synchronization among tasks is also handled by
	  this layer. If uP/DSP drivers handle by themselves, they can use
	  rpmsg directly.

config MTK_MBOX
	tristate "MediaTek Mbox Support"
	help
	  Say yes here to add support for the MediaTek Mbox driver.
	  MTK MBOX is a physical H/W which consists of configurable 128
	  or 256 bytes SRAM and 32 bit irq. The driver does read/write
	  SRAM and IRQ handling.

menu "Security"

source "drivers/soc/mediatek/devapc/Kconfig"
source "drivers/soc/mediatek/devmpu/Kconfig"

endmenu # Security

config MTK_SOCINFO
	tristate "MediaTek SoCInfo Driver"
	select SOC_BUS
	help
	  Include support for the SoC bus socinfo for the MediaTek SoC
	  platforms to provide information about the SoC family and
	  variant to user space.

endmenu
```

## drivers/soc/mediatek/devapc/Kconfig
```kconfig
config MTK_DEVAPC
	tristate "Mediatek Device APC Support"
	help
	  Device APC is a kernel driver controlling internal device security.
	  If someone tries to access a device, which is not allowed by the
	  device, it cannot access the device and will get a violation
	  interrupt. Device APC prevents malicious access to internal devices.

config DEVAPC_ARCH_COMMON
	tristate "Mediatek Device APC driver architecture common"
	help
	  Say yes here to enable support Mediatek
	  Device APC driver which is based on HW
	  architecture version 1.
	  This architecture supports common Infra-peri.

config DEVAPC_ARCH_MULTI
	tristate "Mediatek Device APC driver architecture multi"
	help
	  Say yes here to enable support Mediatek
	  Device APC driver which is based on HW
	  architecture version 2.
	  This architecture supports multiple Infra AO.

config MTK_SERROR_HOOK
	bool "Mediatek Slave Error Dump Hook Support"
	help
	  Say yes here to enable support Mediatek
	  slave error dump which can see Device APC driver
	  violation log in case of slave error happened.
	  This is for debug purpose.

config MTK_SABORT_HOOK
	bool "Mediatek Synchronous Abort Dump Hook Support"
	help
	  Say yes here to enable support Mediatek
	  synchronous abort dump which can see Device APC driver
	  violation log in case of synchronous abort happened.
	  This is for debug purpose.

config DEVAPC_MT6765
	tristate "Mediatek MT6765 Device APC driver"
	select MTK_DEVAPC
	help
	  Say yes here to enable support Mediatek MT6765
	  Device APC driver.

config DEVAPC_MT6768
	tristate "Mediatek MT6768 Device APC driver"
	select MTK_DEVAPC
	select DEVAPC_ARCH_COMMON
	help
	  Say yes here to enable support Mediatek MT6768
	  Device APC driver.
	  This driver is combined with DEVAPC_ARCH_COMMON for
	  common handle flow.

config DEVAPC_MT6789
	tristate "Mediatek MT6789 Device APC driver"
	select MTK_DEVAPC
	select DEVAPC_ARCH_MULTI
	help
	  Say yes here to enable support Mediatek MT6789
	  Device APC driver.
	  This driver is combined with DEVAPC_ARCH_MULTI for
	  common handle flow.

config DEVAPC_MT6833
	tristate "Mediatek MT6833 Device APC driver"
	select MTK_DEVAPC
	select DEVAPC_ARCH_MULTI
	help
	  Say yes here to enable support Mediatek MT6833
	  Device APC driver.
	  This driver is combined with DEVAPC_ARCH_MULTI for
	  common handle flow.

config DEVAPC_MT6853
	tristate "Mediatek MT6853 Device APC driver"
	select MTK_DEVAPC
	select DEVAPC_ARCH_MULTI
	help
	  Say yes here to enable support Mediatek MT6853
	  Device APC driver.
	  This driver is combined with DEVAPC_ARCH_MULTI for
	  common handle flow.

config DEVAPC_MT6855
	tristate "Mediatek MT6855 Device APC driver"
	select MTK_DEVAPC
	select DEVAPC_ARCH_MULTI
	help
	  Say yes here to enable support Mediatek MT6855
	  Device APC driver.
	  This driver is combined with DEVAPC_ARCH_MULTI for
	  common handle flow.

config DEVAPC_MT6873
	tristate "Mediatek MT6873 Device APC driver"
	select MTK_DEVAPC
	select DEVAPC_ARCH_MULTI
	help
	  Say yes here to enable support Mediatek MT6873
	  Device APC driver.
	  This driver is combined with DEVAPC_ARCH_MULTI for
	  common handle flow.

config DEVAPC_MT6879
	tristate "Mediatek MT6879 Device APC driver"
	select MTK_DEVAPC
	select DEVAPC_ARCH_MULTI
	help
	  Say yes here to enable support Mediatek MT6879
	  Device APC driver.
	  This driver is combined with DEVAPC_ARCH_MULTI for
	  common handle flow.

config DEVAPC_MT6893
	tristate "Mediatek MT6893 Device APC driver"
	select MTK_DEVAPC
	select DEVAPC_ARCH_MULTI
	help
	  Say yes here to enable support Mediatek MT6893
	  Device APC driver.
	  This driver is combined with DEVAPC_ARCH_MULTI for
	  common handle flow.

config DEVAPC_MT6895
	tristate "Mediatek MT6895 Device APC driver"
	select MTK_DEVAPC
	select DEVAPC_ARCH_MULTI
	help
	  Say yes here to enable support Mediatek MT6895
	  Device APC driver.
	  This driver is combined with DEVAPC_ARCH_MULTI for
	  common handle flow.

config DEVAPC_MT6983
	tristate "Mediatek MT6983 Device APC driver"
	select MTK_DEVAPC
	select DEVAPC_ARCH_MULTI
	help
	  Say yes here to enable support Mediatek MT6983
	  Device APC driver.
	  This driver is combined with DEVAPC_ARCH_MULTI for
	  common handle flow.
```
