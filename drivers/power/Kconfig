## drivers/power/Kconfig
```kconfig
source "drivers/power/avs/Kconfig"
source "drivers/power/reset/Kconfig"
source "drivers/power/supply/Kconfig"
source "drivers/power/xm_power_debug/Kconfig"
```

## drivers/power/avs/Kconfig
```kconfig
menuconfig POWER_AVS
	bool "Adaptive Voltage Scaling class support"
	help
	  AVS is a power management technique which finely controls the
	  operating voltage of a device in order to optimize (i.e. reduce)
	  its power consumption.
	  At a given operating point the voltage is adapted depending on
	  static factors (chip manufacturing process) and dynamic factors
	  (temperature depending performance).
	  AVS is also called SmartReflex on OMAP devices.

	  Say Y here to enable Adaptive Voltage Scaling class support.

config POWER_AVS_MSM
	bool "Enable Adaptive Voltage Scaling (AVS) for QCOM chipsets"
	default n
	help
	  Enable AVS hardware to fine tune voltage at each frequency. The
	  AVS hardware blocks associated with each Qualcomm ARMv7 cores can
	  fine tune the voltages based on the feedback from the ring
	  oscillators.
```

## drivers/power/byp/Kconfig
```kconfig
config POWER_BYP
	tristate "power byp support"
	default n
	help
 	  Say 'm' to compile as a module
 	  Say 'y' to build into the kernel
```

## drivers/power/mediatek/Kconfig
```kconfig
menuconfig MEDIATEK_CHARGING_SOLUTION
	bool "MediaTek Propritary Configuration for Charging"
	help
	  Check this to enable MediaTek charging configuration.

config MTK_SMART_BATTERY
	tristate "MediaTek Smart Battery Driver"
	help
	  Check this to enable MediaTek smart battery driver.
	  The driver supports charging control flow.
	  It maintais both charger and battery status.
	  It also includes Mediatek gas gauge.
	default n

config POWER_EXT
	tristate "MediaTek Power Ext"
	help
	  Check this if the device is not powered by battery.
	  For example, if the device is powered by AC adapter.
	  Select No if the device needs info about
	  battery voltage, temperature, etc.
	default n

config MTK_AUTO_POWER_ON_WITH_CHARGER
	bool "auto power on when charger in"
	help
	  Check this to support auto power on with charger.

	  In kernel it records necessary info in RTC to
	  support the boot behavior.
	default n

config MTK_SWCHR_SUPPORT
	tristate "MediaTek switch charger"
	help
	  This is to enable switching charger control flow.

	  Set to yes if switching charger is used.
	  Set to no if pmic pulse charger is used.
	default n

config MTK_BQ24160_SUPPORT
	bool "MTK_BQ24160_SUPPORT"
	help
	  This is to enable MediaTek supports to BQ24160.
	  It depends on config MTK_SMART_BATTERY
	  and config MTK_SWCHR_SUPPORT
	  Set to Yes if BQ24160 is used.
	default n

config MTK_BQ24196_SUPPORT
	bool "MediaTek Battery driver for TI BQ24196"
	help
	  BQ24196 charger IC support
          This is to enable MediaTek supports to BQ24196.
          It depends on config MTK_SMART_BATTERY
          and config MTK_SWCHR_SUPPORT
          Set to Yes if BQ24196 is used.
	default n

config MTK_BQ24296_SUPPORT
	bool "MTK_BQ24296_SUPPORT"
	help
          This is to enable MediaTek supports to BQ24296.
          It depends on config MTK_SMART_BATTERY
          and config MTK_SWCHR_SUPPORT
          Set to Yes if BQ24296 is used.
	default n

config MTK_NCP1854_SUPPORT
	bool "MTK_NCP1854_SUPPORT"
	help
          This is to enable MediaTek supports to NCP1854.
          It depends on config MTK_SMART_BATTERY
          and config MTK_SWCHR_SUPPORT
          Set to Yes if NCP1854 is used.
	default n

config MTK_BQ24297_SUPPORT
	bool "MTK_BQ24297_SUPPORT"
	help
          This is to enable MediaTek supports to BQ24297.
          It depends on config MTK_SMART_BATTERY
          and config MTK_SWCHR_SUPPORT
          Set to Yes if BQ24297 is used.
	default n

config MTK_BQ25890_SUPPORT
        bool "MTK_BQ25890_SUPPORT"
        help
          This is to enable MediaTek supports to BQ25890.
          It depends on config MTK_SMART_BATTERY
          and config MTK_SWCHR_SUPPORT
          Set to Yes if BQ25890 is used.
	default n

config MTK_FAN5405_SUPPORT
	bool "MTK_FAN5405_SUPPORT"
	help
          This is to enable MediaTek supports to FAN5405.
          It depends on config MTK_SMART_BATTERY
          and config MTK_SWCHR_SUPPORT
          Set to Yes if FAN5405 is used.
	default n

config MTK_RT9536_SUPPORT
	bool "MTK_RT9536_SUPPORT"
	help
	  This is to enable MediaTek supports to RT9536.
	  It depends on config MTK_SMART_BATTERY
	  and config MTK_SWCHR_SUPPORT
	  Set to Yes if RT9536 is used.
	default n

config MTK_DUAL_INPUT_CHARGER_SUPPORT
        bool "MTK_DUAL_INPUT_CHARGER_SUPPORT"
        help
          This is to enable MediaTek dual input charging.
          The feature can charge battery and use otg device
          at the same time with specific hardware.
        default n

config MTK_DISABLE_POWER_ON_OFF_VOLTAGE_LIMITATION
	bool "MTK_DISABLE_POWER_ON_OFF_VOLTAGE_LIMITATION"
	help
	  This to disable power on off condition check for device.
	  The check includes battery voltage and
	  battery temperature.
	  Enable this config if the device has no battery.
	default n

config MTK_KERNEL_POWER_OFF_CHARGING
	bool "MTK_KERNEL_POWER_OFF_CHARGING"
	help
	   yes : support KPOC feature, power off charging would running by
	   kernel and charging animation by kpoc service. no: not support KPOC
	   feature.
	   device won't enter charging mode if config is no.
	default n

config MTK_BATTERY_PROTECT
	bool "MTK_BATTERY_PROTECT"
	help
	  Mediatek  PMIC supports low battery protect.
	  This config enables notification of low battery event.
	  Enable this feature to support throttle of CPU power
	  to perform battery protect.
	default n

config MTK_BATTERY_THROTTLING
	bool "MTK_BATTERY_THROTTLING"
	help
	  Enable this feature to support active throttle
	  mechanism of CPU to save battery life.
	  The feature throttles CPU or GPU actively
	  to avoid device power drop due to instant
	  peak current.
	default n

config MTK_ENABLE_AGING_ALGORITHM
	bool "Enable MediaTek Battery Aging Algorithm"
	help
	  Enable this feature to enable aging check of battery
	  This feature helps to calibrate fuel gauge
	  by battery voltage.
	  It also helpful to predict aging of battery.
	default n

config MTK_BATTERY_LIFETIME_DATA_SUPPORT
	bool "Enable Battery LifeTime Data Logging"
	help
	  This config is to log battery related info.
	  Set yes and it would keep max/min voltage,
	  max/min charging current, max/min battery
	  temperature, etc.
	default n

config SOC_BY_HW_FG
	bool "Use MediaTek H/W Fuel Gauge"
	default n
	help
	  Mediatek fuel gauge algorithm option.
	  Enable this config to use MediaTek
	  hardware fuel gauge function.
	  It depends on the PMIC capability.

config SOC_BY_AUXADC
	bool "Only use AUXADC for Fuel Gauge"
	default n
	help
          Mediatek fuel gauge algorithm option.
          Enable this config to use MediaTek
          voltage-based fuel gauge function.
          It depends on the PMIC capability.

config SOC_BY_SW_FG
	bool "Use MediaTek S/W Fuel Gauge"
	default n
	help
          Mediatek fuel gauge algorithm option.
          Enable this config to use MediaTek
          software fuel gauge function.
          It depends on the PMIC capability.

config SWCHR_POWER_PATH
	bool "External charger IC supports powerpath"
	default n
	help
	  Set Yes if the external charger IC
	  supports power path function.
	  This affects setting of auxadc channels
	  used to representing voltage of system
	  or battery.

config CUSTOM_BATTERY_CYCLE_AGING_DATA
	bool "Custom battery aging data is provided"
	default n
	help
	  Set Yes if the battery aging table is provided.
	  It includes information about battery
	  capacity aging factor.
	  It is used for gas gauge calibration.

config MTK_JEITA_STANDARD_SUPPORT
	bool "JEITA standard support"
	default n
	help
	  Set Yes if JEITA charging control is needed.
	  MediaTek charging control flow supports
	  JEITA standard and could provide more
	  safety for charging function.

config BAT_LOW_TEMP_PROTECT_ENABLE
	bool "Disable charging when low temperature"
	default n
	help
	  Set Yes if charging needs to be disabled
	  for low temperature.
	  The temperature threshold is adjustable in battery
	  driver.

config STOP_CHARGING_IN_TAKLING
	bool "Hold charging in talking mode"
	default n
	help
	  Set Yes if charging needs to be disabled
	  during talking mode.
	  This is to provide better user experience
	  and safety option.

config CONFIG_DIS_CHECK_BATTERY
	bool "No shutdown if battery is not detected"
	default n
	help
	  Enable this config if device could not
	  be active without battery.
	  Disable this config if device battery could be
	  removed without affecting function.

config CONFIG_USB_IF
	bool "USB IF support"
	default n
	help
	  Set Yes to config if USB IF certification
	  is needed.
	  It limits charging current limit for USB.
	  Set No to config if USB IF is no need.


config HIGH_BATTERY_VOLTAGE_SUPPORT
	bool "Support battery above 4.3V"
	default n
	help
	  Set Yes to config if 4.35V battery is
	  to be supported.
	  Set No to config if 4.2V battery is
	  used.

config MTK_HAFG_20
	bool "MediaTek Fuel Gauge 2.0"
	default n
	help
	  fuel gauge 2.0
	  to achive better battery percentage.
	  Set Yes to support Fuel Gauge 2.0 feature.
	  Set No to disable Fuel Gauge 2.0.

config MTK_EMBEDDED_BATTERY
	bool "MediaTek Fuel Gauge 2.0 Embedded Battery"
	default n
	help
	  Embedded Battery Feature
	  Please note that fuel gauge 2.0 feature is must
	  Set Yes to support Fuel Gauge 2.0 Embedded Battery feature.
	  Set No to disable Fuel Gauge 2.0 Embedded Battery feature.

config MTK_PUMP_EXPRESS_SUPPORT
	bool "MediaTek PUMP EXPRESS"
	default n
	help
	  fast charging, by using linear charger
	  to achive better charging ability.
	  Set Yes to support PE feature.
	  Set No to disable PE.

config MTK_PUMP_EXPRESS_PLUS_SUPPORT
	bool "MediaTek PUMP EXPRESS PLUS"
	default n
	help
	  fast charging, by using switch charger
	  to achive better charging ability.
	  Set Yes to enable PE+.
	  Set No to disable PE+.

config MTK_PUMP_EXPRESS_PLUS_20_SUPPORT
	bool "MediaTek PUMP EXPRESS PLUS 2.0"
	default n
	help
	  fast charging, by using switch charger
	  to achive better charging ability,it reduce more IC heat than PE+
	  Set Yes to enable PE+20.
	  Set No to disable PE+20.

config MTK_BIF_SUPPORT
	bool "MTK_BIF_SUPPORT"
	default n
	help
	  Set yes to support BIF features of a
	  smart battery.
	  Set No to disable BIF feature of a
	  smart battery.
```
