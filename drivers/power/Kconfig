## drivers/power/mt81xx/Kconfig
```kconfig
menuconfig MEDIATEK_CHARGING_SOLUTION
	bool "MediaTek Propritary Configuration for Charging"
	help
	  Check this to enable MediaTek charging configuration.

config MTK_SMART_BATTERY
	bool "MediaTek Smart Battery Driver"
	help
	  Check this to enable MediaTek smart battery driver.
	  The driver supports charging control flow.
	  It maintais both charger and battery status.
	  It also includes Mediatek gas gauge.

config POWER_EXT
	bool "MediaTek Power Ext"
	help
	  Check this if the device is not powered by battery.
	  For example, if the device is powered by AC adapter.
	  Select No if the device needs info about
	  battery voltage, temperature, etc.

config MTK_AUTO_POWER_ON_WITH_CHARGER
	bool "auto power on when charger in"
	help
	  Check this to support auto power on
	  with charger.
	  In kernel it records necessary info in RTC to
	  support the boot behavior.

config MTK_SWCHR_SUPPORT
	bool "MediaTek switch charger"
	help
	  This is to enable switching charger
	  control flow.
	  Set to yes if switching charger is used.
	  Set to no if pmic pulse charger is used.

config MTK_BQ24160_SUPPORT
	bool "MediaTek Battery driver for TI bq24160 charger IC"
	help
	  This is to enable MediaTek supports to BQ24160 Charger IC.
	  It depends on config MTK_SMART_BATTERY
	  and config MTK_SWCHR_SUPPORT
	  Set to Yes if BQ24160 is used.

config MTK_BQ24196_SUPPORT
	bool "MediaTek Battery driver for TI BQ24196 charger IC"
	help
	  BQ24196 charger IC support
	  This is to enable MediaTek supports to BQ24196.
	  It depends on config MTK_SMART_BATTERY
	  and config MTK_SWCHR_SUPPORT
	  Set to Yes if BQ24196 is used.

config MTK_BQ24296_SUPPORT
	bool "MediaTek Battery driver for TI BQ24296 charger IC"
	help
	  This is to enable MediaTek supports to BQ24296.
	  It depends on config MTK_SMART_BATTERY
	  and config MTK_SWCHR_SUPPORT
	  Set to Yes if BQ24296 is used.

config MTK_BQ24297_SUPPORT
	bool "MediaTek Battery driver for TI BQ24297 charger IC"
	help
	  This is to enable MediaTek supports to BQ24297.
	  It depends on config MTK_SMART_BATTERY
	  and config MTK_SWCHR_SUPPORT
	  Set to Yes if BQ24297 is used.

config MTK_BQ24261_SUPPORT
	bool "MediaTek Battery driver for TI BQ24261 charger IC"
	help
	  This is to enable MediaTek supports to BQ24261.
	  It depends on config MTK_SMART_BATTERY
	  and config MTK_SWCHR_SUPPORT
	  Set to Yes if BQ24261 is used.

config MTK_RT9466_SUPPORT
	bool "MediaTek charger driver for Richtek RT9466"
	depends on MTK_SMART_BATTERY && MTK_SWCHR_SUPPORT
	help
	  This is to enable MediaTek supports to RT9466.
	  It depends on config MTK_SMART_BATTERY
	  and config MTK_SWCHR_SUPPORT
	  Set to Yes if RT9466 is used.

config CHARGER_SMB1351
	bool "Summit Microelectronics SMB1351 Battery Charger"
	depends on I2C
	select REGMAP_I2C
	help
	  This is to enable supports to SMB1351.
	  It depends on config MTK_SMART_BATTERY
	  Say Y to include support for Summit Microelectronics SMB1351
	  Battery Charger.

config MTK_BQ25890_SUPPORT
	bool "MediaTek Battery driver for TI BQ25890 charger IC"
	help
	  This is to enable MediaTek supports to BQ25890.
	  It depends on config MTK_SMART_BATTERY
	  and config MTK_SWCHR_SUPPORT
	  Set to Yes if BQ25890 is used.

config MTK_BQ25896_SUPPORT
	bool "MediaTek Battery driver for TI BQ25896 charger IC"
	help
	  This is to enable MediaTek supports to BQ25896.
	  It depends on config MTK_SMART_BATTERY
	  and config MTK_SWCHR_SUPPORT
	  Set to Yes if BQ25896 is used.

config MTK_DISABLE_POWER_ON_OFF_VOLTAGE_LIMITATION
	bool "Disable power on/off condition check for device"
	help
	  This to disable power on off condition check for device.
	  The check includes battery voltage and
	  battery temperature.
	  Enable this config if the device has no battery.

config MTK_KERNEL_POWER_OFF_CHARGING
	bool "MTK kernel power off charging"
	help
	  yes : support KPOC feature, power off charging would running by
	  kernel and charging animation by kpoc service. no: not support KPOC
	  feature.
	  device won't enter charging mode if config is no.

config MTK_BATTERY_PROTECT
	bool "Enable BATTERY PROTECT"
	help
	  Mediatek  PMIC supports low battery protect.
	  This config enables notification of low battery event.
	  Enable this feature to support throttle of CPU power
	  to perform battery protect.

config MTK_BATTERY_THROTTLING
	bool "Enable BATTERY THROTTLING"
	help
	  Enable this feature to support active throttle
	  mechanism of CPU to save battery life.
	  The feature throttles CPU or GPU actively
	  to avoid device power drop due to instant
	  peak current.

config MTK_ENABLE_AGING_ALGORITHM
	bool "Enable MediaTek Battery Aging Algorithm"
	help
	  Enable this feature to enable aging check of battery
	  This feature helps to calibrate fuel gauge
	  by battery voltage.
	  It also helpful to predict aging of battery.

config MTK_BATTERY_LIFETIME_DATA_SUPPORT
	bool "Enable Battery LifeTime Data Logging"
	help
	  This config is to log battery related info.
	  Set yes and it would keep max/min voltage,
	  max/min charging current, max/min battery
	  temperature, etc.

config SOC_BY_HW_FG
	bool "Use MediaTek H/W Fuel Gauge"
	help
	  Mediatek fuel gauge algorithm option.
	  Enable this config to use MediaTek
	  hardware fuel gauge function.
	  It depends on the PMIC capability.

config SOC_BY_AUXADC
	bool "Only use AUXADC for Fuel Gauge"
	help
	  Mediatek fuel gauge algorithm option.
	  Enable this config to use MediaTek
	  voltage-based fuel gauge function.
	  It depends on the PMIC capability.

config SOC_BY_SW_FG
	bool "Use MediaTek S/W Fuel Gauge"
	help
	  Mediatek fuel gauge algorithm option.
	  Enable this config to use MediaTek
	  software fuel gauge function.
	  It depends on the PMIC capability.

config SWCHR_POWER_PATH
	bool "External charger IC supports powerpath"
	help
	  Set Yes if the external charger IC
	  supports power path function.
	  This affects setting of auxadc channels
	  used to representing voltage of system
	  or battery.

config CUSTOM_BATTERY_CYCLE_AGING_DATA
	bool "Custom battery aging data is provided"
	help
	  Set Yes if the battery aging table is provided.
	  It includes information about battery
	  capacity aging factor.
	  It is used for gas gauge calibration.

config MTK_JEITA_STANDARD_SUPPORT
	bool "JEITA standard support"
	help
	  Set Yes if JEITA charging control is needed.
	  MediaTek charging control flow supports
	  JEITA standard and could provide more
	  safety for charging function.

config BAT_LOW_TEMP_PROTECT_ENABLE
	bool "Disable charging when low temperature"
	help
	  Set Yes if charging needs to be disabled
	  for low temperature.
	  The temperature threshold is adjustable in battery
	  driver.

config STOP_CHARGING_IN_TAKLING
	bool "Hold charging in talking mode"
	help
	  Set Yes if charging needs to be disabled
	  during talking mode.
	  This is to provide better user experience
	  and safety option.

config CONFIG_DIS_CHECK_BATTERY
	bool "No shutdown if battery is not detected"
	help
	  Enable this config if device could not
	  be active without battery.
	  Disable this config if device battery could be
	  removed without affecting function.

config CONFIG_USB_IF
	bool "USB IF support"
	help
	  Set Yes to config if USB IF certification
	  is needed.
	  It limits charging current limit for USB.
	  Set No to config if USB IF is no need.

config HIGH_BATTERY_VOLTAGE_SUPPORT
	bool "Support battery above 4.3V"
	help
	  Set Yes to config if 4.35V battery is
	  to be supported.
	  Set No to config if 4.2V battery is
	  used.

config MTK_PUMP_EXPRESS_PLUS_SUPPORT
	bool "MediaTek PUMP EXPRESS PLUS"
	help
	  fast charging, by using switch charger to achive better charging ability
	  enable this config to support high voltage charging
	  available vbus input includes 7V/9V/12V
	  the feature applies to standard charger with pump express plus support
```

## drivers/power/qcom-charger/Kconfig
```kconfig
menu "Qualcomm Technologies Inc Charger and FG Drivers"

config SMB135X_CHARGER
	tristate "SMB135X Battery Charger"
	depends on I2C
	select POWER_SUPPLY
	help
	  Say Y to include support for SMB135X Battery Charger.
	  SMB135X is a dual path switching mode charger capable of charging
	  the battery with 3Amps of current.
	  The driver supports charger enable/disable.
	  The driver reports the charger status via the power supply framework.
	  A charger status change triggers an IRQ via the device STAT pin.

config SMB1351_USB_CHARGER
	tristate "smb1351 usb charger (with VBUS detection)"
	depends on I2C
	select POWER_SUPPLY
	help
	 Say Y to enable support for the SMB1351 switching mode based charger.
	 The driver supports charging control (enable/disable) and
	 charge-current limiting. It also provides USB VBUS detection and
	 notification support. The driver controls SMB1351 via I2C and
	 supports device-tree interface.

config QPNP_SMB2
	tristate "SMB2 Battery Charger"
	depends on MFD_SPMI_PMIC
	select POWER_SUPPLY
	help
	  Say Y to enables support for the SMB2 charging peripheral.
	  The QPNP SMB2 charger driver supports the charger peripheral
	  present in the PMICOBALT chip.
	  The power supply framework is used to communicate battery and
	  usb properties to userspace and other driver consumers such
	  as fuel gauge, USB, and USB-PD.
	  VBUS and VCONN regulators are registered for supporting OTG,
	  and powered Type-C cables respectively.

endmenu
```

## drivers/power/qcom/Kconfig
```kconfig
config MSM_PM
	depends on PM
	select MSM_IDLE_STATS if DEBUG_FS
	select CPU_IDLE_MULTIPLE_DRIVERS
	bool "Qualcomm platform specific PM driver"
	help
	  Platform specific power driver to manage cores and l2
	  low power modes. It interface with various system
	  driver and put the cores into low power modes.

config MSM_NOPM
	default y if !PM
	bool
	help
	  This enables bare minimum support of power management at platform level.
	  i.e WFI

config APSS_CORE_EA
	depends on CPU_FREQ && PM_OPP
	bool "Qualcomm Technology Inc specific power aware driver"
	help
	  Platform specific power aware driver to provide power
	  and temperature information to the scheduler.

config MSM_APM
       bool "Qualcomm Technologies Inc platform specific APM driver"
       help
	Platform specific driver to manage the power source of
	memory arrays. Interfaces with regulator drivers to ensure
	SRAM Vmin requirements are met across different performance
	levels.

if MSM_PM
menuconfig MSM_IDLE_STATS
	bool "Collect idle statistics"
	help
	  Collect cores various low power mode idle statistics
	  and export them in proc/msm_pm_stats. User can read
	  this data and determine what low power modes and how
	  many times cores have entered into LPM modes.

if MSM_IDLE_STATS

config MSM_IDLE_STATS_FIRST_BUCKET
	int "First bucket time"
	default 62500
	help
	  Upper time limit in nanoseconds of first bucket.

config MSM_IDLE_STATS_BUCKET_SHIFT
	int "Bucket shift"
	default 2

config MSM_IDLE_STATS_BUCKET_COUNT
	int "Bucket count"
	default 10

config MSM_SUSPEND_STATS_FIRST_BUCKET
	int "First bucket time for suspend"
	default 1000000000
	help
	  Upper time limit in nanoseconds of first bucket of the
	  histogram.  This is for collecting statistics on suspend.

endif # MSM_IDLE_STATS
endif # MSM_PM
```

## drivers/power/supply/battery_secrete/Kconfig
```kconfig
config BATT_VERIFY_BY_DS28E30
	tristate "ds28e30 driver"
	default n
	help
		It needs a onewire physical controller to work.

config ONEWIRE_GPIO
	tristate "onewire gpio driver"
	default n
	help
		It's an onewire driver.
 
config BATT_VERIFY_BY_SLG
	tristate "slg driver"
	default n
	help
		It needs a onewire physical controller to work.
 
config BATT_VERIFY
	tristate "auth battery driver"
	default n
	help
		It needs a onewire physical controller to work.
```

## drivers/power/supply/cas_qcom/Kconfig
```kconfig
# SPDX-License-Identifier: GPL-2.0-only

menu "Qualcomm Technologies, Inc. Charger and Fuel Gauge support"

config QPNP_SMB5_CAS
	tristate "SMB5 Battery Charger"
	depends on MFD_SPMI_PMIC
	help
	  Say Y to enables support for the SMB5 charging peripheral.
	  The QPNP SMB5 charger driver supports the charger peripheral
	  present in the chip.
	  The power supply framework is used to communicate battery and
	  usb properties to userspace and other driver consumers such
	  as fuel gauge, USB, and USB-PD.
	  VBUS and VCONN regulators are registered for supporting OTG,
	  and powered Type-C cables respectively.

config SMB1398_CHARGER
        tristate "SMB1398 power supply framework based driver"
	depends on MFD_I2C_PMIC
	help
	  Say Y to include the support of SMB1398 Charge driver based on power
	  supply framework.
	  SMB1398 is a combo charger chip which can work in different modes:
	  (1) DIV2 charge pump mode to work as a companion charger to be paired
	  with Qualcomm Technologies, Inc.â<80><99>s family of standalone chargers;
	  (2) DIV2 and 3-level buck combo mode to regulate the output power from
	  wireless charger receiver and provide the input for downstream
	  chargers.

config CHARGER_BQ25790
	tristate "TI BQ25790 battery charger driver"
	depends on I2C
	help
	  Say Y to enable support for TI bq2588x charger driver

config FUEL_GAUGE_BQ28Z610
	tristate "TI bq28z610 battery gauge driver"
	help
	  Say Y to enable support for TI bq27z561 fuel gauge driver

config WATCHDOG_MAX28200
	tristate "maxim watch dog max28200 driver"
	help
	  Say Y to enable support for maxim max28200 driver

config CP_MAX77932
	tristate "maxim charger pump max77932 driver"
	help
	  Say Y to enable support for charger pump driver

config IDT_P9415_CAS
	tristate "idtp9415 wireless Charger"
	depends on I2C
	help
	  Say Y to include support for idtp9415 wireless Charger.
	  idtp9415 is a wireless battery charger.
	  The driver supports charger enable/disable.
	  The driver reports the charger status via the power supply framework.
	  The driver controls idtp9415 via I2C and
	  supports device-tree interface.

config RX1619_TRIM_CAS
	tristate "RX1619 TRIM"
	depends on I2C
	help
	  Say Y to include support for rx1619 wireless Charger.
	  RX1619 is a wireless battery charger chip.
	  The driver supports charger enable/disable.
	  The driver reports the charger status via the power supply framework.
	  The driver controls rx1619 via I2C and
	  supports device-tree interface.

config RX1619_CAS
	tristate "RX1619 wireless Charger"
	depends on I2C
	help
	  Say Y to include support for rx1619 wireless Charger.
	  RX1619 is a wireless battery charger chip.
	  The driver supports charger enable/disable.
	  The driver reports the charger status via the power supply framework.
	  The driver controls rx1619 via I2C and
	  supports device-tree interface.
endmenu
```
