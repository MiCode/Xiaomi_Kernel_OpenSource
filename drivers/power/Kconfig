## drivers/power/supply/hq_chg/Kconfig
```kconfig
# SPDX-License-Identifier: GPL-2.0
#charge_policy
source "drivers/power/supply/hq_chg/charger_policy/Kconfig"

#sc_charger
source "drivers/power/supply/hq_chg/sc_charger/Kconfig"

#protocol
source "drivers/power/supply/hq_chg/sc_charger/protocol/Kconfig"

#subpimc
source "drivers/power/supply/hq_chg/sc_charger/subpmic/Kconfig"

#nu_charger
source "drivers/power/supply/hq_chg/nu_charger/Kconfig"

#nuvolta subpimc
source "drivers/power/supply/hq_chg/nu_charger/subpmic/Kconfig"

#fuelgauge
source "drivers/power/supply/hq_chg/fuelgauge/Kconfig"

#bq_charger
source "drivers/power/supply/hq_chg/bq_charger/Kconfig"

source "drivers/power/supply/hq_chg/battery_secrete/Kconfig"

config HUAQIN_ADAPTER_CLASS
	tristate "support hauqin charger adapter class"
	default n
	help
		Say Y here to support hauqin charger adapter class.

config HUAQIN_CHARGER_CLASS
	tristate "support hauqin charger class"
	default n
	help
		Say Y here to support hauqin charger class.

config HUAQIN_CP_CLASS
	tristate "support hauqin chager pump class"
	default n
	help
		Say Y here to support hauqin chager pump class.

config PD_BATTERY_SECRET
	tristate "pd battery secret"
	default n
	help
		Say Y here to support pd battery secret.

config XIAOMI_SMART_CHG
        tristate "support xiaomi smart charge"
        default n
        help
                Say Y here to support xiaomi smart charge.

config XM_CHG_ANIMATION
        tristate "support xiaomi charge animation"
        default n
        help
                Say Y here to support xiaomi charge animation.

config XM_FG_I2C_ERR
        tristate "support xiaomi fg i2c error"
        default n
        help
                Say Y here to support xiaomi fg i2c error.
```

## drivers/power/supply/hq_chg/battery_secrete/Kconfig
```kconfig
config BATT_VERIFY_BY_DS28E30
	tristate "ds28e30 driver"
	prompt "Support ds28e16 as encryption IC."
	default y
	help
		It needs a onewire physical controller to work.

config ONEWIRE_GPIO
	tristate "onewire gpio driver"
	prompt "Support Onewire Driver."
	default y
	help
		It's an onewire driver.

config BATT_VERIFY_BY_SLG
	tristate "slg driver"
	prompt "Support slg as encryption IC."
	default y
	help
		It needs a onewire physical controller to work.

# N19A code for HQ-360184 by p-wumingzhu1 at 20240103 start 
config BATT_VERIFY_BY_ST
	tristate "st driver"
	prompt "Support sti as encryption IC."
	default m
	help
		It's an onewire driver.
# N19A code for HQ-360184 by p-wumingzhu1 at 20240103 end

config BATT_VERIFY
	tristate "auth battery driver"
	prompt "Support auth battery."
	default y
	help
		It needs a onewire physical controller to work.
```

## drivers/power/supply/hq_chg/bq_charger/Kconfig
```kconfig
#SPDX-License-Identifier: GPL-2.0

config 	BQ_CHARGERPUMP_BQ25960
	tristate "BQ charger support policy"
	default n
	help
		Say Y here to support southchip charger policy.
```

## drivers/power/supply/hq_chg/charger_policy/Kconfig
```kconfig
#SPDX-License-Identifier: GPL-2.0

config HUAQIN_CHARGER_MANAGER
	tristate "support hauqin charger manger"
	default n
	help
		Say Y here to support hauqin charger manger.

config HUAQIN_CP_POLICY
	tristate "support hauqin charger pump policy"
	default n
	help
		Say Y here to support hauqin charger class.

config HUAQIN_QC_POLICY
	tristate "support hauqin qc policy"
	default n
	help
		Say Y here to support hauqin charger class.

config BC12_RETRY_FOR_MI_PD
	tristate "support retry BC1.2"
	default n
	help
		Say Y here to support retry BC1.2.
```

## drivers/power/supply/hq_chg/fuelgauge/Kconfig
```kconfig
#SPDX-License-Identifier: GPL-2.0

config BQ_FUELGAUGE
	tristate "bq28z610 fuelgauge"
	default n
	help
		Say Y here to support bq28z610 fuelgauge.
```

## drivers/power/supply/hq_chg/nu_charger/Kconfig
```kconfig
#SPDX-License-Identifier: GPL-2.0

config NU_CHARGER
	tristate "Nuvolta charger support policy"
	default n
	help
		Say Y here to support nuvolta charger policy.
```

## drivers/power/supply/hq_chg/nu_charger/chargerpump/Kconfig
```kconfig
config NU_CHARGERPUMP_DRIVER
    tristate "nuvolta cp driver"
    default n
    help
      Say Y to use nuvolta cp driver

config NU_CHARGERPUMP_NU2115
    tristate "nuvolta cp nu2115"
    default n
	help
      Say Y to use nuvolta cp nu2115 driver
```

## drivers/power/supply/hq_chg/nu_charger/subpmic/Kconfig
```kconfig
config NU_SUBPMIC_DRIVER
    tristate "nuvolta subpmic driver"
    default n
    help
      Say Y to use subpmic core driver

config NU_SUBPMIC_NU6601
    tristate "subpmic nu6601"
    default n
	help
      Say Y to use nuvolta subpmic nu6601 driver
```

## drivers/power/supply/hq_chg/sc_charger/Kconfig
```kconfig
#SPDX-License-Identifier: GPL-2.0

config SC_CHARGER
	tristate "Southchip charger support policy"
	default n
	help
		Say Y here to support southchip charger policy.
```

## drivers/power/supply/hq_chg/sc_charger/protocol/Kconfig
```kconfig
menuconfig PROTOCOL
	tristate "support protocol for southchip"
	help
	  Say Y here to support protocol.

if PROTOCOL

source "drivers/power/supply/hq_chg/sc_charger/protocol/bc12/Kconfig"

endif
```

## drivers/power/supply/hq_chg/sc_charger/protocol/bc12/Kconfig
```kconfig
config BC12
        tristate "software bc12 protocol"
        default n
        help
          If you say yes here you will get support for the software bc12 protocol.
```

## drivers/power/supply/hq_chg/sc_charger/subpmic/Kconfig
```kconfig
config SUBPMIC_DRIVER
    tristate "subpmic driver"
    default n
    help
      Say Y to use subpmic core driver

config SUBPMIC_6601
    tristate "subpmic 6601"
    default n
	help
      Say Y to use subpmic core driver
```

## drivers/power/supply/lx_chg/fuelgauge/Kconfig
```kconfig
#SPDX-License-Identifier: GPL-2.0

config BQ_FUELGAUGE
	tristate "bq28z610 fuelgauge"
	default n
	help
		Say Y here to support bq28z610 fuelgauge.

config CHARGE_PARTITION
	tristate "charge partition"
    depends on BQ_FUELGAUGE
    help
	  charge partition write/read in kernel
```

## drivers/power/supply/maxim/Kconfig
```kconfig
config FUELGAUGE_MAX77729
	bool
	prompt "Support as maxim fuel gauge IC."
	default n
	help
		It's an fuel gauge driver.

config CHARGER_MAX77729
	bool
	prompt "Support charger Driver."
	default n
	help
		It's an charger driver.
```

## drivers/power/supply/maxim_pipa/Kconfig
```kconfig
config BATT_VERIFY_BY_DS28E16_PIPA
	bool
	prompt "Support ds28e16 as encryption IC."
	default n
	help
		It needs a onewire physical controller to work.

config ONEWIRE_GPIO_PIPA
	bool
	prompt "Support Onewire Driver."
	default n
	help
		It's an onewire driver.
```
