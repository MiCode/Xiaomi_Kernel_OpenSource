## drivers/misc/goodix/Kconfig
```kconfig
config GOODIX_FINGERPRINT
	tristate "generic goodix fingerprint driver"
	default y
	help
	add support for goodix fingerprint driver.
```

## drivers/misc/gps/Kconfig
```kconfig
# Copyright Statement:
#
#  Read-Copy Update mechanism for mutual exclusion
#
#  This program is free software; you can redistribute it and/or modify
#  it under the terms of the GNU General Public License as published by
#  the Free Software Foundation; either version 2 of the License, or
#  (at your option) any later version.
#
#  This program is distributed in the hope that it will be useful,
#  but WITHOUT ANY WARRANTY; without even the implied warranty of
#  MERCHANTABILITY or FITNESS FOR A PARTICULAR PURPOSE.  See the
#  GNU General Public License for more details.
#
#  Copyright MediaTek Corporation, 2010
#
#  Authors: Hua Fu <Hua.Fu@mediatek.com>
#         Yongqing Han <yongqing.han@mediatek.com>





menuconfig GPS
	tristate "GPS drivers"
	default y
	---help---
	  Say Y here for supporting GPS.

if GPS

config MTK_GPS
	tristate "MT3332 GPS driver"
	depends on GPS=y
	default y
	---help---
	  MT6620 internal GPS driver

endif # GPS
```

## drivers/misc/haptic_nv/Kconfig
```kconfig
config AWINIC_HAPTIC_NV
	tristate "Awinic AW8624 haptic driver"
	depends on I2C
	default n
	help
	  Say Y here if you have Awinic AW8624 haptic controller
	  chip in your system.
	  If unsure, say N.
	  To compile this driver as a module, choose M here.
```

## drivers/misc/hdcp/Kconfig
```kconfig
# SPDX-License-Identifier: GPL-2.0-only
config HDCP_QSEECOM
        tristate "QTI High-Bandwidth Digital Content Protection Module"
        depends on QSEECOM
        help
          This module implements HDCP 2.2 features over external interfaces
          such as the DisplayPort interface. It exposes APIs for the interface
          driver to communicate with QTI Secure Execution Environment (QSEE)
          via the QSEECOM Driver and also communicates with the Receiver via
          APIs exposed by the interface driver.
```

## drivers/misc/heci/Kconfig
```kconfig
config INTEL_ISS
	tristate "Intel Integrated Sensors Solution"
	depends on X86 && PCI
	help
	  ISS enabled sensors hub functionality on SoC/chipset level.
	  Placeholder for description line 2.
	  Placeholder for description line 3.
	  Placeholder for description line 4.

config ISS_PATH_SENSCOL
	tristate "ISS path through sensor-collection"
	depends on INTEL_ISS
	help
	  Enables sensor-collection path for hid-sensor-hub.
	  Placeholder for description line 2.
	  Placeholder for description line 3.
	  Placeholder for description line 4.

config ISS_PATH_IIO
	tristate "ISS path through IIO"
	depends on INTEL_ISS
	help
	  Enables IIO path for hid-sensor-hub.
	  Placeholder for description line 2.
	  Placeholder for description line 3.
	  Placeholder for description line 4.
```

## drivers/misc/hqfactoryboot/Kconfig
```kconfig
config BOOT_INTO_FACTORY_MODE
	bool CONFIG_BOOT_INTO_FACTORY_MODE
	default n
	help
	 CONFIG_BOOT_INTO_FACTORY_MODE
```

## drivers/misc/hqhardwareinfo/Kconfig
```kconfig
config HQ_HARDWARE_INFO
	bool CONFIG_HQ_HARDWARE_INFO
	default y
	help
	  CONFIG_HQ_HARDWARE_INFO

config HQ_BOARDINFO_BY_ADC
	bool CONFIG_HQ_BOARDINFO_BY_ADC
	default n
	help
	  show boardinfo by adc
```

## drivers/misc/hqsysfs/Kconfig
```kconfig
config HQ_SYSFS_SUPPORT
  tristate "Enable Huaqin Sysfs Driver"
  default n
  help
    Huaqin Sysfs information driver includes specific information about hardware info and other info for HQ tools

config SERIAL_NUM
  tristate "serial num setting"
  default n
  help
    serial num setting
```

## drivers/misc/hwid/Kconfig
```kconfig
# SPDX-License-Identifier: GPL-2.0
#
# MI_HARDWARE_ID info
#
config MI_HARDWARE_ID
	tristate "Register xiaomi hwid module"
	default n
	help
	  This adds support for mi hwid.
```

## drivers/misc/intel_ld/Kconfig
```kconfig
config INTEL_ST_LD
	tristate "Intel Shared transport driver"
	default m
	help
	   Select this module for shared transport driver
```

## drivers/misc/isl97900_led/Kconfig
```kconfig
# SPDX-License-Identifier: GPL-2.0-only
#
# ISL97900 LED driver configuration
#

config ISL97900_LED
	tristate "ISL97900_I2C_Driver"
	select REGMAP_I2C
	depends on I2C
	help
	  Support for ISL97900 LED driver IC, using this driver,
	  user can set different values to control the LED current
	  using I2C.

	  Say Y if you want to enable ISL97900 driver.
```

## drivers/misc/issp/Kconfig
```kconfig
config ISSP
	bool "Cypress in-system serial programming (ISSP) interface"
	default n
	---help---
	Cypress in-system serial programming (ISSP) interface is used to
	program Cypress micro controllers.
```

## drivers/misc/ktd3136_bl/Kconfig
```kconfig
#
# KTD3136 backlight IC driver configuration
#

config KTD3136_BL
	tristate "KTD3136 backlight IC"
	default m
	help
	  Say Y here if you have KTD3136 backlight IC.
	  If unsure, say N.
```
