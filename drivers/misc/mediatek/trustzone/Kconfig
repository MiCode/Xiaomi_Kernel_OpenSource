## drivers/misc/mediatek/usb20/Kconfig
```kconfig
config USB_MTK_HDRC
	tristate "MediaTek MUSB support"
	select USB_GADGET_SELECTED
	select USB_GADGET_DUALSPEED
	help
	  Say Y here if your system has a high speed USB
	  controller based on the MTK MUSB IP.  Then
	  configure options to match your silicon and the board
	  it's being used with, including the USB peripheral role,
	  or the USB host role, or both.

config MTK_MUSB_QMU_SUPPORT
	bool "QMU Transfer mode of MediaTek MUSB"
	depends on USB_MTK_HDRC
	help
	  Say Y here if your system has a QMU capability for USB
	  controller based on the MTK MUSB IP.
	  QMU is some kind of enhanced DMA mode by HW queeu rather
	  than SW queue to reduce SW effort.

config MTK_MUSB_QMU_PURE_ZLP_SUPPORT
	bool "Transfer ZLP by GDP of MediaTek MUSB"
	depends on MTK_MUSB_QMU_SUPPORT
	help
	  Say Y here if QMU IP supports sending zero
	  length packet(ZLP) by setting ZLP flag in GDP
	  and the driver can enable by internal register.
	  After MT6763 should support this feature.

config MTK_MUSB_DRV_36BIT
	bool "MediaTek MUSB 36bits addressing support"
	default n
	help
	  This selects the MediaTek MUSB support 36-bits
	  address accessing.
	  Say Y here if you want to enable 36-bits addressing support.
	  If unsure, say N.

config USB_MTK_OTG
	bool "MediaTek MUSB OTG support"
	help
	  Enable Mediatek USB Host OTG detection mechanism
	  and USB-IF Compliance Test Program.
	  1. IDDIG - OTG cable attachment detection.
	  2. DRVVBUS - provides the VBUS for the attached devices

config USB_MTK_CHARGER_DETECT
	bool "MediaTek MUSB charger detect"
	depends on MTK_USBFSH
	help
	  If make port1 enable in mt8163, please open the config.
	  When port0 is using, plug in device to port1,
	  port0 will get the disconnect. fix the issue, need open
	  the config.

config MTK_UART_USB_SWITCH
	bool "MediaTek UART could use USB DATA pins"
	help
	  This is a feature for debugging purpose.
	  It uses the USB TX/RX as UART TX/RX.
	  A USB to UART cable is needed to use this feature.
	  Using the UI in the EngineerMode to switch between USB and UART mode.
	  After switching to UART mode and connect to the PC with a USB to UART cable,
	  you can connect to a Virtual COM port on the PC and get the log output to the UART console.

config MTK_MUSB_CARPLAY_SUPPORT
	bool "MediaTek MUSB Carplay support"
	help
	  Say Y here if your want to use carplay.

config MTK_MUSB_SW_WITCH_MODE
	bool "MediaTek MUSB provide user space interface to switch usb role without id pin"
	help
	  Usb host/device/idle mode switch through command, not only depend on ID pin.
	  Say Y here if your want to use software to switch usb mode.

config MTK_MUSB_PORT0_LOWPOWER_MODE
	bool "MediaTek MUSB PORT0 low power mode support"
	help
	  Dynamic control the usb port0 clock when PORT1 not exist.
	  Say Y here if your want to enable port0 low power mode for saving power.

config MTK_MUSB_DUAL_ROLE
	bool "Mediatek MUSB Dual Role mode support"
	select USB_ROLE_SWITCH
	help
	  This is the default mode of working of MTK MUSB controller
	  where both host and gadget
	  features are enabled.
	  It is better to be used with Mediatek extcon and tphy support.
	  Say Y here if your want to use usb role switch.

config MTK_MUSB_PHY
	tristate "MediaTek USB20 PHY support"
        help
          MediaTek USB20 PHY support.
```

## drivers/misc/mediatek/usb2jtag/Kconfig
```kconfig
config MTK_USB2JTAG_SUPPORT
	bool "Enable serial-wired JTAG Debugging through usb port"
	help
	  After selecting both this option and MTK_USB2JTAG_SUPPORT in LK,
	  users could type fastboot command 'fastboot oem usb2jtag 1' to
	  enter the USB2JTAG debug mode. ('fastboot oem usb2jtag 0' for
	  returning to normal mode).
	  Note: Parallel-wired JTAG Debugging and USB driver
	  would be disabled in USB2JTAG debug mode.
```

## drivers/misc/mediatek/usb_boost/Kconfig
```kconfig
#
# MediaTek USB Boost Driver
#

config MTK_USB_BOOST
	tristate "Mediatek USB BOOST Driver"
	help
	  Enables to support usb-boost.
	  If unsure, say N.
```

## drivers/misc/mediatek/usb_c/Kconfig
```kconfig
#
# MediaTek USB USB TYPEC Driver
#

config USB_C_SWITCH
        bool "USB TYPE-C Driver"
        default n
	---help---
	  Enables to support usb-c. So the usb device and host driver register
          the callback func to the usb-c driver. When the usb-c driver detect
          a device/host plugged in/out, it will notify the device/host driver
          by callback func.
	  If unsure, say N.

config USB_C_SWITCH_FUSB302
	bool "MediaTek USB TYPE-C Driver with external solution (FUSB302)"
	default n
	select USB_C_SWITCH
	---help---
	  Enable to support usb-c.
          usb-c is supported by fusb302 and fusb340 and redriver.
          Only supports CC detect, without PD.
          And support DRP, aka UFP and DFP mode.
          If unsure, say N.

config USB_C_SWITCH_SII70XX
	bool "MediaTek USB TYPE-C Driver with external solution (sii70xx)"
	default n
	select USB_C_SWITCH
	---help---
	  Enable to support usb-c.
          usb-c is supported by Sii7033 and redriver.
          Sii7033 supports CC detect, PD and MHL alt mode.
          And support DRP, aka UFP and DFP mode.
          If unsure, say N.

config USB_C_SWITCH_SII70XX_MHL_MODE
	bool "MediaTek USB TYPE-C Driver with external solution (sii70xx MHL Mode)"
	default n
	---help---
	  Enable to support usb-c MHL Mode.
          usb-c is supported by Sii7033 and redriver.
          Sii7033 MHL Mode supports only MHL alt mode.
          If unsure, say N.

config USB_C_SWITCH_ANX7418
	bool "Analogix Type-C interface support"
	default n
	select USB_C_SWITCH
	---help---
	  Enable to support usb-c.
          usb-c is supported by ANX7418.
          ANX7418 supports CC detect, PD and DP alt mode.
          And support DRP, aka UFP and DFP mode.
          If unsure, say N.

config USB_C_SWITCH_MT6353
	bool "MediaTek USB TYPE-C Driver (MT6353)"
	default n
	select USB_C_SWITCH
	---help---
	  Enable to support usb-c.
	  Enables support .
	  usb-c is supported by MT6353 USB TYPE-C (CC only).
	  MT6353 supports CC detect. And support DRP, aka UFP and DFP mode.
	  PD and MHL alt mode are not supported.
	  If unsure, say N.
```

## drivers/misc/mediatek/usb_meta/Kconfig
```kconfig
# SPDX-License-Identifier: GPL-2.0
#
# For MTK USB3.0 IP

config MTK_USB_META
	tristate "MediaTek USB META"
	depends on USB_LIBCOMPOSITE
	help
	  Say Y or M here if your system runs on MediaTek SoCs with
	  'Fast Meta' feature. The feature will generate a virtual comport
	  and that will make 'meta mode" connected faster.

	  If you don't know what this is, please say N.

	  Choose M here to compile this driver as a module, and it
	  will be called meta.ko.
```

## drivers/misc/mediatek/usb_mtp/Kconfig
```kconfig
config USB_CONFIGFS_F_MTP
	tristate "MTP gadget"
	depends on USB_CONFIGFS
	help
	  USB gadget MTP support
```
