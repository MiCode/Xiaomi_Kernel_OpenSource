## drivers/misc/mediatek/trustzone/Kconfig
```kconfig
config HAVE_MTK_IN_HOUSE_TEE_SUPPORT
	bool "Enable MTK in-house TEE Solution"
	def_bool n
	help
	  This option decides if the chip can support MTK TEE.
	  Set to yes if MTK TEE is supported.
	  If you don't know if it is supported, setting to no.
	  This option is needed if you would like to turn on MTK TEE.

config MTK_IN_HOUSE_TEE_SUPPORT
	bool "Enable MTK In House TEE Support"
	depends on HAVE_MTK_IN_HOUSE_TEE_SUPPORT
	default n
	help
	  This enable MTK TEE support.

config MTEE_CMA_SECURE_MEMORY
	bool "MTEE using CMA for secure memory allocation"
	depends on OF
	depends on CMA
	depends on MTK_IN_HOUSE_TEE_SUPPORT
	help
	  Enable allocation secure memory from CMA to free the memory
	  back to Linux CMA when secure memory buffer was not used.
```

## drivers/misc/mediatek/typec/Kconfig
```kconfig
#
# MediaTek USB TYPEC Driver
#

config MTK_USB_TYPEC
	bool "Mediatek USB TYPE-C Driver"
	---help---
	  Enables to support usb-c. So the usb device and host driver register
	  the callback func to the usb-c driver. When the usb-c driver detect
	  a device/host plugged in/out, it will notify the device/host driver
	  by callback func.
	  If unsure, say N.

config MTK_USB_TYPEC_DP_MUX
	bool "Mediatek USB TYPE-C USB DP Mux"
	---help---
	  Enables to support USB DP mux in usb-c.
	  To support TYPE-C USB DP must have a MUX to switch
	  SSRX1/SSTX1/SSRX2/SSTX2 pins.
	  Say Y to enable TYPEC DP Mux
	  If unsure, say N.

config MTK_USB_TYPEC_U3_MUX
	bool "Mediatek USB TYPE-C USB 3.0 Mux"
	---help---
	  Enables to support USB3.0 mux in usb-c.
	  To support TYPE-C USB3.0 must have a MUX to switch
	  SSRX1/SSTX1/SSRX2/SSTX2 pins.
	  Say Y to enable TYPEC USB3.0 Mux
	  If unsure, say N.

config MTK_USB_TYPEC_U3_MUX_V2
	bool "Mediatek USB TYPE-C USB 3.0 Mux V2"
	select MTK_USB_TYPEC_U3_MUX
	help
	  Enable to support Mediatek Type-c mux driver v2 version.
	  The v2 version depends on v1 version configration.
	  It is more easily for customer to manager and add mux
	  module driver.

config TCPC_MT6360
	bool "MediaTek MT6360 TypeC port Controller Driver"
	depends on TCPC_CLASS
	help
	  Say Y to enable MediaTek MT6370
	  TypeC port Controller
	  Also Support Power Delivery
	  Say N to disable

config MTK_TYPEC_WATER_DETECT
	bool "Water detection function for type-c connector"
	depends on TCPC_CLASS
	help
	  Say Yes to enable water detection on type-c connector.
	  If water is detected on the connector, it will show
	  warning to notify end user.
	  If unsure, say N.

config MTK_TYPEC_WATER_DETECT_BY_PCB
	bool "Let PCB decides enabling water detection or not"
	depends on MTK_TYPEC_WATER_DETECT
	help
	  Query GPIO on PCB to judge whether type-c water detection
	  need to be enabled.
	  Say Yes to let PCB decides enabling water detection or not.
	  If unsure, say N.

source "drivers/misc/mediatek/typec/tcpc/Kconfig"
```

## drivers/misc/mediatek/typec/fusb302b/Kconfig
```kconfig
config TYPEC_FUSB302
    tristate "TYPEC_FUSB302 driver"
    depends on I2C
    help
        Say Y or M here if your system has fusb302 ic controller.
```

## drivers/misc/mediatek/typec/mux/Kconfig
```kconfig
# SPDX-License-Identifier: GPL-2.0

config MTK_USB_TYPEC_MUX
	tristate "Mediatek USB TYPE-C Mux Driver"
        select MTK_USB_TYPEC
	help
	  Say Y or M to support Mediatek USB Type-c mux switch
	  driver. MTK Type-c mux driver is a simple architecture
	  mux driver and  control multiple mux switch IC. Works
	  with Type-C Port Controller Manager

config TYPEC_MUX_FUSB304
	tristate "TI FUSB304 Type-C cross switch driver"
	depends on MTK_USB_TYPEC_MUX
	help
	  Say Y or M if your system has a TI FUSB304
	  Type-C cross switch / mux chip found on some
	  devices with a Type-C port. Works with Type-C
	  Port Controller Manager.

config TYPEC_MUX_PTN36241G
	tristate "NXP PTN36241G USB3 Redriver"
	depends on MTK_USB_TYPEC_MUX
	help
	  Say Y or M if your system has a NXP PTN36241G USB3.0 Redriver.
	  Works with Type-C Port Controller Manager.

config TYPEC_MUX_PS5169
	tristate "Parade PS5169 USB Type-C Linear Redriver"
	depends on MTK_USB_TYPEC_MUX
	help
	  Say Y or M if your system has a PS5169 USB Type-C
	  Linear Redriver. Support Type-c USB SSRX1/SSTX1/SSRX2/SSTX2
	  signal driving control. Works with Type-C Port
	  Controller Manager.

config TYPEC_MUX_PS5170
	tristate "Parade PS5170 USB Type-C Linear Redriver"
	depends on MTK_USB_TYPEC_MUX
	help
	  Say Y or M if your system has a PS5170 USB Type-C
	  Linear Redriver. Support Type-c USB SSRX1/SSTX1/SSRX2/SSTX2
	  and DP signal driving control. Works with Type-C Port
	  Controller Manager.

config TYPEC_MUX_DP_SELECTOR
	tristate "USB DP SIGNAL SELECTOR"
	depends on MTK_USB_TYPEC_MUX
	help
	  Say Y or M if your system has a integrate USB/DP selector.
	  Support USB/DP channel switch.
	  Works with Type-C Port Controller Manager.
	  If unsure, say N.

config TYPEC_MUX_PI3DPX1205A
	tristate "DIODES USB TYPE-C DP Linear Redriver"
	depends on MTK_USB_TYPEC_MUX
	help
	  Enables to support USB DP mux in usb-c.
	  To support TYPE-C USB DP must have a MUX to switch
	  SSRX1/SSTX1/SSRX2/SSTX2 pins.
	  Say Y to enable TYPEC DP Mux
	  If unsure, say N.
```

## drivers/misc/mediatek/typec/tcpc/Kconfig
```kconfig
#
# TypeC Port Controller Device Configuration
#

config TCPC_CLASS
	bool "TypeC Port Controller Device Class"
	select MTK_USB_TYPEC
	select TYPEC
	help
	  Say Y to enable
	  Typec Port
	  Controller Device
	  Class

config TCPC_RT1711H
	bool "Richtek RT1711H TypeC port Controller Driver"
	depends on TCPC_CLASS
	default n
	help
	  Say Y to enable
	  Richtek RT1711H
	  TypeC port Controller
	  Driver

config TCPC_RT5081
	bool "Richtek RT5081 TypeC port Controller Driver"
	depends on TCPC_CLASS
	default n
	help
	  Say Y to enable Richtek RT5081
	  TypeC port Controller
	  Also Support Power Delivery
	  Say N to disable

config TCPC_MT6360
	bool "MediaTek MT6360 TypeC port Controller Driver"
	depends on TCPC_CLASS
	help
	  Say Y to enable MediaTek MT6370
	  TypeC port Controller
	  Also Support Power Delivery
	  Say N to disable

config TCPC_MT6362
	tristate "MT6362 SPMI TCPC driver"
	depends on TCPC_CLASS
	depends on MFD_MT6362
	help
	  Say yes here to have support for the MT6362 TCPC
	  Support TypeC port Controller and Power Delivery

	  The driver can also be build as a module.
	  If so, the module will be called tcpci_mt6362

config TCPC_MT6370
	bool "MediaTek MT6370 TypeC port Controller Driver"
	depends on TCPC_CLASS
	default n
	help
	  Say Y to enable MediaTek MT6370
	  TypeC port Controller
	  Also Support Power Delivery
	  Say N to disable

config PD_DBG_INFO
	bool "TCPC power delivery debug information"
	depends on TCPC_CLASS
	default y
	help
	  Say Y to enable
	  power delivery
	  debug information
	  Say N to disable

config USB_POWER_DELIVERY
	bool "Support USB power delivery Function"
	depends on TCPC_CLASS
	default n
	help
	  Say Y to enable
	  USB
	  Power Delivery
	  support

config USB_PD_VBUS_STABLE_TOUT
	int "PD VBUS Stable Timeout"
	depends on USB_POWER_DELIVERY
	range 0 1000                       # >= 0,  <= 1000
	default 125
	help
	  Setup a timeout value (ms)
	  for
	  VBUS change
	  stable

config MTK_TYPEC_WATER_DETECT
	bool "Water detection function for type-c connector"
	depends on TCPC_CLASS
	help
	  Say Yes to enable water detection on type-c connector.
	  If water is detected on the connector, it will show
	  warning to notify end user.
	  If unsure, say N.

config MTK_TYPEC_WATER_DETECT_BY_PCB
	bool "Let PCB decides enabling water detection or not"
	depends on MTK_TYPEC_WATER_DETECT
	help
	  Query GPIO on PCB to judge whether type-c water detection
	  need to be enabled.
	  Say Yes to let PCB decides enabling water detection or not.
	  If unsure, say N.
```

## drivers/misc/mediatek/uart/Kconfig
```kconfig
# Serial Port Driver
menuconfig MTK_SERIAL
	tristate "MediaTek Serial Port Support"
	select SERIAL_CORE
	default y
	---help---
	  This selects MediaTek(R) internal UART driver.
	  If you want to use MediaTek(R) internal UART driver, say Y or M here.
	  If unsure, say N.

config MTK_SERIAL_CONSOLE
	bool "MediaTek Console on Serial Port Support"
	depends on MTK_SERIAL=y
	select SERIAL_CORE_CONSOLE
	default y
	---help---
	  Say Y here if you wish to use MT6516 internal UART as the system
	  console.
	  You should alter the default console setting by kernel
	  command line option "console=ttyMT0" or "console=ttyMT1".

config MTK_SERIAL_MODEM_TEST
	bool "Support modem test"
	depends on MTK_SERIAL=y
	default n
	---help---
	  Say Y here is you want to enable modem test.
	  After enabling this option, UART4 will be switched to modem side.
	  Hence, the command line parameter should be also modified.
	  This is for test purpose only.
```

## drivers/misc/mediatek/uarthub/Kconfig
```kconfig
config MTK_UARTHUB
	tristate "MediaTek UARTHUB Driver"
	help
	  MTK UARTHUB driver for 3 pin reduction
	  the first is apmcu bt host interface
	  the second is md mcu coexistence sw message
	  the third is adsp bt audio message
```

## drivers/misc/mediatek/udi/Kconfig
```kconfig
config MTK_UNIFIED_DEBUG_INTERFACE
	tristate "Mediatek Unified Debug Interface"
	help
	  UDI config to support Unified Debug Interface
	  Note:
	  This is a CPU related debug feature, it is recommended to enable.
	  If unsure, say N.
```

## drivers/misc/mediatek/uncali_acc/Kconfig
```kconfig
config CUSTOM_KERNEL_UNCALI_ACC_SENSOR
	bool "CUSTOM_KERNEL_UNCALI_ACC_SENSOR"
	help
	  Kernel space rotation vector sensor driver.

source "drivers/misc/mediatek/uncali_acc/uncali_acchub/Kconfig"
```

## drivers/misc/mediatek/uncali_gyro/Kconfig
```kconfig
config CUSTOM_KERNEL_UNCALI_GYRO_SENSOR
	bool "CUSTOM_KERNEL_UNCALI_GYRO_SENSOR"
	help
	  Kernel space rotation vector sensor driver.

source "drivers/misc/mediatek/uncali_gyro/uncali_gyrohub/Kconfig"
```

## drivers/misc/mediatek/uncali_mag/Kconfig
```kconfig
config CUSTOM_KERNEL_UNCALI_MAG_SENSOR
	bool "CUSTOM_KERNEL_UNCALI_MAG_SENSOR"
	help
	  Kernel space rotation vector sensor driver.

source "drivers/misc/mediatek/uncali_mag/uncali_maghub/Kconfig"
```

## drivers/misc/mediatek/upower/Kconfig
```kconfig
config MTK_UNIFIED_POWER
	tristate "MediaTek unified power Module"
	help
	  This driver Describes the Standard for measuring power.
	  Those leakage (mw) are calculated by Efuse value and ATE Voltage.
	  Select "y" if you want to enable this features.
	  Select "n" if unsure.

config MTK_EEM_READY
	def_bool y
	depends on MTK_EEM
	help
	  This driver depends PPM
	  Select "y" if you want to enable this features.
	  Select "n" if unsure.
```

## drivers/misc/mediatek/usb/Kconfig
```kconfig
# SPDX-License-Identifier: GPL-2.0

source "drivers/misc/mediatek/usb/usb_meta/Kconfig"
source "drivers/misc/mediatek/usb/usb_rndis/Kconfig"
source "drivers/misc/mediatek/usb/usb_boost/Kconfig"
source "drivers/misc/mediatek/usb/usb_offload/Kconfig"
```

## drivers/misc/mediatek/usb/usb_offload/Kconfig
```kconfig
# SPDX-License-Identifier: GPL-2.0
#
# For MTK USB3.0 IP

config MTK_USB_OFFLOAD
	tristate "MediaTek USB Offload"
	help
	  Say Y or M here if your system runs on MediaTek SoCs with
	  'USB Offload' feature. The feature will use ADSP to transfer
	  Audio ISOC data.

	  If you don't know what this is, please say N.

	  Choose M here to compile this driver as a module, and it
	  will be called usb_offload.ko
```

## drivers/misc/mediatek/usb/usb_rndis/Kconfig
```kconfig
config MTK_USB_CONFIGFS_RNDIS
	tristate "MTK RNDIS"
	depends on USB_CONFIGFS
	depends on NET
	select MTK_USB_U_ETHER
	select MTK_USB_F_RNDIS
	help
	   MTK RNDIS -
	   Microsoft Windows XP bundles the "Remote NDIS" (RNDIS) protocol,
	   and Microsoft provides redistributable binary RNDIS drivers for
	   older versions of Windows.

	   To make MS-Windows work with this, use Documentation/usb/linux.inf
	   as the "driver info file".  For versions of MS-Windows older than
	   XP, you'll need to download drivers from Microsoft's website; a URL
	   is given in comments found in that info file.

config MTK_USB_U_ETHER
	tristate

config MTK_USB_F_RNDIS
	tristate
```

## drivers/misc/mediatek/usb/usb_xhci/Kconfig
```kconfig
# SPDX-License-Identifier: GPL-2.0
#
# USB Host Controller Drivers
#

config DEVICE_MODULES_USB_XHCI_MTK
	tristate "xHCI support for MediaTek SoCs"
	select MFD_SYSCON
	help
	  Say 'Y' to enable the support for the xHCI host controller
	  found in MediaTek SoCs.
	  If unsure, say N.
```

## drivers/misc/mediatek/usb11/Kconfig
```kconfig
#
# MediaTek ICUSB Driver
#

config MTK_USBFSH
	bool "MediaTek USB fullspeed Host driver"
	---help---
	  This is support for Mediatek customized Host-only MUSB hardware
	  The USBFSH driver remove USB Device functions
	  And provide supports for second MODEM or ICUSB, etc.
	  Enable USB port1. before enable, you must
	  confirm that your hw can support. if you can't
	  sure, please set n.

config MTK_ICUSB_SUPPORT
	bool "MediaTek ICUSB SIM card driver"
	depends on MTK_USBFSH
	---help---
	  To support the ICUSB feature on USBFSH port
	  ICUSB is a standard USB interface to connect special SIM card
	  Beside normal SIM card feature, ICUSB provide more features
	  Like Mass Storage, EEM, etc.
	  This port is usually configured as USB port 1 on device.

config MTK_DT_USB_SUPPORT
	bool "MediaTek USBFSH dual talk feature driver"
	depends on MTK_USBFSH
	---help---
	  To enable the dual talk feature in phone over MTK_MUSBFSH USB port
	  When there is second MODEM on the device and connected to main
	  SoC via MTK_MUSBFSH USB port. MTK_DT_USB_SUPPORT is need for
	  supporting dual talk to transfer data between 2 MODEMs
	  This port is usually configured as USB port 1 on device.

config MTK_MUSBFSH_QMU_SUPPORT
	bool "QMU Transfer mode of MediaTek MUSBFSH"
	depends on MTK_USBFSH
	---help---
	  Say Y here if your system has a QMU capability for USB11
	  controller based on the MTK MUSBFSH IP.
	  QMU is some kind of enhanced DMA mode by HW queeu rather
	  than SW queue to reduce SW effort.

config MUSBFSH_VBUS
	bool "HOST VBUS CONTROL of MediaTek MUSBFSH"
	depends on MTK_USBFSH
	---help---
	  Say Y here if your system has support USB11
	  controller based on the MTK MUSBFSH IP. And the HOST
	  power can be control when you want to close or open
	  the USB11 VBUS.

config MUSBFSH_IDDIG
	bool "HOST IDDIG CONTROL of MediaTek MUSBFSH"
	depends on MTK_USBFSH
	---help---
	  Say Y here if your system has support USB11
	  controller based on the MTK MUSBFSH IP. And the HOST
	  related power and clock can be control when you plug
	  or unplug usb via PORT1 IDDIG pin.
```
