## drivers/misc/mediatek/cpuidle/Kconfig
```kconfig
config MEDIATEK_CPUIDLE
	tristate "Mediatek cpu idle driver"
	help
	  This kernel config can buiding mediatek cpu idle driver
	  This driver can support the device to enter idle mode to
	  save power consumption.
          If unsure, say N.
```

## drivers/misc/mediatek/cpumaxfreq/Kconfig
```kconfig
config CPUMAXFREQ_SUPPORT
	tristate "Xiaomi get cpumaxfreq"
	default n
	help
	  Say 'm' here to support cpumaxfreq node
```

## drivers/misc/mediatek/cqdma/Kconfig
```kconfig
config MTK_CQDMA
	bool "Enable MTK CQDMA Driver"
	default n
	help
	  The purpose of Mediatek cqdma is performing
	  data transfer between external memory such as
	  LPDDR3/on-chip SRAM/Memory-mapped I/O.
	  CQDMA support more than one channel to transfer data.
```

## drivers/misc/mediatek/dbg_dump/Kconfig
```kconfig
config MTK_DBG_DUMP
  bool CONFIG_MTK_DBG_DUMP
  default n
  help
    CONFIG_MTK_DBG_DUMP
```

## drivers/misc/mediatek/dbgtop/Kconfig
```kconfig
config MTK_DBGTOP
	bool "MTK DBGTOP driver"
	help
	  This config enable/disable the dbgtop module,
	  which controls the reset flow of debugging
	  features, including DDR reserve mode, DFD,
	  and data latch.
```

## drivers/misc/mediatek/dcm/Kconfig
```kconfig
config MTK_DCM_COMMON
	tristate "Mediatek DCM COMMON"
	depends on ARCH_MEDIATEK && OF
	help
	  For Mediatek Dynamic Clock Management control. Provid a common interface to
	  adjust dcm setting. Setting will not keep after reboot
	  Select "y" if you want to use.
	  Select "n" if you are not sure.

config MTK_DCM_MT6835
	tristate "Mediatek MT6835 DCM control"
	depends on ARCH_MEDIATEK && OF
	select MTK_DCM_COMMON
	help
	  For Mediatek MT6835 Dynamic Clock Management HW control. Only enable when you
	  neet to change mt6835 dcm setting. Setting will not keep after reboot
	  Select "y" if you want to change mt6835 dcm setting.
	  Select "n" if you do not need to change

config MTK_DCM_MT6873
	tristate "Mediatek MT6873 DCM control"
	depends on ARCH_MEDIATEK && OF
	select MTK_DCM_COMMON
	help
	  For Mediatek MT6873 Dynamic Clock Management HW control. Only enable when you
	  neet to change mt6873 dcm setting. Setting will not keep after reboot
	  Select "y" if you want to change mt6873 dcm setting.
	  Select "n" if you do not need to change

config MTK_DCM_MT6853
	tristate "Mediatek MT6853 DCM control"
	depends on ARCH_MEDIATEK && OF
	select MTK_DCM_COMMON
	help
	  For Mediatek MT6853 Dynamic Clock Management HW control. Only enable when you
	  neet to change mt6853 dcm setting. Setting will not keep after reboot
	  Select "y" if you want to change mt6853 dcm setting.
	  Select "n" if you do not need to change

config MTK_DCM_MT6886
	tristate "Mediatek MT6886 DCM control"
	depends on ARCH_MEDIATEK && OF
	select MTK_DCM_COMMON
	help
	  For Mediatek MT6886 Dynamic Clock Management HW control. Only enable when you
	  neet to change mt6886 dcm setting. Setting will not keep after reboot
	  Select "y" if you want to change mt6983 dcm setting.
	  Select "n" if you do not need to change

config MTK_DCM_MT6983
	tristate "Mediatek MT6983 DCM control"
	depends on ARCH_MEDIATEK && OF
	select MTK_DCM_COMMON
	help
	  For Mediatek MT6983 Dynamic Clock Management HW control. Only enable when you
	  neet to change mt6983 dcm setting. Setting will not keep after reboot
	  Select "y" if you want to change mt6983 dcm setting.
	  Select "n" if you do not need to change

config MTK_DCM_MT6985
	tristate "Mediatek MT6985 DCM control"
	depends on ARCH_MEDIATEK && OF
	select MTK_DCM_COMMON
	help
	  For Mediatek MT6985 Dynamic Clock Management HW control. Only enable when you
	  neet to change mt6985 dcm setting. Setting will not keep after reboot
	  Select "y" if you want to change mt6985 dcm setting.
	  Select "n" if you do not need to change
```

## drivers/misc/mediatek/dcm_v1/Kconfig
```kconfig
config MEDIATEK_DCM_COMMON
	tristate "Mediatek DCM COMMON"
	help
	  For Mediatek Dynamic Clock Management control. Provid a common interface to
	  adjust dcm setting. Setting will not keep after reboot
	  Select "y" if you want to use.
	  Select "n" if you are not sure.

config MEDIATEK_DCM_MT6768
	tristate "Mediatek MT6768 DCM control"
	help
	  For Mediatek MT6768 Dynamic Clock Management HW control. Only enable when you
	  neet to change mt6768 dcm setting. Setting will not keep after reboot
	  Select "y" if you want to change mt6768 dcm setting.
	  Select "n" if you do not need to change

config MEDIATEK_DCM_V1
	tristate "Mediatek MT6765 DCM control"
	help
	  For Mediatek MT6765 dcm HW control. Only enable when you
	  neet to change mt6765 dcm setting. Setting will not keep after reboot
	  Select "y" if you want to change mt6761 dcm setting.
	  Select "n" if you do not need to change
```

## drivers/misc/mediatek/dcxo/Kconfig
```kconfig
# XO Related
config MTK_DCXO
	bool "MediaTek DCXO Support"
	---help---
	  MediaTek PMIC DCXO driver. Which support MT6357 PMIC chip.
	  PMIC DCXO module can generate 26MHz clock to other chip.
	  The 26MHz can be adjusted to output a more accurate clock.
```

## drivers/misc/mediatek/debug_latch/Kconfig
```kconfig
config MTK_PLAT_SRAM_FLAG
	bool "MediaTek PLATFORM SRAM FLAG"
	help
	  PLAT_SRAM_FLAG provides APIs to access debugging flags.
	  Which are kept after exception occurs, and we can dump
	  these flags as hints or inputs to post-processing scripts
	  for further analyze.

config MTK_LASTBUS_INTERFACE
	bool "MTK_LASTBUS"
	help
	  LASTBUS is a tool to get the snapshot of peri and infra bus.
	  Enable this feature, you can dump LASTBUS status for peri and
	  infra bus for debug purpose.
```

## drivers/misc/mediatek/debug_tracer/Kconfig
```kconfig
config MTK_DEBUG_TRACER
	bool "MediaTek Debug Tracer Configuration"
	help
	  Select to enable MediaTek Debug Tracer configuration.
	  DEBUG TRACER is a debugging feature to record the historical
	  information on bus. After rebooting, these information could
	  be dumped for debugging.

config MTK_BUS_TRACER
	bool "MediaTek BUS TRACER"
	depends on MTK_DEBUG_TRACER
	help
	  BUS TRACER is a debugging feature to record the historical
	  information on bus. After rebooting, these information could
	  be dumped for debugging. It can also debug with watchpoint,
	  bypass, id, and rw filters
```

## drivers/misc/mediatek/devapc/Kconfig
```kconfig
config MTK_DEVAPC
	bool "Mediatek Device APC Support"
	help
	  Device APC is a kernel driver controlling internal device security.
	  If someone tries to access a device, which is not allowed by the
	  device, it cannot access the device and will get a violation
	  interrupt. Device APC prevents malicious access to internal devices.

config DEVAPC_LEGACY
	bool "Mediatek Device APC driver for legacy platform"
	select MTK_DEVAPC
	help
	  Say yes here to enable support Mediatek legacy
	  Device APC driver.
	  This driver do not split common handle flow
	  into different files.

config DEVAPC_ARCH_V1
	bool "Mediatek Device APC driver architecture v1"
	help
	  Say yes here to enable support Mediatek
	  Device APC driver which is based on HW
	  architecture version 1.
	  This architecture supports 1 Infra AO.

config DEVAPC_ARCH_V2
	bool "Mediatek Device APC driver architecture v2"
	help
	  Say yes here to enable support Mediatek
	  Device APC driver which is based on HW
	  architecture version 2.
	  This architecture supports multiple Infra AO.

config DEVAPC_MMAP_DEBUG
	bool "Mediatek Device APC memory map debug mode"
	help
	  Say yes here to enable support Mediatek
	  Device APC driver to debug violation
	  through catching illegal memory mapped
	  range.

config DEVAPC_SWP_SUPPORT
	bool "Mediatek Device APC software watchpoint support"
	help
	  Say yes here to enable support Mediatek
	  Device APC driver to debug violation
	  through software watchpoint.
	  Support read/write transaction separately.

config DEVAPC_MT6779
	bool "Mediatek MT6779 Device APC driver"
	depends on MACH_MT6779 || COMPILE_TEST
	select DEVAPC_ARCH_V1
	select MTK_DEVAPC
	select DEVAPC_SWP_SUPPORT if MTK_ENG_BUILD
	help
	  Say yes here to enable support Mediatek MT6779
	  Device APC driver.
	  This driver is combined with DEVAPC_ARCH_V1 for
	  common handle flow.

config DEVAPC_MT6768
	bool "Mediatek MT6768 Device APC driver"
	depends on MACH_MT6768 || COMPILE_TEST
	select DEVAPC_ARCH_V1
	select MTK_DEVAPC
	select DEVAPC_MMAP_DEBUG
	select DEVAPC_SWP_SUPPORT if MTK_ENG_BUILD
	help
	  Say yes here to enable support Mediatek MT6768
	  Device APC driver.
	  This driver is combined with DEVAPC_ARCH_V1 for
	  common handle flow.

config DEVAPC_MT6785
	bool "Mediatek MT6785 Device APC driver"
	depends on MACH_MT6785 || COMPILE_TEST
	select DEVAPC_ARCH_V1
	select MTK_DEVAPC
	select DEVAPC_SWP_SUPPORT if MTK_ENG_BUILD
	help
	  Say yes here to enable support Mediatek MT6785
	  Device APC driver.
	  This driver is combined with DEVAPC_ARCH_V1 for
	  common handle flow.

config DEVAPC_MT6885
	bool "Mediatek MT6885 Device APC driver"
	depends on MACH_MT6885 || MACH_MT6893 || COMPILE_TEST
	select DEVAPC_ARCH_V2
	select MTK_DEVAPC
	select DEVAPC_MMAP_DEBUG
	select DEVAPC_SWP_SUPPORT if MTK_ENG_BUILD
	help
	  Say yes here to enable support Mediatek MT6885
	  Device APC driver.
	  This driver is combined with DEVAPC_ARCH_V2 for
	  common handle flow.

config DEVAPC_MT6873
	bool "Mediatek MT6873 Device APC driver"
	depends on MACH_MT6873 || COMPILE_TEST
	select DEVAPC_ARCH_V2
	select MTK_DEVAPC
	select DEVAPC_MMAP_DEBUG
	select DEVAPC_SWP_SUPPORT if MTK_ENG_BUILD
	help
	  Say yes here to enable support Mediatek MT6873
	  Device APC driver.
	  This driver is combined with DEVAPC_ARCH_V2 for
	  common handle flow.

config DEVAPC_MT6853
	bool "Mediatek MT6853 Device APC driver"
	depends on MACH_MT6853 || COMPILE_TEST
	select DEVAPC_ARCH_V2
	select MTK_DEVAPC
	select DEVAPC_MMAP_DEBUG
	select DEVAPC_SWP_SUPPORT if MTK_ENG_BUILD
	help
	  Say yes here to enable support Mediatek MT6853
	  Device APC driver.
	  This driver is combined with DEVAPC_ARCH_V2 for
	  common handle flow.
```

## drivers/misc/mediatek/devinfo/Kconfig
```kconfig
config MTK_DEVINFO_DRIVER
	bool "Support MTK EFUSE driver with sysfs interface"
	default y
	depends on !MTK_DEVINFO_DRIVER_V2
	help
	  EFUSE driver is a must. EFUSE Driver V1 includes the Sysfs driver.
	  EFUSE Sysfs driver v1 is supported in legacy platforms.
	  It is used to provide device information. The devinfo kernel API and
	  user-space API(including ioctl and sysfs) are provided for users to
	  query device information in an easier way.

config MTK_DEVINFO_DRIVER_V2
	bool "Support MTK EFUSE driver without sysfs interface"
	help
	  EFUSE driver is a must. EFUSE Driver V2 removes the Sysfs driver.
	  EFUSE Sysfs driver v1 is supported in legacy platforms.
	  V2 driver makes no difference with v1 driver except that devinfo
	  sysfs driver is removed in newer platforms because the atag has already
	  exported a device node by device tree. Thus, the sysfs driver will
	  be duplicated. So we use the atag device node in the new platforms
	  and deprecated the old EFUSE sysfs driver.
```

## drivers/misc/mediatek/devmpu/Kconfig
```kconfig
config MTK_DEVMPU
	bool "Enable MTK Device MPU driver"
	help
	  Device MPU is a kernel driver providing
	  non-continuous memory protection in the
	  2MB granularity. Note that the protection
	  is conducted in parallel with EMI MPU.

config MTK_DEVMPU_EMI
	bool "Enable MTK Device MPU with EMI MPU"
	select MTK_DEVMPU
	help
	  Device MPU hardware will receive the violation
	  from EMI MPU hardware. Device MPU driver will
	  receive violation via call-back function of
	  EMI MPU.

config MTK_DEVMPU_AEE
	bool "Enable aee_kernel_exception for Device MPU violation"
	depends on MTK_DEVMPU
	help
	  Say yes here to enable aee_kernel_exception. When Device
	  MPU violation occur, Device MPU driver will call
	  aee_kernel_exception, and we will get kernelAPI dump
	  DB for analyze.

config MTK_DEVMPU_SLOG
	bool "Enable slog for Device MPU violation"
	depends on MTK_DEVMPU
	help
	  Say yes here to enable mtk slog. When Device
	  MPU violation occur, Device MPU driver will dump
	  violation info to slog, then slog system record
	  it and list as issue when offline parsing.

config DEVMPU_MT6781
	bool "Mediatek MT6781 Device MPU driver"
	depends on MACH_MT6781
	select MTK_DEVMPU
	select MTK_DEVMPU_SLOG if MTK_AEE_FEATURE
	select MTK_DEVMPU_AEE if MTK_AEE_FEATURE
	help
	  Say yes here to enable support Mediatek MT6781
	  Device MPU driver. This driver is only for
	  Device MPU feature in MT6781 platfom without
	  EMI.

config DEVMPU_MT6833
	bool "Mediatek MT6833 Device MPU driver"
	depends on MACH_MT6833
	select MTK_DEVMPU
	help
	  Say yes here to enable support Mediatek MT6833
	  Device MPU driver. This driver is only for
	  Device MPU feature in MT6833 platfom without
	  EMI.

config DEVMPU_MT6853
	bool "Mediatek MT6853 Device MPU driver"
	depends on MACH_MT6853
	select MTK_DEVMPU
	help
	  Say yes here to enable support Mediatek MT6853
	  Device MPU driver. This driver is combined with
	  ACP features of Device MPU in MT6853 platfom
	  without EMI.

config DEVMPU_MT6873
	bool "Mediatek MT6873 Device MPU driver"
	depends on MACH_MT6873
	select MTK_DEVMPU
	help
	  Say yes here to enable support Mediatek MT6873
	  Device MPU driver. This driver is combined with
	  ACP and EMI features of Device MPU in MT6873
	  platfom.

config DEVMPU_MT6877
	bool "Mediatek MT6877 Device MPU driver"
	depends on MACH_MT6877
	select MTK_DEVMPU
	help
	  Say yes here to enable support Mediatek MT6877
	  Device MPU driver. This driver is only for
	  Device MPU feature in MT6877 platfom without
	  EMI.

config DEVMPU_MT6885
	bool "Mediatek MT6885 Device MPU driver"
	depends on MACH_MT6885 || MACH_MT6893
	select MTK_DEVMPU if (MTK_EMI || MEDIATEK_EMI)
	select MTK_DEVMPU_EMI if (MTK_EMI || MEDIATEK_EMI)
	help
	  Say yes here to enable support Mediatek MT6885
	  Device MPU driver. This driver is combined with
	  SUB, ACP and EMI features of Device MPU in
	  MT6885 platfom.
```

## drivers/misc/mediatek/dfd/Kconfig
```kconfig
config MTK_DFD_INTERNAL_DUMP
	bool "Enable MediaTek DFD internal dump"
	select MTK_PLAT_SRAM_FLAG
	default n
	help
	  DFD (Design for Debug) is a debugging tool,
	  which scans flip-flops and dumps to internal
	  RAM on the WDT reset. After system reboots,
	  those values could be showed in exception db
	  for debugging.
```

## drivers/misc/mediatek/dfrc/Kconfig
```kconfig
config MTK_DYNAMIC_FPS_FRAMEWORK_SUPPORT
	bool "enable framework of dynamic fps"
	default n
	help
	  Define MTK_DYNAMIC_FPS_FRAMEWORK_SUPPORT to enable framework of
	  Mediatek dynamic fps driver.
	  If enable this config, basic modules can adjust refresh rate of
	  system through SurfaceFlinger or display driver.
```

## drivers/misc/mediatek/dramc/Kconfig
```kconfig
config MTK_DRAMC
	tristate "MediaTek DRAMC driver"
	default n
	---help---
	  This selects the MediaTek(R) DRAMC driver.
	  incude the following API
	  PASR
	  DVFS

config MTK_DRAMC_WA
	tristate "MediaTek DRAMC WA driver"
	---help---
	  This selects the MediaTek(R) DRAMC WA driver.
	  Use apxgpt3 to wakeup
	  system when dram data
	  rate 4266 to enter S0_S1
	  after 1 second
```

## drivers/misc/mediatek/dual_ccci/Kconfig
```kconfig
config MTK_CCCI_EXT # CCCI_DRIVER
	bool "Dual CCCI Driver"
	depends on MTK_CCCI_DEVICES
	default n
	help
	  This option enables dual ccci device driver support.
	  If yes, dual_ccci driver is enabled,
	  If no, dual_ccci driver is disabled.
	  The option default is disabled.

config MTK_CCCI_DRIVER # CCCI_DRIVER
	tristate "CCCI Driver"
	depends on MTK_CCCI_DEVICES
	default n
	---help---
	  This option enables ccci device driver support
	  If yes, ccci driver is enabled,
	  If no, ccci driver is disabled.
	  The option default is disabled. and phase out now.
```

## drivers/misc/mediatek/dum-char/Kconfig
```kconfig
config MTK_DUM_CHAR
  bool CONFIG_MTK_DUM_CHAR
  default n
  help
    CONFIG_MTK_DUM_CHAR
```
