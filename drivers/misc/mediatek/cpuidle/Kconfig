## drivers/misc/mediatek/dvfsrc/Kconfig
```kconfig
config MTK_DVFSRC_HELPER
	tristate "MTK DVFSRC Helper debugging Support"
	depends on MTK_DVFSRC
	help
	  This kernel config can be used to debug dvfsrc (dynamic voltage
	  and frequency scaling resource collector) for Mediatek vcore_dvfs.
	  When enable this option, we can trace the control flow for dvfsrc
	  and dump current vcore and dram information.
	  If unsure, say N.

config MTK_DVFSRC_MET
	tristate "MTK DVFSRC MET Support"
	depends on MTK_DVFSRC_HELPER
	help
	  This kernel config can be used to enable VCORE_DVFS info report to for MET.
	  When enable this option, it support reporting current vcore dvfs info to
	  MET system for performance and power tuning.
	  If unsure, say N.

config MTK_DVFSRC_MET_MT6873
	tristate "MTK DVFSRC MET for MT6873"
	select MTK_DVFSRC_MET
	help
	  This kernel config can be used to enable MT6873 DVFSRC MET support.
	  When enable this option, it support reporting current vcore dvfs info to
	  MET system for performance and power tuning.
	  If unsure, say N.

config MTK_DVFSRC_MET_MT6768
	tristate "MTK DVFSRC MET for MT6768"
	select MTK_DVFSRC_MET
	help
	  This kernel config can be used to enable MT6768 DVFSRC MET support.
	  When enable this option, it support reporting current vcore dvfs info to
	  MET system for performance and power tuning.
	  If unsure, say N.

config MTK_DVFSRC_MET_MT6765
	tristate "MTK DVFSRC MET for MT6765"
	select MTK_DVFSRC_MET
	help
	  This kernel config can be used to enable MT6765 DVFSRC MET support.
	  When enable this option, it support reporting current vcore dvfs info to
	  MET system for performance and power tuning.
	  If unsure, say N.
```

## drivers/misc/mediatek/dynamic_boost/Kconfig
```kconfig
menu "MTK CPU boost mechanism"

config MTK_DYNAMIC_BOOST
	bool "Enable a boost interface"
        default n
        help
	  Provide an interface to boost cpu hotplug and dvfs for performance
	  improvement. This is target to kernel modules by event. The boost
	  can support both one-time event and continuous boost. It can cover
	  both HMP and SMP platform.

config TOUCH_BOOST
        bool "Enable touch boost"
        depends on MTK_DYNAMIC_BOOST
        default n
        help
	  This option enables touch boost. It is implemented by registering an
	  input event handler. Once dynamic_boost driver receives an input event,
	  it will hotplug on 2 LITTLE cores and set max frequency. Touch boost is
	  a one-time boost mechanism.

config SCREEN_ON_BOOST
	bool "Enable screen on boost"
	depends on MTK_DYNAMIC_BOOST
	default n
	help
	  This option enables screen on boost. It will register the lcm
	  brightness notifier, and identify the event, FB_BLANK_UNBLANK, as lcm on.
	  It will set at least 2 cores online for 200ms.

endmenu
```

## drivers/misc/mediatek/eccci/Kconfig
```kconfig
config MTK_ECCCI_DRIVER
	tristate "Enable Evolved CCCI Driver as interface for modem"
	depends on MTK_CCCI_DEVICES
	default n
	select MTK_NET_CCMNI
	help
	  This option enables ECCCI device driver support,
	  if yes, then modem1 is using eccci driver,
	  if no, eccci driver is disabled.
	  The option default disabled.

config MTK_ECCCI_CLDMA
	tristate "ECCCI driver using CLDMA HW to communicate wtih LTE modem"
	depends on MTK_ECCCI_DRIVER
	default y
	help
	  This option enables ECCCI CLDMA driver,
	  if yes, then modem1 is using cldma hardware,
	  if no, cldma hardware is disabled.
	  The option default disabled.

config MTK_ECCCI_CCIF
	tristate "ECCCI driver using CCIF HW to communicate wtih LTE modem"
	depends on MTK_ECCCI_DRIVER
	default n
	help
	  This option enables ECCCI CCIF driver,
	  if yes, then modem1 is using ccif hardware,
	  if no, ccif hardware is disabled,
	  The option default disabled.

config MTK_ECCCI_C2K
	tristate "ECCCI driver using CCIF HW to communicate wtih C2K modem"
	depends on MTK_ECCCI_DRIVER
	default n
	help
	  This option enables ECCCI CCIF C2K driver,
	  if yes, c2k modem is enabled,
	  if no, c2k modem is disabled,
	  The option default disabled.

config MTK_SIM_LOCK_POWER_ON_WRITE_PROTECT
	bool "sim lock poweron write protect"
	default n
	help
	  To support SIM lock power on write protect  feature,
	  if yes, then it is supported,
	  if no, it is disabled.
	  The option default disabled.
```

## drivers/misc/mediatek/edmc/Kconfig
```kconfig
config MTK_EDMC_SUPPORT
	bool "EDMC (External DMA) Driver"
	default n
	help
	  The purpose of Mediatek eDMC is performing
	  data transfer between external memory such as
	  DRAM/TCM, It will cooperate with MDLA. eDMC
	  support different modes for image process.

config MTK_EDMC_ION
	bool "MDMC use ION memory"
	depends on MTK_MDLA_ION
	default y
	help
	  Enable MDMC to use MTK ION for better memory
	  utilization. It will automatically enable ION
	  feature of MDLA. It depens on the config of
	  MTK_MDLA_ION.
```

## drivers/misc/mediatek/eem_v2/Kconfig
```kconfig
config MTK_PTPOD_LEGACY
	tristate "MediaTek Performance Thermal Power OverDrive for legacy chip"
	help
	  This driver calculate the minimum voltage of specified frequency
	  by efuse data and get the temperature from thermal to make up the voltage.
	  Select "y" if you want to enable this features.
	  Select "n" if unsure.
```

## drivers/misc/mediatek/eemgpu/Kconfig
```kconfig
config MTK_PTPOD_GPU
	tristate "MediaTek GPU Voltage Scaling Module"
	help
	  This driver provides optimized voltage for
	  GPU DVFS. Those voltages are calculated by
	  a piece of hardware according to temperature
	  and chip process corner.
	  Select "y" if you want to enable this features.
	  Select "n" if unsure.
```

## drivers/misc/mediatek/elliptic/Kconfig
```kconfig
# SPDX-License-Identifier: GPL-2.0

config MTK_ELLIPTIC_USND_PROXIMITY
	bool "ELLIPTIC ultra sound proximity support"
	help
	  For ultra sound proximity kernel driver config.
	  This ultra sound proximity kernel driver
	  cooperate with SCP ultra sound driver to
	  emulate physical proximity sensor. Using
	  IPI interface to communicate with SCP side and
	  be controlled by sensor hal.
```
