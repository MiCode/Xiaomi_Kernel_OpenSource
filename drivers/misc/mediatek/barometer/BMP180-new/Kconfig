## drivers/misc/mediatek/barometer/BMP280-new/Kconfig
```kconfig
config MTK_BMP280_NEW
	bool "BMP280 for MediaTek package"
	default n
	help
	It support different type sensor
	in this platform. If this option
	is set, it will support pressure
	BMP280.
```

## drivers/misc/mediatek/barometer/Kconfig
```kconfig
config CUSTOM_KERNEL_BAROMETER
	bool "CUSTOM_KERNEL_BAROMETER"
	help
	  To detect barometer raw data

source "drivers/misc/mediatek/barometer/BMP180/Kconfig"
source "drivers/misc/mediatek/barometer/BMP180-new/Kconfig"
source "drivers/misc/mediatek/barometer/bmp280/Kconfig"
source "drivers/misc/mediatek/barometer/barohub/Kconfig"
source "drivers/misc/mediatek/barometer/BMP280-new/Kconfig"
```

## drivers/misc/mediatek/barometer/bmp280/Kconfig
```kconfig
config MTK_BMP280
	bool "bmp280 for MediaTek package"
	default n
	help
	It support different type sensor
	in this platform. If this option
	is set, it will support pressure
	bmp280.
```

## drivers/misc/mediatek/base/power/Kconfig
```kconfig
config MTK_CPU_FREQ
	bool "MTK CPU FREQ"
	help
	  This kernel config can be used to enable CPU FREQ.
	  When enable this option, CPU frequency and voltage will be
	  changed which will depended on CPU FREQ governor.
	  If unsure, say N.

config MTK_PTPOD
	bool "MTK PTPOD"
	help
	  This kernel config can be used to enable PTPOD.
	  When enable this option, voltage will be
	  changed which will depended on chip.
	  If unsure, say N.

config MTK_PTPOD_GPU
	bool "MTK PTPOD GPU"
	default n
	help
	  This kernel config can be used to enable gpu PTPOD.
	  When enable this option, gpu voltage will be
	  changed which will depended on chip.
	  If unsure, say N.

config MTK_STATIC_POWER
	bool "MTK STATIC POWER"
	help
	  This kernel config can be used to enable static power.
	  This information can provide power data to someone who
	  need it
	  If unsure, say N.

config MTK_UNIFY_POWER
	bool "MTK UNIFY POWER"
	help
	  This kernel config can be used to enable unified power table.
	  This table can provide power data and capacity to someone who
	  need it.
	  If unsure, say Y.

config CPU_FORCE_TO_BIN2
	bool "Read extra efuse for BIN2 IC"
	help
	  This kernel config can be used to force cpu to segment BIN2.
	  When enable this option, eem driver will read extra efuse to
	  obtain parameters for segment BIN2 IC.
	  If unsure, say N.

config MTK_LP_OPP
	bool "MTK LP OPP"
	help
	  This kernel config can be used to enable MTK LP OPP.
	  When enable this option,
	  cpudvfs opp will be changed for low power.
	  If unsure, say N.

config MTK_SWPM
	bool "MTK SW Power Meter"
	help
	  This kernel config can be used to enable SW power meter. When enable
	  this option, user can turn on SW power meter and get average power
	  for each power rail for low power debugging.
	  If unsure, say N.

config MTK_PBM
	bool "MTK power budget management"
	help
	  This kernel config can be used to enable power budget management.
	  When enable this option, pbm will allocate limit power budget to
	  CPU and GPU when battery voltage is low.

config MTK_QOS_V2
	bool "MTK QOS Framework Ver 2.0"
	default y if MACH_MT6853
	default y if MACH_MT6833
	default y if MACH_MT6877
	default y if MACH_MT6781
	select MTK_QOS_FRAMEWORK
	help
	  This version support QOS version 2.0 feature sets.
	  It supports BW prediction, BW bound detection, and BW limiter.
	  It is also mapped with sspm qos v2.
	  If unsure, say N.
```

## drivers/misc/mediatek/blocktag/Kconfig
```kconfig
#
# block tag trace
#

comment "Storage Block Tag"

config MTK_BLOCK_IO_TRACER
	tristate "Storage Block IO Tracer"
	depends on BLOCK
	help
	  Enable block tagging at block driver, tag requester pid to
	  the accessing pages. This allows MMC/UFS Block IO log to obtian
	  IO statistics of each process. The Block Tag also provides
	  utility functions to MMC/UFS Block IO log, such as throughput
	  calculation, log printing, and ring trace handling.

config MTK_FSCMD_TRACER
	tristate "filesystem Syscall Tracer"
        depends on ARM64
	help
	  If enable, record the syscall start and end timestamp.

config MTK_BLOCK_IO_PM_DEBUG
	bool "Enable Blocktag BLK PM Tracer"
	depends on BLK_PM
	help
	  If it is enabled, there are some pm-related trace
	  events will be create in block layer.
```

## drivers/misc/mediatek/bluetooth/Kconfig
```kconfig
config BCM_BT_POWER
	tristate "Broadcom Bluetooth Power Driver"
	help
	  RFKill bt switch control
```

## drivers/misc/mediatek/boot/Kconfig
```kconfig
config MTK_BOOT
	bool "Enable MTK Boot information Driver"
	depends on MEDIATEK_SOLUTION
	default y
	help
	  Boot information driver includes specific information about booting
	  process, such as boot mode. It supports two functions:
	  (1) boot mode API: caller uses this API to do initialization under
	      different boot mode
	  (2) meta info API: user space program will read the information passed
	      from boot-loader
```

## drivers/misc/mediatek/boot_reason/Kconfig
```kconfig
config MTK_BOOT_REASON
	bool "Enable MTK Boot Reason Driver"
	default y
	help
	  MTK Boot Reason Driver is in charge of returning boot reason passing from early booting
	  stage. The information is passed from boot-loader. Generally, drivers will execute
	  different flows under different boot reason.For example, in normal boot, users
	  needs to press power key. If users trigger reboot in kernel, device should boot up even
	  if power key is not pressed.
```

## drivers/misc/mediatek/btcvsd/Kconfig
```kconfig
config MTK_BTCVSD
  bool CONFIG_MTK_BTCVSD
  default n
  help
    CONFIG_MTK_BTCVSD
```

## drivers/misc/mediatek/btif/Kconfig
```kconfig
config MTK_BTIF
	tristate"MediaTek BTIF Driver"
	help
	  MTK connectivity BTIF driver for A/D die
	  and not supported in combo project
	  It is used to config whether BTIF driver
	  is supported or not.
```

## drivers/misc/mediatek/cache-auditor/Kconfig
```kconfig
config MTK_CPUQOS_V3
	tristate "MTK CPUQoS V3 feature"
	depends on CGROUP_SCHED
	help
	  MTK CPUQoS V3 feature.
	  These features include:
		L3$ management feature:
		It can improve performance to use L3$.
		User can control performance mode and set
		critical tasks.
```

## drivers/misc/mediatek/cache/Kconfig
```kconfig
config MEDIATEK_CACHE_API
	bool "Enable Mediatek Cache API to complement kernel"
	help
	  This add several cache api to provide some debug
	  drivers to use. Ex: aee needs flush all to dump
	  all cache data to DRAM to get full ramdump.
	  If in doubt, say N.
```

## drivers/misc/mediatek/cam_cal/Kconfig
```kconfig
config MTK_CAM_CAL
	bool "MTK camera cal driver"
	help
	  CONFIG_MTK_CAM_CAL define if the camera cal driver should be
	  built in or not. If you want to use EEPROM for sensor. You have
	  enable CONFIG_MTK_CAM_CAL on ProjectConfig. The kernel space for
	  EEPROM will be build. It may be like as "/dev/CAM_CAL_DRV".
	  Use space code will control the driver by open and ioctrl this one.
```

## drivers/misc/mediatek/cam_log/Kconfig
```kconfig
config MI_CAMLOG
    tristate "Camera Camlog Driver Support"
    help
      Enable to build camera Skynet Camlog drivers.
```

## drivers/misc/mediatek/cam_timesync/Kconfig
```kconfig
# SPDX-License-Identifier: GPL-2.0

config MTK_CAM_TIMESYNC
	tristate "Specify Interface Support Cam Timesync"
	default n
	help
	  map camera isp hwclock to boottime and monotonic time.
	  Set Y to enable this feature.
	  If unsure, set N to don't support this feature.
```

## drivers/misc/mediatek/camera_mem/Kconfig
```kconfig
# SPDX-License-Identifier: GPL-2.0

config MTK_CAMERA_MEM_SUPPORT
	tristate "Camera memoy driver"
	depends on MTK_CAMERA_ISP_SUPPORT
	help
	  Camera mem driver for aosp ion. Iova map/unmap implementation.
	  Set Y to enable this feature.
	  If unsure, set N to don't support this feature.
```

## drivers/misc/mediatek/camera_security/Kconfig
```kconfig
config MTK_CAM_SECURITY_SUPPORT
	bool "Secure Camera Infrastructure Support"
	default n
	help
	  This is an option for MTK secure camera infrastructure.
	  It provides hardware-based security that guarantees the data integrity
	  form image sensor, ISP DMA port access to secure memory.
	  If you are not sure about this, do not set it to y.

config MTK_CAM_GENIEZONE_SUPPORT
	bool "M-TEE based Secure Camera Solution"
	default n
	help
	  M-TEE (a.k.a. GENIEZONE) provides a hypervisor (EL2) based environment with
	  MTK hardware-based security protection.
	  When this option is set to y, secure camera resides in M-TEE.
	  If you are not sure about this, do not set it to y.
```

## drivers/misc/mediatek/cameraisp/Kconfig
```kconfig
config MTK_CAMERA_ISP
	bool "Camera ISP Driver Support"
	default y
	help
	  Enable to build various camera isp drivers
	  like dpe, rsc, tsf, etc. Disable to prevent
	  camera drivers from being built into the
	  kernel image.

source "drivers/misc/mediatek/cameraisp/src/Kconfig"
source "drivers/misc/mediatek/cameraisp/owe/Kconfig"
source "drivers/misc/mediatek/cameraisp/rsc/Kconfig"
source "drivers/misc/mediatek/cameraisp/wpe/Kconfig"
source "drivers/misc/mediatek/cameraisp/dpe/Kconfig"
source "drivers/misc/mediatek/cameraisp/tsf/Kconfig"
source "drivers/misc/mediatek/cameraisp/mfb/Kconfig"
source "drivers/misc/mediatek/cameraisp/fdvt/Kconfig"
source "drivers/misc/mediatek/cameraisp/pda/Kconfig"
```

## drivers/misc/mediatek/cameraisp/dip/Kconfig
```kconfig
config MTK_CAMERA_DIP_ISP6S
	tristate "[DIP] Digital Image Process"
	depends on MTK_CAMERA_ISP_SUPPORT
	help
	  Digital Image Process.
	  digital computer process digital images
	  through an algorithm.


config MTK_CAMERA_DUAL_DIP_ISP6S
	tristate "[DIP] Digital Image Process"
	depends on MTK_CAMERA_ISP_SUPPORT
	help
	  Digital Image Process.
	  digital computer process digital images
	  through an algorithm.
```

## drivers/misc/mediatek/cameraisp/dpe/Kconfig
```kconfig
config MTK_CAMERA_DPE_ISP7
	tristate "[DPE] Depth Engine"
	depends on MTK_CAMERA_ISP_SUPPORT
	help
	  Depth Engine.
	  Enable to calculate the depth information
	  between two images on Dual Camera Application.
	  Disable if it is not supported or not wanted.

config MTK_CAMERA_DPE_ISP6S
	tristate "[DPE] Depth Engine"
	depends on MTK_CAMERA_ISP_SUPPORT
	help
	  Depth Engine.
	  Enable to calculate the depth information
	  between two images on Dual Camera Application.
	  Disable if it is not supported or not wanted.
```

## drivers/misc/mediatek/cameraisp/fdvt/Kconfig
```kconfig
config MTK_CAMERA_FD_ISP6S
	tristate "[FD] Face Detection"
	depends on MTK_CAMERA_ISP_SUPPORT
	help
	  Face Detection.
	  Enable to detect faces on images.
	  Disable if it is not supported or
	  not wanted.
```

## drivers/misc/mediatek/cameraisp/mfb/Kconfig
```kconfig
config MTK_CAMERA_MFB_ISP6S
	tristate "[MFB] Multi Frame Blending"
	depends on MTK_CAMERA_ISP_SUPPORT
	help
	  Depth-related Engine.
	  Enable to calculate the occlusion information
	  between two images on Dual Camera Application.
	  Disable if it is not supported or not wanted.
```

## drivers/misc/mediatek/cameraisp/owe/Kconfig
```kconfig
config MTK_CAMERA_ISP_OWE_SUPPORT
	bool "[OWE] Occlusion and Weighted Median Filter"
	default n
	depends on MTK_CAMERA_ISP
	help
	  Depth-related Engine.
	  Enable to calculate the occlusion information
	  between two images on Dual Camera Application.
	  Disable if it is not supported or not wanted.
```
