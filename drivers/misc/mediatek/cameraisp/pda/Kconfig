## drivers/misc/mediatek/cameraisp/pda/Kconfig
```kconfig
config MTK_CAMERA_ISP_PDA_SUPPORT
	tristate "[PDA] Phase Distortion point Accelerator"
	help
	  Phase Distortion point Accelerator.
	  Enable to calculate the PD correlation for PD-AF.
	  Disable if it is not supported or not wanted.
```

## drivers/misc/mediatek/cameraisp/rsc/Kconfig
```kconfig
config MTK_CAMERA_RSC_ISP6S
	tristate "[RSC]Rolling Shutter Cancellation Support"
	depends on MTK_CAMERA_ISP_SUPPORT
	help
	  Rolling Shutter Cancellation. Enable to compensate
	  any distortion due to the interplay of moving objects
	  and rolling shutters of CMOS sensors. Disable if it is
	  not supported or not wanted.
```

## drivers/misc/mediatek/cameraisp/src/Kconfig
```kconfig
config MTK_CAMERA_ISP_CAMERA_SUPPORT
	tristate "[ISP] Image Signal Processor"
	depends on MTK_CAMERA_ISP
	help
	  Image Signal Processor.
	  Enable to do image Signal process.
	  Disable if it is not supported or
	  not wanted.
```

## drivers/misc/mediatek/cameraisp/src/isp_3/Kconfig
```kconfig
config MTK_CAMERA_ISP_RAW_SUPPORT_ISP3_M
	tristate "[ISP] Image Signal Processor - mt6761"
	help
	  Enable to build mt6761 camera isp driver which
	  processes and enhances the image raw data
	  from the imgsensor.
	  Disable if it is not supported or not wanted.

config MTK_CAMERA_ISP_RAW_SUPPORT_ISP3_Z
	tristate "[ISP] Image Signal Processor - mt6739"
	help
	  Enable to build mt6739 camera isp driver which
	  from the imgsensor.
	  Disable if it is not supported or not wanted.
```

## drivers/misc/mediatek/cameraisp/src/isp_4/Kconfig
```kconfig
config MTK_CAMERA_ISP_RAW_SUPPORT_ISP4_T
	tristate "[ISP] Image Signal Processor - mt6768"
	help
	  Enable to build mt6768 camera isp driver which
	  processes and enhances the image raw data
	  from the imgsensor.
	  Disable if it is not supported or not wanted.

config MTK_CAMERA_ISP_RAW_SUPPORT_ISP4_C
	tristate "[ISP] Image Signal Processor - mt6765"
	help
	  Enable to build mt6765 camera isp driver which
	  processes and enhances the image raw data
	  from the imgsensor.
	  Disable if it is not supported or not wanted.
```

## drivers/misc/mediatek/cameraisp/tsf/Kconfig
```kconfig
config MTK_CAMERA_ISP_TSF_SUPPORT
	bool "[TSF] Table Smooth Function Support"
	default n
	depends on MTK_CAMERA_ISP
	help
	  Table Smooth Function.
	  Enable to compensate lens
	  shading.
	  Disable if it is ot supported or not wanted.
```

## drivers/misc/mediatek/cameraisp/wpe/Kconfig
```kconfig
config MTK_CAMERA_WPE_ISP6S
	tristate "[WPE] Warping Engine"
	default n
	depends on MTK_CAMERA_ISP_SUPPORT
	help
	  Warpning Engineis an important module to off-load
	  CPU/GPU loading on te feature like Electronic Image
	  Stabilization. The function of WPE is dedicated for
	  real-time image warping.
```

## drivers/misc/mediatek/ccci_util/Kconfig
```kconfig
menuconfig MTK_CCCI_DEVICES
	bool "CCCI Devices"
	default n
	help
	  Say Y here to enable CCCI basic
	  support. If you say N,
	  all CCCI related code
	  (including dummy API) will be disable.

config MTK_MD1_SUPPORT
	int "configure modem 1 boot up capability"
	depends on MTK_CCCI_DRIVER || MTK_CCCI_EXT || MTK_ECCCI_DRIVER
	default 0
	help
	  modem 1 mode:
	  0=>invalid,
	  1=>2g,
	  2=>3g,
	  3=>wg,
	  4=>tg,
	  5=>lwg,
	  6=>ltg,
	  7=>sglte,
	  8=>ultg,
	  9=>ulwg,
	  10=>ulwtg,
	  11=>ulwcg,
	  12=>ulwctg,
	  13=>ulttg,
	  14=>ulfwg,
	  15=>ulfwcg,
	  16=>ulctg,
	  17=>ultctg,
	  18=>ultwg,
	  19=>ultwcg,
	  20=>ulftg,
	  21=>ulfctg

config MTK_MD3_SUPPORT
	int "configure modem 3 boot up capability"
	depends on MTK_CCCI_DRIVER || MTK_CCCI_EXT || MTK_ECCCI_DRIVER
	default 0
	help
	  modem 3 mode:
	  1=>2g,
	  2=>3g,
	  0=>invalid
```

## drivers/misc/mediatek/ccmni/Kconfig
```kconfig
config MTK_NET_CCMNI
	bool "MediaTek CCMNI driver"
	depends on MTK_CCCI_DEVICES
	default n
	select WIRELESS_EXT
	select WEXT_PRIV
	help
	  This option enables CCMNI driver,
	  if yes, then CCMNI driver is used to communicate with CCCI driver by Kernel network,
	  if no, Kernel network uses ccci port_net to send and recevie data.
	  The option default depends on MTK_CCCI_DEVICES.
```

## drivers/misc/mediatek/ccu/src/Kconfig
```kconfig
config MTK_CCU
	tristate "MTK_CCU"
	default n
	help
	  Support 3A using CCU hardware
	  Offers speed up of 3A, including
	  Faster control flow and
	  Stabler frame rate.
	  Select yes to build the CCU driver into the kernel.
	  Select module to build CCU drivers of all platforms as modules.

config MTK_CCU_ISP4
	bool "Build ISP4 CCU driver into kernel"
	default n
	depends on MTK_CCU
	help
	  Select yes to build the ISP4 CCU driver
	  into the kernel.
	  Select no to build the ISP4 CCU driver as
	  a kernel module.

config MTK_CCU_ISP5
	bool "Build ISP5 CCU driver into kernel"
	default n
	depends on MTK_CCU
	help
	  Select yes to build the ISP5 CCU driver
	  into the kernel.
	  Select no to build the ISP5 CCU driver as
	  a kernel module.

config MTK_CCU_ISP6
	bool "Build ISP6 CCU driver into kernel"
	default n
	depends on MTK_CCU
	help
	  Select yes to build the ISP6 CCU driver
	  into the kernel.
	  Select no to build the ISP6 CCU driver as
	  a kernel module.

config MTK_CCU_ISP6S
	bool "Build ISP6S CCU driver into kernel"
	default n
	depends on MTK_CCU
	help
	  Select yes to build the ISP6S CCU driver
	  into the kernel.
	  Select no to build the ISP6S CCU driver as
	  a kernel module.
```

## drivers/misc/mediatek/chargepump/Kconfig
```kconfig
config	CUSTOM_KERNEL_CHARGEPUMP
	bool "chargepump Support"
	default n
	help
	  This feature Option is used for projects which using exteranl backlight driver
	  if you want to  external backlight driver, please turn on this feature first,
	  then LED driver call external backlight driver API.
	  Also this feature related to flashlight and DSV driver.

config LEDS_RT4832
	bool "RT4832 Support"
	default n
	help
	  charge pump driver for external backlight and flashlight
	  it support DSV, flashlight, LED module.
	  if you want to use external backlight driver moulde on your project,
	  please turn on chargepump option also.

config LEDS_RT8542
	bool "RT8542 Support"
	default n
	help
	  charge pump driver for external backlight and flashlight
	  it support DSV, flashlight, LED module.
	  if you want to use external backlight driver moulde on your project,
	  please turn on chargepump option also.

config DSV_SM5107
	bool "SM5107 Support"
	default n
	help
	  charge pump driver for external backlight and flashlight
	  it support DSV, flashlight, LED module.
	  if you want to use external backlight driver moulde on your project,
	  please turn on chargepump option also.
```

## drivers/misc/mediatek/chip/Kconfig
```kconfig
config MTK_CHIP
	bool "Enable MTK Chip Version Driver"
	help
	  MTK chip version driver will provide below information
	  (1) chip ID: for driver to handle different mechanism under different
	      HW
	  (2) chip version: for driver to identify different capability for IC
	      with the same chip ID
```

## drivers/misc/mediatek/cirq/Kconfig
```kconfig
config MTK_SYS_CIRQ
	bool "sys cirq"
	help
	  System interrupt controller(SYS_CIRQ) is a low-power interrupt
	  controller which is designed to work outside MCUSYS as second level
	  interrupt controller. With SYS_CIRQ, the MCUSYS can be completely
	  turned off to improve system power consumption without losing
	  interrupts.

config FAST_CIRQ_CLONE_FLUSH
	bool "fast cirq clone flush"
	depends on MTK_SYS_CIRQ
	help
	  Legacy CIRQ driver clone and flush IRQ pol/sen/pending very slow,
	  since it checks every IRQ to decide if it should clone or not. This
	  config speed up the process by only clone once when the sysetm first
	  enter low power mode. and only setup cirq IDs for wakeup source.
```

## drivers/misc/mediatek/clkbuf/Kconfig
```kconfig
config MTK_CLK_BUFFER
	tristate "MediaTek Clock Buffer Support"
	select REGMAP
	help
	  Say yes here to add support for the MediaTek Clock Buffer
	  driver, which support interface for  PMIC 26Mhz output to
	  other HW component such as BB_MD/WCN/NFC/RF/UFS.
	  It could also control FPM/LPM mode switch state.

config MTK_CLKBUF_BBLPM
	bool "MediaTek Clock Buffer BBLPM Mode Support"
	select REGMAP
	help
	  Say yes here to add support for the MediaTek Clock Buffer
	  BBLPM, which support PMIC 26Mhz output transfer to low
	  power mode, less accurate with power consumption.
	  But with restrict condition for some of  XO_BUFFER need to
	  be disabled.

config MTK_CLKBUF_NFC
	bool "MediaTek Clock Buffer NFC Support"
	select REGMAP
	help
	  Say yes here to support for MediaTek Clock Buffer XO_NFC,
	  which support PMIC 26Mhz output to NFC HW component. If
	  this config is not set, XO_NFC will be disabled when
	  driver is probed.

config MTK_CLKBUF
	tristate "Mediatek Clock Buffer Driver Support"
	select REGMAP
	help
	  Select yes for Mediatek Clock Buffer driver support. The
	  driver support for SW debug control to DCXO which output
	  26MHz to other HW module such as BB_MD/WCN/NFC/RF/UFS etc.
	  Moreover, the driver also allowed user control FPM, BBLPM,
	  LPM DCXO mode.

config MTK_CLKBUF_V1
	bool "Mediatek Clock Buffer V1 Driver Support"
	depends on MTK_CLKBUF
	help
	  Select yes for Mediatek Clock Buffer driver V1 support.
	  The driver support for SW debug control for DCXO related
	  interfaces which control connsys, nfc interface for 26M
	  output.

config MTK_SRCLKEN_RC_V1
	bool "Mediatek SRCLKEN RC Support"
	depends on MTK_CLKBUF
	help
	  Select yes for Mediatek SRCLKEN RC HW module support. The
	  HW module for central manager control of DCXO HW output.
	  Moreover, it support finer control of DCXO to several
	  module such as Connsys can be divided to Wifi, BT, GPS etc.
```

## drivers/misc/mediatek/cm_mgr/Kconfig
```kconfig
config MTK_CM_MGR
	tristate "MTK CPU Memory Latency Management"
	help
	  This kernel config can be used to enable CM_MGR. When enable
	  this option, dram opp level will be changed which will depended
	  on power table.
	  If unsure, say N.

config MTK_CM_IPI
	tristate "MTK CM use IPI"
	help
	  This kernel config can be used to enable CM IPI. When enable
	  this option, we will use ipi on system buffer to improve
	  performance and power.
	  If unsure, say N.

config MTK_CM_MGR_LEGACY
	tristate "MTK CM_MGR for LEGACY"
	help
	  This kernel config can be used to enable CM_MGR. When enable
	  this option, dram opp level will be changed which will depended
	  on power table.
	  If unsure, say N.

config MTK_CM_MGR_MT6833
	tristate "MTK CM_MGR for MT6833"
	help
	  This kernel config can be used to enable CM_MGR MT6833. When enable
	  this option, dram opp level will be changed which will depended
	  on power table.
	  If unsure, say N.

config MTK_CM_MGR_MT6768
	tristate "MTK CM_MGR for MT6768"
	help
	  This kernel config can be used to enable CM_MGR MT6853. When enable
	  this option, dram opp level will be changed which will depended
	  on power table.
	  If unsure, say N.

config MTK_CM_MGR_MT6765
	tristate "MTK CM_MGR for MT6765"
	help
	  This kernel config can be used to enable CM_MGR MT6765. When enable
	  this option, dram opp level will be changed which will depended
	  on power table.
	  If unsure, say N.

config MTK_CM_MGR_MT6789
	tristate "MTK CM_MGR for MT6789"
	help
	  This kernel config can be used to enable CM_MGR MT6789. When enable
	  this option, dram opp level will be changed which will depended
	  on power table.
	  If unsure, say N.

config MTK_CM_MGR_MT6853
	tristate "MTK CM_MGR for MT6853"
	help
	  This kernel config can be used to enable CM_MGR MT6853. When enable
	  this option, dram opp level will be changed which will depended
	  on power table.
	  If unsure, say N.

config MTK_CM_MGR_MT6855
	tristate "MTK CM_MGR for MT6855"
	help
	  This kernel config can be used to enable CM_MGR MT6855. When enable
	  this option, dram opp level will be changed which will depended
	  on power table.
	  If unsure, say N.

config MTK_CM_MGR_MT6873
	tristate "MTK CM_MGR for MT6873"
	help
	  This kernel config can be used to enable CM_MGR MT6873. When enable
	  this option, dram opp level will be changed which will depended
	  on power table.
	  If unsure, say N.

config MTK_CM_MGR_MT6879
	tristate "MTK CM_MGR for MT6879"
	help
	  This kernel config can be used to enable CM_MGR MT6879. When enable
	  this option, dram opp level will be changed which will depended
	  on power table.
	  If unsure, say N.

config MTK_CM_MGR_MT6893
	tristate "MTK CM_MGR for MT6893"
	help
	  This kernel config can be used to enable CM_MGR MT6893. When enable
	  this option, dram opp level will be changed which will depended
	  on power table.
	  If unsure, say N.

config MTK_CM_MGR_MT6983
	tristate "MTK CM_MGR for MT6983"
	help
	  This kernel config can be used to enable CM_MGR MT6983. When enable
	  this option, dram opp level will be changed which will depended
	  on power table.
	  If unsure, say N.

config MTK_CM_MGR_MT6895
	tristate "MTK CM_MGR for MT6895"
	help
	  This kernel config can be used to enable CM_MGR MT6983. When enable
	  this option, dram opp level will be changed which will depended
	  on power table.
	  If unsure, say N.
```

## drivers/misc/mediatek/cm_mgr_legacy/Kconfig
```kconfig
config MTK_CM_MGR_LEGACY
	tristate "MTK CM_MGR for LEGACY"
	help
	  This kernel config can be used to enable CM_MGR. When enable
	  this option, dram opp level will be changed which will depended
	  on power table.
	  If unsure, say N.
```

## drivers/misc/mediatek/cmdq/Kconfig
```kconfig
config MTK_CMDQ_MBOX_EXT
	tristate "enable CMDQ mailbox driver extension"
	help
	  This extension enable debug feature, such as cmdq-status,
	  cmdq-record, pre-dump, timeout error dump, first error buffer
	  and aee db. Enable performance tools which add instruction
	  inside packet and profiling. Also enable secure path with
	  new sec controller which decuple with v3 driver.

config MTK_CMDQ_DEBUG
	tristate "enable CMDQ mailbox driver hw trace debug extension"
	help
	  This extension enables hw trace feature for cmdq driver, we
	  only default enable hw trace feature in userdebug/eng load, and avoid
	  user load for performance concern. But for hw trace feature,
	  user can enable/disable it with adb command.
```

## drivers/misc/mediatek/cmo/Kconfig
```kconfig
config MTK_ION_CACHE_OPTIMIZATION
	bool "MTK FPGA EARLY PORTING"
	default n
	help
	  This option is used for optimize ion cache
	  operation flow, users only pass flushed address
	  and range, CMO driver decides using which operations
	  (by set/way or by range).
```

## drivers/misc/mediatek/conn_md/Kconfig
```kconfig
config MTK_CONN_MD
	bool "Support mtk connsys modem config"
	default n if MTK_COMBO_CHIP_CONSYS_6885
	default n if MTK_COMBO_CHIP_CONSYS_6893
	default y if MTK_CONN_LTE_IDC_SUPPORT
	help
	  It is used to config whether IDC feature
	  is supported or not.
	  When IDC feature is required,
	  this config must be enabled to support
	  SW IDC message exchange.
	  Usually if a project support both LTE and Wi-Fi,
	  IDC feature is necessary to avoid interference between LTE and Wi-Fi.
```

## drivers/misc/mediatek/conn_scp/Kconfig
```kconfig
config MTK_CONN_SCP
	tristate "Support mtk connsys scp bridge"
	help
	  It is used to config whether IDC feature
	  is supported or not.
	  When IDC feature is required,
	  this config must be enabled to support
	  SW IDC message exchange.
	  Usually if a project support both LTE and Wi-Fi,
	  IDC feature is necessary to avoid interference between LTE and Wi-Fi.
```
