## drivers/misc/mediatek/sensors-1.0/accelerometer/mpu6050g/Kconfig
```kconfig
config MTK_MPU6050G
	bool "MPU6050G g-sensor for MediaTek package"
	help
	  It support different accelerometer sensor.
          If this option is set,
	  it will support
          MPU6050G Accelerometer.
```

## drivers/misc/mediatek/sensors-1.0/accelgyro/Kconfig
```kconfig
config MTK_AUTO_DETECT_ACCELGYRO
	bool "MTK AUTO DETECT ACCELEGYRO Sensor"
	depends on MTK_SENSOR_SUPPORT
	help
	  one load to support different accelerometer and gyro sensor.
	  If this option is set, multiple accelerometer and gyro driver
	  can be configured at the same time, but only one
	  can be probed.

config CUSTOM_KERNEL_ACCELGYRO
	bool "MTK_BMI160_ACCELGYRO_SPI for MediaTek package"
	default n
	help
	  The BMI160 is a highly integrated,
	  low power internal measurement unit
	  that provides precise acceleration
	  and angular rate (gyroscopic) measurement.
	  this config will turn on accelerometer feature.

source "drivers/misc/mediatek/sensors-1.0/accelgyro/bmi160-spi/Kconfig"
```

## drivers/misc/mediatek/sensors-1.0/accelgyro/bmi160-spi/Kconfig
```kconfig
config MTK_BMI160_SPI
	bool "MTK_BMI160 for MediaTek package"
	default n
	help
	  The BMI160 is a highly integrated,
	  low power internal measurement unit
	  that provides precise acceleration
	  and angular rate (gyroscopic) measurement.
	  this config will turn on accelerometer feature.
```

## drivers/misc/mediatek/sensors-1.0/activity_sensor/Kconfig
```kconfig
config CUSTOM_KERNEL_ACTIVITY_SENSOR
	bool "CUSTOM KERNEL ACTIVITY SENSOR"
	help
	  Kernel space activity sensor driver.
	  A activity is a device,
	  usually portable and electronic or electromechanical,
	  the state of some device motion.

source "drivers/misc/mediatek/sensors-1.0/activity_sensor/activityhub/Kconfig"
```

## drivers/misc/mediatek/sensors-1.0/activity_sensor/activityhub/Kconfig
```kconfig
config MTK_ACTIVITYHUB
	bool "activityhub for MediaTek package"
	default n
	help
	  MTK sensor hub driver for activity sensor.
	  If this option is set,
	  it will support
	  activityhub driver.
```

## drivers/misc/mediatek/sensors-1.0/alsps/Kconfig
```kconfig
config CUSTOM_KERNEL_ALSPS
	bool "CUSTOM KERNEL ALSPS Config"
	help
	  ALSPS sensor driver to detect ambient light and the object is close
	  or far awary from device. After configure this configuration,
	  the specific ambient light and proximity sensor driver configuration
	  should be configured as well.

config MTK_AUTO_DETECT_ALSPS
	bool "MTK AUTO DETECT ALSPS Sensor"
	help
	  This feature Option is used for projects which using more than one
	  ALSPS sensors, more than one ALSPS drivers can be builded in to
	  project and be auto detected by setting this option to yes,
	  usually only one ALSPS driver can be probed.

config CUSTOM_KERNEL_ALS
	bool "CUSTOM KERNEL ALS Config"
	help
	  ALS sensor driver to detect ambient light.
	  After configure this configuration,the specific
	  ambient light sensor driver configuration
	  should be configured as well.

source "drivers/misc/mediatek/sensors-1.0/alsps/alspshub/Kconfig"
source "drivers/misc/mediatek/sensors-1.0/alsps/cm36558/Kconfig"
source "drivers/misc/mediatek/sensors-1.0/alsps/ltr303/Kconfig"
source "drivers/misc/mediatek/sensors-1.0/alsps/ltr559/Kconfig"
source "drivers/misc/mediatek/sensors-1.0/alsps/stk3x1x/Kconfig"
```

## drivers/misc/mediatek/sensors-1.0/alsps/alspshub/Kconfig
```kconfig
config MTK_ALSPSHUB
	bool "alspshub for MediaTek package"
	help
	  It support different alspshub sensor.
	  If this option is set,
	  it will support
	  sensorhub gyroscope.
```

## drivers/misc/mediatek/sensors-1.0/alsps/ltr303/Kconfig
```kconfig
config MTK_LTR303
	bool "ltr303 als sensor for MediaTek package"
	help
	  It support different type sensor in this platform
	  If this option is set, it will support ambient
          and light sensor ltr303
```

## drivers/misc/mediatek/sensors-1.0/alsps/stk3x1x/Kconfig
```kconfig
config MTK_STK3X1X_NEW
	bool "STK3X1X for MediaTek package"
	help
	  It support different type sensor
	  in this platform. If this option
	  is set, it will support ambient
	  and light sensor STK3X1X.
```

## drivers/misc/mediatek/sensors-1.0/barometer/Kconfig
```kconfig
config CUSTOM_KERNEL_BAROMETER
	bool "CUSTOM KERNEL BAROMETER Config"
	help
	  one load to support different barometer sensor.
	  This feature Option is used for projects which using more than one
	  barometer, and be auto detected by setting this option to yes
	  If unsure, say N.

source "drivers/misc/mediatek/sensors-1.0/barometer/barohub/Kconfig"
#source "drivers/misc/mediatek/sensors-1.0/barometer/BMP280-new/Kconfig"
```

## drivers/misc/mediatek/sensors-1.0/barometer/barohub/Kconfig
```kconfig
config MTK_BAROHUB
	bool "barohub for MediaTek package"
	default n
	help
	  It support different barohub sensor.
	  If this option is set,
	  it will support
	  sensorhub gyroscope.
```

## drivers/misc/mediatek/sensors-1.0/biometric/Kconfig
```kconfig
config CUSTOM_KERNEL_BIOMETRIC_SENSOR
	bool "Support biometric sensor"
	help
	  biometric sensor to detect EKG(Electrocardiogram),
	  PPG(Photoplethysmogram ), etc.
	  If the platform is supported for biometric, this
	  configuration should be configured, and the biometric
	  driver configuration should be configured as well.

source "drivers/misc/mediatek/sensors-1.0/biometric/mt6381/Kconfig"
```

## drivers/misc/mediatek/sensors-1.0/gyroscope/ITG1010/Kconfig
```kconfig
config MTK_ITG1010
	tristate "ITG1010 for MediaTek package"
	default n
	help
	  It support different gyroscope sensor.
	  If this option is set, it will support
	  ITG1010 gyroscope which is a single-chip,
	  3 axis MEMS gyroscope IC.
```

## drivers/misc/mediatek/sensors-1.0/gyroscope/Kconfig
```kconfig
config CUSTOM_KERNEL_GYROSCOPE
	bool "CUSTOM KERNEL GYROSCOPE Config"
	help
	  gyroscope sensor to detect gyroscope from x y z axis.
	  If the platform is supported for gyroscope, this
	  configuration should be configured, and the gyroscope
	  driver configuration should be configured as well.

source "drivers/misc/mediatek/sensors-1.0/gyroscope/gyrohub/Kconfig"
#source "drivers/misc/mediatek/sensors-1.0/gyroscope/bmi160gy-i2c/Kconfig"
source "drivers/misc/mediatek/sensors-1.0/gyroscope/ITG1010/Kconfig"
#source "drivers/misc/mediatek/sensors-1.0/gyroscope/mpu6050gy/Kconfig"
```

## drivers/misc/mediatek/sensors-1.0/gyroscope/bmi160gy-i2c/Kconfig
```kconfig
config MTK_BMI160GY_I2C
	bool "MTK_BMI160GY_I2C for MediaTek package"
	default n
	help
	  The BMI160 is a highly integrated,
	  low power internal measurement unit
	  that provides precise acceleration
	  and angular rate (gyroscopic) measurement.
	  It support different gyroscope sensor.
	  If this option is set, it will support
	  BMI160 gyroscope.
```

## drivers/misc/mediatek/sensors-1.0/gyroscope/gyrohub/Kconfig
```kconfig
config MTK_GYROHUB
	bool "gyrohub for MediaTek package"
	help
	  It support different gyrohub sensor.
	  If this option is set,
	  it will support
	  sensorhub gyroscope.
```

## drivers/misc/mediatek/sensors-1.0/gyroscope/lsm6ds3hgy/Kconfig
```kconfig
config MTK_LSM6DS3HGY
	bool "LSM6DS3H for MediaTek package"
	default n
	help
	  LSM6DS3H is a system-in-package featureing a 3D digital accelerometer
	  and a 3D digital gyroscope performing at 1.1mA in high-performance mode
	  and enabling always-on low-power features for an optional motion
	  experience for the customer.
```

## drivers/misc/mediatek/sensors-1.0/gyroscope/mpu6050gy/Kconfig
```kconfig
config MTK_MPU6050GY
	bool "MPU6050GY gyroscope for MediaTek package"
	help
	  It support different gyroscope sensor.
	  If this option is set,
	  it will support MPU6050 gyroscope.
```

## drivers/misc/mediatek/sensors-1.0/high_freq_sensor/Kconfig
```kconfig
config MTK_HIGH_FREQ_SENSOR
	bool "MTK HIGH FREQUENCY SENSOR Config"
	help
	  high frequency sensor is an architecture to detect
	  sensor raw data. If the platform is supported for high
	  frequency sensor, this configuration should be configured,
	  and the subdevice driver configuration should be configured as well.

source "drivers/misc/mediatek/sensors-1.0/high_freq_sensor/lsm6dsm_secondary/Kconfig"
```

## drivers/misc/mediatek/sensors-1.0/hwmon/Kconfig
```kconfig
config MTK_HWMON
	bool "MTK HWMON Config"
	default n
	help
	  CONFIG_MTK_HWMON for sensor common util
```

## drivers/misc/mediatek/sensors-1.0/magnetometer/Kconfig
```kconfig
config MTK_AUTO_DETECT_MAGNETOMETER
	bool "MTK AUTO DETECT MAGNETOMETER Sensor"
	help
	  one load to support different magnetometer sensor.
	  This feature Option is used for projects which using more than one
	  magnetometer, more than one ALSPS drivers can be builded in to
	  project and be auto detected by setting this option to yes

config CUSTOM_KERNEL_MAGNETOMETER
	bool "CUSTOM KERNEL MAGNETOMETER Config"
	help
	  compass driver to detect compass raw data and report orientatino
	  data. A compass is an instrument used for navigation and
	  orientation that shows direction relative to the geographic
	  cardinal directions, or "points".

source "drivers/misc/mediatek/sensors-1.0/magnetometer/maghub/Kconfig"
source "drivers/misc/mediatek/sensors-1.0/magnetometer/akm09915/Kconfig"
source "drivers/misc/mediatek/sensors-1.0/magnetometer/akm09911/Kconfig"
source "drivers/misc/mediatek/sensors-1.0/magnetometer/akm09918/Kconfig"
```

## drivers/misc/mediatek/sensors-1.0/magnetometer/akm09915/Kconfig
```kconfig
config MTK_AKM09915_NEW
	bool "AKM09915 for MediaTek package"
	default n
	help
	  It support different magnetometer sensor.
	  If this option is set,
	  it will support
	  AKMD09915 magnetometer with high sensitive hall sensor technology.
```

## drivers/misc/mediatek/sensors-1.0/magnetometer/akm09918/Kconfig
```kconfig
config MTK_AKM09918
	bool "AKM09918 for MediaTek package"
	default n
	help
	  It support different magnetometer sensor.
	  If this option is set,
	  it will support
	  AKMD09918 magnetometer.
```

## drivers/misc/mediatek/sensors-1.0/magnetometer/maghub/Kconfig
```kconfig
config MTK_MAGHUB
	bool "maghub for MediaTek package"
	default n
	help
	  It support different maghub sensor.
	  If this option is set,
	  it will support
	  sensorhub gyroscope.
```
