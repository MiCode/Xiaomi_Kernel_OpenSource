## drivers/misc/mediatek/sensors-1.0/sensorHub/Kconfig
```kconfig
config CUSTOM_KERNEL_SENSORHUB
	bool "CUSTOM KERNEL SENSORHUB support"
	help
	  Kernel space sensor hub driver.
	  Define project used all sensor hub
	  sensors. The value is combination of sensor hub driver(get data...etc)
	  and sensor hub framework driver(transmit shf info)

#source "drivers/misc/mediatek/sensors-1.0/sensorHub/SCP_sensorHub/Kconfig"
#source "drivers/misc/mediatek/sensors-1.0/sensorHub/SCP_sensorHub_v1/Kconfig"
#source "drivers/misc/mediatek/sensors-1.0/sensorHub/SCP_shf/Kconfig"

source "drivers/misc/mediatek/sensors-1.0/sensorHub/nanohub/Kconfig"
```

## drivers/misc/mediatek/sensors-1.0/sensorHub/nanohub/Kconfig
```kconfig
config NANOHUB
	tristate "Nanohub"
	default N
	help
	  Enable support for the nanohub sensorhub driver.
	  This driver supports the android nanohub sensorhub.
	  Set Y to enable this feature.
	  If in doubt, say N here.

if NANOHUB

config NANOHUB_MTK_IPI
	bool "Nanohub MTK IPI"
	default Y
	help
	  Enable nanohub MTK IPI support.
	  Either this or NANOHUB_SPI/NANOHUB_I2C should be selected.
	  MTK platform only protocol.
	  If in doubt, say N here.

endif # NANOHUB
```

## drivers/misc/mediatek/sensors-1.0/sensor_cal/Kconfig
```kconfig
config CUSTOM_KERNEL_SENSOR_CAL
  bool "CUSTOM_KERNEL_SENSOR_CAL"
  help
    Kernel driver which implements file I/O to read&write sensor cal file 
```

## drivers/misc/mediatek/sensors-1.0/sensorfusion/Kconfig
```kconfig
config CUSTOM_KERNEL_SENSOR_FUSION
	bool "CUSTOM KERNEL SENSOR FUSION config"
	help
	  fusion sensor is a sensor conclusion.
	  If the platform is supported for fusion, this
	  configuration should be configured, and the fusion
	  driver configuration should be configured as well.

config CUSTOM_KERNEL_GRV_SENSOR
	bool "CUSTOM KERNEL GRV SENSOR config"
	help
	  grv sensor is a sensor fusion type.
	  If the platform is supported for grv, this
	  configuration should be configured, and the grv
	  driver configuration should be configured as well.

config CUSTOM_KERNEL_GMRV_SENSOR
	bool "CUSTOM KERNEL GMRV SENSOR config"
	help
	  gmrv sensor is a sensor fusion type.
	  If the platform is supported for gmrv, this
	  configuration should be configured, and the gmrv
	  driver configuration should be configured as well.

config CUSTOM_KERNEL_RV_SENSOR
	bool "CUSTOM KERNEL RV SENSOR config"
	help
	  rv sensor is a sensor fusion type.
	  If the platform is supported for rv, this
	  configuration should be configured, and the rv
	  driver configuration should be configured as well.

config CUSTOM_KERNEL_LINEARACCEL_SENSOR
	bool "CUSTOM KERNEL LINEARACCEL SENSOR config"
	help
	  linearacc sensor is a sensor fusion type.
	  If the platform is supported for linearacc, this
	  configuration should be configured, and the linearacc
	  driver configuration should be configured as well.

config CUSTOM_KERNEL_GRAVITY_SENSOR
	bool "CUSTOM KERNEL GRAVITY SENSOR config"
	help
	  gravity sensor is a sensor fusion type.
	  If the platform is supported for gravity, this
	  configuration should be configured, and the gravity
	  driver configuration should be configured as well.

config CUSTOM_KERNEL_ORIENTATION
	bool "CUSTOM KERNEL ORIENTATION config"
	help
	  orient sensor is a sensor fusion type.
	  If the platform is supported for orient, this
	  configuration should be configured, and the orient
	  driver configuration should be configured as well.

config CUSTOM_KERNEL_UNCALI_ACC_SENSOR
	bool "CUSTOM KERNEL UNCALI ACC SENSOR config"
	help
	  ungyro sensor is a sensor fusion type.
	  If the platform is supported for unacc, this
	  configuration should be configured, and the unacc
	  driver configuration should be configured as well.

config CUSTOM_KERNEL_UNCALI_GYRO_SENSOR
	bool "CUSTOM KERNEL UNCALI GYRO SENSOR config"
	help
	  ungyro sensor is a sensor fusion type.
	  If the platform is supported for ungyro, this
	  configuration should be configured, and the ungyro
	  driver configuration should be configured as well.

config CUSTOM_KERNEL_UNCALI_MAG_SENSOR
	bool "CUSTOM KERNEL UNCALI MAG SENSOR config"
	help
	  unmag sensor is a sensor fusion type.
	  If the platform is supported for unmag, this
	  configuration should be configured, and the unmag
	  driver configuration should be configured as well.

source "drivers/misc/mediatek/sensors-1.0/sensorfusion/uncali_maghub/Kconfig"
source "drivers/misc/mediatek/sensors-1.0/sensorfusion/uncali_gyrohub/Kconfig"
source "drivers/misc/mediatek/sensors-1.0/sensorfusion/gamerotvechub/Kconfig"
source "drivers/misc/mediatek/sensors-1.0/sensorfusion/rotatvechub/Kconfig"
source "drivers/misc/mediatek/sensors-1.0/sensorfusion/gmagrotvechub/Kconfig"
source "drivers/misc/mediatek/sensors-1.0/sensorfusion/gravityhub/Kconfig"
source "drivers/misc/mediatek/sensors-1.0/sensorfusion/linearacchub/Kconfig"
source "drivers/misc/mediatek/sensors-1.0/sensorfusion/orienthub/Kconfig"
source "drivers/misc/mediatek/sensors-1.0/sensorfusion/uncali_acchub/Kconfig"
```

## drivers/misc/mediatek/sensors-1.0/sensorfusion/gamerotvechub/Kconfig
```kconfig
config MTK_GAMEROTVECHUB
	bool "gamerotvechub for MediaTek package"
	help
	  MTK sensor hub driver for Game rotation vector sensor.
	  If this option is set,
	  it will support
	  gamerotvechub driver.
```

## drivers/misc/mediatek/sensors-1.0/sensorfusion/gmagrotvechub/Kconfig
```kconfig
config MTK_GMAGROTVECHUB
	bool "gmagrotvechub for MediaTek package"
	help
	  MTK sensor hub driver for Geomagnetic rotation vector sensor.
	  If this option is set,
	  it will support
	  gmagrotvechub driver.
```

## drivers/misc/mediatek/sensors-1.0/sensorfusion/gravityhub/Kconfig
```kconfig
config MTK_GRAVITYHUB
	bool "gravityhub for MediaTek package"
	help
	  MTK sensor hub driver for Gravity sensor.
	  If this option is set,
	  it will support
	  gravityhub driver.
```

## drivers/misc/mediatek/sensors-1.0/sensorfusion/linearacchub/Kconfig
```kconfig
config MTK_LINEARACCHUB
	bool "linearacchub for MediaTek package"
	default n
	help
	  MTK sensor hub driver for Linear acceleration sensor.
	  If this option is set,
	  it will support
	  linearacchub driver.
```

## drivers/misc/mediatek/sensors-1.0/sensorfusion/orienthub/Kconfig
```kconfig
config MTK_ORIENTHUB
	bool "orienthub for MediaTek package"
	help
	  MTK sensor hub driver for Orientation sensor.
	  If this option is set,
	  it will support
	  orienthub driver.
```

## drivers/misc/mediatek/sensors-1.0/sensorfusion/rotatvechub/Kconfig
```kconfig
config MTK_ROTATVECHUB
	bool "rotatvechub for MediaTek package"
	help
	  MTK sensor hub driver for Rotation vector sensor.
	  If this option is set,
	  it will support
	  rotatvechub driver.
```

## drivers/misc/mediatek/sensors-1.0/sensorfusion/sensorfusion_hub/Kconfig
```kconfig
source "drivers/misc/mediatek/sensors-1.0/sensorfusion/sensorfusion_hub/uncali_maghub/Kconfig"
source "drivers/misc/mediatek/sensors-1.0/sensorfusion/sensorfusion_hub/uncali_gyrohub/Kconfig"
source "drivers/misc/mediatek/sensors-1.0/sensorfusion/sensorfusion_hub/gamerotvechub/Kconfig"
source "drivers/misc/mediatek/sensors-1.0/sensorfusion/sensorfusion_hub/rotatvechub/Kconfig"
source "drivers/misc/mediatek/sensors-1.0/sensorfusion/sensorfusion_hub/gmagrotvechub/Kconfig"
source "drivers/misc/mediatek/sensors-1.0/sensorfusion/sensorfusion_hub/gravityhub/Kconfig"
source "drivers/misc/mediatek/sensors-1.0/sensorfusion/sensorfusion_hub/linearacchub/Kconfig"
source "drivers/misc/mediatek/sensors-1.0/sensorfusion/sensorfusion_hub/orienthub/Kconfig"
source "drivers/misc/mediatek/sensors-1.0/sensorfusion/sensorfusion_hub/uncali_acchub/Kconfig"
```

## drivers/misc/mediatek/sensors-1.0/sensorfusion/sensorfusion_hub/linearacchub/Kconfig
```kconfig
config MTK_LINEARACCHUB
	bool "linearacchub for MediaTek package"
	help
	  MTK sensor hub driver for Linear acceleration sensor.
	  If this option is set,
	  it will support
	  linearacchub driver.
```

## drivers/misc/mediatek/sensors-1.0/sensorfusion/sensorfusion_hub/uncali_acchub/Kconfig
```kconfig
config MTK_UNCALI_ACCHUB
	bool "uncali_acchub for MediaTek package"
	help
	  MTK sensor hub driver for Accelerameter sensor.
	  If this option is set,
	  it will support
	  uncali_acchub driver.
```

## drivers/misc/mediatek/sensors-1.0/sensorfusion/sensorfusion_hub/uncali_gyrohub/Kconfig
```kconfig
config MTK_UNCALI_GYROHUB
	bool "uncali_gyrohub for MediaTek package"
	help
	  MTK sensor hub driver for Gyroscope uncalibrated sensor.
	  If this option is set,
	  it will support
	  uncali_gyrohub driver.
```

## drivers/misc/mediatek/sensors-1.0/sensorfusion/uncali_gyrohub/Kconfig
```kconfig
config MTK_UNCALI_GYROHUB
	bool "uncali_gyrohub for MediaTek package"
	default n
	help
	  MTK sensor hub driver for Gyroscope uncalibrated sensor.
	  If this option is set,
	  it will support
	  uncali_gyrohub driver.
```

## drivers/misc/mediatek/sensors-1.0/sensorfusion/uncali_maghub/Kconfig
```kconfig
config MTK_UNCALI_MAGHUB
	bool "uncali_maghub for MediaTek package"
	help
	  MTK sensor hub driver for Magnetic field uncalibrated sensor.
	  If this option is set,
	  it will support
	  uncali_maghub driver.
```

## drivers/misc/mediatek/sensors-1.0/situation/Kconfig
```kconfig
config CUSTOM_KERNEL_SITUATION
	bool "mediatek situation sensor tag"
	help
	  Kernel space support situation sensor driver.
	  If the platform is supported for gesture, this
	  configuration should be configured, and the situation
	  driver configuration should be configured as well.

source "drivers/misc/mediatek/sensors-1.0/situation/situation_hub/Kconfig"
```

## drivers/misc/mediatek/sensors-1.0/situation/answercall/Kconfig
```kconfig
config MTK_ANSWER_CALL_HUB
	bool "glghub for MediaTek package"
	default n
	help
	  A answer call is a device,
	  usually portable and electronic
	  or electromechanical,
	  that detect answer call a person takes.
```

## drivers/misc/mediatek/sensors-1.0/situation/device_orientation/Kconfig
```kconfig
config MTK_DEVICE_ORIENTATION_HUB
	bool "device orientation hub for MediaTek package"
	default n
	help
	  A device orientation is a device,
	  usually portable and
	  electronic or electromechanical,
	  that detect device's orientation.
```

## drivers/misc/mediatek/sensors-1.0/situation/elevator_detect/Kconfig
```kconfig
config ELEVATOR_DETECT
	bool "elevator detect hub for MediaTek package"
	default n
```

## drivers/misc/mediatek/sensors-1.0/situation/flat/Kconfig
```kconfig
config MTK_FLAT_HUB
	bool "flat for MediaTek package"
	default n
	help
	  Put the device lie on the table.
```

## drivers/misc/mediatek/sensors-1.0/situation/glance_gesture/Kconfig
```kconfig
config MTK_GLGHUB
	bool "glghub for MediaTek package"
	default n
	help
	  A glance gesture is a device,
	  usually portable and electronic
	  or electromechanical,
	  that detect glance action a person takes.
```

## drivers/misc/mediatek/sensors-1.0/situation/inpocket/Kconfig
```kconfig
config MTK_INPKHUB
	bool "inpocket for MediaTek package"
	help
	  A in pocket is a device,
	  usually portable
	  and electronic or electromechanical,
	  that detect device's position.
```

## drivers/misc/mediatek/sensors-1.0/situation/lightsecondary/Kconfig
```kconfig
config MTK_LIGHTSECONDARY_HUB
	bool "lightsecondaryhub for MediaTek package"
	default n
	help
	  A lightsecondary is a device,
	  usually portable and electronic
	  or electromechanical,
	  that detect distance between the body and device .
```
