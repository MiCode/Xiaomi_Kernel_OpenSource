## drivers/misc/mediatek/sensors-1.0/situation/motion_detect/Kconfig
```kconfig
config MTK_MOTION_DETECT_HUB
	bool "motion detect hub for MediaTek package"
	default n
	help
	  A motion detection is a device,
	  usually portable
	  and electronic or electromechanical,
	  that detect device is moved.
```

## drivers/misc/mediatek/sensors-1.0/situation/pickup_gesture/Kconfig
```kconfig
config MTK_PICKUPHUB
	bool "pickuphub for MediaTek package"
	default n
	help
	  A pick up is a device,
	  usually portable
	  and electronic or electromechanical,
	  that detect device is picked up.
```

## drivers/misc/mediatek/sensors-1.0/situation/sar/Kconfig
```kconfig
config MTK_SAR_HUB
	bool "sarthub for MediaTek package"
	default n
	help
	  A sar is a device,
	  usually portable and electronic
	  or electromechanical,
	  that detect distance between the body and device .
```

## drivers/misc/mediatek/sensors-1.0/situation/sar_algo/Kconfig
```kconfig
config MTK_SAR_ALGO_HUB
	tristate "flat for MediaTek package"
	help
	  Put the device lie on the table.
```

## drivers/misc/mediatek/sensors-1.0/situation/sar_algo_top/Kconfig
```kconfig
config MTK_SAR_ALGO_TOP_HUB
	bool "flat for MediaTek package"
	help
	  Put the device lie on the table.
```

## drivers/misc/mediatek/sensors-1.0/situation/situation_hub/Kconfig
```kconfig
source "drivers/misc/mediatek/sensors-1.0/situation/situation_hub/stationary/Kconfig"
source "drivers/misc/mediatek/sensors-1.0/situation/situation_hub/inpocket/Kconfig"
source "drivers/misc/mediatek/sensors-1.0/situation/situation_hub/wake_gesture/Kconfig"
source "drivers/misc/mediatek/sensors-1.0/situation/situation_hub/glance_gesture/Kconfig"
source "drivers/misc/mediatek/sensors-1.0/situation/situation_hub/answercall/Kconfig"
source "drivers/misc/mediatek/sensors-1.0/situation/situation_hub/pickup_gesture/Kconfig"
source "drivers/misc/mediatek/sensors-1.0/situation/situation_hub/device_orientation/Kconfig"
source "drivers/misc/mediatek/sensors-1.0/situation/situation_hub/motion_detect/Kconfig"
source "drivers/misc/mediatek/sensors-1.0/situation/situation_hub/tilt_detector/Kconfig"
source "drivers/misc/mediatek/sensors-1.0/situation/situation_hub/flat/Kconfig"
source "drivers/misc/mediatek/sensors-1.0/situation/situation_hub/sar/Kconfig"
```

## drivers/misc/mediatek/sensors-1.0/situation/situation_hub/answercall/Kconfig
```kconfig
config MTK_ANSWER_CALL_HUB
	bool "glghub for MediaTek package"
	help
	  A answer call is a device,
	  usually portable and electronic
	  or electromechanical,
	  that detect answer call a person takes.
```

## drivers/misc/mediatek/sensors-1.0/situation/situation_hub/motion_detect/Kconfig
```kconfig
config MTK_MOTION_DETECT_HUB
	bool "motion detect hub for MediaTek package"
	help
	  A motion detection is a device,
	  usually portable
	  and electronic or electromechanical,
	  that detect device is moved.
```

## drivers/misc/mediatek/sensors-1.0/situation/situation_hub/sar/Kconfig
```kconfig
config MTK_SAR_HUB
	bool "sarthub for MediaTek package"
	help
	  A sar is a device,
	  usually portable and electronic
	  or electromechanical,
	  that detect distance between the body and device .
```

## drivers/misc/mediatek/sensors-1.0/situation/situation_hub/sar_unify/Kconfig
```kconfig
config MTK_SAR_UNIFY_HUB
	bool "flat for MediaTek package"
	help
	  Put the device lie on the table.
```

## drivers/misc/mediatek/sensors-1.0/situation/situation_hub/stationary/Kconfig
```kconfig
config MTK_STATHUB
	bool "stahub for MediaTek package"
	help
	  A stationary is a device,
	  usually portable
	  and electronic or electromechanical,
	  that detect device is kept static.
```

## drivers/misc/mediatek/sensors-1.0/situation/situation_hub/tilt_detector/Kconfig
```kconfig
config MTK_TILTDETECTHUB
	bool "tiltdetecthub for MediaTek package"
	help
	  A tilt detect is a device,
	  usually portable and electronic
	  or electromechanical,
	  that detect device is picked up with 35 degree.
```

## drivers/misc/mediatek/sensors-1.0/situation/situation_hub/wake_gesture/Kconfig
```kconfig
config MTK_WAKEHUB
	bool "wakehub for MediaTek package"
	help
	  A wake is a device,
	  usually portable and electronic
	  or electromechanical,
	  that detect device is picked up with 35 degree.
```

## drivers/misc/mediatek/sensors-1.0/situation/stationary/Kconfig
```kconfig
config MTK_STATHUB
	bool "stahub for MediaTek package"
	default n
	help
	  A stationary is a device,
	  usually portable
	  and electronic or electromechanical,
	  that detect device is kept static.
```

## drivers/misc/mediatek/sensors-1.0/step_counter/Kconfig
```kconfig
config CUSTOM_KERNEL_STEP_COUNTER
	bool "CUSTOM_KERNEL_STEP_COUNTER"
	help
	  A step counter is a device, usually portable and electronic or electromechanical,
	  that counts each step a person takes by detecting the motion of the person's hands or hips.

config CUSTOM_KERNEL_SIGNIFICANT_MOTION
	bool "open significant motion"
	help
	  Kernel space sigificant motion sensor driver.

source "drivers/misc/mediatek/sensors-1.0/step_counter/stepsignhub/Kconfig"
```

## drivers/misc/mediatek/sensors-1.0/step_counter/stepsignhub/Kconfig
```kconfig
config MTK_STEPSIGNHUB
	bool "STEPSIGNHUB for MediaTek package"
	default n
	help
	  A significant motions is a device,
	  usually portable
	  and electronic or electromechanical,
	  that detect each step a person takes
	  by detecting the motion of the person's hands or hips.
```

## drivers/misc/mediatek/shake_sensor/Kconfig
```kconfig
config CUSTOM_KERNEL_SHAKE_SENSOR
	bool "CUSTOM_KERNEL_SHAKE_SENSOR"
	help
	  Kernel space shake sensor driver.
```

## drivers/misc/mediatek/simtray/Kconfig
```kconfig
config SIMTRAY_STATUS
	tristate "Xiaomi SIM tray status"
	default n
	help
	  Say 'm' here to support SIM tray GPIO detection
```

## drivers/misc/mediatek/slbc/Kconfig
```kconfig
config MTK_SLBC
	tristate "MTK SLBC"
	help
	  This kernel config can be used to enable SLBC. When enable
	  this option, we will use system buffer to improve performance
	  and power.
	  If unsure, say N.

config MTK_SLBC_MT6893
	tristate "MTK SLBC MT6893"
	help
	  This kernel config can be used to enable SLBC at mt6893. When enable
	  this option, we will use system buffer to improve performance
	  and power.
	  If unsure, say N.

config MTK_SLBC_MT6983
	tristate "MTK SLBC MT6983"
	help
	  This kernel config can be used to enable SLBC at mt6983. When enable
	  this option, we will use system buffer to improve performance
	  and power.
	  If unsure, say N.

config MTK_SLBC_MT6895
	tristate "MTK SLBC MT6895"
	help
	  This kernel config can be used to enable SLBC at mt6895. When enable
	  this option, we will use system buffer to improve performance
	  and power.
	  If unsure, say N.

config MTK_SLBC_IPI
	tristate "MTK SLBC use IPI"
	help
	  This kernel config can be used to enable SLBC IPI. When enable
	  this option, we will use scmi on system buffer to improve
	  performance and power.
	  If unsure, say N.

config MTK_SLBC_MMSRAM
	tristate "MTK SLBC use MMSRAM"
	select MTK_SLBC
	help
	  This kernel config can be used to enable SLBC MMSRAM. When enable
	  this option, we will use system buffer to improve performance
	  and power.
	  If unsure, say N.
```

## drivers/misc/mediatek/smartpa/Kconfig
```kconfig
config MTK_SMARTPA_SOUND
	bool "MTK sound for external I2C driver"
	default n
	help
	  If you say Y, enable mtk audio i2c driver to control
	  external device for example:smartpa device.
```

## drivers/misc/mediatek/smi/Kconfig
```kconfig
config MTK_SMI_EXT
	bool "MTK SMI Common Driver Code"
	select MEMORY if !MTK_SMI_VARIANT
	select MTK_SMI if !MTK_SMI_VARIANT
	help
	  This config enable/disable SMI Driver.
	  SMI Driver is used to arbitrate memory bandwidth of multimedia.
	  and it can optimize multimedia memory usage in different scenarios.
	  If you are not sure about this, set y

config MTK_SMI_VARIANT
	bool "MTK SMI Tablet Code"
	select MTK_SMI_EXT
	help
	  It's for smi common tablet framework,
	  it is used to arbitrate memory bandwidth of multimedia,
	  it can optimize multimedia memory usage in different scenarios,
	  and it will enable power-domain.
```

## drivers/misc/mediatek/sound/Kconfig
```kconfig
config MTK_SOUND_DRV
  bool CONFIG_MTK_SOUND_DRV
  default n
  help
    CONFIG_MTK_SOUND_DRV
```

## drivers/misc/mediatek/spm/Kconfig
```kconfig
config MTK_SPM
	tristate "MTK SPM"
	help
	  This kernel config can be used to enable MTK QOS FRAMEWORK.
	  When enabling this option, BW Limiter and BW Bound Detector
	  will be enabled and set EMI hardware.
	  If unsure, say N.

config MTK_SPM_V0
	tristate "MTK SPM V0"
	help
	  This kernel config can be used to enable MTK SPM V0
	  for MT6765.

	  If unsure, say N.
```

## drivers/misc/mediatek/spm_v4/Kconfig
```kconfig
config MTK_SPM_V4
	tristate "MTK SPM V4"
	help
	  This kernel config can be used to enable MTK SPM V4
	  for MT6739, MT6763 and MT6771, spm is used to control
	  harware resource when devices enter suspend or idle state.
	  If unsure, say N.
```
