## drivers/misc/mediatek/nand/Kconfig
```kconfig
#nand
menuconfig MTK_MTD_NAND
	bool "Nand support based on Mediatek nand controller"
	depends on MTD
	help
	  NAND flash memory, a type of non-volatile storage device,
	  introduced by Toshiba in 1989. With formal commands,
	  controller can access data via devices.
	  This configuration enable Mediatek NAND controller to perform
	  operations on NAND devices of verious vendors.
	  For products choosing raw NAND as booting device,this configuration
	  must say y.
	  Since kernel using MTD as storage device common driver,
	  this configuration depends on MTD_NAND config.
	  Please visit JEDEC sites for more information.

config MTK_TLC_NAND_SUPPORT
	bool "Support TLC Nand based on Mediatek nand controller"
	depends on MTK_MTD_NAND
	help
	  In electronics, TLC is a memory element capable of
	  storing more than a single bit of information.
	  TLC NAND flash is a flash memory technology using multiple levels per
	  cell to allow more bits to be stored using the same number of
	  transistors.
	  The primary benefit of TLC flash memory is its lower cost per unit of
	  storage due to the higher data density, and memory-reading software
	  can compensate for a larger bit error rate.
	  Thus,firmware and driver to support TLC devices need to take care of
	  data robustness, and TLC features with extend command and storage
	  methods.
	  Compatible with SLC, MLC and TLC, Mediatek controller driver and
	  firmware have implement various method to enhance data robustness.
	  While using TLC devices as booting device, please set this
	  configuration as y to enable TLC features.

config MNTL_SUPPORT
	bool "Mediatek MNTL driver"
	depends on MTK_MTD_NAND
	help
	  MNTL designed by Mediatek own FTL for block device support,
	  And It is Mediatek Nand Translation Layer.
	  For mlc or tlc nand support this feature need to be opened.
	  Enable this feature if want to use MNTL handle nand management.
```

## drivers/misc/mediatek/nfc/Kconfig
```kconfig
config NFC_CHIP_SUPPORT
	tristate "NFC driver solution - NFC Controller Driver"
	depends on I2C
	help
	  STMicroelectronics ST21NFC Near Field Communication controller
	  support. ST21NFC is standalone NFC and ST54 is combined with secure
	  element. If configures to be y, means devices supports NFC
	  functionality. If configures to be n, means devices doesn't support
	  NFC functionality.


config MTK_NFC_CLKBUF_ENABLE
	bool "Enable clock buffer for NFC"
	help
	  Enable clock buffer from PMIC for NFC.
	  This configuration need to be set if support NFC functionality
	  whether STMicroelectronics solution or not.
	  If NFC solution is not STMicroelectronics,
	  this configuration SHOULD be set.
```

## drivers/misc/mediatek/otp/Kconfig
```kconfig
config MTK_OTP
	bool "MTK One-Time-Programmable Support"
	default n
	help
	  MTK One-Time-Programmable (i.e. OTP or EFUSE Run-Time Blowing)
	  APIs provide the mechanism for blowing, reading or to re-init
	  specific EFUSE customer fields in kernel or MD side. It helps
	  to set the PMIC to the correct settings for OTP and maintains
	  a mutex for solving currency issue.
```

## drivers/misc/mediatek/partition/Kconfig
```kconfig
config MTK_GPT_SCHEME_SUPPORT
	bool "MTK GUID Partition Table SCHEME SUPPORT"
	depends on EFI_PARTITION
	help
	  MTK Support for GUID Partition Table
	  Provide APIs to query GPT information
	  Set Y to support.
	  Set N to disable.
```

## drivers/misc/mediatek/pbm/Kconfig
```kconfig
config MTK_PBM
	tristate "MTK power budget management"
	select MTK_MDPM if MTK_PLAT_POWER_MT6765 = n
	help
	  This kernel config can be used to enable power budget management.
	  When enable this option, pbm will allocate limit power budget to
	  CPU and GPU when battery voltage is low.
	  If unsure, say N.
```

## drivers/misc/mediatek/pbm_v1/Kconfig
```kconfig
config MTK_PBM_LEGACY
	tristate "MTK power budget management legacy"
	help
	  This kernel config can be used to enable power budget management.
	  When enable this option, pbm will allocate limit power budget to
	  CPU and GPU when battery voltage is low.
	  If unsure, say N.
```

## drivers/misc/mediatek/pcie/Kconfig
```kconfig
config MTK_PCIE_SMT_SUPPORT
	bool "Mediatek PCIe SMT test"
	help
	  PCIe loopback test for SMT.
	  Set Y to enable this feature.
	  If unsure, Set N.
```

## drivers/misc/mediatek/pd/Kconfig
```kconfig
config TCPC_CLASS
	bool "TypeC Port Controller Device Class"
	help
	  Say Y to enable
	  Typec Port
	  Controller Device
	  Class

config USB_POWER_DELIVERY
	bool "Support USB power delivery Function"
	default n
	help
	  Say Y to enable
	  USB
	  Power Delivery
	  support

config TCPC_RT1711
	bool "Richtek RT1711 TypeC port Controller Driver"
	depends on TCPC_CLASS
	default n
	help
	  Say Y to enable
	  Richtek RT1711
	  TypeC port Controller
	  Driver

config TCPC_RT1711H
	bool "Richtek RT1711H TypeC port Controller Driver"
	depends on TCPC_CLASS
	default n
	help
	  Say Y to enable
	  Richtek RT1711H
	  TypeC port Controller
	  Driver

config USB_PD_VBUS_STABLE_TOUT
	int "PD VBUS Stable Timeout"
	depends on USB_POWER_DELIVERY
	range 0 1000                       # >= 0,  <= 1000
	default 125
	help
	  Setup a timeout value (ms)
	  for
	  VBUS change
	  stable

config RT7207_ADAPTER
	bool "Richtek RT7207 PD Adapter"
	depends on TCPC_CLASS
	default n
	help
	  Say Y to enable
	  Richtek RT7207
	  PD Adapter
	  Function.
```

## drivers/misc/mediatek/pdr_sensor/Kconfig
```kconfig
config CUSTOM_KERNEL_PDR_SENSOR
       bool "CUSTOM_KERNEL_PDR_SENSOR"
       default n
       help
          Kernel space PDR sensor driver.

source "drivers/misc/mediatek/pdr_sensor/pdrhub/Kconfig"
```

## drivers/misc/mediatek/pdr_sensor/pdrhub/Kconfig
```kconfig
config MTK_PDRHUB
	bool "pdrhub for MediaTek package"
	default n
	help
	  It support different pdrhub sensor.
          If this option is set,
	  it will support
          sensorhub pdrsensor.
```

## drivers/misc/mediatek/pedometer/Kconfig
```kconfig
config CUSTOM_KERNEL_PEDOMETER
	bool "CUSTOM_KERNEL_PEDOMETER"
	help
	  Kernel space pedometer sensor driver.

source "drivers/misc/mediatek/pedometer/pedohub/Kconfig"
```

## drivers/misc/mediatek/pedometer/pedohub/Kconfig
```kconfig
config MTK_PEDOHUB
	bool "pedohub for MediaTek package"
	default n
	help
	  It support different pedohub sensor.
          If this option is set,
	  it will support
          sensorhub pedometer.
```

## drivers/misc/mediatek/perf_common/Kconfig
```kconfig
config MTK_PERF_COMMON
	bool "MTK system performance common feature"
	help
	  CONFIG_MTK_PERF_COMMON provides common entrypoint to support
	  multiple the system performance features and it can easily
	  extend. The trigger period is aligned to sched-tick. If you are
	  not sure about whether to enable it or not, please set n.


config MTK_PERF_TRACKER
	bool "MTK system performance index support"
	depends on MTK_PERF_COMMON
	help
	  CONFIG_PERF_TRACKER define if system performance index should
	  be built-in or not. It supports system related performance index
	  via trace. If you are not sure about whether to enable it or not,
	  please set n.

config MTK_CORE_CTL
	bool "MTK Core Control with CPU Isolation"
	depends on MTK_SCHED_EXTENSION
	help
	  This config is for the core control policy with CPU isolation.
	  The core control online and offline CPU cores based on task
	  utilizations from scheduler information automatically.
	  If you are not sure about whether to enable it or not,
	  please set n.
```

## drivers/misc/mediatek/performance/Kconfig
```kconfig
config MTK_FPSGO_V3
	tristate "Support FPSGO_V3 framework"
	help
	  Support FPSGO_V3 framework for most FPS performance and
	  low power balance. As a perquisite to ensure FPS performance,
	  FPSGO_V3 persuades lowest power consumption for better DoU
	  endurance and gaming experience.
	  FPSGO_V3 include AI performance and low power.
	  If you are not sure about this, set n.

config MTK_PERFORMANCE_MODULE
	tristate "Mediatek Performance Module"
	help
	  For MediaTek performance modules, such as FPSGO and EARA-QoS
	  Select "y" if you want to enable power throttling feature
	  Select "n" if unsure.

config MTK_FRS
	tristate "Mediatek Frame Rate Smoother"
	help
	  Support Frame Rate Smoother kernel intergface. It will adjustment
	  target fps by thermal.
	  If you are not sure about this, set n.

config MTK_LOAD_TRACKER
	tristate "CPU Loading Tracking Service"
	depends on CPU_FREQ
	default n
	help
	  MTK_LOAD_TRACKER is the kernel config of CPU Loading Tracking
	  Service designed by MTK, which is a service to get CPU Loading
	  information. User can register callback and config polling
	  duration to get CPU loading.

config MTK_PERF_IOCTL_MAGT
	tristate "Mediatek Adaptive Gaming Technology"
	help
	  Support MAGT analysis performance.
          If you are not sure about this, set n.
```

## drivers/misc/mediatek/pick_up_sensor/Kconfig
```kconfig
config CUSTOM_KERNEL_PICK_UP_SENSOR
	bool "CUSTOM_KERNEL_PICK_UP_SENSOR"
	help
	  Kernel space pick up sensor driver.

source "drivers/misc/mediatek/pick_up_sensor/pickuphub/Kconfig"
```

## drivers/misc/mediatek/pidmap/Kconfig
```kconfig
#
# Kernel configuration file for Mediatek proprietary timers
#
# Copyright (C) 2018 Mediatek Inc.
#
# Authors:
#	Stanley Chu <stanley.chu@mediatek.com>
#
# This program is free software; you can redistribute it and/or
# modify it under the terms of the GNU General Public License
# as published by the Free Software Foundation; either version 2
# of the License, or (at your option) any later version.
# See the COPYING file in the top-level directory or visit
# <http://www.gnu.org/licenses/gpl-2.0.html>
#
# This program is distributed in the hope that it will be useful,
# but WITHOUT ANY WARRANTY; without even the implied warranty of
# MERCHANTABILITY or FITNESS FOR A PARTICULAR PURPOSE.  See the
# GNU General Public License for more details.
#
# This program is provided "AS IS" and "WITH ALL FAULTS" and
# without warranty of any kind. You are solely responsible for
# determining the appropriateness of using and distributing
# the program and assume all risks associated with your exercise
# of rights with respect to the program, including but not limited
# to infringement of third party rights, the risks and costs of
# program errors, damage to or loss of data, programs or equipment,
# and unavailability or interruption of operations. Under no
# circumstances will the contributor of this Program be liable for
# any damages of any kind arising from your use or distribution of
# this program.

config MTK_PID_MAP
	bool "Map of PID and Task Name"
	default n
	help
	  Enable task name recorder to
	  provide more pid and task name mappings.
	  More memory will be required for this feature,
	  so please consider the trade-off.
```
