## drivers/misc/mediatek/pmic/Kconfig
```kconfig
#
# MTK PMIC configuration
#

config MTK_PMIC_NEW_ARCH
	tristate "MediaTek Power Management New Arch driver"
	default n
	---help---
	  This selects for MediaTek(R) PMIC New Arch driver.
	  Separate pmic feature form Power folder that also have battery and charging feature.
	  Select y to support MTK PMIC NEW ARCH.
	  If so, you should choose the corresponding main chip to follow.

	  Select n to support MTK PMIC LEGACY ARCH.

config MTK_PMIC_COMMON
	tristate "MediaTek Power Management Common driver"
	default n
	---help---
	  This selects for MediaTek(R) PMIC common driver.
	  This feature is mainly to separate to common and platform part from driver layer.
	  Select y to support MTK PMIC COMMON feature.
	  Set n and choose other chip.

config MTK_PMIC_CHIP_MT6353
	tristate "MediaTek PMIC MT6353 Driver"
	default n
	---help---
	  This selects for MediaTek(R) PMIC MT6353 driver.
	  It's main chip type and providing power features like auxadc,
	  buck/ldo, interrupt-controller..etc
	  Set y to support this driver.
	  Set n and choose other chip.

config MTK_PMIC_CHIP_MT6355
	tristate "MediaTek PMIC MT6355 Driver"
	default n
	---help---
	  This selects for MediaTek(R) PMIC MT6355 driver.
	  It's main chip type and providing power features like auxadc,
	  buck/ldo, interrupt-controller..etc
	  Set y to support this driver.
	  Set n and choose other chip.

config MTK_PMIC_CHIP_MT6356
	tristate "MediaTek PMIC MT6356 Driver"
	default n
	---help---
	  This selects for MediaTek(R) PMIC MT6356 driver.
	  It's main chip type and providing power features like auxadc,
	  buck/ldo, interrupt-controller..etc
	  Set y to support this driver.
	  Set n and choose other chip.

config MTK_PMIC_CHIP_MT6357
	tristate "MediaTek PMIC MT6357 Driver"
	default n
	---help---
	  This selects for MediaTek(R) PMIC MT6357 driver.
	  It's main chip type and providing power features like auxadc,
	  buck/ldo, interrupt-controller..etc
	  Set y to support this driver.
	  Set n and choose other chip.

config MTK_PMIC_CHIP_MT6358
	tristate "MediaTek PMIC MT6358 Driver"
	default n
	---help---
	  This selects for MediaTek(R) PMIC MT6358 driver.
	  It's main chip type and providing power features like auxadc,
	  buck/ldo, interrupt-controller..etc
	  Set y to support this driver.
	  Set n and choose other chip.

config MTK_PMIC_CHIP_MT6359
	tristate "MediaTek PMIC MT6359 Driver"
	default n
	---help---
	  This selects for MediaTek(R) PMIC MT6359 driver.
	  It's main chip type and providing power features like auxadc,
	  buck/ldo, interrupt-controller..etc
	  Set y to support this driver.
	  Set n and choose other chip.

config MTK_PMIC_CHIP_MT6359P
	tristate "MediaTek PMIC MT6359P Driver"
	default n
	---help---
	  This selects for MediaTek(R) PMIC MT6359P driver.
	  It's main chip type and providing power features like auxadc,
	  buck/ldo, interrupt-controller..etc
	  Set y to support this driver.
	  Set n and choose other chip.

config MTK_PMIC_CHIP_MT6390
	tristate "MediaTek PMIC MT6390 Driver"
	default n
	---help---
	  This selects for MediaTek(R) PMIC MT6390 driver.
	  It's main chip type and providing power features like auxadc,
	  buck/ldo, interrupt-controller..etc
	  Set y to support this driver.
	  Set n and choose other chip.

config MTK_PMIC_CHIP_MT6335
	tristate "MediaTek Power MT6335 Driver"
	default n
	---help---
	  This selects for MediaTek(R) PMIC MT6335 driver.
	  It's main chip type and providing power features like auxadc,
	  buck/ldo, interrupt-controller..etc
	  Set y to support this driver.
	  Set n and choose other chip.

config MTK_EXTBUCK
	tristate "EXT BUCK Driver"
	default n
	---help---
	  This selects for EXT BUCK driver.
	  It's sub chip type and used mainly in buck controlling.
	  Set y to support this driver.
	  Set n and choose other chip.

config EXTBUCK_MT6311
	bool "MediaTek I2C Ext Buck MT6311"
	depends on MTK_EXTBUCK
	default n
	---help---
	  MediaTek(R) I2C interface External BUCK MT6311 driver.
	  External Buck for PROC1.
	  Regulator Driver.
	  Set y to enable it.
	  Set n to disable it.

config MTK_AUXADC_INTF
	bool "MediaTek PMIC Auxadc interface"
	depends on MTK_PMIC_NEW_ARCH
	default n
	---help---
	  MediaTek PMIC Auxadc interface Driver
	  only for MTK_PMIC_NEW_ARCH
	  Set y to enable it.
	  Set n to disable it.

config REGULATOR_ISL91302A
	bool "Intersil Spi Ext Buck Isl91302a"
	depends on MTK_EXTBUCK
	select RT_REGMAP
	default n
	---help---
	  Intersil SPI Interface
	  External Buck for
	  GPU, PROC1, PROC2
	  Regulator Driver

config REGULATOR_RT5734
	bool "Richtek Spi Ext Buck rt5734"
	depends on MTK_EXTBUCK
	select RT_REGMAP
	default n
	---help---
	  Richtek SPI Interface External Buck for GPU, PROC1, PROC2
	  Regulator Driver
	  Say Y to enable it.
	  Say N to disable it.

config REGULATOR_RT5738
	bool "Richtek Ext Buck RT5738"
	depends on MTK_EXTBUCK
	default n
	---help---
	  Richtek I2c Interface
	  Extern Buck for MTK Platform
	  Say Y to enable it.
	  Say N to disable it.

config REGULATOR_MT6691
	bool "MediaTek I2C Ext Buck MT6691"
	depends on MTK_EXTBUCK
	default n
	---help---
	  Richtek I2c Interface
	  Extern Buck for MTK Platform
	  Say Y to enable it.
	  Say N to disable it.

config MTK_EXTERNAL_CHARGER_TYPE_DETECT
	bool "MediaTek external charger type detection"
	depends on MTK_PMIC_NEW_ARCH
	default n
	---help---
	  MediaTek external charger type detection flow
	  only for MTK_PMIC_NEW_ARCH
	  It used to support external charger type detection.
	  Default is MTK PMIC path. Select Y to disable MTK charger type detect.
	  Set y to enable it.
	  Set n to disable it.

source "drivers/misc/mediatek/pmic/mt6370/Kconfig"
source "drivers/misc/mediatek/pmic/mt6360/Kconfig"
```

## drivers/misc/mediatek/pmic/mt6360/Kconfig
```kconfig
source "drivers/misc/mediatek/pmic/mt6360/pmu/Kconfig"
source "drivers/misc/mediatek/pmic/mt6360/pmic/Kconfig"
source "drivers/misc/mediatek/pmic/mt6360/ldo/Kconfig"
```

## drivers/misc/mediatek/pmic/mt6360/ldo/Kconfig
```kconfig
config MT6360_LDO
	bool "Support for MT6360 LDO part"
	depends on I2C
	select RT_REGMAP
	help
	  This selects for MediaTek(R) Sub PMIC MT6360 LDO parts.
	  It's cordinate ldo feature
	  Select Y to enable support for MT6360 LDO.
```

## drivers/misc/mediatek/pmic/mt6360/pmic/Kconfig
```kconfig
config MT6360_PMIC
	bool "Support for MT6360 PMIC part"
	depends on I2C
	select RT_REGMAP
	help
	  This selects for MediaTek(R) Sub PMIC MT6360 PMU parts.
	  2-Channel Buck with Thermal Shutdown and Overlord Protection
	  2-Channel LDO used to DRAM Power
	  Select Y to enable support for MT6360 PMU.
```

## drivers/misc/mediatek/pmic/mt6360/pmu/Kconfig
```kconfig
config MFD_MT6360_PMU
	bool "Support for MT6360 PMU part"
	depends on I2C
	select MFD_CORE
	select RT_REGMAP
	help
	  This selects for MediaTek(R) Sub PMIC MT6360 PMU parts.
	  It's cordinate some features like
	  fled, rgbled, charger.
	  Select Y to enable support for MT6360 PMU.

config MT6360_PMU_CHARGER
	bool "MT6360 PMU Charger Part"
	depends on MFD_MT6360_PMU
	help
	  This selects for MT6360 PMU Charger driver.
	  Usually used in primary charger by gauge and thermal.
	  Depends on MFD_MT6360_PMU.
	  Say Y here to enable support for MT6360 charger device.

config MT6360_PMU_CHARGER_TYPE_DETECT
	bool "MT6360 PMU Charger Type Detect"
	depends on MT6360_PMU_CHARGER
	depends on MTK_EXTERNAL_CHARGER_TYPE_DETECT
	default MTK_EXTERNAL_CHARGER_TYPE_DETECT
	help
	  Depends on enable MT6360 PMU Charger
	  Say Y here to enable support for
	  MT6360 charger type detect instead of using PMIC.

config MT6360_PMU_FLED
	bool "MT6360 PMU FLED Part"
	depends on LEDS_CLASS && MFD_MT6360_PMU
	select RT_FLASHLIGHT
	help
	  This selects for MT6360 PMU Flashlight LED driver.
	  Support Normal/Strobe/Torch mode by camera.
	  Say Y here to enable support for
	  MT6360 flashlight LED device.

config MT6360_PMU_RGBLED
	bool "MT6360 PMU RGBLED Part"
	depends on LEDS_CLASS && MFD_MT6360_PMU
	help
	  Support four channels and cc/pwm/breath mode.
	  Isink4 can also use as CHG_VIN power good Indicator.
	  Say Y here to enable support for
	  MT6360 RGB LED device.
```

## drivers/misc/mediatek/pmic/mt6370/Kconfig
```kconfig
config MFD_MT6370_PMU
	bool "Support for MT6370 PMU part"
	depends on I2C
	select MFD_CORE
	select RT_REGMAP
	help
	  This selects for MediaTek(R) Sub PMIC MT6370 PMU parts.
	  It's cordinate some features like
	  bled, fled, ldo, dsv, charger.
	  Select Y to enable support for MT6370 PMU.


config MT6370_PMU_CHARGER
	bool "MT6370 PMU Charger Part"
	depends on MFD_MT6370_PMU
	help
	  This selects for MT6370 PMU Charger driver.
	  Usually used in primary charger by gauge and thermal.
	  Depends on MFD_MT6370_PMU.
	  Say Y here to enable support for MT6370 charger device.

config MT6370_PMU_CHARGER_TYPE_DETECT
	bool "MT6370 PMU Charger Type Detect"
	depends on MT6370_PMU_CHARGER
	depends on MTK_EXTERNAL_CHARGER_TYPE_DETECT
	default MTK_EXTERNAL_CHARGER_TYPE_DETECT
	help
	  Depends on enable MT6370 PMU Charger
	  Say Y here to enable support for
	  MT6370 charger type detect instead of using PMIC.

config MT6370_PMU_FLED
	bool "MT6370 PMU FLED Part"
	depends on LEDS_CLASS && MFD_MT6370_PMU
	select FLASHLIGHT
	select RT_FLASH_LED
	help
	  This selects for MT6370 PMU Flashlight LED driver.
	  Support Normal/Strobe/Torch mode by camera.
	  Say Y here to enable support for
	  MT6370 flashlight LED device.

config MT6370_PMU_BLED
	bool "MT6370 PMU BLED Part"
	depends on LEDS_CLASS && MFD_MT6370_PMU
	help
	  This selects for MT6370 PMU Backlight LED driver.
	  Support use I2C/PWM mode control screen backlight.
	  Say Y here to enable support for
	  MT6370 Backlight LED device.

config MT6370_PMU_RGBLED
	bool "MT6370 PMU RGBLED Part"
	depends on LEDS_CLASS && MFD_MT6370_PMU
	help
	  Support four channels and cc/pwm/breath mode.
	  Isink4 can also use as CHG_VIN power good Indicator.
	  Say Y here to enable support for
	  MT6370 RGB LED device.

config MT6370_PMU_LDO
	bool "MT6370 PMU LDO Part"
	depends on REGULATOR && MFD_MT6370_PMU
	help
	  Support Built-In low Dropout Linear Regulator.
	  This selects for Regulator control by IRTX or Vibrator.
	  Operation from Kernel Regulator Framework.
	  Say Y here to enable support for
	  MT6370 ldo device.

config MT6370_PMU_DSV
	bool "MT6370 PMU DSV Part"
	depends on REGULATOR && MFD_MT6370_PMU
	help
	  This selects for Single High-Efficiency Boost Converter.
	  Provide positive and negative voltage for LCD display bias.
	  Say Y here to enable support for
	  MT6370 dsv device.
```

## drivers/misc/mediatek/pmic/mt6397/pmic/Kconfig
```kconfig
config MT6397_PMIC
	bool "Support for MT6397 PMIC part"
	help
	  This selects for MediaTek(R) PMIC MT6397 driver.
	  It's main chip type and providing power features like auxadc,
	  buck/ldo, interrupt-controller..etc
	  Set y to support this driver.
	  Set n and choose other chip.
```
