## drivers/misc/mediatek/mdpm/Kconfig
```kconfig
config MTK_MDPM
	tristate "MTK modem power meter"
	help
	  This kernel config can be used to enable modem power meter.
	  When enable this option, mdpm will collect modem status for
	  MD power meter.
	  If unsure, say N.
```

## drivers/misc/mediatek/mdpm_v1/Kconfig
```kconfig
config MTK_MDPM_LEGACY
	tristate "MTK modem power meter"
	help
	  This kernel config can be used to enable modem power meter.
	  When enable this option, mdpm will collect modem status for
	  MD power meter.
	  If unsure, say N.

config MTK_MDPM_LEGACY_V1
	tristate "MTK modem power meter v1"
	help
	  This kernel config can be used to enable modem power meter v1.
	  When enable this option, mdpm will collect modem status for
	  MD power meter.
	  If unsure, say N.
```

## drivers/misc/mediatek/memblock/Kconfig
```kconfig
#
# Memory Block
#

comment "Memory Block"

config MTK_MEMORY_BLOCK
	tristate "Memory Block"
	depends on BLOCK
	help
	  Memory Block is the method of managing memory regions
	  during the early bootstrap period while the usual kernel
	  memory allocators are not up and running yet.
	  Enable MediaTek memory block feature to provide procedures for
	  maintaining information about logical memory blocks.
```

## drivers/misc/mediatek/memory-amms/Kconfig
```kconfig
config MTK_AMMS
	tristate "Support Mediatek AP and Modem Sharing Memory techonology"
	help
	  Mediatek Memory sharing techonology
	  It tries to free Modem memory once not
	  used. Modem should support this as well
	  or it won't work. If you are not sure
	  Please select "N"
```

## drivers/misc/mediatek/met_drv/Kconfig
```kconfig
config MTK_MET_CORE
	bool "MET CORE"
	default y if MTK_MET
	help
	  This selects the MET wrapper function for MET device.
	  If you want MET feature, say Y here.
	  This is needed if support for MET devices is required.
	  If unsure, say N.

config MTK_MET_PLF
	tristate "MET PLATFORM"
	depends on MTK_MET_CORE
	help
	  This selects the MET profile function for MET device.
	  If you want MET feature, say Y here.
	  This is needed if support for MET devices is required.
	  If unsure, say N.
```

## drivers/misc/mediatek/mixdev/Kconfig
```kconfig
menuconfig MTK_MIX_DEVICES
	bool "mix Devices"
	default y
	help
	  Say Y here to enable mix dev support.
```

## drivers/misc/mediatek/mjc/Kconfig
```kconfig
# MJC
config MTK_MJC_DRIVER
	bool "MediaTek MJC Driver"
	default n
	help
	  ClearMotion is a display tcehnology that enhance visual quality for
	  smoother and clearer video playback.
	  Feature : Super Slow Motion, 120Hz, ...
```

## drivers/misc/mediatek/mkp/Kconfig
```kconfig
config MTK_MKP
	tristate "MTK MKP feature"
	help
	  Protect the kernel section and module section, and
	  provide hook implementation to detect the changes
	  of critical kernel data. It uses some mechanisms
	  provided by EL2 to set memory type in S2 page table.
```

## drivers/misc/mediatek/mlog/Kconfig
```kconfig
config MTK_MLOG
	bool "Support memory log"
	default y
	help
          Periodic memory log module.

		  Mlog will tracking memory usage include meminfo, buddy system,
		  hardware memory and process memory and oom_score_adj.
		  Enable this may casue a little memory buffer overhead but keep
		  tracking previous memory status. For dump memory usage,
		  please cat /d/mlog for persistent memory dump.
```

## drivers/misc/mediatek/mmdvfs/Kconfig
```kconfig
config MTK_MMDVFS
	bool "MediaTek MMDVFS Support"
	help
	  Say yes here to add support for the MediaTek Multimedia DVFS (MMDVFS)
	  driver. The MMDVFS is used to set clk for Mediatek multimedia hardwares
	  , such as display, camera, mdp and video codec. Say no if your device
	  does not need to do DVFS for Multimedia hardwares.
```

## drivers/misc/mediatek/mminfra/Kconfig
```kconfig
# SPDX-License-Identifier: GPL-2.0

config MTK_MMINFRA
	tristate "MediaTek MMInfra driver"
	depends on ARCH_MEDIATEK || COMPILE_TEST
	help
	  This driver is for the Multimedia Infrastructure in MediaTek SoCs.
	  The MMINFRA driver mainly help control power, clock and security setting
	  for the bus of multimedia users, such as display, camera, mdp and video
	  codec. The MMINFRA driver also provide backup and restore function for
	  registers located in the same power domain.
```

## drivers/misc/mediatek/mmp/Kconfig
```kconfig
config MMPROFILE
	tristate "MMProfile module enable or disable"
	help
	  Enable other module to use Multimedia profiling mechanism.
	  By enable this config, the mmp/ driver is built into kernel.
	  Otherwise other module will use empty functions in header file
	  instead. This is to make the profiling mechanism driver to be
	  a switchable module.

config MTK_MMPROFILE_SUPPORT
	bool "MMProfile function enable or disable"
	default y
	depends on MMPROFILE
	help
	  Multimedia profiling mechanism function support.
	  By enable this config, the actual implementation under mmp/src/
	  will be used.
	  Otherwise mmp/dummy/ is used to provide empty functions. In this
	  situation, the profiling mechanism will not work.

config MTK_MMPROFILE_DEBUG
	bool "MMProfile function debug"
	depends on MTK_MMPROFILE_SUPPORT
	help
	  Multimedia profiling mechanism function debug feature.
	  By enable this config, the actual implementation under mmp/src/
	  will be used. This is to make the profiling mechanism driver can
	  dump input/output buffer.
```

## drivers/misc/mediatek/mmstat/Kconfig
```kconfig
config MMSTAT_TRACER
	tristate "Trace memory status periodically"
	depends on TRACING
	help
	  Periodic tracing of memory status.

	  Mmstat tracer will track memory usage periodically according to
	  indicated timer interval, which includes meminfo, buddy system,
	  hardware memory(if possible) and process memory.
```

## drivers/misc/mediatek/monitor_hang/Kconfig
```kconfig
config MTK_HANG_DETECT
	tristate "hang detect monitor"
	help
	  MTK_HANG_DETECT is the kernel config of hang feature designed by MTK,
	  which is a debug feature for detecting device hang. When the device
	  hang is detected by this mechanism, it will notice get some
	  debug information.

config MTK_HANG_DETECT_DB
	bool "hang detect AEE DB"
	depends on MTK_AEE_FEATURE
	help
	  MTK_HANG_DETECT_DB is the kernel config of
	  hang feature designed by MTK
	  which is deponded on MTK_AEE_AED
	  when detect device hang, will create AEE DB.

config MTK_HANG_DETECT_LOG
	bool "hang detect debug log"
	help
	  MTK_HANG_DETECT_LOG is the kernel config of hang feature designed by
	  MTK, when detect device hang, it will print debug log. The kernel
	  debug log is larger, We can't enable the feature general. But when
	  MTK_HANG_DETECT_DB is disable, we should enable this feature.
```

## drivers/misc/mediatek/mrdump/Kconfig
```kconfig
config MTK_MRDUMP
  bool CONFIG_MTK_MRDUMP
  default n
  help
    CONFIG_MTK_MRDUMP
```

## drivers/misc/mediatek/mt_logger/Kconfig
```kconfig
config MTK_MT_LOGGER
  bool CONFIG_MTK_MT_LOGGER
  default n
  help
    CONFIG_MTK_MT_LOGGER
```

## drivers/misc/mediatek/mtee/Kconfig
```kconfig
config MTK_IN_HOUSE_TEE_SUPPORT
	bool "Enable MTK In House TEE Support"
	help
	  This option decides if the support MTK in-house TEE
	  (Trusted Execution Environment)
	  Set to yes if MTK TEE is supported.
	  If you are not sure if it is supported, set it to no.
```

## drivers/misc/mediatek/mtk-interconnect/Kconfig
```kconfig
# SPDX-License-Identifier: GPL-2.0-only

config INTERCONNECT_MTK_EXTENSION
	tristate "Mediatek Network-on-Chip interconnect extension drivers"
	depends on INTERCONNECT_MTK
	help
	  New framework for Mediatek's Network-on-Chip interconnect hardware.
```

## drivers/misc/mediatek/mtk_sdio/Kconfig
```kconfig
config MMC_MTK_SDIO
	tristate "MediaTek SDIO Interface support"
	depends on HAS_DMA
	help
	  This selects the MediaTek(R) SDIO Interface.
	  If you have a machine with a integrated SDIO reader, say Y or M here.
	  This is needed if support for any SDIO devices is required.
	  If unsure, say N.
```

## drivers/misc/mediatek/mtkpasr/Kconfig
```kconfig
config MTKPASR
	bool "MTK proprietary PASR mechanism"
	depends on SYSFS && ZSMALLOC && ARM && HIGHMEM
	select LZO_COMPRESS
	select LZO_DECOMPRESS
	default n
	help
	  Mediatek PASR mechanism

config MTKPASR_RDIRECT
	bool "Bank scanning direction"
	depends on MTKPASR
	default y
	help
	  Scanning direction of MTKPASR

config MTKPASR_MAFL
	bool "Mark it As Free by removing page blocks from buddy allocator to its List"
	depends on MTKPASR
	default y
	help
	  Enhance the PASR performance on collecting free banks

config MTKPASR_ALLEXTCOMP
	bool "No ZRAM/SWAP"
	depends on MTKPASR
	default n

config MTKPASR_DEBUG
	bool "MTK proprietary PASR debug support"
	depends on MTKPASR
	default n
	help
	  This option adds additional debugging code to MTK PASR
```

## drivers/misc/mediatek/mtprintk/Kconfig
```kconfig
config MTK_PRINTK
	tristate "mtk printk enhance"
	help
	  mtk printk enhance feature, it include
	  uart console control and kernel log
	  much detect. It can build in or insmode.
	  kernel log much detect only enable in eng load.

config MTK_PRINTK_UART_CONSOLE
	bool "MTK printk UART controller"
	default y
	help
	  MTK_PRINTK_UART_CONSOLE which is used to control whether to
	  control printk to uart console.  when boot up finish
	  uart console do not output printk log.
	  also RD can set the setting by command.

config LOG_TOO_MUCH_WARNING
	bool "printk too much warning"
	default n
	help
	  LOG_TOO_MUCH_WARNING which is used to control whether to
	  detect printk too much issue. kernel log too much will detect and
	  create a exception when printk log large than
	  LOG_TOO_MUCH_DETECT_COUNT in one second.

config LOG_TOO_MUCH_DETECT_COUNT
	hex "printk too much detect count"
	default 0xC8
	depends on LOG_TOO_MUCH_WARNING

config LOG_TOO_MUCH_DETECT_GAP
	hex "detect log too much delay time"
	default 30
	depends on LOG_TOO_MUCH_WARNING

config MTK_PRINTK_DEBUG
	bool "Just for MTK to debug info"
	default n
	help
	  MTK_PRINTK_DEBUG is used for debugging instead of gki.
	  First, it adds process name in log info.

	  Second, when one cpu exec console_unlock and log is too much,
	  it may be writing to console for long time.
	  This may Trigger HWT.
	  We should better detect the duration in console.
	  When the duration is over criteria, it will Report DB.
```

## drivers/misc/mediatek/mtprof/Kconfig
```kconfig
config MTPROF
	tristate "Enable MTK profiler/debugger tool"
	default n
	help
	  CONFIG_MTPROF define if mtk profiling/debugger tools should be
	  built-in, module or not. It includes bootprof logger which is for
	  boot time profiling. If you are not sure about whether to
	  enable it or not, please set n.

config BOOTPROF_THRESHOLD_MS
	int "Threshold of driver init duration(ms)"
	depends on MTPROF
	default 15
	help
	  CONFIG_BOOTPROF_THRESHOLD_MS define the threshold of driver init
	  duration.If init duration is larger than threshold, bootprof will
	  record the driver info and init time for boot time profiling.
	  (Unit: millisecond)

config MTK_IRQ_MONITOR
	tristate "Enable MTK IRQ Monitor"
	help
	  MTK_IRQ_MONITOR can monitor ISR/SOFTIRQ processing duration,
	  IRQ disabled duration and burst IRQ. Say Y here to enable MTK
	  IRQ monitor. If you are not sure about whether to enable it or not,
	  please set n.

config MTK_IRQ_MONITOR_DEBUG
	tristate "Enable MTK IRQ Monitor Debug"
	help
	  MTK_IRQ_MONITOR_DEBUG if used to debug ISR/SOFTIRQ processing
	  duration, IRQ disabled duration and burst IRQ. It is only enabled
	  on userdebug load. Say Y here to enable MTK IRQ monitor debug.
	  If you are not sure about whether to enable it or not,
	  please set n.

config MTK_IRQ_MONITOR_DEFAULT_ENABLED
	bool "Enable all tracers of MTK IRQ Monitor by default"
	depends on MTK_IRQ_MONITOR
	select TRACE_IRQFLAGS

config MTK_IRQ_MONITOR_IRQ_TIMER_OVERRIDE
	bool "Override the thresholds of irq duration timer (ms)"
	depends on MTK_IRQ_MONITOR
```

## drivers/misc/mediatek/mu3d/Kconfig
```kconfig
#
# MediaTek USB 3.0 Controller Driver
#

config USBIF_COMPLIANCE
	tristate "MediaTek MUSB U3 USBIF COMPLIANCE"
	default n
	---help---
	  This selects the MediaTek USB-IF Compliance Test Program.
	  MediaTek I2C bus adapter is the base for some other I2C client, eg: touch, sensors.
	  If you want to verify USB-IF COMPLIANCE, say Y.
	  If unsure, say N.

config USB_MU3D_PIO_ONLY
	tristate "MediaTek MUSB Gadget support EP0 PIO mode"
	default n
	---help---
	  Say Y here if you want to disable USB DMA function.
	  All data is copied between memory and FIFO by the CPU.
	  DMA controllers are ignored.
	  If unsure, say N.

config USB_MU3D_DRV
	tristate "MediaTek SSUSB MAC Driver support"
	default n
	---help---
	  This selects the MediaTek USB MAC driver.
	  Say Y here if your system using Mediatek USB3.0 IP.
	  It supports super-speed, high-speed and full-speed.
	  If unsure, say N.

config USB_MU3D_DVT
	tristate "MediaTek SSUSB DVT support"
	default n
	---help---
	  Say Y here if your system using Mediatek USB3.0 IP
	  and would like to do verification program.
	  It just support MediaTek verification use not enable
	  in full load
	  If unsure, say N.

config MTK_SIB_USB_SWITCH
	tristate "MediaTek USB and SIB switch"
	default n
	---help---
	  This selects the MediaTek USB and SIB switch.
	  Say Y here if you want to enable USB and SIB switch.
	  Support share USB pin to SIB function.
	  If unsure, say N.

config USB_MU3D_DEFAULT_U2_MODE
	tristate "MediaTek SSUSB default in USB High-Speed Mode"
	default y
	---help---
	  This selects the MediaTek USB speed.
	  Say Y here if you want to keep USB in high speed.
	  Say N here if you want to enable USB super speed.
	  If unsure, say Y.

config USB_MU3D_DRV_36BIT
	tristate "MediaTek SSUSB 36bits addressing support"
	default n
	---help---
	  This selects the MediaTek SSUSB(USB3.0 HW IP) support 36-bits
	  address accessing.
	  Say Y here if you want to enable 36-bits addressing support.
	  If unsure, say N.
```
