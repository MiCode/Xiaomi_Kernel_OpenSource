## drivers/misc/mediatek/tilt_detector_sensor/Kconfig
```kconfig
config CUSTOM_KERNEL_TILT_DETECTOR_SENSOR
	bool "CUSTOM_KERNEL_TILT_DETECTOR_SENSOR"
	help
	  Kernel space tilt detector sensor driver.
source "drivers/misc/mediatek/tilt_detector_sensor/tiltdetecthub/Kconfig"
```

## drivers/misc/mediatek/timer/Kconfig
```kconfig
# SPDX-License-Identifier: GPL-2.0

source "drivers/misc/mediatek/timer/accuracy-test/Kconfig"
```

## drivers/misc/mediatek/timer/accuracy-test/Kconfig
```kconfig
# SPDX-License-Identifier: GPL-2.0

config MTK_TIMER_ACCURACY_TEST
	tristate "mtk timer gpt and systimer accurancy UT test"
	help
	  MTK_TIMER_ACCURANCY_TEST which is used to test gpt and systimer
	  accurancy, this config only open in UT test.
	  Normally we do not open this config, when this config is enabled,
	  rtc driver need to patch to support RTC_INT_CNT_L.
```

## drivers/misc/mediatek/timer/timesync/Kconfig
```kconfig
#
# Kernel configuration file for Mediatek proprietary timers
#
# Copyright (C) 2017 Mediatek Inc.
#
# Authors:
#	Stanley Chu <stanley.chu@mediatek.com>
#
# This program is free software; you can redistribute it and/or
# modify it under the terms of the GNU General Public License
# as published by the Free Software Foundation; either version 2
# of the License, or (at your option) any later version.
# See the COPYING file in the top-level directory or visit
# <http://www.gnu.org/licenses/gpl-2.0.html>
#
# This program is distributed in the hope that it will be useful,
# but WITHOUT ANY WARRANTY; without even the implied warranty of
# MERCHANTABILITY or FITNESS FOR A PARTICULAR PURPOSE.  See the
# GNU General Public License for more details.
#
# This program is provided "AS IS" and "WITH ALL FAULTS" and
# without warranty of any kind. You are solely responsible for
# determining the appropriateness of using and distributing
# the program and assume all risks associated with your exercise
# of rights with respect to the program, including but not limited
# to infringement of third party rights, the risks and costs of
# program errors, damage to or loss of data, programs or equipment,
# and unavailability or interruption of operations. Under no
# circumstances will the contributor of this Program be liable for
# any damages of any kind arising from your use or distribution of
# this program.

config MTK_TIMER_TIMESYNC
	tristate "Time synchronization between kernel sched_clock and sys_timer tick"
	default n
	help
	  This selects the support for time synchronization between kernel
	  sched_clock and sys_timer tick.

	  Time synchronization may be required in some sub-systems, for example,
	  sspm and scp ...etc, to have ability to get the same sched_clock
	  as kernel in AP.

	  If unsure, say N.

config MTK_ARCHCOUNTER_TIMESYNC
	tristate "Time synchronization between archcounter time and monotonic time"
	default y
	help
	  This selects the support for time synchronization between archcounter time
	  and monotonic time.

	  Time synchronization may be required in some sub-systems, for example,
	  camera ...etc, to have ability to get the same monotonic time as kernel
	  in AP.

	  If unsure, say N.
```

## drivers/misc/mediatek/tinysys_scmi/Kconfig
```kconfig
# SPDX-License-Identifier: GPL-2.0

config MTK_TINYSYS_SCMI
	tristate "Specify TINYSYS SCMI Interface Support"
	help
	  TINYSYS SCMI is for MediaTek in-house power protocol
	  Set Y to enable this feature.
	  If unsure, set N to stay with legancy feature.
```

## drivers/misc/mediatek/tkcore/Kconfig
```kconfig
# Copyright (c) 2015-2018 TrustKernel Incorporated
# All Rights Reserved.
#
# This program is free software; you can redistribute it and/or
# modify it under the terms of the GNU General Public License
# version 2 as published by the Free Software Foundation.
#
# This program is distributed in the hope that it will be useful,
# but WITHOUT ANY WARRANTY; without even the implied warranty of
# MERCHANTABILITY or FITNESS FOR A PARTICULAR PURPOSE. See the
# GNU General Public License for more details.

config TRUSTKERNEL_TEE_SUPPORT
	bool "TrustKernel Trusted Execution Environment Support"
	default n
	---help---
	  Enable the support of TrustKernel TEE drivers.
	  All Trustkernel related functions will depend on this option.
	  Say Y if you would like yo enable this feature.
	  If unsure, say N.

config TRUSTKERNEL_TEE_FP_SUPPORT
	bool "TrustKernel Trusted Execution Environment Finger Print Support"
	depends on TRUSTKERNEL_TEE_SUPPORT
	default y
	---help---
	  Enable TrustKernel TEE clock management mechanism.
	  This feature allows TEE OS to manage clock already
	  used by Linux.
	  Say Y if you would like yo enable this feature.
	  If unsure, say Y.

config TRUSTKERNEL_TEE_RPMB_SUPPORT
	bool "TrustKernel Trusted Execution Environment RPMB Support"
	depends on TRUSTKERNEL_TEE_SUPPORT
	default n
	---help---
	  Enable the access of Replay Protected Memory Block
	  region for Trustkernel TEE.
	  Say Y if you would like yo enable this feature.
	  If unsure, say Y.
```

## drivers/misc/mediatek/trng/Kconfig
```kconfig
config MTK_TRNG_DRIVER
	bool "Enable MTK TRNG driver"
	default y if (!FPGA_EARLY_PORTING) && (EXT4_ENCRYPTION || EXT4_FS_ENCRYPTION || F2FS_FS_ENCRYPTION)
	help
	  TRNG contributes randomness to kernel
	  CRNG in boot process. This is required
	  when FBE is enabled. TRNG kernel driver
	  also creates procfs to dump random number
	  through SMC call in eng load.
```

## drivers/misc/mediatek/trusted_mem/Kconfig
```kconfig
# Copyright (C) 2018 MediaTek Inc.
#
# This program is free software: you can redistribute it and/or modify
# it under the terms of the GNU General Public License version 2 as
# published by the Free Software Foundation.
#
# This program is distributed in the hope that it will be useful,
# but WITHOUT ANY WARRANTY; without even the implied warranty of
# MERCHANTABILITY or FITNESS FOR A PARTICULAR PURPOSE. See the
# GNU General Public License for more details.

#
# Protect Memory configuration
#
config MTK_PROT_MEM_SUPPORT
	tristate "MTK Protect Memory Support"
	depends on MTK_GZ_KREE
	default y
	help
	  Enable the support of MediaTek protect memory driver.
	  This driver is in charge of protect memory region require/release
	  from SSMR and also the memory allocation/free requests from ION.
	  It is a proxy of MediaTek proprietary EL2 hypervisor for protect
	  memory management.
	  Say Y if you would like to enable this feature.
	  If unsure, say N.

#
# SVP Secure Memory configuration
#
config MTK_SECURE_MEM_SUPPORT
	tristate "MTK SVP SECURE Memory Support"
	depends on TRUSTONIC_TEE_SUPPORT || MTK_TEE_GP_SUPPORT
	default y
	help
	  Enable the support of MediaTek SVP secure memory driver.
	  This driver is in charge of SVP secure memory region require/release
	  from SSMR and also the memory allocation/free requests from ION.
	  It is a proxy of TEE secure memory driver for SVP secure memory
	  management.
	  Say Y if you would like to enable this feature.
	  If unsure, say N.

#
# WFD Secure Memory configuration
#
config MTK_WFD_SMEM_SUPPORT
	tristate "MTK WFD SECURE Memory Support"
	depends on MTK_SECURE_MEM_SUPPORT && MTK_SEC_VIDEO_PATH_SUPPORT
	default y
	help
	  Enable the support of MediaTek WFD secure memory driver.
	  This driver is in charge of WFD secure memory region require/release
	  from SSMR and also the memory allocation/free requests from ION.
	  It is a proxy of TEE secure memory driver for WFD secure memory
	  management.
	  Say Y if you would like to enable this feature.
	  If unsure, say N.

#
# HAPP Memory configuration
#
config MTK_HAPP_MEM_SUPPORT
	tristate "MTK MTEE Hypervisor App Memory Support"
	depends on MTK_GZ_KREE
	default n
	help
	  Enable the support of MediaTek MTEE EL2 app memory driver.
	  This driver is in charge of EL2 app memory region require/release
	  from SSMR and also the memory allocation/free requests from ION.
	  It is a proxy of MediaTek proprietary EL2 hypervisor for isolated
	  memory management.
	  Say Y if you would like to enable this feature.
	  If unsure, say N.

#
# SDSP Memory configuration
#
config MTK_SDSP_MEM_SUPPORT
	tristate "MTK MTEE SDSP Firmware Memory Support"
	depends on MTK_GZ_KREE
	default n
	help
	  Enable the support of MediaTek MTEE SDSP firmware memory driver.
	  This driver is in charge of SDSP image memory region require/release
	  from SSMR and also the memory allocation/free requests from ION.
	  It is a proxy of MediaTek proprietary EL2 hypervisor for isolated
	  memory management.
	  Say Y if you would like to enable this feature.
	  If unsure, say N.

#
# SDSP/TEE Shared Memory configuration
#
config MTK_SDSP_SHARED_MEM_SUPPORT
	tristate "MTK MTEE SDSP Shared Memory Support"
	depends on MTK_GZ_KREE
	default n
	help
	  Enable the support of MediaTek MTEE SDSP shared memory driver.
	  This driver is in charge of SDSP shared memory region require/release
	  from SSMR and also the memory allocation/free requests from ION.
	  It is a proxy of MediaTek proprietary EL2 hypervisor for isolated
	  memory management.
	  Say Y if you would like to enable this feature.
	  If unsure, say N.

#
# MTEE Multiple Chunk Memory configuration
#
config MTK_MTEE_MULTI_CHUNK_SUPPORT
	tristate "MTK MTEE Multiple Chunk Memory Support"
	depends on MTK_HAPP_MEM_SUPPORT || MTK_SDSP_MEM_SUPPORT || \
		   MTK_SDSP_SHARED_MEM_SUPPORT
	default y
	help
	  Enable the support of MediaTek MTEE multiple chunks memory driver.
	  This driver is in charge of multi-chunk memory region require/release
	  from SSMR and also the memory allocation/free requests from ION.
	  It is a proxy of MTEE multi-chunk memory driver for isolated memory
	  management.
	  Say Y if you would like to enable this feature.
	  If unsure, say N.

#
# Trusted Memory Subsystem Configuration
#
config MTK_TRUSTED_MEMORY_SUBSYSTEM
	tristate "MTK Trusted Memory Subsystem Support"
	depends on MTK_PROT_MEM_SUPPORT || MTK_SECURE_MEM_SUPPORT || \
		   MTK_MTEE_MULTI_CHUNK_SUPPORT
	default y
	help
	  Enable the support of MediaTek trusted memory subsystem driver.
	  This driver provide a general subsystem layer for trusted peer memory
	  manager such as EL2 hypervisor or TEE. New type of trusted memory can
	  be registered to this subsystem easily.
	  Say Y if you would like to enable this feature.
	  If unsure, say N.
```
