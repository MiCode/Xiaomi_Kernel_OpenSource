## drivers/misc/mediatek/srclken_rc/Kconfig
```kconfig
config MTK_SRCLKEN_RC
	tristate "MediaTek SRCLKEN RC Support"
	select REGMAP
	help
	  Say yes here to add support for the MediaTek SRCLKEN RC
	  driver, which supports debug interface for monitoring XO 26M/
	  DCXO/Vcore/LDO/Buck state with all subsys such as suspend/
	  dpidle/MD/RF/BT/SCP...etc.
	  It would also inform other subsystem/module to run suitable
	  sw setting for srclken-rc driver.
```

## drivers/misc/mediatek/ssc/Kconfig
```kconfig
config MTK_SSC_MODULE
	tristate "Enable Shared S-RAM Control"
	help
	  SSC (Shared S-RAM Control) that designed by Mediatek is an resource
	  control mechanism with respect to S-RAM. It coordinate S-RAM voltage
	  requests from other modules(such as GPU and ISP) and configure S-RAM
	  voltage.

config MTK_SSC_DBG_V1
	tristate "Enable Shared S-RAM Control debug module v1"
	depends on MTK_SSC_MODULE
	help
	  This option adds an debug kernel module for additional interface to
	  manipulate SSC module.
	  Set Y to select this feature for SSC v1 debugging.
	  If unsure, set N to disable.


config MTK_SSC_DBG_V2
	tristate "Enable Shared S-RAM Control debug module v2"
	depends on MTK_SSC_MODULE
	help
	  This option adds an debug kernel module for additional interface to
	  manipulate SSC module.
	  Set Y to select this feature for SSC v2 debugging.
	  If unsure, set N to disable.
```

## drivers/misc/mediatek/sspm/Kconfig
```kconfig
# SPDX-License-Identifier: GPL-2.0

config MTK_TINYSYS_SSPM_SUPPORT
	tristate "Specify Interface Support SSPM"
	default n
	help
	  SSPM is a MediaTek in-house hardware for power management under
	  secure world.
	  Set Y to enable this feature.
	  If unsure, set N to stay with legancy feature.

config MTK_TINYSYS_SSPM_PLT_SUPPORT
	bool "Specify Interface of SSPM on Platform"
	default n
	help
	  SSPM is a MediaTek in-house hardware for power management based
	  on platform.
	  Set Y to enable this feature for specific platform.
	  If unsure, set N to stay with legancy feature.

config MTK_TINYSYS_SSPM_V0
	bool "Specify Interface SSPM Version0"
	help
	  Set Interface SSPM Version as V0.
	  V0 is based on Tinysys IPI mechanism.
	  Set Y to enable this feature.
	  If unsure, set N to stay with original feature.

config MTK_TINYSYS_SSPM_V1
	bool "Specify Interface SSPM Version1"
	help
	  Set Interface SSPM Version as V1.
	  V1 is based on Tinysys IPI mechanism.
	  Set Y to enable this feature.
	  If unsure, set N to stay with original feature.

config MTK_TINYSYS_SSPM_V2
	bool "Specify Interface SSPM Version2"
	help
	  Set Interface SSPM Version as V2.
	  V2 is based on Tinysys IPI mechanism.
	  Set Y to enable this feature.
	  If unsure, set N to stay with original feature.

config MTK_TINYSYS_SSPM_V3
	bool "Specify Interface SSPM Version3"
	help
	  Set Interface SSPM Version as V3.
	  V3 is based on SCMI mechanism.
	  Set Y to enable this feature.
	  If unsure, set N to stay with original feature.

config MTK_MET_MEM_ALLOC
	bool "Using dynamic allocate memory for MET"
```

## drivers/misc/mediatek/ssusb/Kconfig
```kconfig
# For MTK USB3.0 IP++++
config SSUSB_DRV
	tristate "MediaTek MU3D Gadget support"
	default n
	help
	  Say Y if support Gadget based on
	  MediaTek USB3.0 Device controller.
	  It will turn on ssusb support.
	  If unsure,say N.

config SSUSB_MU3_PHY
	bool "MU3 PHY"
	default n
	---help---
	  Enables support
	  MU3 PHY for SSUSB or XHCI.
	  It's common config for USB PHY,
	  we need turn on it if support USB_MU3D_DRV.
	  If unsure,say N.

config SSUSB_U3_PHY_GPIO_SUPPORT
	bool "MU3 PHY registers access by I2C"
	depends on SSUSB_MU3_PHY
	default n
	---help---
	  Enables support for
	  read/write PHY registers by external I2C.
	  It's only for FPGA test.
	  If unsure,say N.

config SSUSB_U3_PHY_AHB_SUPPORT
	bool "MU3 PHY registers access by AHB"
	depends on SSUSB_MU3_PHY
	default n
	---help---
	  Enables support for
	  read/write PHY registers by internal AHB.
	  It's one type of USB PHY.
	  If unsure,say N.

config SSUSB_MTK_XHCI
	tristate "MediaTek U3 XHCI support"
		default n
	---help---
	  Enables support
	  Mediatek U3 XHCI functions.
	  If we want to support USB host,we need turn on this config.
	  If unsure,say N.

config SSUSB_MTK_TEST_XHCI
	tristate "MediaTek U3 TEST XHCI driver support"
		default n
	---help---
	  Enables support
	  Mediatek U3 XHCI test driver kernel framework.
	  This test driver is for USB complicate test.
	  If unsure,say N.

config SSUSB_C60802_SUPPORT
	bool "MU3 PHY C60802 support"
	depends on SSUSB_MU3_PHY
	default n
	---help---
	  Enables support for
	  external PHY(Ver C).
	  It's only for FPGA test.
	  If unsure,say N.

config SSUSB_D60802_SUPPORT
	bool "MU3 PHY D60802 support"
	depends on SSUSB_MU3_PHY
	default n
	---help---
	  Enables support
	  for external PHY(Ver D).
	  It's only for FPGA test.
	  If unsure,say N.

config SSUSB_E60802_SUPPORT
	bool "MU3 PHY E60802 support"
	depends on SSUSB_MU3_PHY
	default n
	---help---
	  Enables support
	  for external PHY(Ver E).
	  It's only for FPGA test.
	  If unsure,say N.

config SSUSB_PROJECT_PHY
	bool "MU3 ASIC PHY support"
	depends on SSUSB_MU3_PHY
	default n
	---help---
	  Enables support
	   for ASIC PHY.
	   We often use it for USB PHY now.
	  If unsure,say N.

config SSUSB_PHY0_U2_CURRENT_DETECT
	bool "U2 CURRENT DYNAMIC DETECTIONG"
	depends on SSUSB_MU3_PHY
	default n
	---help---
	  Enable it if dynamically select current source of u2-phy0
	  which are internal current or U3 current; it's add only for
	  mt8173-magna platform. so for others, disable it anyway.
	  If unsure, say N.
```

## drivers/misc/mediatek/ssw/Kconfig
```kconfig
config CUSTOM_KERNEL_SSW
	string "CUSTOM_KERNEL_SSW"
	help
	  To choose kernel sim switch driver
	  ssw_single: internal switcher for MT6572,MT6582,MT6592
	  ssw_generic: internal switcher for MT6589
	  ssw_generic_v2: internal switcher for K2 phone
	  fxla2203: phase-out
	  combo_fxla2203: external switcher for MT6582+EVDO, MT6592+EVDO
	  combo_fxla2203_v2: 2 2X2 external switcher for ROME(MT6595 MT6795) DSDA
	  combo_fxla2203_v3: 1 2X2 external switcher for X2(MT6595 MT6795) DSDA
	  ssw_single_v2: internal switcher for Denali(1,2,3)
```

## drivers/misc/mediatek/step_counter/bmi160_stc/Kconfig
```kconfig
config MTK_BMI160_STC
	bool "BMI160 stc for MediaTek package"
	default n
	help
	It support different step counter sensor.
	If this option is set,
	 it will support
	 BMI160 step counter.
```

## drivers/misc/mediatek/subpmic/Kconfig
```kconfig
config MTK_SUBPMIC_MISC
	tristate "Mediatek Subpmic Miscellaneous"
	help
	  Enable to support Mediatek subpmic miscellaneous functions.
	  For example, customized debugfs for different chips.
	  Other platform dependent operations,
	  e.g., communication between modem and AP.

config MTK_SUBPMIC_DEBUGFS
	tristate "Mediatek Subpmic Debugfs"
	depends on DEBUG_FS
	help
	  Enable to support Mediatek Submic Debugfs
	  Say Y here to create debugfs node in
	  /d/ext_dev_io/ folder
	  Say N here to disable

config SUBPMIC_DBG
	tristate "Mediatek subpmic Debug core"
	depends on MTK_SUBPMIC_MISC
	help
	  Say Y here to enable Mediatek subpmic debug support.
	  Say N here to disable.
	  Provide Read/Write interface by debugfs ext_dev_io.
	  Also support multiple size condition.
```

## drivers/misc/mediatek/swpm/Kconfig
```kconfig
config MTK_SWPM_MODULE
	tristate "Meditaek Software Power Model Module"
	help
	  For MediaTek Software Power Model Module,
	  modling SoC likes CPU, GPU and DRAM power.
	  Select "y" if you want to enable SWPM features.
	  Select "n" if unsure.

config MTK_SWPM_DBG_COMMON
	tristate "Meditaek Software Power Model common debug Module"
	help
	  Select MTK_SWPM_DBG_COMMON then Mediatek Software Power Model
	  common debug feature will be enabled. The common debug
	  feature will support basic debug control and show the
	  information to console and ftrace.

config MTK_SWPM_PERF_ARMV8_PMU
	tristate "Meditaek Software Power Model Power Model uses ARMV8 and L3-cache PMU"
	help
	   Select MTK_SWPM_PERF_ARMV8_PMU then support for the
	   ARMV8 PMU and L3 cache performance monitor unit (PMU).

config MTK_SWPM_MT6789
	tristate "Specify Mediatek SWPM Platform is MT6789"
	depends on MTK_SWPM_MODULE
	select MTK_SWPM_DBG_COMMON
	help
	  Select MediaTek Software Power Model Platform is MT6789
	  for power management.
	  Set Y to select this feature for specific platform-mt6789.
	  If unsure, set N to disable.

config MTK_SWPM_MT6853
	tristate "Specify Mediatek SWPM Platform is MT6853"
	depends on MTK_SWPM_MODULE
	select MTK_SWPM_DBG_COMMON
	help
	  Select MediaTek Software Power Model Platform is MT6853
	  for power management.
	  Set Y to select this feature for specific platform-mt6853.
	  If unsure, set N to disable.

config MTK_SWPM_MT6855
	tristate "Specify Mediatek SWPM Platform is MT6855"
	depends on MTK_SWPM_MODULE
	select MTK_SWPM_DBG_COMMON
	help
	  Select MediaTek Software Power Model Platform is MT6855
	  for power management.
	  Set Y to select this feature for specific platform-mt6855.
	  If unsure, set N to disable.

config MTK_SWPM_MT6873
	tristate "Specify Mediatek SWPM Platform is MT6873"
	depends on MTK_SWPM_MODULE
	select MTK_SWPM_DBG_COMMON
	help
	  Select MediaTek Software Power Model Platform is MT6873
	  for power management.
	  Set Y to select this feature for specific platform-mt6873.
	  If unsure, set N to disable.

config MTK_SWPM_MT6879
	tristate "Specify Mediatek SWPM Platform is MT6879"
	depends on MTK_SWPM_MODULE
	select MTK_SWPM_DBG_COMMON
	help
	  Select MediaTek Software Power Model Platform is MT6879
	  for power management.
	  Set Y to select this feature for specific platform-mt6879.
	  If unsure, set N to disable.

config MTK_SWPM_MT6885
	tristate "Specify Mediatek SWPM Platform is MT6885"
	depends on MTK_SWPM_MODULE
	select MTK_SWPM_DBG_COMMON
	help
	  Select MediaTek Software Power Model Platform is MT6885
	  for power management.
	  Set Y to select this feature for specific platform-mt6885.
	  If unsure, set N to disable.

config MTK_SWPM_MT6893
	tristate "Specify Mediatek SWPM Platform is MT6893"
	depends on MTK_SWPM_MODULE
	select MTK_SWPM_DBG_COMMON
	help
	  Select MediaTek Software Power Model Platform is MT6893
	  for power management.
	  Set Y to select this feature for specific platform-mt6893.
	  If unsure, set N to disable.

config MTK_SWPM_MT6983
	tristate "Specify Mediatek SWPM Platform is MT6983"
	depends on MTK_SWPM_MODULE
	select MTK_SWPM_DBG_COMMON
	help
	  Select MediaTek Software Power Model Platform is MT6983
	  for power management.
	  Set Y to select this feature for specific platform-mt6983.
	  If unsure, set N to disable.

config MTK_SWPM_MT6895
	tristate "Specify Mediatek SWPM Platform is MT6895"
	depends on MTK_SWPM_MODULE
	select MTK_SWPM_DBG_COMMON
	help
	  Select MediaTek Software Power Model Platform is MT6895
	  for power management.
	  Set Y to select this feature for specific platform-mt6895.
	  If unsure, set N to disable.
```

## drivers/misc/mediatek/sync/Kconfig
```kconfig
config MTK_SYNC
	bool "Simplified software synchronization objects"
	default n
	help
	  A simplified SW_SYNC that provides essential APIs for
	  other kernel modules.
	  default value is "n"
	  If you want to use mtk display driver, please set y.
```

## drivers/misc/mediatek/sysenv/Kconfig
```kconfig
config MTK_SYSENV
	bool "Enable sysenv driver"
	default n
	help
	  Define sysenv driver config to enable sysenv driver.
	  Sysenv driver is used for storing settings needed by bootloader.
	  Set Y to support.
	  Set N to disable.
```

## drivers/misc/mediatek/systracker/Kconfig
```kconfig
config MTK_SYSTRACKER_V2
	bool "Enable MTK System Tracker Debugger V2"
	help
	  SYSTRACKER driver is a debugging feature.
	  SYSTRACKER is a hardware debugger to record timeout transaction
	  and trigger SLV_ERR or interrupt to notify CPU.
	  Support 2 stage timeout & watchpoint SLV_ERR
```

## drivers/misc/mediatek/task_turbo/Kconfig
```kconfig
config MTK_TASK_TURBO
	bool "MTK task turbo feature"
	depends on MTK_SCHED_CPU_PREFER
	help
	  A new option CONFIG_MTK_TASK_TURBO for the feature.
	  Task turbo provide enhancement of APP launch and lock
	  latency via Preempting lock waiting queue and more
	  oppotunity to occupy CPU resource.
	  If you are not sure about whether to enable it or not,
	  please set n.
```

## drivers/misc/mediatek/tee_sanity/Kconfig
```kconfig
config MTK_TEE_SANITY
	tristate "Mediatek TEE sanity"
	help
	  This option enables tee_sanity driver which is used to
	  TEEs functional test. For example,
	  register interrupts as G1S/G1NS and switch back and forth
	  is necessary.
```

## drivers/misc/mediatek/teei/270/tz_driver/Kconfig
```kconfig
# Copyright (c) 2015-2017 MICROTRUST Incorporated
# Copyright (C) 2019 XiaoMi, Inc.
# All Rights Reserved.
#
# This program is free software; you can redistribute it and/or
# modify it under the terms of the GNU General Public License
# version 2 as published by the Free Software Foundation.
#
# This program is distributed in the hope that it will be useful,
# but WITHOUT ANY WARRANTY; without even the implied warranty of
# MERCHANTABILITY or FITNESS FOR A PARTICULAR PURPOSE. See the
# GNU General Public License for more details.

#config MICROTRUST_TZ_EXTENSIONS
#	bool "Enable microtrust TrustZone extensions"
#	default y
#	---help---
#	  Enables microtrust TrustZone extensions to the Linux kernel.

config MICROTRUST_TZ_DRIVER
	tristate "Support teei_driver function"
	default n
	---help---
	Enable teei_driver framework.
	Enable teei_driver framework.
	Enable teei_driver framework.
	Enable teei_driver framework.
	Communication with the secure OS
```

## drivers/misc/mediatek/teei/Kconfig
```kconfig
config MICROTRUST_TEE_SUPPORT
	bool "Enable Microtrust TEEI Support"
	default n
	---help---
	  Enable Microtrust TEEI Support

config MICROTRUST_TZ_DRIVER
	tristate "Microtrust TEEI Driver"
	depends on MICROTRUST_TEE_SUPPORT
	default y
	---help---
	  Enable TEEI Linux Kernel Tz Driver

config MICROTRUST_VFS_DRIVER
	tristate "Microtrust Virtual File System Driver"
	depends on MICROTRUST_TEE_SUPPORT
	default y
	---help---
	  Enable TEEI Virtual File System Driver

config MICROTRUST_FP_DRIVER
	tristate "Microtrust Fingerprint Driver"
	depends on MICROTRUST_TEE_SUPPORT
	default y
	---help---
	  Enable TEEI Fingerprint Driver

config MICROTRUST_KEYMASTER_DRIVER
	tristate "Microtrust keymaster Driver"
	depends on MICROTRUST_TEE_SUPPORT
	default y
	---help---
	  Enable TEEI Keymaster Driver
```

## drivers/misc/mediatek/teei/V1.0/tz_driver/Kconfig
```kconfig
#
# Industrial TZ driver configuration
#

#config MICROTRUST_TZ_EXTENSIONS
#	bool "Enable microtrust TrustZone extensions"
#	default y
#	---help---
#	  Enables microtrust TrustZone extensions to the Linux kernel.

config MICROTRUST_TZ_DRIVER
	tristate "Support teei_driver function"
	default n
	---help---
	Enable teei_driver framework.
	#Communication with the secure OS
```

## drivers/misc/mediatek/thermal/Kconfig
```kconfig
config MTK_LEGACY_THERMAL
	tristate "Use MTK legacy thermal code"
	help
	  Upstream thermal code and legacy thermal
	  code are not compatiable. As a result,
	  add a new switch MTK_LEGACY_THERMAL to replace
	  CONFIG_THERMAL for MTK legacy thermal code.

config MTK_THERMAL_PA_VIA_ATCMD
	tristate "Thermal switch for query modem RF temp"
	help
	  Internal switch for thermal management
	  to query modem RF temperature
	  via AT command.
	  (RIL sockets)

config MTK_LEGACY_THERMAL_PLATFORM
	string "chip name"
	help
	  To separate platform codes for legacy thermal
	  drivers. Config platform name for your
	  selection. It's used for legacy thermal
	  drivers only.

config MTK_LEGACY_PLATFORM
	string "chip name"
	help
	  To separate platform codes for legacy thermal
	  drivers. Config platform name for your
	  selection. It's used for legacy thermal
	  drivers only.
```
