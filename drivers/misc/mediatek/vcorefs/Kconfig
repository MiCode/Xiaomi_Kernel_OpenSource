## drivers/misc/mediatek/vcorefs/Kconfig
```kconfig
config MTK_VCOREFS
	bool "MTK Vcore DVFS support"
	default n
	help
	  Say Y here to enable MTK Vcore DVFS support
```

## drivers/misc/mediatek/vcorefs_v3/Kconfig
```kconfig
config MTK_VCOREFS_LEGACY
	tristate "MTK VCOREFS LEGACY"
	help
	  This kernel config can be used to enable MTK VCOREFS LEGACY
	  for MT6739, spm is used to control vcore and dram frequency
	  it should be enabled by default.
	  If unsure, say N.
```

## drivers/misc/mediatek/vcp/Kconfig
```kconfig
config MTK_TINYSYS_VCP_SUPPORT
	tristate "Specify Interface Support VCP"
	help
	  VCP is a MediaTek in-house DSP which can receive
	  command from IPI interface.
	  Set Y to enable this feature.
	  If unsure,
	  Set N to stay with legancy feature.

config MTK_TINYSYS_VCP_VERSION
	string "Support MTK VCP Driver Version"
	depends on MTK_TINYSYS_VCP_SUPPORT
	default ""
	help
	  MTK_TINYSYS_VCP_VERSION define which vcp version will be used
```

## drivers/misc/mediatek/vdec_fmt/Kconfig
```kconfig
config MTK_VDEC_FMT
	bool "mtk vdec formatter"
	help
	  This option enables mtk vdec formatter driver,
	  if yes, it means this platform supports VDEC-FMT(or miniMDP) HW,
	  if no, it means this platform not supports VDEC-FMT(or miniMDP) HW.
```

## drivers/misc/mediatek/vibrator/Kconfig
```kconfig
config MTK_VIBRATOR
	tristate "MediaTek Vibrator driver"
	default n
	  ---help---
	  Vibrator driver support for MediaTek SOC.
	  You can customize the vibrate strength and lowest vibrate time.
	  If you want to use MediaTek Vibrator driver, say Y or M here.
	  If unsure, say N.
```

## drivers/misc/mediatek/video/Kconfig
```kconfig
menuconfig MTK_FB
	bool "MediaTek Framebuffer Driver"
	depends on FB
	select FB_CFB_FILLRECT
	select FB_CFB_COPYAREA
	select FB_CFB_IMAGEBLIT
	select FB_SOFT_CURSOR
	help
	  This selects the MediaTek(R) frame buffer driver.
	  Meditek Framebuffer Driver is driver display.
	  If you want to use MediaTek(R) frame buffer diver, please make sure it is Y in xxx_defconfig.mk.
	  If unsure, set N in xxx_defconfig.mk.

config MTK_VIDEOX
	bool "enable medietak display driver"
	default n
	help
	  define CONFIG_MTK_VIDEOX to enable Mediatek display driver.
	  MTK_VIDEOX design meditek display driver.
	  If you want to use Meditek display driver, please make sure it is Y in xxx_defconfig.mk.
	  If unsure, set N.

config MTK_LCM_PHYSICAL_ROTATION
	string "define LCM PHYSICAL ROTATION"
	help
	  To set the angle between dimension of UI layout and LCM scan direction.
	  If you want to use rotation in LCM, please define it is set in xxx_defconfig.mk.
	  MTK_LCM_PHYSICAL_ROTATION=0 means not rotation.
	  MTK_LCM_PHYSICAL_ROTATION=180 means 180 rotation.

config MTK_ROUND_CORNER_SUPPORT
	bool "enable medietak display round corner"
	default n
	help
	  define CONFIG_MTK_ROUND_CORNER_SUPPORT to enable Mediatek Round Corner on display.
	  If you want to use Meditek Round Corner on display, please make sure it is Y in xxx_defconfig.mk.
	  This feature require round corner pattern provided in lcm driver folder.
	  If unsure, set N.

config LCM_HEIGHT
	string "define LCM HEIGHT size"
	default "1920"
	help
	  To set LCM resolution height size.
	  This define is in ProjectConfig.mk.
	  LCM height can be set 1024/1920/680 etc.
	  If you want to change LCM height, please define it in ProjectConfig.mk.

config LCM_WIDTH
	string "LCM width size"
	default "1080"
	help
	  To set LCM resolution width size.
	  This define is in ProjectConfig.mk.
	  LCM width can be set 1080/480/400 etc.
	  If you want to change LCM width, please define it in ProjectConfig.mk.

config CUSTOM_LCM_X
	string "define LCM fake X coordinate"
	default "0"
	help
	  To set X coordinate in WHD.
	  This define in xxxx_defconfig.mk.
	  If you want to change LCM resolution, please set it.
	  default value is "0".

config CUSTOM_LCM_Y
	string "define LCM fake Y coordinate"
	default "0"
	help
	  To set Y coordinate in WHD.
	  This define in xxx_defconfig.mk.
	  If you want to change LCM resolution, please set it.
	  defaule value is "0".

config MTK_FB_SUPPORT_ASSERTION_LAYER
	bool "AEE Assertion Layer Support"
	depends on MTK_FB
	select FONT_SUPPORT
	select FONT_8x16
	help
	  This enable support for AEE assertion layer.
	  It define in xxx_defconfig.mk.
	  If you want to enable AEE assertion layer support, say Y here.
	  If unsure, say N.

config MTK_AAL_SUPPORT
	bool "support AAL"
	default n
	help
	  Decide whether to support ambient-light adaptive luma and
	  display visual enhancement.
	  This feature requires the cowork of AAL user-space algorithm process.
	  Please also turn on MTK_AAL_SUPPORT in ProjectConfig.mk.

config MTK_OD_SUPPORT
	bool "support od"
	default n
	help
	  Over drive LCD to enhance the response time.
	  On high frame rate (e.g. 120Hz) platform, the LCD response time is
	  not short enough to display clear moving objects.
	  This feature allows to speed up the change time of each pixels.
	  MUST fill the over-drive table correctly according to LCD property.

config SINGLE_PANEL_OUTPUT
	bool "support single panel output"
	default n
	help
	  Decide whether to support single panel display feature.
	  Panel and tv can't not display at the same time.
	  When hdmi plug in, only show display in tv, panle will be black screen.
	  And when hdmi plug out, panel will resume.

config MTK_OVERLAY_ENGINE_SUPPORT
	bool "support overlay time division multiplex"
	default n
	help
	  This enable support overlay time division multiplex.
	  This enable means support overlay engine.
	  If you want display support Overlay time division mulptiplex, set Y in xxx_defconfig.mk.
	  If unsure, set N.

config MTK_CONSUMER_PARTIAL_UPDATE_SUPPORT
	bool "support partial update"
	default n
	help
	  This enable support display partial support.
	  Define it means display driver support partial update.
	  If you want to support partial update, please set Y in xxx_defconfig.mk.
	  If unsure, set N.

config MTK_PQ_COLOR_MODE
	string "Config PQ_COLOR_MODE (MDP & DISP COLOR on/off)"
	default "DISP"
	help
	  This control mdp color on/off and disp color on/off
	  if value equals to DISP, only display color is on.
	  if value equals to MDP, only mdp color is on.
	  if value equals to DISP_MDP, mdp and display color are both on.
	  if value equals to OFF, mdp and display color are both off.

config MTK_DRE30_SUPPORT
	bool "support DRE 30"
	default n
	help
	  Decide whether to support ambient-light adaptive luma and
	  display visual enhancement ver.3.
	  This feature requires the cowork of AAL user-space algorithm process.
	  Please also turn on MTK_AAL_SUPPORT amd MTK_DRE30_SUPPORT in ProjectConfig.mk.

config MTK_DISPLAY_LOW_MEMORY_DEBUG_SUPPORT
	bool "enable medietak display low memory debug"
	default n
	help
	  define CONFIG_MTK_DISPLAY_LOW_MEMORY_DEBUG_SUPPORT
	  to enable Mediatek display low memory debug on display for low memory project.
	  If enable this option, display some debug buffer will be reduced or closed.
	  If you want to use Meditek display low memory debug, please make sure it is Y in xxx_defconfig.mk.
	  If unsure, set N.
```

## drivers/misc/mediatek/videocodec/Kconfig
```kconfig
config MTK_VIDEOCODEC_DRIVER
	tristate "MediaTek VideoCodec Driver"
	help
	  VideoCodec driver is used to support
	  Video Playback/Video
	  Recording/Video related features...
	  which is using MTK solution

config MTK_VIDEOCODEC_IPM_V1
	bool "MediaTek VideoCodec Driver IPM V1"
	help
	  VideoCodec driver is used to support
	  Video Playback/Video
	  Recording/Video related features...
	  which is using MTK solution

config MTK_VIDEOCODEC_IPM_V2
	bool "MediaTek VideoCodec Driver IPM V2"
	help
	  VideoCodec driver is used to support
	  Video Playback/Video
	  Recording/Video related features...
	  which is using MTK solution
```

## drivers/misc/mediatek/videox/Kconfig
```kconfig
config MTK_VIDEOX
  bool CONFIG_MTK_VIDEOX
  default n
  help
    CONFIG_MTK_VIDEOX
```

## drivers/misc/mediatek/vmm/Kconfig
```kconfig
# SPDX-License-Identifier: GPL-2.0

config MTK_VMM_NOTIFIER
	tristate "MediaTek VMM Notifier driver"
	help
	  This driver is for the Multimedia Infrastructure in MediaTek SoCs.
	  The VMM notifier driver mainly help to nofify MM MCU that camera
	  related mtcmos status. If one of camera mtcmos is on, VMM DVFS has
	  limitation of adjusting voltage, therefore notify camera mtcmos
	  status is necessary for sake of hardware stability.
```

## drivers/misc/mediatek/vmm_dbg/Kconfig
```kconfig
# SPDX-License-Identifier: GPL-2.0

config MTK_VMM_DBG
	tristate "MediaTek VMM DBG driver"
	help
	  This driver is for VMM DVFS debug. It handshakes with SRAMRC driver
	  and query ccu registers when it receives callback from SRAMRC.
```

## drivers/misc/mediatek/vmm_spm/Kconfig
```kconfig
# SPDX-License-Identifier: GPL-2.0

config MTK_VMM_SPM
	tristate "MediaTek VMM SPM driver"
	help
	  This driver is for the Multimedia Infrastructure in MediaTek SoCs.
	  The VMM SPM driver mainly help control VMM buck isolation. It's a
	  basic setting during VMM buck being powering up/down. It leaverages
	  regulator fwk notification callback to get the status of buck control
	  and sets up related SPM registers.
```

## drivers/misc/mediatek/vow/Kconfig
```kconfig
config MTK_VOW_SUPPORT
	bool "MediaTek VOW support"
	select MTK_AUDIO_IPI
	help
	  For VOW kernel driver config. This voice wakeup
	  kernel driver cooperate with SCP VOW driver to
	  wakeup phone by doing voice recognition. Using
	  IPI interface to communicate with SCP side and
	  be controlled by sound trigger HAL.

config MTK_VOW_DUAL_MIC_SUPPORT
	bool "MediaTek VOW dual mic support"
	help
	  For VOW kernel driver config. This config can
	  open dual mic control path which can transfer
	  two channels data into sound trigger HAL. This
	  feature need to work with MTK_VOW_SUPPORT.

config MTK_VOW_2E2K_SUPPORT
	bool "MediaTek VOW two engine two keyword support"
	help
	  For VOW kernel driver config. This config can
	  reserve two keyword memory, and work with SCP
	  and sound trigger HAL. It can report two keyword's
	  wakeup status to HAL. This feature need to work
	  with MTK_VOW_SUPPORT.

config MTK_VOW_AMAZON_SUPPORT
	bool "MediaTek VOW AMAZON keyword support"
	help
	  For VOW kernel driver config. This config can
	  support AMAZON voice assistant, and work with SCP
	  and sound trigger HAL. It can report Alexa keyword
	  wakeup status to HAL. This feature need to work
	  with MTK_VOW_SUPPORT.

config MTK_VOW_GVA_SUPPORT
	bool "MediaTek VOW Google keyword support"
	help
	  For VOW kernel driver config. This config can
	  reserve Google voice assistant, and work with SCP
	  and sound trigger HAL. It can report Google keyword
	  wakeup status to HAL. This feature need to work
	  with MTK_VOW_SUPPORT.

config MTK_VOW_MAX_PDK_NUMBER
	int "MediaTek VOW MAX PDK model support"
	default 0
	help
	  For VOW kernel driver config. This config can
	  support different PDK model number, and work with SCP
	  and sound trigger HAL. This feature need to work
	  with MTK_VOW_SUPPORT.

config MTK_VOW_PCMCALLBACK_SUPPORT
	string "MediaTek VOW open pcm callback support"
	default "none"
	help
	  For VOW kernel driver config. This config can
	  support transferring voice data since passing phase2
	  recognition in SCP. This feature need to work
	  with MTK_VOW_SUPPORT.

config MTK_VOW_DSP_VERSION
	string "MediaTek VOW DSP Version"
	help
	  For VOW kernel driver config. This config can
	  indicate DSP version. This feature need to work
	  with MTK_VOW_SUPPORT.
```

## drivers/misc/mediatek/vpu/Kconfig
```kconfig
config MTK_VPU_SUPPORT
	bool "MediaTek VPU Driver"
	select MTK_APUSYS_VPU
	---help---
	  Support image processing using VPU hardware.
	  Customers and third party could use VPU to develop
	  feature and algorithm by themselves. There is better
	  performance and power if image process algorithm
	  land on VPU instead of CPU/GPU.

config MTK_VPU_SUPPORT_DEBUG
	bool "MediaTek VPU Debugging Features"
	depends on MTK_VPU_SUPPORT
	select MTK_APUSYS_VPU_DEBUG
	---help---
	  Enable debug facilities of VPU, such as
	  kernel logs, register dumps, device logs,
	  VPU jtag functions, and MET trace.
	  Disable, if you don't need them.
```

## drivers/misc/mediatek/wake_gesture_sensor/Kconfig
```kconfig
config CUSTOM_KERNEL_WAKE_GESTURE_SENSOR
	bool "CUSTOM_KERNEL_WAKE_GESTURE_SENSOR"
	help
	  Kernel space wake up gesture sensor driver.
source "drivers/misc/mediatek/wake_gesture_sensor/wakehub/Kconfig"
```

## drivers/misc/mediatek/watchpoint/Kconfig
```kconfig
config MTK_WATCHPOINT
	bool "Enable MTK WATCH POINT Driver"
	default n
	help
	  Watch pointer driver is a debugging feature,
	  which allows user to monitor on certain hardware
	  physical address. After enabling a watchpoint, any
	  access to this address would trigger an interrupt.
```

## drivers/misc/mediatek/widevine_drm/Kconfig
```kconfig
config MTK_WIDEVINE_DRM
	tristate "MediaTek widevine l1 driver"
	help
	  This is widevine drm driver, it is used to get secure handle from dma-buf
```

## drivers/misc/mediatek/wmt_ccci/Kconfig
```kconfig
config MTK_WMT_CCCI
  bool CONFIG_MTK_WMT_CCCI
  default n
  help
    CONFIG_MTK_WMT_CCCI
```

## drivers/misc/mediatek/xhci/Kconfig
```kconfig
#
# Mediatek XHCI Driver
#

config USB_MTK_DUALMODE
	bool "MediaTek DUAL MODE support"
	depends on USB_XHCI_MTK
	---help---
	  Enable Mediatek USB Host OTG DUAL-ROLE SUPPORT
	  The USB Port can act device role or host role.
	  Say Y here if your system support usb otg DUAL_ROLE.
	  If unsure, say N.

config MTK_TEST_XHCI
	tristate "MediaTek U3 TEST XHCI driver support"
	---help---
	  Enables support Mediatek U3 XHCI test driver
	  kernel framework.
	  Say Y if you would like to do verification program.
	  If unsure, say N.

config USB_MTK_OTG_SWITCH
	tristate "MediaTek OTG IDDIG Function Switch"
	depends on USB_XHCI_MTK_IDDIG
	---help---
	  Enable Mediatek OTG function Switch mechanism.
	  The default OTG DUALROLE function is disabled.
	  User can switch to enable or disable by command.
	  Say Y here if your want to use mechanism.
	  If unsure, say N.

config USB_XHCI_MTK_SUSPEND_SUPPORT
	tristate "MediaTek XHCI SUSPEND SUPPORT"
	depends on USB_XHCI_MTK
	---help---
	  Enable Mediatek OTG function Switch mechanism.
	  The default OTG DUALROLE function is disabled.
	  User can switch to enable or disable by command.
	  Say Y here if your want to use mechanism.

config USB_VBUS_GPIO
	tristate "MediaTek OTG VBUS GPIO control support"
	depends on USB_XHCI_MTK_IDDIG
	---help---
	  Enable Mediatek USB OTG VBUS GPIO control mechanism.
	  Say Y here if your want to use mechanism.
	  If unsure, say N.

config USB_XHCI_MTK_IDDIG
	bool "MediaTek OTG IDDIG support"
	default n
	depends on USB_MTK_DUALMODE
	---help---
	  Enable Mediatek USB Host OTG detection mechanism
	  IDDIG - OTG cable attachment detection.
	  Say Y here if your system support OTG IDDIG detection.
	  If unsure, say N.
```

## drivers/misc/mediatek/xo/Kconfig
```kconfig
# XO Related
config MTK_XO
	bool "MediaTek XO Support"
	---help---
	  MediaTek XO driver.
	  Which support MT8167/MT8516/MT8511 chips.
	  XO module can generate 26MHz clock to other chip.
	  The 26MHz can be adjusted to output a more accurate clock.
	  XO module can generate 32.768KHz clock to other chip.
```

## drivers/misc/mi-ioturbo/Kconfig
```kconfig
# SPDX-License-Identifier: GPL-2.0-only
#
# Mi ioturbo info
#


config MI_IOTURBO_SUPPORT
	tristate "xiaomi ioturbo function"
	default n
	help
	  This adds supprot for mi ioturbo function.
```

## drivers/misc/mi-memory/Kconfig
```kconfig
# SPDX-License-Identifier: GPL-2.0-only
#
# Mi memory info
#


config MI_MEMORY_SYSFS
	tristate "show memory info"
	default n
	help
	  This adds support for mi memory info.
```

## drivers/misc/mi-memory_c3j1/Kconfig
```kconfig
# SPDX-License-Identifier: GPL-2.0-only
#
# Mi memory info
#
config MI_MEMORY_SYSFS_C3J1
	tristate "show memory info"
	default n
	help
	  This adds support for mi memory info.
```
