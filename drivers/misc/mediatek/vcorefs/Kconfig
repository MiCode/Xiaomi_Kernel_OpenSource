## drivers/misc/mi-power/Kconfig
```kconfig
# SPDX-License-Identifier: GPL-2.0-only
#
# Mi power info
#


config MI_POWER_INFO
	tristate "Power debug info"
	default n
	help
	  This adds support for mi power debug info.
```

## drivers/misc/mi_gamekey/Kconfig
```kconfig
config MI_GAMEKEY
    tristate "xiaomi physical game key"
    default n
    help
    xiaomi physical game key, can detect press on the key and key whether pop.
```

## drivers/misc/mi_sw_sync/Kconfig
```kconfig
config MI_SW_SYNC
        tristate "mi sw sync"
        default n
        help
          this module support some disp functions for performance.
```
