## drivers/misc/mediatek/sensor_bio/gyroscope/Kconfig
```kconfig
config CUSTOM_KERNEL_GYROSCOPE
	bool "CUSTOM_KERNEL_GYROSCOPE"
	help
	  gyroscope sensor to detect gyroscope from x y z axis.
          If the platform is supported for gyroscope, this
          configuration should be configured, and the gyroscope
          driver configuration should be configured as well.

source "drivers/misc/mediatek/sensor_bio/gyroscope/gyrohub/Kconfig"
```

## drivers/misc/mediatek/sensor_bio/humidity/Kconfig
```kconfig
config CUSTOM_KERNEL_HUMIDITY
	bool "CUSTOM_KERNEL_HUMIDITY"
	help
	  To detect humidity raw data

source "drivers/misc/mediatek/sensor_bio/humidity/hmdyhub/Kconfig"
```

## drivers/misc/mediatek/sensor_bio/hwmon/Kconfig
```kconfig
config MTK_HWMON
  bool CONFIG_MTK_HWMON
  default n
  help
    CONFIG_MTK_HWMON
```

## drivers/misc/mediatek/sensor_bio/magnetometer/Kconfig
```kconfig
config MTK_AUTO_DETECT_MAGNETOMETER
	bool "MTK_AUTO_DETECT_MAGNETOMETER"
	help
	  one load to support different magnetometer sensor.
          This feature Option is used for projects which using more than one
	  magnetometer, more than one ALSPS drivers can be builded in to
	  project and be auto detected by setting this option to yes

config CUSTOM_KERNEL_MAGNETOMETER
	bool "CUSTOM_KERNEL_MAGNETOMETER"
	help
	  compass driver to detect compass raw data and report orientatino
	  data. A compass is an instrument used for navigation and
          orientation that shows direction relative to the geographic
          cardinal directions, or "points".

source "drivers/misc/mediatek/sensor_bio/magnetometer/maghub/Kconfig"
```

## drivers/misc/mediatek/sensor_bio/pedometer/Kconfig
```kconfig
config CUSTOM_KERNEL_PEDOMETER
	bool "CUSTOM_KERNEL_PEDOMETER"
	help
	  Kernel space pedometer sensor driver.

source "drivers/misc/mediatek/sensor_bio/pedometer/pedohub/Kconfig"
```

## drivers/misc/mediatek/sensor_bio/sensorHub/SCP_sensorHub_v1/Kconfig
```kconfig
config MTK_SCP_SENSORHUB_V1
	bool "MTK_SCP_SENSORHUB_V1 for Mediatek package"
	default n
```

## drivers/misc/mediatek/sensor_bio/sensorHub/SCP_shf/Kconfig
```kconfig
config MTK_SENSOR_HUB_SUPPORT
	bool "MTK_SENSOR_HUB_SUPPORT"
	help
	  To enable MTK sensor hub kernel shf
```

## drivers/misc/mediatek/sensor_bio/sensorfusion/Kconfig
```kconfig
config CUSTOM_KERNEL_SENSOR_FUSION
	bool "CUSTOM_KERNEL_SENSOR_FUSION"
	help
	  fusion sensor is a sensor conclusion.
          If the platform is supported for fusion, this
          configuration should be configured, and the fusion
          driver configuration should be configured as well.
config CUSTOM_KERNEL_GRV_SENSOR
	bool "CUSTOM_KERNEL_GRV_SENSOR"
	help
	  grv sensor is a sensor fusion type.
          If the platform is supported for grv, this
          configuration should be configured, and the grv
          driver configuration should be configured as well.
config CUSTOM_KERNEL_GMRV_SENSOR
	bool "CUSTOM_KERNEL_GMRV_SENSOR"
	help
	  gmrv sensor is a sensor fusion type.
          If the platform is supported for gmrv, this
          configuration should be configured, and the gmrv
          driver configuration should be configured as well.
config CUSTOM_KERNEL_RV_SENSOR
	bool "CUSTOM_KERNEL_RV_SENSOR"
	help
	  rv sensor is a sensor fusion type.
          If the platform is supported for rv, this
          configuration should be configured, and the rv
          driver configuration should be configured as well.
config CUSTOM_KERNEL_LINEARACCEL_SENSOR
	bool "CUSTOM_KERNEL_LINEARACCEL_SENSOR"
	help
	  linearacc sensor is a sensor fusion type.
          If the platform is supported for linearacc, this
          configuration should be configured, and the linearacc
          driver configuration should be configured as well.
config CUSTOM_KERNEL_GRAVITY_SENSOR
	bool "CUSTOM_KERNEL_GRAVITY_SENSOR"
	help
	  gravity sensor is a sensor fusion type.
          If the platform is supported for gravity, this
          configuration should be configured, and the gravity
          driver configuration should be configured as well.
config CUSTOM_KERNEL_ORIENTATION
	bool "CUSTOM_KERNEL_ORIENTATION"
	help
	  orient sensor is a sensor fusion type.
          If the platform is supported for orient, this
          configuration should be configured, and the orient
          driver configuration should be configured as well.
config CUSTOM_KERNEL_UNCALI_GYRO_SENSOR
	bool "CUSTOM_KERNEL_UNCALI_GYRO_SENSOR"
	help
	  ungyro sensor is a sensor fusion type.
          If the platform is supported for ungyro, this
          configuration should be configured, and the ungyro
          driver configuration should be configured as well.
config CUSTOM_KERNEL_UNCALI_MAG_SENSOR
	bool "CUSTOM_KERNEL_UNCALI_MAG_SENSOR"
	help
	  unmag sensor is a sensor fusion type.
          If the platform is supported for unmag, this
          configuration should be configured, and the unmag
          driver configuration should be configured as well.

source "drivers/misc/mediatek/sensor_bio/sensorfusion/uncali_maghub/Kconfig"
source "drivers/misc/mediatek/sensor_bio/sensorfusion/uncali_gyrohub/Kconfig"
source "drivers/misc/mediatek/sensor_bio/sensorfusion/gamerotvechub/Kconfig"
source "drivers/misc/mediatek/sensor_bio/sensorfusion/rotatvechub/Kconfig"
source "drivers/misc/mediatek/sensor_bio/sensorfusion/gamerotvechub/Kconfig"
source "drivers/misc/mediatek/sensor_bio/sensorfusion/gmagrotvechub/Kconfig"
source "drivers/misc/mediatek/sensor_bio/sensorfusion/gravityhub/Kconfig"
source "drivers/misc/mediatek/sensor_bio/sensorfusion/linearacchub/Kconfig"
source "drivers/misc/mediatek/sensor_bio/sensorfusion/orienthub/Kconfig"
```

## drivers/misc/mediatek/sensor_bio/tilt_detector_sensor/Kconfig
```kconfig
config CUSTOM_KERNEL_TILT_DETECTOR_SENSOR
	bool "CUSTOM_KERNEL_TILT_DETECTOR_SENSOR"
	help
	  Kernel space tilt detector sensor driver.
source "drivers/misc/mediatek/sensor_bio/tilt_detector_sensor/tiltdetecthub/Kconfig"
```

## drivers/misc/mediatek/sensors-1.0/Kconfig
```kconfig
config MTK_SENSOR_SUPPORT
	tristate "MTK_SENSOR_SUPPORT"
	help
		Sensor config for sensor feature in project.
		Please say y here if you want to support sensors
		with mediatek sesnor architecture.
		If unsure, say N.

source "drivers/misc/mediatek/sensors-1.0/accelerometer/Kconfig"
source "drivers/misc/mediatek/sensors-1.0/alsps/Kconfig"
source "drivers/misc/mediatek/sensors-1.0/gyroscope/Kconfig"
source "drivers/misc/mediatek/sensors-1.0/magnetometer/Kconfig"
source "drivers/misc/mediatek/sensors-1.0/hwmon/Kconfig"
source "drivers/misc/mediatek/sensors-1.0/barometer/Kconfig"
source "drivers/misc/mediatek/sensors-1.0/step_counter/Kconfig"
source "drivers/misc/mediatek/sensors-1.0/situation/Kconfig"
source "drivers/misc/mediatek/sensors-1.0/sensorHub/Kconfig"
```

## drivers/misc/mediatek/sensors-1.0/accelerometer/Kconfig
```kconfig
config MTK_AUTO_DETECT_ACCELEROMETER
	bool "MTK AUTO DETECT ACCELEROMETER Sensor"
	depends on MTK_SENSOR_SUPPORT
	help
	  one load to support different accelerometer sensor.
	  If this option is set, multiple accelerometer driver
	  can be configured at the same time, but only one
	  can be probed.

config CUSTOM_KERNEL_ACCELEROMETER
	bool "CUSTOM KERNEL ACCELEROMETER Config"
	help
	  accelerometer sensor to detect accelerometer from x y z axis.
	  If the platform is supported for acceleometer, this
	  configuration should be configured, and the acceleometer
	  driver configuration should be configured as well.

source "drivers/misc/mediatek/sensors-1.0/accelerometer/accelhub/Kconfig"
source "drivers/misc/mediatek/sensors-1.0/accelerometer/bmi160-i2c/Kconfig"
source "drivers/misc/mediatek/sensors-1.0/accelerometer/lsm6ds3hg/Kconfig"
source "drivers/misc/mediatek/sensors-1.0/accelerometer/mpu6050g/Kconfig"
```

## drivers/misc/mediatek/sensors-1.0/accelerometer/accelhub/Kconfig
```kconfig
config MTK_ACCELHUB
	bool "accelhub for MediaTek package"
	help
	  It support different accelerometer sensor.
	  If this option is set,
	  it will support
	  sensorhub Accelerometer.
```

## drivers/misc/mediatek/sensors-1.0/accelerometer/bma2xx/Kconfig
```kconfig
config MTK_BMA2XX
	bool "bma2xx g-sensor for MediaTek package"
	help
	  bma2xx driver support some bosh g-sensor chip
	  such as bma220, bma222, etc .
	  now this driver is used for bma223.
```

## drivers/misc/mediatek/sensors-1.0/accelerometer/bmi160-i2c/Kconfig
```kconfig
config MTK_BMI160_I2C
	bool "MTK_BMI160_I2C for MediaTek package"
	default n
	help
	  The BMI160 is a highly integrated,
	  low power internal measurement unit
	  that provides precise acceleration
	  and angular rate (gyroscopic) measurement.
	  It support different accelerometer sensor.
	  If this option is set, it will support
	  MTK_BMI160 Accelerometer.
```

## drivers/misc/mediatek/sensors-1.0/accelerometer/mc3410-i2c/Kconfig
```kconfig
config MTK_MC3410_I2C
	bool "MTK_MC3410 for MediaTek package"
	default n
	help
	  The MC3410 is a highly integrated,
	  low power internal measurement unit
	  that provides precise acceleration
	  measurement.
	  this config will turn on accelerometer feature.
```

## drivers/misc/mediatek/sensors-1.0/accelerometer/mc3433/Kconfig
```kconfig
config MTK_MC3433
	bool "mc3433 g-sensor for MediaTek package"
	help
	  mc3433 driver support some mc g-sensor chip
	  such as mc34xx, etc .
	  now this driver is used for mc34xx.
```
