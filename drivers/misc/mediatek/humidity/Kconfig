## drivers/misc/mediatek/humidity/Kconfig
```kconfig
config CUSTOM_KERNEL_HUMIDITY
	bool "CUSTOM_KERNEL_HUMIDITY"
	help
	  To detect humidity raw data

source "drivers/misc/mediatek/humidity/hts221/Kconfig"
source "drivers/misc/mediatek/humidity/hmdyhub/Kconfig"
```

## drivers/misc/mediatek/humidity/hmdyhub/Kconfig
```kconfig
config MTK_HMDYHUB
	bool "hmdyhub for MediaTek package"
	default n
	help
	  It support different hmdyhub sensor.
          If this option is set,
	  it will support
          sensorhub gyroscope.
```

## drivers/misc/mediatek/humidity/hts221/Kconfig
```kconfig
config MTK_HTS221
	bool "hts221 for MediaTek package"
	default n
	help
	It support different type sensor
	in this platform. If this option
	is set, it will support humidity
	by hts221.
```

## drivers/misc/mediatek/i2c/Kconfig
```kconfig
config MTK_I2C
	tristate "MediaTek I2C adapter"
	depends on I2C
	default y
	---help---
	  This selects the MediaTek(R) Integrated Inter Circuit bus driver.
	  MediaTek(R) I2C bus adapter is the base for some other I2C client, eg: touch, sensors.
	  If you want to use MediaTek(R) I2C interface, say Y or M here.
	  If unsure, say N.


config MTK_I2C_EXTENSION
	def_bool y if (ARCH_MT6735 || ARCH_MT6735M || ARCH_MT6753 || ARCH_MT6580 || ARCH_MT6755 || ARCH_MT6570)
	help
	  Select this if your platform need MTK i2c extension.

config MTK_I2C_ARBITRATION
	def_bool y if (ARCH_MT6797)
	help
	  Select this if your platform need MTK i2c arbitration support.

config MTK_AP_TO_SCP_I2C
	def_bool y if (ARCH_MT6752 || ARCH_MT8163)
	---help---
	  This option enables AP to control SCP I2C controller 2.
```

## drivers/misc/mediatek/imgsensor/Kconfig
```kconfig
config MTK_IMGSENSOR
	bool CONFIG_MTK_IMGSENSOR
	default n
	help
	  CONFIG_MTK_IMGSENSOR

source "drivers/misc/mediatek/imgsensor/src/Kconfig"
```

## drivers/misc/mediatek/imgsensor/src/Kconfig
```kconfig
config SPECIFY_IMGSENSOR
	bool "Specify image sensor name"
	depends on MTK_IMGSENSOR
	help
	  Specify name of each sensor to prevent obtaining wrong sensor driver
	  with same sensor ID. For example, imx258_mipi_raw and
	  imx258_mipi_mono are of same sensor ID. If not specifying sensor,
	  imx258_mipi_mono may be recognized as imx258_mipi_raw.

config IMGSENSOR_MAIN
	string "Custom main image sensor"
	depends on SPECIFY_IMGSENSOR
	help
	  Specify name of main sensor to prevent obtaining wrong sensor driver
	  with same sensor ID. For example, imx258_mipi_raw and
	  imx258_mipi_mono are of same sensor ID. If not specifying sensor,
	  imx258_mipi_mono may be recognized as imx258_mipi_raw.

config IMGSENSOR_MAIN2
	string "Custom main2 image sensor"
	depends on SPECIFY_IMGSENSOR
	help
	  Specify name of main2 sensor to prevent obtaining wrong sensor driver
	  with same sensor ID. For example, imx258_mipi_raw and
	  imx258_mipi_mono are of same sensor ID. If not specifying sensor,
	  imx258_mipi_mono may be recognized as imx258_mipi_raw.

config IMGSENSOR_SUB
	string "Custom sub image sensor"
	depends on SPECIFY_IMGSENSOR
	help
	  Specify name of sub sensor to prevent obtaining wrong sensor driver
	  with same sensor ID. For example, imx258_mipi_raw and
	  imx258_mipi_mono are of same sensor ID. If not specifying sensor,
	  imx258_mipi_mono may be recognized as imx258_mipi_raw.

config IMGSENSOR_SUB2
	string "Custom sub2 image sensor"
	depends on SPECIFY_IMGSENSOR
	help
	  Specify name of sub2 sensor to prevent obtaining wrong sensor driver
	  with same sensor ID. For example, imx258_mipi_raw and
	  imx258_mipi_mono are of same sensor ID. If not specifying sensor,
	  imx258_mipi_mono may be recognized as imx258_mipi_raw.

config IMGSENSOR_MAIN3
	string "Custom main3 image sensor"
	depends on SPECIFY_IMGSENSOR
	help
	  Specify name of main3 sensor to prevent obtaining wrong sensor driver
	  with same sensor ID. For example, imx258_mipi_raw and
	  imx258_mipi_mono are of same sensor ID. If not specifying sensor,
	  imx258_mipi_mono may be recognized as imx258_mipi_raw.
```

## drivers/misc/mediatek/imgsensor/src/isp6s/camera_ldo/Kconfig
```kconfig
config HQ_CAMERA_LDO
	tristate "CONFIG_HQ_CAMERA_LDO"
	default n
	help
	  HQ CAMERA LDO driver
```

## drivers/misc/mediatek/iommu/Kconfig
```kconfig
config MTK_IOMMU_MISC
	tristate "misc iommu driver for enhanced feature"
	depends on MTK_IOMMU || MTK_IOMMU_ARM32
	help
	  Choose this option to enable mediatek misc iommu driver.
	  Misc iommu includes the enhanced features about iommu hardware.
	  For example, it can implement iommu secure driver for secure
	  feature or debug feature.

config MTK_IOMMU_MISC_DBG
	tristate "Enable Mediatek IOMMU debug feature"
	depends on MTK_IOMMU_MISC
	help
	  Choose this option to enable mediatek iommu debug driver.
	  According to the characteristic of hardware, we need to add
	  some debug information. For example translation fault, hardware
	  dump information and so on. In addition, for ion buffer, we can
	  use dma_buf information to monitor iova, but if user use
	  "dma_alloc_attrs" to allocate buffer, we can not monitor iova.
	  So we can use list to save all iova node and dump it.

config MTK_IOMMU_MISC_SECURE
	tristate "Enable Mediatek IOMMU secure feature"
	depends on MTK_IOMMU_MISC
	help
	  Choose this option to enable mediatek iommu secure driver. IOMMU
	  also can support transaction besides supporting normal transaction.
	  In iommu secure driver, we can implement IOMMU secure driver
	  initialization for MTEE and other requirements for secure mapping.
	  In addition, we also run iommu protected banks(bank1~bank3) probe
	  and link with mtk_iommu.

config MTK_IOMMU_MISC_TEST
	tristate "Enable Mediatek IOMMU test feature"
	depends on MTK_IOMMU_MISC
	help
	  Choose this option to enable mediatek iommu test driver.
	  The feature tests mtk iommu driver software flow whether it is
	  normal work. For example, reserve iova region test, create page
	  table test, allocation iova by iommu framework test, allocation
	  iova by dma-buf framework test and so on. We can need to ensure
	  MTK iommu driver is available before iommu's masters use it by
	  iommu test.

config MTK_IOMMU_DEBUG
	bool "Debugging log for Mediatek IOMMU"
	help
	  Select this to see the detailed log message that shows what
	  happens in the IOMMU driver.
	  If unsure, say N.
```

## drivers/misc/mediatek/ir_learning/Kconfig
```kconfig
config MTK_IR_LEARNING_SUPPORT
	bool "MediaTek consumer IR learning solution"
	default n
	---help---
	  IR-learning driver support for MediaTek solution
```

## drivers/misc/mediatek/irq/Kconfig
```kconfig
config MTK_IRQ
	bool "Enable MTK interrupt controller for 32-bit kernel"
	help
		It decides whether the system uses MTK interrupt controller
		for 32-bit kernel; which forwards IRQs to target CPU, and
		provides flexibility to set priority, mask, group, polarity,
		and triggering for IRQs
```

## drivers/misc/mediatek/irrx/Kconfig
```kconfig
config MTK_IRRX
	bool "support MTK irrx"
	depends on MEDIA_SUPPORT && LIRC
	help
		If the platform is supported for IRRX,
		this configuration should be configured,
		and the IRRX driver configuration should
		be configured as well.

config MTK_IRRX_PLAT
	string "MediaTek irrx register map rely on specific IC"
	depends on MTK_IRRX
	default "default"
	---help---
	  choose which irrx register map you want to use.
	  Every IC has its own irrx register map.
	  So should implement driver rely on specific IC and
	  get register map from ic designer.

source "drivers/misc/mediatek/irrx/nec/Kconfig"
source "drivers/misc/mediatek/irrx/rc5/Kconfig"
source "drivers/misc/mediatek/irrx/rc6/Kconfig"
source "drivers/misc/mediatek/irrx/sirc/Kconfig"
source "drivers/misc/mediatek/irrx/rcmm/Kconfig"
```

## drivers/misc/mediatek/irrx/nec/Kconfig
```kconfig
config MTK_IRRX_NEC
	bool "Support MTK IR NEC protocol"
	depends on MTK_IRRX
	help
		It support different IR protocol.
		This protocol is defined by NEC.
		If this option is set, it will support
		NEC IRRX protocol.
```

## drivers/misc/mediatek/irrx/rc5/Kconfig
```kconfig
config MTK_IRRX_RC5
	bool "Support MTK IR RC5 protocol"
	depends on MTK_IRRX
	help
		It support different IR protocol.
		This protocol is defined by Philips.
		If this option is set, it will support
		RC5 IRRX protocol.
```

## drivers/misc/mediatek/irrx/rc6/Kconfig
```kconfig
config MTK_IRRX_RC6
	bool "Support MTK IR RC6 protocol"
	depends on MTK_IRRX
	help
		It support different IR protocol.
		This protocol is defined by Philips.
		If this option is set, it will support
		RC6 IRRX protocol.
```

## drivers/misc/mediatek/irrx/rcmm/Kconfig
```kconfig
config MTK_IRRX_RCMM
	bool "Support MTK IR RCMM protocol"
	depends on MTK_IRRX
	help
		It support different IR protocol.
		This protocol is defined by Philips.
		If this option is set, it will support
		RCMM IRRX protocol.
```

## drivers/misc/mediatek/irrx/sirc/Kconfig
```kconfig
config MTK_IRRX_SIRC
	bool "Support MTK IR SIRC protocol"
	depends on MTK_IRRX
	help
		It support different IR protocol.
		This protocol is defined by Sony.
		If this option is set, it will support
		SIRC IRRX protocol.
```

## drivers/misc/mediatek/irtx/Kconfig
```kconfig
config MTK_IRTX_PWM_SUPPORT
	tristate "Mediatek PWM IR transmitter"
	depends on RC_CORE
	depends on ARCH_MEDIATEK
	depends on MTK_PWM
	help
	   Say Y if you want to use the PWM IR transmitter
	   on Mediatek SoCs.

	   To compile this driver as a module, choose M here: the
	   module will be called mtk-irtx-pwm.
```

## drivers/misc/mediatek/jpeg/Kconfig
```kconfig
config MTK_JPEG
	tristate "enable JPEG Dec driver extension"
	help
		Mediatek jpeg codec driver provides HW capability
		to decode jpeg image.
		To compile this driver as modules, choose M here:
		the modules will be called jpeg-driver.
```

## drivers/misc/mediatek/keyhint/Kconfig
```kconfig
comment "Key Hint"

config MTK_KEY_HINT
	bool "Key management tool for HIE"
	depends on HIE
	default y
	help
	  Enable Key Hint to manage keys for HIE
	  (Hardware Inline Encryption).

	  Keys in key-hint are managed by LRU and the key index
	  is directly mapped to crypto slots index in crypto IP
	  embbeded in storage host.
```

## drivers/misc/mediatek/l2c_share/Kconfig
```kconfig
config MTK_L2C_SHARE
        bool "Enable MTK L2 cache share ram feature"
        help
          Share CPU L2 cache as a general purpose internal SRAM.
```

## drivers/misc/mediatek/l3c_part/Kconfig
```kconfig
config MTK_L3C_PART
	tristate "MediaTek L3C partition driver"
	---help---
	  This enable the MediaTek(R) L3C partition driver.
	  Include the L3C partition init and provide the
	  partition setting API to adjust the partition of
	  APMCU port and ACP port.
```

## drivers/misc/mediatek/laser/Kconfig
```kconfig
config MTK_LASER
  bool CONFIG_MTK_LASER
  default n
  help
    CONFIG_MTK_LASER
```

## drivers/misc/mediatek/lastpc/Kconfig
```kconfig
config MTK_LASTPC
  bool CONFIG_MTK_LASTPC
  default n
  help
    CONFIG_MTK_LASTPC
```

## drivers/misc/mediatek/lcm/Kconfig
```kconfig
config MTK_LCM
	bool "Enable LCM driver"
	default n
	help
	  define LCM driver config to enable LCM driver.
	  To set LCM driver which you choose avoid cannot driver LCM.
	  Please make sure CONFIG_MTK_LCM in xxxxxx_defconfig.mk.
	  And also make sure true on in ProjectConfig.mk

config CUSTOM_KERNEL_LCM
	string "define mediatek kernel LCM driver"
	help
	  To choose kernel LCM driver name.
	  This config is to select which LCM driver you want to use.
	  Please make sure CUSTOME_KERNEL_LCM in xxxxx_defconfig.mk.
	  And also make sure turn on in ProjectConfig.mk

config MTK_LCM_DEVICE_TREE_SUPPORT
	bool "support LCM device tree connect with display drivers"
	help
	  Decide whether to support LCM device tree based configuration.
	  This feature requires the connection between display driver and LCM devices.
	  Please also turn on MTK_LCM_DEVICE_TREE_SUPPORT in ProjectConfig.mk.
	  If not define MTK_LCM_DEVICE_TREE_SUPPORT
	  there will not connect between display driver and LCM devices.
```
