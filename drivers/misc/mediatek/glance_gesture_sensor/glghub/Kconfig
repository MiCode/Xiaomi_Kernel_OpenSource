## drivers/misc/mediatek/hdmi/Kconfig
```kconfig
# HDMI
config CUSTOM_KERNEL_HDMI
	string "Select vendor driver"
	help
	  To select vendor driver.
	  e.g:"Sii8348","ANX7805","ANX7625","MT8193"

config MTK_HDMI_SUPPORT
	bool "Enable or disable HDMI feature"
	default n
	help
	  To control whether enable or disable HDMI feature. If choose yes,
	  phone's screen can be demonstrated on TV via HDMI cable.

config MTK_HDMI_3D_SUPPORT
	bool "Enable or disable HDMI 3D feature"
	default n
	help
	  To control whether enable or disable HDMI 3D feature. If choose yes,
	  phone's screen can show 3D content on TV via HDMI cable.

config MTK_MT8193_HDMI_SUPPORT
	bool "Enable or disable MT8193 HDMI feature"
	depends on MTK_HDMI_SUPPORT
	depends on MTK_MT8193_SUPPORT
	help
	  To control whether enable or disable MT8193 HDMI feature.
	  If choose yes,
	  screen can show on TV via MT8193.
	  else
	  do not support MT8193.

config MTK_INTERNAL_HDMI_SUPPORT
	bool "Enable the Internal HDMI Support"
	default n
	depends on MTK_HDMI_SUPPORT
	help
	  Enable the Internal HDMI Support
	  If choose yes,
	  screen can show on TV via internal HDMI.
	  else
	  do not support HDMI.

config MTK_HDMI_HDCP_SUPPORT
	bool "Enable hdmi tx hdcp support"
	depends on MTK_HDMI_SUPPORT
	help
	  Enable hdmi tx hdcp support
	  If choose yes,
	  screen can show on TV via HDMI and support hdcp.
	  else
	  do not support hdcp.
```

## drivers/misc/mediatek/heart_rate_sensor/Kconfig
```kconfig
config CUSTOM_KERNEL_HEART_RATE_SENSOR
	bool "CUSTOM_KERNEL_HEART_RATE_SENSOR"
	help
	  Kernel space heart rate sensor driver.
          A heart rate monitor is a personal monitoring device
          that allows one to measure one's heart rate in real
          time or record the heart rate for later study.

config CUSTOM_KERNEL_HEART
	bool "CUSTOM_KERNEL_HEART"
	help
	  Kernel space heart rate sensor driver.
          A heart rate monitor is a personal monitoring device
          that allows one to measure one's heart rate in real
          time or record the heart rate for later study.
```

## drivers/misc/mediatek/hifi4dsp_spi/Kconfig
```kconfig
#
# MediaTek SPI SLAVE DRIVER
#

config MTK_SPI_SLAVE_SUPPORT
    bool "Support Mediatek SPI Slave"
    default y
    help
      spi slave driver for display
```

## drivers/misc/mediatek/hifi_dsp/Kconfig
```kconfig
config MTK_HIFIXDSP_SUPPORT
	bool "Specify Platform Support HIFIxDSP"
	help
	  HIFIxDSP is a MediaTek in-house DSP which can do
	  different audio process from IPI interface.
	  Set Y to enable this feature.
	  If unsure,
	  Set N to stay with legacy feature.
```
