## drivers/misc/mediatek/gpio/Kconfig
```kconfig
#
#Kconfig for mediatek/gpio
#
config MTK_MT6306_GPIO_SUPPORT
	tristate "MediaTek MT6306 GPIO Controller support"
	default n
	---help---
	  This selects the MediaTek(R) MT6306 GPIO driver.
	  Some pinctrl functions need the utilities from this driver.
	  If you want to use MediaTek(R) GPIO driver, say Y or M here.
	  If unsure, say N.
```

## drivers/misc/mediatek/gpt/Kconfig
```kconfig
# common gpt driver
config MTK_GPT_COMMON
	bool "General Purpose Timer Support Common"
	---help---
	TK General_Purpose_Timer driver support common code between different Socs.
```

## drivers/misc/mediatek/gpu/Kconfig
```kconfig
config MTK_GPU_SUPPORT
	bool "Support MTK GPU"
	default n
	help
	  config supports MTK GPU driver.
	  CONFIG_MTK_GPU_SUPPORT defines
	  if the gpu driver should be built in or not

config MTK_GPU_VERSION
	string "Support MTK GPU Driver Version"
	default ""
	help
	  CONFIG_MTK_GPU_VERSION define which gpu ddk version will be used
	  It has three parts
	  1.vendor name 2.GPU architecture name 3. driver version

config MTK_GPU_COMMON_DVFS_SUPPORT
	bool "Support GPU VSync-Based DVFS Policy"
	default n
	help
	  config supports to enable GPU DVFS policy.
	  It is nice method to save power.
	  It is recommended to enable it when MTK_GPU_SUPPORT is enabled.

config MTK_GPU_OPP_STATS_SUPPORT
	bool "Support GPU opp stat"
	depends on MTK_GPU_COMMON_DVFS_SUPPORT
	default y
	help
	  This config supports to enable opp stat during DVFS.
	  This also provides to track DevFreq like in debugFS and add
	  idle stats at runtime. Provides API set that can query in
	  other kernel modules.

config MTK_GPU_R5P0
	bool "Force to use r5p0 driver"
	default n
	help
	  config defines to use r5p0 drivers
	  Choose this option to force r5p0 driver verison

config SW_SYNC64
	bool "Enable SW 64bit sync counter"
	depends on SW_SYNC
	help
	  A sync object driver that uses a 64bit counter to coordinate
	  syncrhronization.  Useful when there is no hardware primitive backing
	  the synchronization.

config MTK_GPU_SPM_DVFS_SUPPORT
	bool "Enable GPU SPM DVFS"
	default n
	help
	  Choose this option to enable a dedicated HW to do GPU DVFS.
	  The feature is still under experiment. Enable only if you know
	  what your are doing.
	  MTK_GPU_COMMON_DVFS_SUPPORT and MTK_GPU_SPM_DVFS_SUPPORT shouldn't
	  exist concurrently.

config MTK_GPU_SWPM_SUPPORT
	bool "Enable GPU SPM DVFS"
	default n
	help
	   config supports to make SWPM enable/disable GPU power model
```

## drivers/misc/mediatek/gpu/gpu_mali/mali_bifrost/mali-r25p0/drivers/gpu/arm/midgard/arbitration/Kconfig
```kconfig
# SPDX-License-Identifier: GPL-2.0
#
# (C) COPYRIGHT 2012-2020 ARM Limited. All rights reserved.
#
# This program is free software and is provided to you under the terms of the
# GNU General Public License version 2 as published by the Free Software
# Foundation, and any use by you of this program is subject to the terms
# of such GNU licence.
#
# A copy of the licence is included with the program, and can also be obtained
# from Free Software Foundation, Inc., 51 Franklin Street, Fifth Floor,
# Boston, MA  02110-1301, USA.
#
#

config MALI_ARBITRATION
	bool "Enable Virtualization reference code"
	depends on MALI_MIDGARD
	default n
	help
	  Enables the build of several reference modules used in the reference
	  virtualization setup for Mali
	  If unsure, say N.
```

## drivers/misc/mediatek/gpu/gpu_mali/mali_bifrost/mali-r25p0/drivers/gpu/arm/midgard/arbitration/mali_arbiter/Kconfig
```kconfig
# SPDX-License-Identifier: GPL-2.0 OR MIT
#
# (C) COPYRIGHT 2020 Arm Limited or its affiliates. All rights reserved.
#
#

config MALI_ARBITRATION
	tristate "Enable compilation of arbitration modules"
	default n
	default y if MALI_ARBITER_SUPPORT
	help
	  This option enables the compilation of arbitration modules needed to
	  to create a virtualized setup.
```

## drivers/misc/mediatek/gpu/gpu_mali/mali_midgard/mali-r12p1/drivers/base/ump/Kconfig
```kconfig
#
# (C) COPYRIGHT 2012 ARM Limited. All rights reserved.
#
# This program is free software and is provided to you under the terms of the
# GNU General Public License version 2 as published by the Free Software
# Foundation, and any use by you of this program is subject to the terms
# of such GNU licence.
#
# A copy of the licence is included with the program, and can also be obtained
# from Free Software Foundation, Inc., 51 Franklin Street, Fifth Floor,
# Boston, MA  02110-1301, USA.
#
#



config UMP
	tristate "Enable Unified Memory Provider (UMP) support"
	default n
    help
	  Enable this option to build support for the ARM UMP module.
	  UMP can be used by the Mali T6xx module to improve performance
	  by reducing the copying of data by sharing memory.

	  To compile this driver as a module, choose M here:
	  this will generate one module, called ump.
```

## drivers/misc/mediatek/gpu/gpu_mali/mali_midgard/mali-r7p0/drivers/gpu/drm/pl111/Kconfig
```kconfig
#
# (C) COPYRIGHT ARM Limited. All rights reserved.
#
# This program is free software and is provided to you under the terms of the
# GNU General Public License version 2 as published by the Free Software
# Foundation, and any use by you of this program is subject to the terms
# of such GNU licence.
#
# A copy of the licence is included with the program, and can also be obtained
# from Free Software Foundation, Inc., 51 Franklin Street, Fifth Floor,
# Boston, MA  02110-1301, USA.
#
#

config DRM_PL111
	tristate "DRM Support for PL111 CLCD Controller"
	depends on DRM
	select DRM_KMS_HELPER
	select VT_HW_CONSOLE_BINDING if FRAMEBUFFER_CONSOLE
	help
	  Choose this option for DRM support for the PL111 CLCD controller.
	  If M is selected the module will be called pl111_drm.
```

## drivers/misc/mediatek/gpu/gpu_mali/mali_midgard/mali-r7p0_v2/drivers/base/dma_buf_test_exporter/Kconfig
```kconfig
#
# (C) COPYRIGHT 2012 ARM Limited. All rights reserved.
#
# This program is free software and is provided to you under the terms of the
# GNU General Public License version 2 as published by the Free Software
# Foundation, and any use by you of this program is subject to the terms
# of such GNU licence.
#
# A copy of the licence is included with the program, and can also be obtained
# from Free Software Foundation, Inc., 51 Franklin Street, Fifth Floor,
# Boston, MA  02110-1301, USA.
#
#


config DMA_SHARED_BUFFER_TEST_EXPORTER
	tristate "Test exporter for the dma-buf framework"
	depends on DMA_SHARED_BUFFER
	help
	  This option enables the test exporter usable to help test importerts.
```

## drivers/misc/mediatek/gpu/gpu_mali/midgard-r26p0/Documentation/devicetree/bindings/arm/smc-protected-mode-switcher.txt
```
#
# (C) COPYRIGHT 2017 ARM Limited. All rights reserved.
#
# This program is free software and is provided to you under the terms of the
# GNU General Public License version 2 as published by the Free Software
# Foundation, and any use by you of this program is subject to the terms
# of such GNU licence.
#
# This program is distributed in the hope that it will be useful,
# but WITHOUT ANY WARRANTY; without even the implied warranty of
# MERCHANTABILITY or FITNESS FOR A PARTICULAR PURPOSE. See the
# GNU General Public License for more details.
#
# You should have received a copy of the GNU General Public License
# along with this program; if not, you can access it online at
# http://www.gnu.org/licenses/gpl-2.0.html.
#
# SPDX-License-Identifier: GPL-2.0
#
#

* ARM SMC protected mode switcher devices

Required properties :

- compatible : Must be "arm,smc-protected-mode-switcher"
- arm,smc,protected_enable : SMC call ID to enable protected mode
- arm,smc,protected_disable : SMC call ID to disable protected mode and reset
			      device

An example node :

	gpu_switcher {
		compatible = "arm,smc-protected-mode-switcher";
		arm,smc,protected_enable = <0xff06>;
		arm,smc,protected_disable = <0xff07>;
	};
```

## drivers/misc/mediatek/gravity/Kconfig
```kconfig
config CUSTOM_KERNEL_GRAVITY_SENSOR
	bool "CUSTOM_KERNEL_GRAVITY_SENSOR"
	help
	  Kernel space gravity sensor driver.

source "drivers/misc/mediatek/gravity/gravityhub/Kconfig"
```

## drivers/misc/mediatek/gud/311c/Kconfig
```kconfig
#
# Trustonic drivers configuration
#
config TRUSTONIC_TEE
	tristate "Trustonic TEE Driver"
	depends on ARM || ARM64
	default y
	---help---
	  Enable Trustonic TEE Support.
	  This option enables MobiCore Driver which is used to communicate with
	  TEE OS, for things like, setting up log buffers, interrupt pins,
	  and IPC channels.

config TRUSTONIC_TEE_LPAE
	bool "Trustonic TEE uses LPAE"
	depends on TRUSTONIC_TEE
	default y if ARM64
	default n if ARM
	---help---
	  Enable Trustonic TEE 64-bit physical addresses support
	  This allows 32-bit trusted driver has capabilities of map/unmap
	  64-bit physical addresses, which is useful in device equipped with
	  RAM size more than 4GB.

config TRUSTONIC_TEE_DEBUG
	bool "Trustonic TEE driver debug mode"
	depends on TRUSTONIC_TEE
	default n
	---help---
	  Enable the debug mode in the Trustonic TEE Driver.
	  Enable Debug mode in the MobiCore Driver.
	  MobiCore Driver has loglevel control thru DEBUG and VERBOSE
	  This option enables MCDRV_DBG() macros to print useful debugging
	  information about mobicore operations.

config TRUSTONIC_TRUSTED_UI
	tristate "Trustonic Trusted UI"
	depends on TRUSTONIC_TEE
	---help---
	  Enable <t-base Trusted User Interface
	  Trustonic TUI features was based on Trustonic TEE mechanism to protect
	  Touch/Display inside TEE, to prevent malicious access of sensitive data
	  used by APPs like Banking.
```

## drivers/misc/mediatek/gud/Kconfig
```kconfig
#
# TRUSTONIC TEE configuration
#
config TRUSTONIC_TEE_SUPPORT
	bool "Enable Trustonic TEE Support"
	select MTK_TEE_SANITY
	default n
	---help---
	  Enable Trustonic TEE Support.
	  This option enables MobiCore Driver which is used to communicate with
	  TEE OS, for things like, setting up log buffers, interrupt pins,
	  and IPC channels.

config TRUSTONIC_TEE_VERSION
	string "TRUSTONIC TEE Version"
	depends on TRUSTONIC_TEE_SUPPORT
	default "410"

config TRUSTONIC_TEE_DEBUG
	bool "Trustonic TEE driver debug mode"
	depends on (TRUSTONIC_TEE_SUPPORT) && (TRUSTONIC_TEE_VERSION="311c")
	default n
	---help---
	  Enable the debug mode in the Trustonic TEE Driver.
	  Unlike MOBICORE_DEBUG and MOBICORE_VERBOSE used in TBASE 302 series,
	  TBASE 311 series use one option to turn on necessary debug logs.
	  Enable this option for debugging and see more detailed driver flow.

#
# MobiCore configuration
#
config MOBICORE_DRIVER
	tristate "MobiCore Driver"
	depends on (TRUSTONIC_TEE_SUPPORT) && (TRUSTONIC_TEE_VERSION="302d")
	default y
	---help---
	  Enable Linux Kernel MobiCore Support
	  This option enables MobiCore Driver which is used to communicate with
	  TEE OS, for things like, setting up log buffers, interrupt pins,
	  and IPC channels.

config MOBICORE_DEBUG
	bool "MobiCore Module debug mode"
	depends on MOBICORE_DRIVER
	default n
	---help---
	  Enable Debug mode in the MobiCore Driver.
	  MobiCore Driver has loglevel control thru DEBUG and VERBOSE
	  This option enables MCDRV_DBG() macros to print useful debugging
	  information about mobicore operations.

config MOBICORE_VERBOSE
	bool "MobiCore Module verbose debug mode"
	depends on MOBICORE_DEBUG
	default n
	---help---
	  Enable Verbose Debug mode in the MobiCore Driver.
	  It enables MCDRV_DBG_VERBOSE() macros to print extra information
	  about mobicore operations. Beware: this is only useful for
	  debuging deep in the driver because it prints too much logs

config MOBICORE_API
	tristate "Linux MobiCore API"
	depends on MOBICORE_DRIVER
	default y
	---help---
	  Enable Linux Kernel MobiCore API
	  This option enables MobiCore Driver which is used to communicate with
	  TEE OS, for things like, setting up log buffers, interrupt pins,
	  and IPC channels.

config TRUSTONIC_TRUSTED_UI
	tristate "<t-base TUI"
	depends on TRUSTONIC_TEE_SUPPORT
	default n
	---help---
	  Enable <t-base Trusted User Interface
	  Trustonic TUI features was based on Trustonic TEE mechanism to protect
	  Touch/Display inside TEE, to prevent malicious access of sensitive data
	  used by APPs like Banking.
```

## drivers/misc/mediatek/gyroscope/ITG1010-new/Kconfig
```kconfig
config MTK_ITG1010_NEW
	tristate "ITG1010 for MediaTek package"
        default n
        help
        It support different gyroscope sensor.
        If this option is set,
	  	it will support
         ITG1010 gyroscope.
```

## drivers/misc/mediatek/gyroscope/Kconfig
```kconfig
config CUSTOM_KERNEL_GYROSCOPE
	bool "CUSTOM_KERNEL_GYROSCOPE"
	help
	  gyroscope sensor to detect gyroscope from x y z axis.
	  If the platform is supported for gyroscope, this
	  configuration should be configured, and the gyroscope
	  driver configuration should be configured as well.

config CUSTOM_KERNEL_GYROSCOPE_MODULE
	bool "Use to control the gyroscope sensor build type"
	help
	  Use to control the sensor build tpye.
	  If the config is set, it means sensor
	  will build ko module.
	  This is request fromo Google about odm driver.

source "drivers/misc/mediatek/gyroscope/ITG1010-new/Kconfig"
source "drivers/misc/mediatek/gyroscope/lsm6ds3gy/Kconfig"
source "drivers/misc/mediatek/gyroscope/mpu6050gy-new/Kconfig"
source "drivers/misc/mediatek/gyroscope/mpu6515/Kconfig"
source "drivers/misc/mediatek/gyroscope/gyrohub/Kconfig"
source "drivers/misc/mediatek/gyroscope/icm20645gy/Kconfig"
source "drivers/misc/mediatek/gyroscope/lsm6ds3hgy/Kconfig"
source "drivers/misc/mediatek/gyroscope/bmi160gy/Kconfig"
```

## drivers/misc/mediatek/gyroscope/bmi160gy/Kconfig
```kconfig
config MTK_BMI160GY_NEW
	bool "MTK_BMI160GY_NEW for MediaTek package"
	default n
	help
	  It support different gyroscope sensor.
	  If this option is set,
  	  it will support
	  BMI120 gyroscope.
```

## drivers/misc/mediatek/gyroscope/icm20645gy/Kconfig
```kconfig
config MTK_ICM20645GY
        bool "ITG1010 for MediaTek package"
        default n
        help
        It support different gyroscope sensor.
        If this option is set,
	  	it will support
         ITG1010 gyroscope.
```

## drivers/misc/mediatek/gyroscope/lsm6ds3gy/Kconfig
```kconfig
config MTK_LSM6DS3
	bool "ST LSM6DS3 Gyroscope driver for MediaTek package"
	default n
	help
	  To claim the support of gyroscope of LSM6DS3 A+G sensor.
	  If this option is set,
	  it will support gyroscope function of LSM6DS3.
	  If unsure,say N.
```

## drivers/misc/mediatek/gyroscope/mpu6050gy-new/Kconfig
```kconfig
config MTK_MPU6050GY_NEW
	bool "MPU6050GY for MediaTek package"
	default n
        help
        It support different gyroscope sensor.
        If this option is set,
	  	it will support
         MPU6050GY gyroscope.
```

## drivers/misc/mediatek/gyroscope/mpu6515/Kconfig
```kconfig
config MTK_MPU6515G
        bool "MPU6515G for MediaTek package"
        default n
	help
        It support different gyroscope sensor.
        If this option is set,
	  	it will support
         MPU6515 gyroscope.
```

## drivers/misc/mediatek/hbt/Kconfig
```kconfig
# SPDX-License-Identifier: GPL-2.0

config MTK_HBT
	tristate "32-bit syscall support for the MTK HBT"
	depends on 64BIT && COMPAT
	help
	  This is the driver for MediaTek HBT.
	  If you want HBT feature, say m here.
	  This is needed if support for HBT devices is required.
	  If unsure, say N.
```
