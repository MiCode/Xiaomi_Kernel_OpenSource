## drivers/misc/mediatek/accelerometer/icm20645g/Kconfig
```kconfig
config MTK_ICM20645G
	bool "MC3410 for MediaTek package"
	default n
	help
	  It support different accelerometer sensor.
          If this option is set,
	  it will support
          MC3410 Accelerometer.
```

## drivers/misc/mediatek/accelerometer/lsm6ds3/Kconfig
```kconfig
config MTK_LSM6DS3
	bool "ST LSM6DS3 accelerometer driver for MediaTek package"
	default n
	help
	  To claim the support of LSM6DS3 accelerometer driver.
	  If this option is set,
	  it will support LSM6DS3 Accelerometer.
	  If unsure,say N.
```

## drivers/misc/mediatek/accelerometer/mc3410-new/Kconfig
```kconfig
config MTK_MC3410_NEW
	tristate "MC3410 for MediaTek package"
	default n
	help
	  It support different accelerometer sensor.
          If this option is set,
	  it will support
          MC3410 Accelerometer.
```

## drivers/misc/mediatek/accelerometer/mma8653/Kconfig
```kconfig
config MTK_MMA8653
	bool "MTK_MMA8653 for MediaTek package"
	default n
	help
	  It support different accelerometer sensor.
          If this option is set,
	  it will support
          MTK_MMA8653 Accelerometer.

config MMA8653_LOWPASS
	bool "MMA8653_LOWPASS for Mediatek package"
	default n
	help
	Say Y here if you have MTK_MMA8653 gsensor MMA8653_LOWPASS.

	If unsure, say N.

	To compile this dirver as a module, choose M here: the
	module will be called.

config CUSTOM_KERNEL_SENSORHUB
	bool "MTK_MMA8653 for Mediatek package"
	default n
	help
	Say Y here if you have MTK_MMA8653 gsensor CUSTOM_KERNEL_SENSORHUB.

	If unsure, say N.

	To compile this dirver as a module, choose M here: the
	module will be called.
```

## drivers/misc/mediatek/accelerometer/mpu6050g-new/Kconfig
```kconfig
config MTK_MPU6050G_NEW
	bool "MPU6050G for MediaTek package"
	default n
	help
	  It support different accelerometer sensor.
          If this option is set,
	  it will support
          MPU6050G Accelerometer.
```

## drivers/misc/mediatek/accelerometer/mpu6515/Kconfig
```kconfig
config MTK_MPU6515A
        bool "MPU6515A for MediaTek package"
        default n
	help
	  It support different accelerometer sensor.
          If this option is set,
	  it will support
          MPU6515 Accelerometer.
```

## drivers/misc/mediatek/accelerometer/rt3000/Kconfig
```kconfig
config MTK_ACCEL_RT3000
	bool "Support RichTek RT3000 accelerometer for MediaTek package"
	help
	  It support different accelerometer sensor.
          If this option is set,
	  it will support
          RT3000 Accelerometer.
```

## drivers/misc/mediatek/adsp/Kconfig
```kconfig
config MTK_AUDIODSP_SUPPORT
	tristate "MTK Audio DSP Support"
	help
	  AUDIO_DSP is a MediaTek in-house DSP which can do
	  different audio process.
	  Set Y to enable this feature.
	  If unsure, Set N to stay with legancy feature.

config MTK_ADSP_V1
	tristate "MTK Audio DSP Generation 1"
	depends on MTK_AUDIODSP_SUPPORT
	help
	  This kernel config can be used to enable Audio DSP
	  Generation 1 driver for specific plaforms.
	  it need to enable MTK_AUDIODSP_SUPPORT for basic functions.
	  Set Y to enable this feature.
	  If unsure, say N.

config MTK_ADSP_V2
	tristate "MTK ADSP DSP Generation 2"
	depends on MTK_AUDIODSP_SUPPORT
	help
	  This kernel config can be used to enable Audio DSP
	  Generation 2 driver for specific plaforms.
	  it need to enable MTK_AUDIODSP_SUPPORT for basic functions.
	  Set Y to enable this feature.
	  If unsure, say N.

config MTK_AUDIODSP_DEBUG_SUPPORT
	bool "MTK Audio DSP Debug support"
	help
	  This is a debug interface for Audio DSP
	  Set Y to enable this feature.
	  Set N to disable this feature.
	  If unsure, Set N to disable it.
```

## drivers/misc/mediatek/aee/Kconfig
```kconfig
config MTK_AEE_FEATURE
	tristate "Enable Android Exception Enhancement"
	select FIQ_GLUE if !TRUSTONIC_TEE_SUPPORT && !ARM_PSCI && !TRUSTY
	select TRACER_SNAPSHOT
	select FTRACE
	help
	  AEE (Android Exception Engine) that designed by  Mediatek is an
	  exception catching and debugging information generation mechanism.
	  It can collect and dump information to filesystem
	  (/sdcard/mtklog/aee_exp)  when exceptions occur(E.g. kernel
	  panic/android system server crash and ..)

config MTK_AEE_AED
	tristate "Enable AEE Kernel Exception Report Daemon"
	depends on MTK_AEE_FEATURE
	help
	  MTK_AEE_AED is the kernel config of aed, which is the base support for
	  aee features. Such as:
	  aed debug: some test case for aee driver itself
	  aed main: aed main function and ioctl for user space aee
	  monitor hang: detect hang feature...

config MTK_AEE_IPANIC
	tristate "Enable AEE Kernel Panic Dump"
	depends on MTK_AEE_FEATURE
	help
	  MTK_AEE_IPANIC is the kernel config of ipanic feature designed by
	  MTK, which is the enhancement of kernel defaut panic flow, and
	  combined with aee. It will do some hook function and get some
	  kernel panic information for debug.

config MTK_AEE_UT
	tristate "control AED debug file"
	help
	  MTK_AEE_UT is the kernel config of aed-debug.c
	  aed-debug.c is AEE UT test case file, just for generate some vendor
	  exception to test AEE dump flow, include in KE, HWT, HW_reboot, EE,
	  and kernelAPI exception

config MTK_AEE_HANGDET
	tristate "Enable AEE Kernel Hang Detector"
	depends on MTK_AEE_FEATURE
	help
	  MTK_AEE_HANGDET is the kernel config of hang detector feature
	  designed by MTK, which is the mechanism to check if each cpu
	  is alived. When cpu hang is detected, raise excetpion.
```

## drivers/misc/mediatek/almk/Kconfig
```kconfig
config MTK_ALMK
	bool CONFIG_MTK_ALMK
	default y
	  help
	  CONFIG_MTK_ALMK define if the almk driver should be built in or not
```

## drivers/misc/mediatek/alsps/APDS9930-new/Kconfig
```kconfig
config MTK_APDS9930_NEW
	bool "APDS9930_NEW for MediaTek package"
	default n
	help
	It support different type sensor
	in this platform. If this option
	is set, it will support ambient
	and light sensor APDS9930.
```

## drivers/misc/mediatek/alsps/EPL2182-new/Kconfig
```kconfig
config MTK_EPL2182_NEW
	bool "MTK_EPL2182_NEW for MediaTek package"
	default n
	help
	It support different type sensor
	in this platform. If this option
	is set, it will support ambient
	and light sensor MTK_EPL2182_NEW.
```

## drivers/misc/mediatek/alsps/Kconfig
```kconfig
config CUSTOM_KERNEL_ALSPS
	bool "CUSTOM_KERNEL_ALSPS"
	help
	  ALSPS sensor driver to detect ambient light and the object is close
	  or far awary from device. After configure this configuration,
          the specific ambient light and proximity sensor driver configuration
          should be configured as well.

config MTK_AUTO_DETECT_ALSPS
	bool "MTK_AUTO_DETECT_ALSPS"
	help
	  This feature Option is used for projects which using more than one
	  ALSPS sensors, more than one ALSPS drivers can be builded in to
	  project and be auto detected by setting this option to yes,
          usually only one ALSPS driver can be probed.

config CUSTOM_KERNEL_ALSPS_MODULE
	bool "Use to control the alsps sensor build type"
	help
	  Use to control the sensor build tpye.
	  If the config is set, it means sensor
	  will build ko module.
	  This is request fromo Google about odm driver.

source "drivers/misc/mediatek/alsps/cm36652-new/Kconfig"
source "drivers/misc/mediatek/alsps/cm36686-new/Kconfig"
source "drivers/misc/mediatek/alsps/cm36558/Kconfig"
source "drivers/misc/mediatek/alsps/APDS9930-new/Kconfig"
source "drivers/misc/mediatek/alsps/EPL2182-new/Kconfig"
source "drivers/misc/mediatek/alsps/stk3x1x-new/Kconfig"
source "drivers/misc/mediatek/alsps/alspshub/Kconfig"
source "drivers/misc/mediatek/alsps/cm3232-new/Kconfig"
```

## drivers/misc/mediatek/alsps/cm36558/Kconfig
```kconfig
config MTK_CM36558
	bool "cm36558 for MediaTek package"
	default n
	help
	It support different type sensor
	in this platform. If this option
	is set, it will support ambient
	and light sensor CM36558.
```

## drivers/misc/mediatek/alsps/cm36652-new/Kconfig
```kconfig
config MTK_CM36652_NEW
	tristate "cm36652 for MediaTek package"
	default n
	help
	It support different type sensor
	in this platform. If this option
	is set, it will support ambient
	and light sensor CM36652.
```

## drivers/misc/mediatek/answer_call_sensor/Kconfig
```kconfig
config CUSTOM_KERNEL_ANSWER_CALL_SENSOR
	bool "CUSTOM_KERNEL_ANSWER_CALL_SENSOR"
	help
	  Kernel space answer call sensor driver.

source "drivers/misc/mediatek/answer_call_sensor/answercall/Kconfig"
```

## drivers/misc/mediatek/apusys/Kconfig
```kconfig
config MTK_APUSYS_SUPPORT
	tristate "APUSYS driver"
	help
	  Enable Mediatek APUSYS feature for centralize control.
	  Middleware and APU scheduler will control memory,
	  QoS, and normal/deadline command queue in central layer.
	  Support multiple, multicore APU command scheduling and
	  execution in low level driver.

config MTK_APUSYS_DEBUG
	bool "APUSYS debug"
	depends on MTK_APUSYS_SUPPORT
	help
	  Enable debug facilities of APUSYS, including
	  trace points and trace tags. Recommended for
	  analysis resource issues, such as starvation.
	  Disable, if you don't need them.

config MTK_APUSYS_RT_SUPPORT
	bool "APUSYS Preemption"
	help
	  For Mediatek APUSYS preemption features.
	  This config will enable MDLA/VPU preemption feature.
	  It will increase performance for high priority task.
	  MDLA/VPU should be enable/disable at the same time.

config MTK_APUSYS_MDLA_SUPPORT
	bool "MDLA driver"
	help
	  Support deep neural network calculation using
	  hardware accelerator. Customers and third party
	  could use MDLA to develop feature and algorithm
	  by themselves.

config MTK_APUSYS_VPU
	bool "VPU driver"
	help
	  Support image processing using VPU hardware.
	  Customers and third party could use VPU to develop
	  feature and algorithm by themselves. There is better
	  performance and power if image process algorithm
	  land on VPU instead of CPU/GPU.

config MTK_VPU_SUPPORT
	bool "VPU Driver (Legacy)"
	select MTK_APUSYS_VPU
	help
	  Alias of MTK_APUSYS_VPU, used to support
	  platforms that were using vpu v2.0, v3.0 driver configs.
	  The VPU driver of APUSYS is backward compatible
	  to v2.0, v3.0 drivers.

config MTK_APUSYS_VPU_DEBUG
	bool "VPU Debug"
	depends on MTK_APUSYS_VPU
	help
	  Enable debug facilities of VPU, such as
	  kernel logs, register dumps, device logs,
	  VPU jtag functions, and MET trace.
	  Disable, if you don't need them.

config MTK_VPU_SUPPORT_DEBUG
	bool "VPU Debug (Legacy)"
	depends on MTK_VPU_SUPPORT
	select MTK_APUSYS_VPU_DEBUG
	help
	  Alias of MTK_APUSYS_VPU_DEBUG, used to support
	  platforms that were using vpu v2.0, v3.0 driver configs.
	  The VPU driver of APUSYS is backward compatible
	  to v2.0, v3.0 drivers.

config MTK_APUSYS_EDMA_SUPPORT
	bool "EDMA (External DMA) Driver"
	help
	  The purpose of Mediatek eDMA is performing
	  data transfer between external memory such as
	  DRAM/TCM, It will cooperate with MDLA. eDMA
	  support different modes for image process.

source "drivers/misc/mediatek/apusys/power/Kconfig"
```

## drivers/misc/mediatek/apusys/power/Kconfig
```kconfig
config MTK_APUSYS_SUPPORT
	tristate "APUSYS Power Driver"
	help
	  Enable Mediatek APU_TOP mtcmos control.
	  Support APU_TOP generic power domain multi-user use.
	  APU RPC HW for power on/off flow control and
	  execution in low level driver.
```

## drivers/misc/mediatek/atf/Kconfig
```kconfig
config MTK_ATF_LOGGER
	tristate "atf logger kernel driver"
	depends on HAVE_ARM_SMCCC && ARCH_MEDIATEK && OF
	help
	  ARM Trusted Firmwear Logger which is designed by Mediatek.
	  The logger provide a /proc interface for reading from
	  user space. We can obtain live TF-A log through
	  atf logger driver
```

## drivers/misc/mediatek/audio_ipi/Kconfig
```kconfig
config MTK_AUDIO_IPI
	tristate "Enable MTK audio ipi support"
	depends on MTK_AUDIODSP_SUPPORT || CONFIG_MTK_SCP_AUDIO
	default m
	help
	  This option enables MTK audio ipi modules to communicate
	  with subsystem.
	  This option depends on MediaTek in-house audio DSP support
	  or audio feature support on MediaTek in-house DSP.
```

## drivers/misc/mediatek/audio_scp/Kconfig
```kconfig
config MTK_AUDIO_SCP_RECOVERY_SUPPORT
	bool "Enable MTK AUDIO SCP RECOVERY Support"
	depends on MTK_TINYSYS_SCP_SUPPORT && SND_SOC_MTK_SCP_SMARTPA
	help
	  This enable MTK audio SCP recovery support.
	  SCP recovery mechanism will help SCP SmartPA recovery when
	  scp reset happens. The recovery mechanism will inform audio
	  userspace to close audio and restart again.
```

## drivers/misc/mediatek/auxadc/Kconfig
```kconfig
config MTK_AUXADC
    tristate "MediaTek AUXADC driver"
    default y
    help
      AUXADC driver support for MediaTek SOC
      If you want to use MediaTek AUXADC driver, say Y or M here.If unsure, say N.

config AUXADC_NEED_POWER_ON
    tristate "Support MediaTek IC that need to enable power for AUXADC"
    depends on MTK_AUXADC
    help
      AUXADC driver support for MediaTek IC which need to enbale power.
      If you want to use MediaTek AUXADC driver to enable power for these IC, say Y or M here.If unsure, say N.

config AUXADC_NOT_CONTROL_APMIXED_BASE
    tristate "Support MediaTek ICs that don't need to control APMIXED_BASE"
    depends on MTK_AUXADC
    help
      AUXADC driver support for MediaTek IC which don't need to control APMIXED_BASE.
      If you don't want to use MediaTek AUXADC driver to control APMIXED_BASE for these IC, say Y or M here.If unsure, say N.
```
