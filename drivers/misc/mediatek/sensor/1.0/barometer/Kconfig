## drivers/misc/mediatek/sensor/1.0/barometer/Kconfig
```kconfig
config CUSTOM_KERNEL_BAROMETER
	bool "CUSTOM KERNEL BAROMETER Config"
	help
	  To detect barometer raw data

source "drivers/misc/mediatek/sensor/1.0/barometer/barohub/Kconfig"
source "drivers/misc/mediatek/sensor/1.0/barometer/BMP280-new/Kconfig"
```

## drivers/misc/mediatek/sensor/1.0/biometric/mt6381/Kconfig
```kconfig
config MTK_MT6381
	bool "MT6381 for MediaTek package"
	default n
	help
	  MT6381 is a 2-in-1 bio-sensing analog
	  front-end(AFE) module to facilitate
	  bio-signal acquisition. The AFE consists
	  of low noise voltage and current sensing
	  channels, and is capable of sensing EKG
	  (Electrocardiography) and PPG
	  (Photoplethysmography) simultaneously.
```

## drivers/misc/mediatek/sensor/1.0/magnetometer/akm09911/Kconfig
```kconfig
config MTK_AKM09911
	tristate "AKM09911 for MediaTek package"
	default n
	help
	  It support different magnetometer sensor.
	  If this option is set, it will support
	  AKMD09911 magnetometer which is a 3-axis electronic
	  compass IC with high sensitive Hall sensor technology.
```

## drivers/misc/mediatek/sensor/1.0/sensorfusion/gravityhub/Kconfig
```kconfig
config MTK_GRAVITYHUB
	bool "gravityhub for MediaTek package"
	default n
	help
	  MTK sensor hub driver for Gravity sensor.
	  If this option is set,
	  it will support
	  gravityhub driver.
```

## drivers/misc/mediatek/sensor/1.0/sensorfusion/uncali_acchub/Kconfig
```kconfig
config MTK_UNCALI_ACCHUB
	bool "uncali_acchub for MediaTek package"
	default n
	help
	  MTK sensor hub driver for Accelerameter sensor.
	  If this option is set,
	  it will support
	  uncali_acchub driver.
```

## drivers/misc/mediatek/sensor/1.0/sensorfusion/uncali_maghub/Kconfig
```kconfig
config MTK_UNCALI_MAGHUB
	bool "uncali_maghub for MediaTek package"
	default n
	help
	  MTK sensor hub driver for Magnetic field uncalibrated sensor.
	  If this option is set,
	  it will support
	  uncali_maghub driver.
```

## drivers/misc/mediatek/sensor/1.0/situation/tilt_detector/Kconfig
```kconfig
config MTK_TILTDETECTHUB
	bool "tiltdetecthub for MediaTek package"
	default n
	help
	  A tilt detect is a device,
	  usually portable and electronic
	  or electromechanical,
	  that detect device is picked up with 35 degree.
```

## drivers/misc/mediatek/sensor/2.0/Kconfig
```kconfig
source "drivers/misc/mediatek/sensor/2.0/lsm6dsm_secondary/Kconfig"
source "drivers/misc/mediatek/sensor/2.0/test/Kconfig"

config J22_SAR
	tristate "j22_sar"
	default N
	help
	  Enable support for the j22 sar.
	  This driver supports the j22 sar.

	  If in doubt, say N here.
```

## drivers/misc/mediatek/sensor/2.0/bmp380/Kconfig
```kconfig
config MTK_BMP380_SUPPORT
	bool " MTK_BMP380_SUPPORT for MediaTek package"
	default n
	help
	  Enable MTK BMP380 support.
	  BMP380 is a low-power and low-noise
	  barometric pressure sensor.
	  If in doubt, say N here.
```

## drivers/misc/mediatek/sensor/2.0/lsm6dsm_secondary/Kconfig
```kconfig
config MTK_HF_LSM6DSM_SECONDARY
	bool "lsm6dsm for MediaTek package"
	help
	  It support lsm6dsm secondary gyroscope sensor.
	  If this option is set,
	  it will support
	  lsm6dsm secondary gyroscope sensor.
```

## drivers/misc/mediatek/sensor/2.0/mtk_nanohub/Kconfig
```kconfig
config CUSTOM_KERNEL_ALS_MULTI_CALI_SUPPORT
	bool "multi_cali for MediaTek package"
	help
	  It support multi_cali.
	  If this option is set,
	  it will support
	  multi_cali.

config CUSTOM_KERNEL_SCP_BUMP_UP
	bool "set scp in a higher mips for ARES"
	help
	  It support ares set scp to a higher mips.

config CUSTOM_KERNEL_CCT
	bool "cct_cali for MediaTek package"
	help
	  It support cct_cali.
	  If this option is set,
	  it will support
	  cct_cali.
```

## drivers/misc/mediatek/sensor/2.0/mtk_nanohub/nanohub/Kconfig
```kconfig
# SPDX-License-Identifier: GPL-2.0

config NANOHUB
	bool "Nanohub"
	help
	  Enable support for the nanohub sensorhub driver.
	  This driver supports the android nanohub sensorhub.
	  MTK sensor v1.0&v2.0 need this.
	  If in doubt, say N here.

if NANOHUB

config NANOHUB_MTK_IPI
	bool "Nanohub MTK IPI"
	help
	  Enable nanohub MTK IPI support.
	  Either this or NANOHUB_SPI/NANOHUB_I2C should be selected.
	  MTK platform only protocol.
	  If in doubt, say N here.

endif # NANOHUB
```

## drivers/misc/mediatek/sensor/2.0/sensorhub/Kconfig
```kconfig
config MTK_SENSORHUB
	tristate "sensorhub architecture for MediaTek package"
	help
	  It support mediatek sensorhub architecture.
	  If this option is set,
	  it will support
	  mediatek sensorhub architecture.
```

## drivers/misc/mediatek/sensor/2.0/test/Kconfig
```kconfig
config MTK_HF_TEST_CASE
	bool "high frequency manager test demo for MediaTek package"
	help
	  It support high frequency manager test demo.
	  If this option is set,
	  it will support
	  high frequency manager test demo.
```

## drivers/misc/mediatek/sensor/Kconfig
```kconfig
# SPDX-License-Identifier: GPL-2.0

config MTK_SENSOR_SUPPORT
	tristate "MTK SENSOR SUPPORT"
	help
	  Sensor config for sensor feature in project.
	  Please say Y here if you want to support and sensors
	  with mediatek sensor architecture.
	  If unsure, say N.

#source "drivers/misc/mediatek/sensor/1.0/Kconfig"
source "drivers/misc/mediatek/sensor/2.0/Kconfig"
```

## drivers/misc/mediatek/sensorHub/Kconfig
```kconfig
config CUSTOM_KERNEL_SENSORHUB
	bool "CUSTOM_KERNEL_SENSORHUB"
	help
	  Kernel space sensor hub driver. Define project used all sensor hub
	  sensors. The value is combination of sensor hub driver(get data...etc)
	  and sensor hub framework driver(transmit shf info)

source "drivers/misc/mediatek/sensorHub/SCP_sensorHub/Kconfig"
source "drivers/misc/mediatek/sensorHub/SCP_sensorHub_v1/Kconfig"
source "drivers/misc/mediatek/sensorHub/SCP_shf/Kconfig"
```

## drivers/misc/mediatek/sensor_bio/Kconfig
```kconfig
source "drivers/misc/mediatek/sensor_bio/accelerometer/Kconfig"
source "drivers/misc/mediatek/sensor_bio/alsps/Kconfig"
source "drivers/misc/mediatek/sensor_bio/gyroscope/Kconfig"
source "drivers/misc/mediatek/sensor_bio/magnetometer/Kconfig"
source "drivers/misc/mediatek/sensor_bio/hwmon/Kconfig"
source "drivers/misc/mediatek/sensor_bio/barometer/Kconfig"
source "drivers/misc/mediatek/sensor_bio/humidity/Kconfig"
source "drivers/misc/mediatek/sensor_bio/activity_sensor/Kconfig"
source "drivers/misc/mediatek/sensor_bio/pedometer/Kconfig"
source "drivers/misc/mediatek/sensor_bio/sensorfusion/Kconfig"
source "drivers/misc/mediatek/sensor_bio/step_counter/Kconfig"
source "drivers/misc/mediatek/sensor_bio/tilt_detector_sensor/Kconfig"
source "drivers/misc/mediatek/sensor_bio/gesture/Kconfig"
source "drivers/misc/mediatek/sensor_bio/sensorHub/Kconfig"
```

## drivers/misc/mediatek/sensor_bio/accelerometer/Kconfig
```kconfig
config MTK_AUTO_DETECT_ACCELEROMETER
	bool "MTK_AUTO_DETECT_ACCELEROMETER"
	depends on MTK_SENSOR_SUPPORT
	help
	  one load to support different accelerometer sensor.
          If this option is set, multiple accelerometer driver
          can be configured at the same time, but only one
          can be probed.

config CUSTOM_KERNEL_ACCELEROMETER
	bool "CUSTOM_KERNEL_ACCELEROMETER"
	help
	  accelerometer sensor to detect accelerometer from x y z axis.
          If the platform is supported for acceleometer, this
          configuration should be configured, and the acceleometer
          driver configuration should be configured as well.

source "drivers/misc/mediatek/sensor_bio/accelerometer/accelhub/Kconfig"
```

## drivers/misc/mediatek/sensor_bio/activity_sensor/Kconfig
```kconfig
config CUSTOM_KERNEL_ACTIVITY_SENSOR
	bool "CUSTOM_KERNEL_ACTIVITY_SENSOR"
	help
	  Kernel space activity sensor driver.

source "drivers/misc/mediatek/sensor_bio/activity_sensor/activityhub/Kconfig"
```

## drivers/misc/mediatek/sensor_bio/alsps/Kconfig
```kconfig
config CUSTOM_KERNEL_ALSPS
	bool "CUSTOM_KERNEL_ALSPS"
	help
	  ALSPS sensor driver to detect ambient light and the object is close
	  or far awary from device. After configure this configuration,
          the specific ambient light and proximity sensor driver configuration
          should be configured as well.

config MTK_AUTO_DETECT_ALSPS
	bool "MTK_AUTO_DETECT_ALSPS"
	help
	  This feature Option is used for projects which using more than one
	  ALSPS sensors, more than one ALSPS drivers can be builded in to
	  project and be auto detected by setting this option to yes,
          usually only one ALSPS driver can be probed.

source "drivers/misc/mediatek/sensor_bio/alsps/alspshub/Kconfig"
```

## drivers/misc/mediatek/sensor_bio/barometer/Kconfig
```kconfig
config CUSTOM_KERNEL_BAROMETER
	bool "CUSTOM_KERNEL_BAROMETER"
	help
	  To detect barometer raw data

source "drivers/misc/mediatek/sensor_bio/barometer/barohub/Kconfig"
```

## drivers/misc/mediatek/sensor_bio/gesture/Kconfig
```kconfig
config CUSTOM_KERNEL_GESTURE_SENSOR
	bool "mediatek gesture sensor tag"
	help
	  Kernel space support gesture sensor driver.
	  If the platform is supported for gesture, this
	  configuration should be configured, and the gesture
	  driver configuration should be configured as well.

config CUSTOM_KERNEL_GLANCE_GESTURE_SENSOR
	bool "mediatek glance gesture sensor type"
	help
	  Kernel space glance gesture sensor driver.
	  If the platform is supported for glance gesture, this
	  configuration should be configured, and the glance gesture
	  driver configuration should be configured as well.

config CUSTOM_KERNEL_PICK_UP_SENSOR
	bool "mediatek pickup gesture sensor type"
	help
	  Kernel space pick up sensor driver.
	  If the platform is supported for pickup gesture, this
	  configuration should be configured, and the pickup gesture
	  driver configuration should be configured as well.

config CUSTOM_KERNEL_ANSWER_CALL_SENSOR
	bool "mediatek answer call sensor type"
	help
	  Kernel space answer call sensor driver.
	  If the platform is supported for answer call, this
	  configuration should be configured, and the answer call
	  driver configuration should be configured as well.

config CUSTOM_KERNEL_WAKE_GESTURE_SENSOR
	bool "mediatek wake gesture sensor type"
	help
	  Kernel space wake up gesture sensor driver.
	  If the platform is supported for wake gesture, this
	  configuration should be configured, and the wake gesture
	  driver configuration should be configured as well.

source "drivers/misc/mediatek/sensor_bio/gesture/stationary/Kconfig"
source "drivers/misc/mediatek/sensor_bio/gesture/inpocket/Kconfig"
source "drivers/misc/mediatek/sensor_bio/gesture/wake_gesture/Kconfig"
source "drivers/misc/mediatek/sensor_bio/gesture/glance_gesture/Kconfig"
source "drivers/misc/mediatek/sensor_bio/gesture/pickup_gesture/Kconfig"
source "drivers/misc/mediatek/sensor_bio/gesture/answercall/Kconfig"
```
