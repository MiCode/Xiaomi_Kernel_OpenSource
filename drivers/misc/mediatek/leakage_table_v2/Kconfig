## drivers/misc/mediatek/lpm/Kconfig
```kconfig
config MTK_LOW_POWER_MODULE
	tristate "Meditaek Low Power Module"
	help
	  For MediaTek Low Power Module, such as CPU idle,
	  CPU suspend low power enhencement.
	  Select "y" if you want to enable low power features.
	  Select "n" if unsure.

config MTK_LPM_DBG_COMMON
	bool "Meditaek Low Power common debug Module"
	help
	  Select MTK_LPM_DBG_COMMON then Mediatek low module
	  common debug feature will be enabled. The common debug
	  feature will support basic debug control and show the
	  information to console.


config MTK_LPM_GS_DUMP_SUPPORT
	bool "Meditaek Low Power golden setting checker"
	help
	  Select MTK_LPM_GS_DUMP_SUPPORT then Mediatek low module
	  golden setting dump mechanism enable.
	  Select "y" if you want to enable gs dump features.
	  Select "n" if unsure.

config MTK_LPM_GS_DUMP_VERSION
	string "Meditaek Low Power golden setting checker version"
	default "v1"
	help
	  Set MTK_LPM_GS_DUMP_VERSION for Mediatek low module
	  golden setting dump mechanism version.

config MTK_LPM_MODULE_NAME
	string "Set mtk-lpm module output name"
	default "generic" if MTK_PLATFORM = ""
	default MTK_PLATFORM if MTK_PLATFORM != ""
	help
	  Customize the debug module output name.
	  Set the specific name for kernel module.
	  The platform name will be set as default
	  name if the MTK_LPM_MODULE_NAME didn't
	  set before.

config MTK_LPM_MT6779
	tristate "Specify Mediatek LPM Platform is MT6779"
	depends on MTK_LOW_POWER_MODULE
	help
	  Select MediaTek Low Power Module Platform is MT6779
	  for power management.
	  Set Y to select this feature for specific platform-mt6779.
	  If unsure, set N to disable.

config MTK_LPM_MT6853
	tristate "Specify Mediatek LPM Platform is MT6853"
	depends on MTK_LOW_POWER_MODULE
	select MTK_LPM_DBG_COMMON
	help
	  Select MediaTek Low Power Module Platform is MT6853
	  for power management.
	  Set Y to select this feature for specific platform-mt6853.
	  If unsure, set N to disable.

config MTK_LPM_MT6855
	tristate "Specify Mediatek LPM Platform is MT6855"
	depends on MTK_LOW_POWER_MODULE
	select MTK_LPM_DBG_COMMON
	help
	  Select MediaTek Low Power Module Platform is MT6855
	  for power management.
	  Set Y to select this feature for specific platform-mt6855.
	  If unsure, set N to disable.

config MTK_LPM_MT6873
	tristate "Specify Mediatek LPM Platform is MT6873"
	depends on MTK_LOW_POWER_MODULE
	select MTK_LPM_DBG_COMMON
	help
	  Select MediaTek Low Power Module Platform is MT6873
	  for power management.
	  Set Y to select this feature for specific platform-mt6873.
	  If unsure, set N to disable.

config MTK_LPM_MT6879
	tristate "Specify Mediatek LPM Platform is MT6879"
	depends on MTK_LOW_POWER_MODULE
	select MTK_LPM_DBG_COMMON
	help
	  Select MediaTek Low Power Module Platform is MT6879
	  for power management.
	  Set Y to select this feature for specific platform-mt6879.
	  If unsure, set N to disable.

config MTK_LPM_MT6885
	tristate "Specify Mediatek LPM Platform is MT6885"
	depends on MTK_LOW_POWER_MODULE
	select MTK_LPM_DBG_COMMON
	help
	  Select MediaTek Low Power Module Platform is MT6885
	  for power management.
	  Set Y to select this feature for specific platform-mt6885.
	  If unsure, set N to disable.

config MTK_LPM_MT6893
	tristate "Specify Mediatek LPM Platform is MT6893"
	depends on MTK_LOW_POWER_MODULE
	select MTK_LPM_DBG_COMMON
	help
	  Select MediaTek Low Power Module Platform is MT6893
	  for power management.
	  Set Y to select this feature for specific platform-mt6893.
	  If unsure, set N to disable.

config MTK_LPM_MT6895
	tristate "Specify Mediatek LPM Platform is MT6895"
	depends on MTK_LOW_POWER_MODULE
	select MTK_LPM_DBG_COMMON
	help
	  Select MediaTek Low Power Module Platform is MT6895
	  for power management.
	  Set Y to select this feature for specific platform-mt6895.
	  If unsure, set N to disable.

config MTK_LPM_MT6983
	tristate "Specify Mediatek LPM Platform is MT6983"
	depends on MTK_LOW_POWER_MODULE
	select MTK_LPM_DBG_COMMON
	help
	  Select MediaTek Low Power Module Platform is MT6983
	  for power management.
	  Set Y to select this feature for specific platform-mt6983.
	  If unsure, set N to disable.

config MTK_LPM_MT6789
	tristate "Specify Mediatek LPM Platform is MT6789"
	depends on MTK_LOW_POWER_MODULE
	select MTK_LPM_DBG_COMMON
	help
	  Select MediaTek Low Power Module Platform is MT6789
	  for power management.
	  Set Y to select this feature for specific platform-mt6789.
	  If unsure, set N to disable.
```

## drivers/misc/mediatek/m4u/Kconfig
```kconfig
config MTK_M4U
	bool "MediaTek M4U driver"
	depends on MTK_ION
	help
	  M4U driver support for multimedia hardware use non-physical continuous memory.
```

## drivers/misc/mediatek/mach/Kconfig
```kconfig
menu "MTK Board Support Package"

choice
	bool "MTK Board"

config MTK_EVB_BOARD
	bool "MTK EVB BOARD"
	depends on (ARCH_MT6595 || ARCH_MT6795 || ARCH_MT6752 || ARCH_MT6735 || ARCH_MT6735M || ARCH_MT6753)
	select ARM_L1_CACHE_SHIFT_6 if (!ARM64)
	help
	  Select if you are using an EVB board.

config MTK_FPGA
	bool "MTK FPGA"
	depends on (ARCH_MT6595 || ARCH_MT6795 || ARCH_MT6752 || ARCH_MT6735 || ARCH_MT6735M || ARCH_MT6753)
	select ARM_L1_CACHE_SHIFT_6 if (!ARM64)
	help
	  Select if you are using the FPGA board.

endchoice

config FPGA_CA7
	bool "FPGA CA7"
	depends on MTK_FPGA
	default n
	help
	  Select if you are using the CA7 FPGA board.

config MTK_PSCI
	bool "MT6752 PSCI boot method"
	depends on (ARCH_MT6735 || ARCH_MT6795 || ARCH_MT6752)
	default n
	help
	  Select if you want to enable PSCI boot method on MTK platform.

config MAX_DRAM_SIZE_SUPPORT
	hex "The maximum size of the DRAM can be supported in the kernel"
	default 0x10000000
	depends on (ARCH_MT6595 || ARCH_MT6795 || ARCH_MT6752 || ARCH_MT6735 || ARCH_MT6735M || ARCH_MT6753)
	help
	  Define the maximum size of the kernel can be supported.
	  It will modify the memory size if it size is smaller than
	  the memory size passed by the boot loader to the MAX_DRAM_SIZE_SUPPORT.
	  Notice that the maximum DRAM size is including the memory size
	  reserved for the modem and the PMEM.

endmenu
```

## drivers/misc/mediatek/magnetometer/Kconfig
```kconfig
config MTK_AUTO_DETECT_MAGNETOMETER
	bool "MTK_AUTO_DETECT_MAGNETOMETER"
	help
	  one load to support different magnetometer sensor.
          This feature Option is used for projects which using more than one
	  magnetometer, more than one ALSPS drivers can be builded in to
	  project and be auto detected by setting this option to yes

config CUSTOM_KERNEL_MAGNETOMETER
	bool "CUSTOM_KERNEL_MAGNETOMETER"
	help
	  compass driver to detect compass raw data and report orientatino
	  data. A compass is an instrument used for navigation and
          orientation that shows direction relative to the geographic
          cardinal directions, or "points".

config CUSTOM_KERNEL_MAGNETOMETER_MODULE
	bool "Use to control the mag sensor build type"
	help
	  Use to control the sensor build tpye.
	  If the config is set, it means sensor
	  will build ko module.
	  This is request fromo Google about odm driver.

source "drivers/misc/mediatek/magnetometer/akm8963-new/Kconfig"
source "drivers/misc/mediatek/magnetometer/akm09911-new/Kconfig"
source "drivers/misc/mediatek/magnetometer/akm09912/Kconfig"
source "drivers/misc/mediatek/magnetometer/s62x/Kconfig"
source "drivers/misc/mediatek/magnetometer/yamaha532-new/Kconfig"
source "drivers/misc/mediatek/magnetometer/bmc156_mag/Kconfig"
source "drivers/misc/mediatek/magnetometer/st480/Kconfig"
source "drivers/misc/mediatek/magnetometer/maghub/Kconfig"
```

## drivers/misc/mediatek/magnetometer/akm09911-new/Kconfig
```kconfig
config MTK_AKM09911_NEW
	tristate "AKM09911 for MediaTek package"
	default n
	help
	  It support different magnetometer sensor.
          If this option is set,
	  it will support
          AKMD09911 magnetometer.
```

## drivers/misc/mediatek/magnetometer/akm09912/Kconfig
```kconfig
config MTK_AKM09912
	bool "AKM09911 for MediaTek package"
	default n
	help
	  It support different magnetometer sensor.
          If this option is set,
	  it will support
          AKMD09911 magnetometer.
```

## drivers/misc/mediatek/magnetometer/bmc156_mag/Kconfig
```kconfig
config MTK_BMC156_MAG
	bool "bmc156 magnetometer for MediaTek package"
	help
	  It support different magnetometer sensor.
          If this option is set,
	  it will support
          bmc156 magnetometer.
```

## drivers/misc/mediatek/magnetometer/s62x/Kconfig
```kconfig
config MTK_S62X
	bool "s62x for MediaTek package"
	default n
	help
	  It support different magnetometer sensor.
          If this option is set,
	  it will support
          s62x magnetometer.
```

## drivers/misc/mediatek/magnetometer/yamaha532-new/Kconfig
```kconfig
config MTK_YAS532_NEW
        bool "YAS532 for Mediatek package"
        default n
	help
	  It support different magnetometer sensor.
          If this option is set,
	  it will support
          Yamaha532 magnetometer.
```

## drivers/misc/mediatek/masp/Kconfig
```kconfig
config MTK_SECURITY_SW_SUPPORT
	tristate "Mediatek Security SW Support"
	help
	  This is the driver for MediaTek kernel security.
	  This module contains the random id and dm-verity handle functions
	  To compile this driver as a module, choose M here: the
	  module will be called masp.

config MTK_SEC_MODEM_NVRAM_ANTI_CLONE
	tristate "Modem NVRam Anti-Clone Support"
	help
	  This option is used to enable modem NVRAM anti-clone functionality
	  [dependency_relationship]: yes If this option is turned on, the
	  modem part should also turn on for the following setting 1. Modem
	  project file CUSTOM_OPTION += __NVRAM_BIND_TO_CHIP_CIPHER__ 2. by
	  default, only two LID is defaulted has MSP attribute
	  (1)NVRAM_EF_SML_LID (2)NVRAM_EF_SIM_LOCK_LID 3. if want to turn on
	  specific LID, please add attribute NVRAM_ATTR_MSP
```

## drivers/misc/mediatek/mcdi/Kconfig
```kconfig
config MEDIATEK_MCDI
	tristate "Mediatek Multi-Core Deep Idle driver"
	help
	  This kernel config can be used to enable mcdi driver.
	  When enable this option, It can Support CPU to enter
	  sleep mode
          If unsure, say N.
```

## drivers/misc/mediatek/mcupm/Kconfig
```kconfig
config MTK_TINYSYS_MCUPM_SUPPORT
	tristate "Specify Interface Support MCUPM"
	help
	  MCUPM is a MediaTek in-house hardware for APMCU
	  power management
	  Set Y to enable this feature.
	  If unsure, set N to stay with legancy feature.
```

## drivers/misc/mediatek/md32/Kconfig
```kconfig
config MD32_SUPPORT
	bool "MediaTek MD32 Support"
	help
	  Support for the MD32 in MediaTek SoCs.
	  The MD32 is a tiny processor to handle specific tasks such as
	  Sensor HUB, Deep Power Down, thermal management, DVFS, and so on.
```

## drivers/misc/mediatek/mddp/Kconfig
```kconfig
config MTK_MDDP_SUPPORT
	tristate "Support Mediatek MD Direct Path"
	help
	  This config is used to enable or disable direct path
	  between Mediatek Modem and WiFi dirver,
	  so applications in Modem can send/receive IP
	  packets to/from WiFi directly.

config MTK_MCIF_WIFI_SUPPORT
	bool "Support Mediatek MD Consys Interface WiFi Service"
	depends on MTK_MDDP_SUPPORT
	help
	  This config is used to enable or disable connection
	  between Mediatek Modem WiFi Service and Mediatek WiFi
	  dirver, so applications in Modem can send/receive IP
	  packets to/from WiFi coprocessor through MCIF directly.

config MTK_MDDP_WH_SUPPORT
	bool "Support Mediatek MD Direct Path WiFi Hotspot"
	depends on MTK_MCIF_WIFI_SUPPORT
	help
	  This config is used to enable or disable WiFi Hotspot
	  through MCIF. When config is enabled, tethering traffic
	  can be transferred between Modem and WiFi coprocessor
	  directly instead of crossing application processor
	  all the time.
```

## drivers/misc/mediatek/mdla/Kconfig
```kconfig
config MTK_MDLA_SUPPORT
	bool "MDLA (Mediatek Deep Learning Accelerator) Driver"
	help
	  Support deep neural network calculation using
	  hardware accelerator. Customers and third party
	  could use MDLA to develop feature and algorithm
	  by themselves.
```

## drivers/misc/mediatek/mdp/Kconfig
```kconfig
config MTK_MDP
	tristate "enable MDP driver extension"
	help
	  This extension enable debug feature, such as mdp-status,
	  cmdq-record, pre-dump, timeout error dump, first error buffer
	  and aee db. Enable performance tools which add instruction
	  inside packet and profiling.

config MTK_MDP_MT6873
	tristate "enable MDP MT6783 driver extension"
	help
	  This extension enable debug feature, such as mdp-status,
	  cmdq-record, pre-dump, timeout error dump, first error buffer
	  and aee db. Enable performance tools which add instruction
	  inside packet and profiling.

config MTK_MDP_MT6853
	tristate "enable MDP MT6853 driver extension"
	help
	  This extension enable debug feature, such as mdp-status,
	  cmdq-record, pre-dump, timeout error dump, first error buffer
	  and aee db. Enable performance tools which add instruction
	  inside packet and profiling.

config MTK_MDP_MT6893
	tristate "enable MDP MT6893 driver extension"
	help
	  This extension enable debug feature, such as mdp-status,
	  cmdq-record, pre-dump, timeout error dump, first error buffer
	  and aee db. Enable performance tools which add instruction
	  inside packet and profiling.

config MTK_MDP_MT6983
        tristate "enable MDP MT6983 driver extension"
        help
          This extension enable debug feature, such as mdp-status,
          cmdq-record, pre-dump, timeout error dump, first error buffer
          and aee db. Enable performance tools which add instruction
          inside packet and profiling.

config MTK_MDP_MT6833
	tristate "enable MDP MT6833 driver extension"
	help
	  This extension enable debug feature, such as mdp-status,
	  cmdq-record, pre-dump, timeout error dump, first error buffer
	  and aee db. Enable performance tools which add instruction
	  inside packet and profiling.

config MTK_MDP_MT6768
	tristate "enable MDP MT6768 driver extension"
	help
	  This extension enable debug feature, such as mdp-status,
	  cmdq-record, pre-dump, timeout error dump, first error buffer
	  and aee db. Enable performance tools which add instruction
	  inside packet and profiling.

config MTK_MDP_MTEE_SUPPORT
	tristate "enable MDP secure path for MTEE"
	help
	  This extension enable secure path in MTEE OS.
	  In secure camera. secure video playback scenario, mdp need
	  use send cmdq control request to config mdp secure register
	  in secure world.

config MTK_MDP_MT6789
	tristate "enable MDP MT6789 driver extension"
	help
	  This extension enable debug feature, such as mdp-status,
	  cmdq-record, pre-dump, timeout error dump, first error buffer
	  and aee db. Enable performance tools which add instruction
	  inside packet and profiling.
```
