## drivers/misc/mediatek/leakage_table_v2/Kconfig
```kconfig
config MTK_STATIC_POWER_LEGACY
	tristate "MediaTek GPU Voltage Scaling Module"
	help
	  This driver provides leakage efuse dump for
	  multiple domain. Those leakage (mw) are
	  calculated by Efuse value and ATE Voltage.
	  Select "y" if you want to enable this features.
	  Select "n" if unsure.
```

## drivers/misc/mediatek/leds/Kconfig
```kconfig
config MTK_LEDS
	tristate "MediaTek LED Support"
	depends on LEDS_CLASS
	---help---
	  This selects the MediaTek(R) LEDs connected to MediaTek chips.
	  If you want to use MediaTek(R) LEDs support, say Y or M here.
	  If unsure, say N.
	  Mediatek LED module includes backlight, indicate LED, keypad LED, button LED etc.

config LIGHTNESS_MAPPING_VALUE
	int "Backlight brightness mapping value"
	default 255
	---help---
	  Backlight brightness mapping value, from 0 to 255.

config BACKLIGHT_SUPPORT_LP8557
	bool "Support backlight lp8557 board"
	default n
	---help---
	  LED driver for LP8557 support.
	  Set y to support.
	  Set n to disable.
	  For pwm external backlight.

config BACKLIGHT_SUPPORT_LM3697
	bool "LM3697(DW8832) Support"
	default n
	---help---
	  LED driver for lm3697(dw8832) support.
	  Set y to support.
	  Set n to disable.
	  Charge pump driver for external backlight.

config LEDS_MTK_DISP
	tristate "Mediatek display LED support"
	depends on LEDS_CLASS
	---help---
	  This option enables support for Mediatek display LEDs.
	  say 'y' to enable this
          Set n to disable.
	  To compile this driver as a module, the module will be called leds-mtk-disp.

config LEDS_MTK_PWM
	tristate "Mediatek pwm LED support"
	depends on LEDS_CLASS
	depends on PWM_MTK_DISP
	help
	  This option enables support for Mediatek pwm LEDs.
	  say 'y' to enable this

	  To compile this driver as a module, choose 'M' here: the module
	  will be called leds-mtk-pwm.

config LEDS_MTK_I2C
	tristate "Mediatek i2c LED support"
	depends on LEDS_CLASS
	help
	  This option enables support for Mediatek i2c LEDs.
	  say 'y' to enable this

	  To compile this driver as a module, choose 'M' here: the module
	  will be called leds-mtk-i2c.

config CONTROL_BL_TEMPERATURE
	bool "Support backlight controlled by thermal"
	---help---
	  This option enables support thermal to set max brightness.
	  Set y to support.
	  Set n to not support.
	  This option enables means thermal can set brightness by the api of led driver.
```

## drivers/misc/mediatek/lens/Kconfig
```kconfig
config MTK_LENS
	bool CONFIG_MTK_LENS
	default n
	help
	  CONFIG_MTK_LENS

config MTK_LENS_USE_MODULE
	bool "Mediatek lens driver build as module"
	default n
	help
	  Say Y here if you want to build touch driver as xxx.ko.

	  If unsure, say N.

	  To compile this dirver as a module,
	  It will be called by insmod xxx.ko in init.rc.

#
# LENS
#

config MTK_LENS_DUMMYLENS_SUPPORT
	bool "Dummy Lens Driver"
	default n
	help
	  Dummy Lens Driver
	  This config is used to enable the corresponding
	  lens driver for the camera sensor module
	  Set as y if the driver is used in this project

config MTK_LENS_DW9800AF_SUPPORT
        bool "DW9800AF Lens Driver"
        default n
        help
          DW9800AF Lens Driver
          This config is used to enable the corresponding
          lens driver for the camera sensor module
          Set as y if the driver is used in this project

config MTK_LENS_DW9714AF_SUPPORT
        bool "DW9714AF Lens Driver"
        default n
        help
          DW9714AF Lens Driver
          This config is used to enable the corresponding
          lens driver for the camera sensor module
          Set as y if the driver is used in this project

config MTK_LENS_AK7377AF_SUPPORT
        bool "AK7377AF Lens Driver"
        default n
        help
          AK7377AF Lens Driver
          This config is used to enable the corresponding
          lens driver for the camera sensor module
          Set as y if the driver is used in this project

config MTK_LENS_BU63165AF_SUPPORT
	bool "BU63165AF Lens Driver"
	default n
	help
	  BU63165AF Lens Driver
	  This config is used to enable the corresponding
	  lens driver for the camera sensor module
	  Set as y if the driver is used in this project

config MTK_LENS_BU63169AF_SUPPORT
	bool "BU63169AF Lens Driver"
	default n
	help
	  BU63169AF Lens Driver
	  This config is used to enable the corresponding
	  lens driver for the camera sensor module
	  Set as y if the driver is used in this project

config MTK_LENS_AD5820AF_SUPPORT
	bool "AD5820AF Lens Driver"
	default n
	help
	  AD5820AF Lens Driver
	  This config is used to enable the corresponding
	  lens driver for the camera sensor module
	  Set as y if the driver is used in this project

config MTK_LENS_AD5823_SUPPORT
	bool "AD5823 Lens Driver"
	default n
	help
	  AD5823 Lens Driver
	  This config is used to enable the corresponding
	  lens driver for the camera sensor module
	  Set as y if the driver is used in this project

config MTK_LENS_AD5823AF_SUPPORT
	bool "AD5823AF Lens Driver"
	default n
	help
	  AD5823AF Lens Driver
	  This config is used to enable the corresponding
	  lens driver for the camera sensor module
	  Set as y if the driver is used in this project

config MTK_LENS_AK7345AF_SUPPORT
	bool "AK7345AF Lens Driver"
	default n
	help
	  AK7345AF Lens Driver
	  This config is used to enable the corresponding
	  lens driver for the camera sensor module
	  Set as y if the driver is used in this project

config MTK_LENS_AK7371AF_SUPPORT
	bool "AK7371AF Lens Driver"
	default n
	help
	  AK7371AF Lens Driver
	  This config is used to enable the corresponding
	  lens driver for the camera sensor module
	  Set as y if the driver is used in this project

config MTK_LENS_BU6424AF_SUPPORT
	bool "BU6424AF Lens Driver"
	default n
	help
	  BU6424AF Lens Driver
	  This config is used to enable the corresponding
	  lens driver for the camera sensor module
	  Set as y if the driver is used in this project

config MTK_LENS_BU6429AF_SUPPORT
	bool "BU6429AF Lens Driver"
	default n
	help
	  BU6429AF Lens Driver
	  This config is used to enable the corresponding
	  lens driver for the camera sensor module
	  Set as y if the driver is used in this project

config MTK_LENS_BU64745GWZAF_SUPPORT
	bool "BU64745GWZAF Lens Driver"
	default n
	help
	  BU64745GWZAF Lens Driver
	  This config is used to enable the corresponding
	  lens driver for the camera sensor module
	  Set as y if the driver is used in this project

config MTK_LENS_AK7345AF_SUPPORT
	bool "AK7345AF Lens Driver"
	default n
	help
	  AK7345AF Lens Driver
	  This config is used to enable the corresponding
	  lens driver for the camera sensor module
	  Set as y if the driver is used in this project

config MTK_LENS_DW9800WAF_SUPPORT
	bool "DW9800WAF Lens Driver"
	default n
	help
	  DW9800WAF Lens Driver
	  This config is used to enable the corresponding
	  lens driver for the camera sensor module
	  Set as y if the driver is used in this project

config MTK_LENS_DW9718AF_SUPPORT
	bool "DW9718AF Lens Driver"
	default n
	help
	  DW9718AF Lens Driver
	  This config is used to enable the corresponding
	  lens driver for the camera sensor module
	  Set as y if the driver is used in this project

config MTK_LENS_DW9718SAF_SUPPORT
	bool "DW9718SAF Lens Driver"
	default n
	help
	  DW9718SAF Lens Driver
	  This config is used to enable the corresponding
	  lens driver for the camera sensor module
	  Set as y if the driver is used in this project

config MTK_LENS_DW9714AF_SUPPORT
	bool "DW9714AF Lens Driver"
	default n
	help
	  DW9714AF Lens Driver
	  This config is used to enable the corresponding
	  lens driver for the camera sensor module
	  Set as y if the driver is used in this project

config MTK_LENS_DW9714A_SUPPORT
	bool "DW9714A Lens Driver"
	default n
	help
	  DW9714A Lens Driver
	  This config is used to enable the corresponding
	  lens driver for the camera sensor module
	  Set as y if the driver is used in this project

config MTK_LENS_DW9814AF_SUPPORT
	bool "DW9814AF Lens Driver"
	default n
	help
	  DW9814AF Lens Driver
	  This config is used to enable the corresponding
	  lens driver for the camera sensor module
	  Set as y if the driver is used in this project

config MTK_LENS_LC898122AF_SUPPORT
	bool "LC898122AF Lens Driver"
	default n
	help
	  LC898122AF Lens Driver
	  This config is used to enable the corresponding
	  lens driver for the camera sensor module
	  Set as y if the driver is used in this project

config MTK_LENS_LC898212AF_SUPPORT
	bool "LC898212AF Lens Driver"
	default n
	help
	  LC898212AF Lens Driver
	  This config is used to enable the corresponding
	  lens driver for the camera sensor module
	  Set as y if the driver is used in this project

config MTK_LENS_LC898212XDAF_SUPPORT
	bool "LC898212XDAF Lens Driver"
	default n
	help
	  LC898212XDAF Lens Driver
	  This config is used to enable the corresponding
	  lens driver for the camera sensor module
	  Set as y if the driver is used in this project

config MTK_LENS_LC898214AF_SUPPORT
	bool "LC898214AF Lens Driver"
	default n
	help
	  LC898212AF Lens Driver
	  This config is used to enable the corresponding
	  lens driver for the camera sensor module
	  Set as y if the driver is used in this project

config MTK_LENS_FM50AF_SUPPORT
	bool "FM50AF Lens Driver"
	default n
	help
	  FM50AF Lens Driver
	  This config is used to enable the corresponding
	  lens driver for the camera sensor module
	  Set as y if the driver is used in this project

config MTK_LENS_FP5510E2AF_SUPPORT
	bool "FP5510E2AF Lens Driver"
	default n
	help
	  FM50AF Lens Driver
	  This config is used to enable the corresponding
	  lens driver for the camera sensor module
	  Set as y if the driver is used in this project

config MTK_LENS_MT9P017AF_SUPPORT
	bool "MT9P017AF Lens Driver"
	default n
	help
	  MT9P017AF Lens Driver
	  This config is used to enable the corresponding
	  lens driver for the camera sensor module
	  Set as y if the driver is used in this project

config MTK_LENS_OV8825AF_SUPPORT
	bool "OV8825AF Lens Driver"
	default n
	help
	  OV8825AF Lens Driver
	  This config is used to enable the corresponding
	  lens driver for the camera sensor module
	  Set as y if the driver is used in this project

config MTK_LENS_SENSORDRIVE_SUPPORT
	bool "SENSORDRIVE Lens Driver"
	default n
	help
	  SENSORDRIVE Lens Driver
	  This config is used to enable the corresponding
	  lens driver for the camera sensor module
	  Set as y if the driver is used in this project

config MTK_LENS_GAF001AF_SUPPORT
	bool "GAF001AF Lens Driver"
	default n
	help
	  GAF001AF Lens Driver
	  This config is used to enable the corresponding
	  lens driver for the camera sensor module
	  Set as y if the driver is used in this project

config MTK_LENS_GAF002AF_SUPPORT
	bool "GAF002AF Lens Driver"
	default n
	help
	  GAF002AF Lens Driver
	  This config is used to enable the corresponding
	  lens driver for the camera sensor module
	  Set as y if the driver is used in this project

config MTK_LENS_GAF008AF_SUPPORT
	bool "GAF008AF Lens Driver"
	default n
	help
	  GAF008AF Lens Driver
	  This config is used to enable the corresponding
	  lens driver for the camera sensor module
	  Set as y if the driver is used in this project

config MTK_LENS_WV511AAF_SUPPORT
	bool "WV511AAF Lens Driver"
	default n
	help
	  WV511AAF Lens Driver
	  This config is used to enable the corresponding
	  lens driver for the camera sensor module
	  Set as y if the driver is used in this project
```

## drivers/misc/mediatek/linearacceleration/Kconfig
```kconfig
config CUSTOM_KERNEL_LINEARACCEL_SENSOR
	bool "CUSTOM_KERNEL_LINEARACCEL_SENSOR"
	help
	  Kernel space linear acceleration sensor driver.

source "drivers/misc/mediatek/linearacceleration/linearacchub/Kconfig"
```

## drivers/misc/mediatek/locking/Kconfig
```kconfig
config MTK_LOCKING_AEE
	tristate "Enable MTK locking AEE"
	depends on PROVE_LOCKING && HAVE_KPROBES && MODULES && MTK_AEE_FEATURE
	select KPROBES
	help
	  CONFIG_MTK_LOCKING_AEE define if mtk locking AEE tool should be
	  built-in, module or not. If mtk locking AEE tool is enabled, a
	  Kernel API dump will be generated when the lockdep is turned off.
	  If you are not sure about whether to enable it or not, please set n.
```

## drivers/misc/mediatek/log_store/Kconfig
```kconfig
config MTK_DRAM_LOG_STORE
	tristate "mtk DRAM log store"
	help
	  DRAM log store featuer is used to store log(preload, lk) in DRAM,
	  which can be readed in kernel phase.
	  you should set in project configure file.
	  it will use SRAM buff.

config MTK_DRAM_LOG_STORE_ADDR
	hex "DRAM log store address(use SRAM)"
	default 0
	depends on MTK_DRAM_LOG_STORE
	help
	  store the SRAM address of log header information.
	  it will store the log header information.
	  the address should equal with preloader and lk setting.
	  the address behind in ramconsole.

config MTK_DRAM_LOG_STORE_SIZE
	hex "DRAM log store size(use SRAM)"
	default 0
	depends on MTK_DRAM_LOG_STORE
	help
	  store the SRAM size of log header information.
	  the default value is 1K.
	  should equal with preloader and lk setting.
	  need discussion with ramconsole owner.
```
