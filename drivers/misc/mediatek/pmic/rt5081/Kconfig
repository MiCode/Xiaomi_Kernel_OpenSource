## drivers/misc/mediatek/scp/Kconfig
```kconfig
config MTK_TINYSYS_SCP_SUPPORT
	tristate "Specify Interface Support SCP"
	help
	  SCP is a MediaTek in-house DSP which can receive
	  command from IPI interface.
	  Set Y to enable this feature.
	  If unsure,
	  Set N to stay with legancy feature.

config MTK_TINYSYS_SCP_LOGGER_SUPPORT
	bool "SCP Logger support"
	depends on MTK_TINYSYS_SCP_SUPPORT
	help
	  This is debug feature: SCP logger on/off option.
	  Set Y to enable this feature.
	  Set N to disable this feature.
	  If unsure, Set Y to have debug log.

config MTK_TINYSYS_SCP_VERSION
	string "Support MTK SCP Driver Version"
	depends on MTK_TINYSYS_SCP_SUPPORT
	default ""
	help
	  MTK_TINYSYS_SCP_VERSION define which scp version will be used

config MTK_TINYSYS_SCP_CM4_SUPPORT
	bool "Specify micro processor CM4 supported by SCP"
	depends on MTK_TINYSYS_SCP_SUPPORT
	default n
	help
	  CM4 is one uP supported by SCP which designed by ARM corp.
	  Set Y to enable this feature.
	  If unsure,
	  Set N to stay with legacy feature.

config MTK_TINYSYS_SCP_DEBUG_SUPPORT
	bool "SCP Debug support"
	help
	  This is a debug interface for SCP
	  Set Y to enable this feature.
	  Set N to disable this feature.
	  If unsure, Set N to disable it.
```

## drivers/misc/mediatek/sda/Kconfig
```kconfig
config MTK_SDA
	bool "Mediatek System Debug Architecture"
	help
	  SDA (System Debug Architecture) is designed by Mediatek to
	  provide utilities for critical information catching and analysis.

	  This select device drivers or pure software module which control
	  or use SDA utilities. Catching data are stored in the storage
	  of devices. Mediatek in-house tools are needed for reading the
	  data and analysis result.

if MTK_SDA

config MTK_CACHE_PARITY_CHECK
	tristate "MediaTek CACHE PARITY CHECK"
	help
	  This selects the device driver for the cache parity-check
	  module. The module detects errors or corrects errors of CPU
	  cache in the Mediatek SoC.

	  Enable this to get the report on detection or correction
	  of errors.

config MTK_BUS_PARITY_CHECK
	tristate "MediaTek BUS PARITY CHECK"
	help
	  This selects the device driver for the bus parity-check
	  module. The module detects errors of bus in the Mediatek SoC.

	  Enable this to get the report on detection or correction
	  of errors.

config MTK_IRQ_DBG
	tristate "MediaTek IRQ dbg driver"
	help
	  This selects the device driver for the interrupt
	  debug module. The module provides APIs of irq debug
	  in the Mediatek SoC.

	  Enable this to get the interrupt related APIs for
	  debugging only.

config MTK_IRQ_DBG_LEGACY
	tristate "MediaTek IRQ dbg driver"
	help
	  This selects the device driver for the interrupt
	  debug module. The module provides APIs of irq debug
	  in the Mediatek SoC with sysirq.

	  Enable this to get the interrupt related APIs for
	  debugging only.

config MTK_DBGTOP
	tristate "MTK DBGTOP driver"
	help
	  This selects the Mediatek(R) dbgtop driver.
	  Provide APIs for interactions between debuggers
	  and some hardware modules.

config MTK_BTM_SUPPORT
	tristate "MediaTek BUS TRACER MODULE Support"
	help
	  BUS TRACER MODULE is a debugging feature to record the historical
	  information on bus. After rebooting, these information could
	  be dumped for debugging. It can also debug with watchpoint,
	  bypass, id, and rw filters

config MTK_BTM_V1
	tristate "MediaTek BUS TRACER MODULE V1"
	depends on MTK_BTM_SUPPORT
	help
	  This kernel config can be used to enable
	  BTMv1 driver for specific plaforms.
	  It contains ap/infra/peri bus tracers.
	  It need to enable MTK_BTM_SUPPORT for basic functions.
endif
```

## drivers/misc/mediatek/secmem/Kconfig
```kconfig
#
# Secure Memory configuration
#
config MTK_SVP_DISABLE_SODI
	tristate "Disable SODI while SVP playback"
	depends on TRUSTONIC_TEE_SUPPORT
	default n
	help
	  System will enter screen on device idle (SODI) while secure
	  video playback (SVP) playback in some specific project/platform,
	  and this will cause video playback hang issues. (depending on
	  Trustonic TEE Support or Microtrust TEE Support or other 3rd-party TEE)
```

## drivers/misc/mediatek/selinux_warning/Kconfig
```kconfig
# SELinux
config MTK_SELINUX_AEE_WARNING
	bool "Enable SELinux AEE Warning "
	depends on SECURITY_SELINUX
	default n
	---help---
	  This option enables SELinux violation AEE warning.
	  The warning will be shown as yellow screen with information
	  indicating which module triggers this violation so that
	  tester can easily identify there is a violation and the module.
```

## drivers/misc/mediatek/sensor/1.0/alsps/alspshub/Kconfig
```kconfig
config MTK_ALSPSHUB
	bool "alspshub for MediaTek package"
	default n
	help
	  It support different alspshub sensor.
	  If this option is set,
	  it will support
	  sensorhub gyroscope.
```
