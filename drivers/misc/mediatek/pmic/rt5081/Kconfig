## drivers/misc/mediatek/pmic/rt5081/Kconfig
```kconfig
config MFD_RT5081_PMU
	bool "Support for RT5081 PMU part"
	depends on I2C
	select MFD_CORE
	select RT_REGMAP
	help
	  Select Y
	  to enable
	  support
	  for RT5081 PMU.

config RT5081_PMU_CHARGER
	bool "RT5081 PMU Charger Part"
	depends on MFD_RT5081_PMU
	help
	  Say Y here
	  to enable
	  supprot for RT5081
	  charger device.

config RT5081_PMU_CHARGER_TYPE_DETECT
	bool "RT5081 PMU Charger Type Detect"
	depends on RT5081_PMU_CHARGER
	depends on MTK_EXTERNAL_CHARGER_TYPE_DETECT
	default MTK_EXTERNAL_CHARGER_TYPE_DETECT
	help
	  Say Y here
	  to enable
	  supprot for RT5081
	  charger type detect.

config RT5081_PMU_FLED
	bool "RT5081 PMU FLED Part"
	depends on LEDS_CLASS && MFD_RT5081_PMU
	select FLASHLIGHT
	select RT_FLASH_LED
	help
	  Say Y here
	  to enable
	  supprot for
	  RT5081 fled device.

config RT5081_PMU_BLED
	bool "RT5081 PMU BLED Part"
	depends on LEDS_CLASS && MFD_RT5081_PMU
	help
	  Say Y here
	  to enable supprot
	  for
	  RT5081 bled device.

config RT5081_PMU_RGBLED
	bool "RT5081 PMU RGBLED Part"
	depends on LEDS_CLASS && MFD_RT5081_PMU
	help
	  Say Y here
	  to enable supprot
	  for
	  RT5081 rgbled device.

config RT5081_PMU_LDO
	bool "rt5081 PMU LDO Part"
	depends on REGULATOR && REGULATOR_MTK && MFD_RT5081_PMU
	help
	  Say Y here
	  to enable
	  support for
	  RT5081 ldo device.

config RT5081_PMU_DSV
	bool "rt5081 PMU DSV Part"
	depends on REGULATOR && REGULATOR_MTK && MFD_RT5081_PMU
	help
	  Say Y here to
	  enable support
	  for
	  RT5081 dsv device.
```

## drivers/misc/mediatek/pmic_protect/Kconfig
```kconfig
config MTK_PMIC_PROTECT
	tristate "MTK PMIC protection"
	help
	  For MediaTek PMIC protection. It is used to prevent from PMIC
	  damage.
	  Select "y" if you want to enable.
	  Select "n" if unsure.
```

## drivers/misc/mediatek/pmic_wrap/Kconfig
```kconfig
config MTK_PMIC_WRAP_HAL
	bool "MediaTek PMIC_WRAP driver"
	---help---
	  MediaTek PMIC_WRAP driver.
	  The PMIC wrapper serves as the bridge for communication between AP and PMIC.
	  Set y to support this driver.
	  Set n and choose other chargers.
```

## drivers/misc/mediatek/pmsr/Kconfig
```kconfig
config MTK_PMSR
	tristate "Mediatek PMSR Signal profiling tool"
	help
	  PMSR means Power Management State Register.
	  For Mediatek low power pmsr signal profiling features.
	  Profiling several hw signals for debug purposes.
	  Select "n" if you are not sure.
```

## drivers/misc/mediatek/power/Kconfig
```kconfig
# Power Related
config MTK_PMIC
	bool "MediaTek PMIC driver"
	default n
	---help---
	  MediaTek PMIC driver.
	  Set y to support this driver.
	  Set n and choose other chargers.
	  This driver uses MTK_PWRAP.

config MTK_SWITCH_INPUT_OUTPUT_CURRENT_SUPPORT
	bool "Mediatek allow to configure input/charging current"
	default n
	---help---
	Mediatek switch charger input output current.
	Set y to support.
	Set n to disable.
	switch charger often supports this feature.

config MTK_WIRELESS_CHARGER_SUPPORT
	bool "Mediatek Wireless charger driver"
	default n
	---help---
	yes : support wireless charger feature, it can show the wireless
	charging animation and charging icon when receive wireless charger
	plug-in. no: not support wireless charger feature, stay with
	legancy feature, which cannot sense the exist of the wireles
	charger.

config MTK_POWER_EXT_DETECT
	bool "MediaTek Power Ext detect"
	default n
	---help---
	EVB/Phone share load configration.
	Require one GPIO to do detection,
	GPIO high mean EVB, otherwise mean phone platform.
```

## drivers/misc/mediatek/power_gs/Kconfig
```kconfig
config MTK_POWER_GS
  bool CONFIG_MTK_POWER_GS
  default yes
  help
    CONFIG_MTK_POWER_GS
```

## drivers/misc/mediatek/power_gs_v1/Kconfig
```kconfig
config MTK_POWER_GS_LEGACY
	tristate "MTK power golden setting legacy"
	help
	  This kernel config can be used to enable power golden setting.
	  When enable this option, spm will dump pmic golden setting
	  for low power tuning.
	  If unsure, say N.

config MTK_POWER_GS_LEGACY_V2
	tristate "MTK power golden setting legacy"
	help
	  This kernel config can be used to enable power golden setting.
	  When enable this option, spm will dump pmic golden setting
	  for low power tuning.
	  If unsure, say N.
```

## drivers/misc/mediatek/power_throttling/Kconfig
```kconfig
config MTK_POWER_THROTTLING_COMMON
	bool "MTK power throttling common"
	help
	  For MediaTek power throttling. Provide common interface for MTK
	  power throttle.
	  Select "y" if you want to enable power throttling feature
	  Select "n" if unsure.

config PMIC_LBAT_SERVICE
	tristate "PMIC lbat service"
	select MTK_POWER_THROTTLING_COMMON
	help
	  For MediaTek PMIC lbat service.
	  It will detect if VBAT is higher or lower some threshold and trigger
	  interrupt to notify.
	  Select "y" if you want to enable PMIC lbat service.
	  Select "n" if unsure.

config MTK_BATTERY_OC_POWER_THROTTLING
	tristate "MTK battery over current throttle"
	select MTK_POWER_THROTTLING_COMMON
	help
	  For MediaTek battery over current power throttling.
	  Power throttle when battery current loading higher than some
	  threshold.
	  Select "y" if you want to enable battery over current power
	  throttling feature.
	  Select "n" if unsure.

config MTK_BATTERY_PERCENT_THROTTLING
	tristate "MTK battery percent power throttle"
	select MTK_POWER_THROTTLING_COMMON
	help
	  For MediaTek battery percent throttling.
	  Power throttle when battery percent lower than some threshold
	  Select "y" if you want to enable battery percent power throttling
	  feature
	  Select "n" if unsure.

config MTK_BATTERY_PERCENT_THROTTLING_DEBUG
	tristate "MTK battery percent power throttle debug"
	help
	  For MediaTek battery percent throttling debug.
	  This option shuold be enable only for battery percent throttling debug
	  Select "y" if you want to enable battery percent throttling debug
	  feature
	  Select "n" if unsure.

config MTK_DYNAMIC_LOADING_POWER_THROTTLING
	tristate "MTK dynamic loading throttle"
	select MTK_POWER_THROTTLING_COMMON
	help
	  For MediaTek dynamic loading power throttling.
	  Dynamic loading Imix calculation for power budget management.
	  Select "y" if you want to enable dynamic loading power throttling
	  feature.
	  Select "n" if unsure.

config MTK_LOW_BATTERY_POWER_THROTTLING
	tristate "MTK low battery throttle"
	select MTK_POWER_THROTTLING_COMMON
	select PMIC_LBAT_SERVICE
	help
	  For MediaTek low battery power throttling.
	  Power throttle when battery voltage lower than some threshold.
	  Select "y" if you want to enable low battery power throttling
	  feature.
	  Select "n" if unsure.

config MTK_MD_POWER_THROTTLING
	tristate "MTK modem power throttling"
	depends on MTK_ECCCI_DRIVER
	help
	  For MediaTek modem power throttling.
	  Throttle MTK modem power when MTK power throttling triggers
	  Select "y" if you want to enable MTK modem power throttling
	  feature
	  Select "n" if unsure.

config MTK_CPU_POWER_THROTTLING
	tristate "MTK CPU power throttling"
	help
	  For MediaTek CPU power throttling.
	  Throttle MTK CPU power when MTK power throttling triggers
	  Select "y" if you want to enable MTK CPU power throttling
	  feature
	  Select "n" if unsure.
```

## drivers/misc/mediatek/ppm_v3/Kconfig
```kconfig
config MTK_PPM
	tristate "MTK Performance and Power Management"
	help
	  This kernel config can be used to enable PPM.
	  Handles power/performance related requests from
	  kernel or user-space–Calculates appropriate CPU
	  core number and frequency range accordingly.
	  If unsure, say N.
```

## drivers/misc/mediatek/pseudo_m4u/Kconfig
```kconfig
config MTK_PSEUDO_M4U
	bool "PSEUDO m4u driver for MTK m4u"
	depends on MTK_IOMMU && (!MTK_M4U)
	help
	  MTK iommu support m4u.
```

## drivers/misc/mediatek/pwm/Kconfig
```kconfig
config MTK_PWM
	tristate "MediaTek PWM driver"
	default n
	help
	  PWM: pluse-width modulation.
	  PWM driver support for MediaTek SOC.
	  If you want to use MediaTek PWM driver, say Y or M here.
	  If unsure, say N.
config MTK_PWM_V1
	tristate "MediaTek PWM_V1 driver"
	default n
	help
	  PWM: pluse-width modulation.
	  PWM driver support for MediaTek SOC, PWM_V1's pwm base chagne
          from 0x10,0x50,0x90,... to 0x80,0xc0,0x100,...
	  If you want to use MediaTek PWM_V1 driver, say Y or M here.
	  If unsure, say N.
```

## drivers/misc/mediatek/qos/Kconfig
```kconfig
config MTK_QOS_FRAMEWORK
	tristate "MTK QOS FRAMEWORK"
	help
	  This kernel config can be used to enable MTK QOS FRAMEWORK.
	  When enabling this option, BW Limiter and BW Bound Detector
	  will be enabled and set EMI hardware.
	  If unsure, say N.

config MTK_QOS_MT6893
	tristate "MTK QOS for MT6893"
	help
          This kernel config can be used to enable MTK QOS MT6893.
	  When enabling this option, BW Limiter and BW Bound Detector
	  will be enabled and set EMI hardware.
	  If unsure, say N.

config MTK_QOS_MT6768
	tristate "MTK QOS for MT6768"
	help
	This kernel config can be used to enable MTK QOS MT6768.
	When enabling this option, BW Limiter and BW Bound Detector
	will be enabled and set EMI hardware.
	If unsure, say N.

config MTK_QOS_MT6765
	tristate "MTK QOS for MT6765"
	help
	This kernel config can be used to enable MTK QOS MT6765.
	will be enabled and set EMI hardware.
	If unsure, say N.
```

## drivers/misc/mediatek/ram_console/Kconfig
```kconfig
config MTK_RAM_CONSOLE
	bool "mt ram console"
	help
	  ram_console is a feature which will record some
	  debug information and can be read after reboot.
	  It can be configured as SRAM or DRAM.
	  Each ram type should be set address and size.
```

## drivers/misc/mediatek/rotationvector/Kconfig
```kconfig
config CUSTOM_KERNEL_RV_SENSOR
	bool "CUSTOM_KERNEL_RV_SENSOR"
	help
	  Kernel space rotation vector sensor driver.

source "drivers/misc/mediatek/rotationvector/rotatvechub/Kconfig"
```

## drivers/misc/mediatek/rps/Kconfig
```kconfig
config MTK_NET_RPS
	tristate "MediaTek rps set API"
	depends on MTK_NET_CCMNI
	default MTK_NET_CCMNI
	help
	  Choose this option to set rps by API.
	  It will be called for ccmni & rndis driver.
	  If rps is set, out of order packets will not happen,
	  performance will be improved because softirq can worked
	  in the different cpu.
```

## drivers/misc/mediatek/rrc/Kconfig
```kconfig
# RRC
config MTK_RRC_SUPPORT
	bool "MTK_RRC_SUPPORT"
	default n
	help
	  RRC(Refresh Rate Controller) is a display tcehnology that automatically switch display refresh rate for
	  smoother and clearer user experience.

config MTK_DISPLAY_120HZ_SUPPORT
	bool "MTK_DISPLAY_120HZ_SUPPORT"
	default n
	help
	  This option enable 120Hz display feature.
	  This feature also require panel support 120Hz refresh rate.
	  If you want to use MediaTek 120Hz display feature, say Y here.
	  If unsure, say N.
```

## drivers/misc/mediatek/rt-regmap/Kconfig
```kconfig
config RT_REGMAP
	bool "Richtek regmap"
	help
	  Say Y to enable Richtek regmap
	  Interface for register debug node and ops.
	  This config decide to use regmap easy
	  for debug in RT chip.
```

## drivers/misc/mediatek/rtc/Kconfig
```kconfig
# RTC Related
config MTK_RTC
	bool "MediaTek Real Time Clock Support"
	default n
	help
	  A real-time clock (RTC) is a computer
	  clock (most often in the form of an
	  integrated circuit) that keeps track
	  of the current time.
```

## drivers/misc/mediatek/sched/Kconfig
```kconfig
config MTK_SCHEDULER
	tristate "mtk scheduler feature"
	help
	  Choose this option to enable mtk schduler feature.
	  These features include
		non-linear DVFS control
		EAS enhancement

config MTK_OPP_CAP_INFO
	bool "Per-opp capacity information"
	depends on MTK_CPUFREQ_SUGOV_EXT
	help
	  Choose this option to provide per-opp capacity API.
	  Scheduler module will get per-opp capacity from sram and
	  initialize opp capacity table. This config is used by
	  performance tuning framework and non-linear frequency control.

config NONLINEAR_FREQ_CTL
	bool "Non-linear frequency control"
	depends on MTK_OPP_CAP_INFO
	help
	  Choose this option to enable non-linear frequency control.
	  This will change per-opp capacity from linear scaled by
	  freuqency to evaluated by benchmark. This makes capacity
	  more accurate and will let scheduler/schedutil use more
	  suitable frequency.

config MTK_EAS
	bool "MTK EAS enhancement"
	depends on MTK_SCHEDULER
	help
	  MTK EAS enhancement features.
	  These featues include
	   1. load balance in the same frequency domain
	   2. hint aware in idle balance
	   3. Notify thermal ceiling to scheduler by reading thermal
		ceiling in SRAM and updating thermal pressure.

config MTK_THERMAL_AWARE_SCHEDULING
	bool "thermal aware scheduling"
	depends on MTK_EAS && MTK_THERMAL_INTERFACE
	help
	  CPU leakage optimization by temperature balance in the
	  same frequency domain.
	  Task placement consider temperature for leakage.
	  Use current Per-core temperature (per-10'c, per-die).
	  Favor tasks to CPU with lowest thermal pressure.

config MTK_LEAKAGE_AWARE_TEMP
	bool "MTK leakage aware temperature"
	depends on MTK_EAS &&  MTK_THERMAL_INTERFACE
	help
	  Compute energy will consider CPU leakage and
	  CPU leakage will aware per-CPU temperature.
	  Favor to put tasks into CPU with lowest temperature and
	  to save power.

config MTK_NEWIDLE_BALANCE
	bool "new idle balance for hint task"
	depends on MTK_EAS
	help
	  When a CPU is newly IDLE, pull the runnable task
	  with Latency-sensitive hint in other CPUs to this IDLE CPU.
	  This feature enhances the latency of the task with
	  latency-sensitive hint.

config MTK_CORE_PAUSE
	bool "core pause driver"
	depends on MTK_SCHEDULER
	help
	   Choose this option to provide core pause related API.
	   core pause intends to have a way to force a CPU to go idle
	   and to resume as quickly as possible, with as little
	   disruption as possible on the system.

config MTK_SCHED_BIG_TASK_ROTATE
	bool "scheduling big task rotate"
	depends on MTK_SCHEDULER
	help
	   Swap two misfit tasks between big cores and little core,
	   equally distributed runtime for each misfit task.
	   It can use for parallel thread at multi-core to reduce
	   execution time.

config MTK_CPUFREQ_SUGOV_EXT
	tristate "mediatek sugov governor"
	depends on CPU_FREQ && SMP
	help
	   Choose this option to provide vendor cpufreq governor build
	   by mediatek. This governor support non-linear freq control and
	   vary optimizations. This config should be enable when
	   you want full mtk solution.

config MTK_OPP_MIN
	bool "mediatek sugov governor"
	depends on MTK_CPUFREQ_SUGOV_EXT && MTK_THERMAL_INTERFACE
	help
	   To improve critical task performance under same power budget
	   On-time deliver critical task frequency boost hint to thermal.

config MTK_CORE_CTL
	tristate "MTK Core Control with CPU Isolation"
	depends on MTK_CORE_PAUSE
	help
	  This config is for the core control policy with CPU isolation.
	  The core control online and offline CPU cores based on task
	  utilizations from scheduler information automatically.
	  If you are not sure about whether to enable it or not,
	  please set n.
```
