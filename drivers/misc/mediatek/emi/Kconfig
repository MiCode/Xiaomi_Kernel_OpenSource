## drivers/misc/mediatek/geniezone/gz-trusty/Kconfig
```kconfig
menu "GZ Trusty"


config HAVE_MTK_GZ_LOG
	bool "GZ gz_log & trusty_log support"
	help
	 This symbol is used to build gz_log into kernel.
	 The gz_log driver will create a proc node which can only printthe gz
	 message.
	 It will be select if MTK_ENABLE_GENIEZONE is on.
	 If the gz_log driver failed or this symbol is false, the mtk logger
	 can not read the gz message correctly.

config MT_GZ_TRUSTY_DEBUGFS
	tristate "Trusty debugfs for Mediatek platforms"

config TRUSTY_INTERRUPT_MAP
	bool "GZ Trusty interrupt map"

config TRUSTY_INTERRUPT_FIQ_ONLY
	bool "GZ Trusty interrupt fiq support"
	help
	  This is used for Trusty to support handling new flow in GICv3
	  If this is selected, NWd will not route IRQ to Secure OS
	  but just fire NOP.
	  This is MUST for us to handle G0S IRQ for Secure OS.

config MTK_NEBULA_VM_SUPPORT
	tristate "Nebula VM OS Enable"
	depends on MTK_ENABLE_GENIEZONE
	help
	  This is used for MTK Geniezone to Support Nebula VM OS.
	  Nebula's IRQ will be routed by Linux to Geniezone.
	  Say Y if you would like to enable this feature.
	  If unsure, say N.

endmenu

# GZ Trusty
```

## drivers/misc/mediatek/geomagneticrotationvector/Kconfig
```kconfig
config CUSTOM_KERNEL_GMRV_SENSOR
	bool "CUSTOM_KERNEL_GMRV_SENSOR"
	help
	  Kernel space geomagnetic rotation vector sensor driver.

source "drivers/misc/mediatek/geomagneticrotationvector/gmagrotvechub/Kconfig"
```

## drivers/misc/mediatek/gesture/Kconfig
```kconfig
config CUSTOM_KERNEL_GESTURE_SENSOR
	bool "CUSTOM_KERNEL_GESTURE_SENSOR"
	help
	  Kernel space support gesture sensor driver.

source "drivers/misc/mediatek/gesture/inpocket/Kconfig"
source "drivers/misc/mediatek/gesture/stationary/Kconfig"
```

## drivers/misc/mediatek/glance_gesture_sensor/Kconfig
```kconfig
config CUSTOM_KERNEL_GLANCE_GESTURE_SENSOR
	bool "CUSTOM_KERNEL_GLANCE_GESTURE_SENSOR"
	help
	  Kernel space glance(touch wake up) gesture sensor driver.

source "drivers/misc/mediatek/glance_gesture_sensor/glghub/Kconfig"
```
