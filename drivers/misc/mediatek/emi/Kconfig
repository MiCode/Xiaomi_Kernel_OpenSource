## drivers/misc/mediatek/emi/Kconfig
```kconfig
config MTK_EMI
	bool "EMI driver"
	default n
	help
	  This config enable/disable the IP-based EMI
	  driver, which includes bandwidth limiter
	  (BWL), memory protect unit (MPU), and EMI
	  latency monitor (ELM).
```

## drivers/misc/mediatek/emi_bwl/Kconfig
```kconfig
config MTK_EMI_BWL
  bool "enable MTK_EMI_BWL"
  default n
  help
    This config enable/disable EMI Bandwidth Limit driver.
    EMI Bandwidth Limit driver is used to set different
    bandwidth limit value for different scenario.
    It can set individual value for all EMI master ports.
```

## drivers/misc/mediatek/emi_mbw/Kconfig
```kconfig
config MTK_EMI_MBW
  bool "enable MTK_EMI_MBW"
  default y
  help
    This enable MTK_EMI_MBW
```

## drivers/misc/mediatek/emi_mpu/Kconfig
```kconfig
config MTK_EMI_MPU
	bool "enable MTK_EMI_MPU"
	default n
	help
	  This config enable/disable EMI MPU Driver.
	  EMI MPU driver is used to protect some memory regions.
	  It can set protected start/end address of the memory region,
	  and access permission of all domains for that region.
```

## drivers/misc/mediatek/et/Kconfig
```kconfig
config MTK_ET
	tristate "MediaTek Debug Module"
	default m
	help
	  This driver provides exception handling for
	  debug.
	  Select "y" if you want to enable this features.
	  Select "n" if unsure.
```

## drivers/misc/mediatek/exm/Kconfig
```kconfig
config MTK_EXTMEM
	bool "mtk external memory"
	default n
	depends on MTK_INTERNAL
	help
	  external config for gmo project
```

## drivers/misc/mediatek/ext_disp/Kconfig
```kconfig
config SINGLE_PANEL_OUTPUT
	bool "Decide whether to support single panel display feature"
	default n
	help
	  Decide whether to support single panel display feature.
	  Panel and tv can't not display at the same time.
	  When hdmi plug in, only show display in tv, panle will be black screen.
	  And when hdmi plug out, panel will resume.

config MTK_DUAL_DISPLAY_SUPPORT
	int "Select external display device"
	range 0 2
	default "0"
	help
	  To select vendor driver.
	  If choose "0", phone can't support external display or can support MHL/DP.
	  If choose "1", phone can support epaper panel.
	  If choose "2", phone can support dual LCD panel.
```

## drivers/misc/mediatek/ext_gic/Kconfig
```kconfig
config MTK_GIC_EXT
	bool "gic extend"
	depends on !MTK_GIC
	default n
	help
	  Add extensions for GIC driver.
	  Including interrupt polarity setup, check the current interrupt
	  targart CPUs, debug information dump, and mask/unmask for power
	  scenario.

config MTK_GIC_V3_EXT
	bool "gic-v3 extend"
	select MTK_GIC_EXT
	default n
	help
	  Add extensions for GIC-v3 driver.
	  Including interrupt polarity setup, check the current interrupt
	  targart CPUs, debug information dump, and mask/unmask for power
	  scenario.
```

## drivers/misc/mediatek/extcon/Kconfig
```kconfig
config EXTCON_MTK_USB
	tristate "MediaTek EXTCON USB Support"
	select EXTCON
	select USB_ROLE_SWITCH
	help
	  Say Y here to enable extcon support for USB cable detection
	  on the Mediatek PMIC.
```

## drivers/misc/mediatek/face_down_sensor/Kconfig
```kconfig
config CUSTOM_KERNEL_FACE_DOWN_SENSOR
	bool "CUSTOM_KERNEL_FACE_DOWN_SENSOR"
	help
	  Kernel space face down sensor driver.
```

## drivers/misc/mediatek/flashlight/Kconfig
```kconfig
#
# Flashlight device configuration
#

config MTK_FLASHLIGHT
	tristate "Mediatek flashlight driver"
	help
	  This is flashlight driver for camera.

	  Say Y here if you want a flashlight core to handle flashlight devices.
	  If you have any questions about this, say Y here,
	  only say N if you know exactly what you are doing.

config MTK_FLASHLIGHT_AW3644
	tristate "Mediatek flashlight with driver IC (AW3644)"
	depends on MTK_FLASHLIGHT
	help
	  This is for the flashlight driver IC (AW3644).

	  Say Y here if you want a flashlight driver IC AW3644.
	  Select this only if your board has this IC.

	  Say M here if you want to compile this driver as a module.

config MTK_FLASHLIGHT_LED191
	tristate "Mediatek flashlight led191 gpio driver"
	depends on MTK_FLASHLIGHT
	help
	  This is flashlight led191 gpio driver for camera.

	  Say Y here if you want a driver IC with GPIO interface.
	  Select this only if your board has this IC.

	  Say M here if you want to compile this driver as a module.

config MTK_FLASHLIGHT_LM3642
	tristate "Mediatek flashlight with driver IC (TI LM3642)"
	depends on MTK_FLASHLIGHT
	help
	  This is for the flashlight driver IC (TI LM3642).

	  Say Y here if you want a flashlight driver IC LM3642.
	  Select this only if your board has this IC.

	  Say M here if you want to compile this driver as a module.

config MTK_FLASHLIGHT_LM3643
	tristate "Mediatek flashlight with driver IC (TI LM3643)"
	depends on MTK_FLASHLIGHT
	help
	  This is for the flashlight driver IC (TI LM3643).

	  Say Y here if you want a flashlight driver IC LM3643.
	  Select this only if your board has this IC.

	  Say M here if you want to compile this driver as a module.

config MTK_FLASHLIGHT_LM3644
	tristate "Mediatek flashlight with driver IC (TI LM3644)"
	depends on MTK_FLASHLIGHT
	help
	  This is for the flashlight driver IC (TI LM3644).

	  Say Y here if you want a flashlight driver IC LM3644.
	  Select this only if your board has this IC.

	  Say M here if you want to compile this driver as a module.

config MTK_FLASHLIGHT_RT4505
	tristate "Mediatek flashlight with driver IC (Richtek RT4505)"
	depends on MTK_FLASHLIGHT
	help
	  This is for the flashlight driver IC (Richtek RT4505).

	  Say Y here if you want a flashlight driver IC RT4505.
	  Select this only if your board has this IC.

	  Say M here if you want to compile this driver as a module.

config MTK_FLASHLIGHT_RT5081
	tristate "Mediatek flashlight with driver IC (Richtek RT5081)"
	depends on MTK_FLASHLIGHT && RT_FLASHLIGHT
	help
	  This is for the flashlight driver IC (Richtek RT5081).

	  Say Y here if you want a flashlight driver IC RT5081.
	  Select this only if your board has this IC.

	  Say M here if you want to compile this driver as a module.

config MTK_FLASHLIGHT_MT6336
	tristate "Mediatek flashlight with driver IC (Mediatek MT6336)"
	depends on MTK_FLASHLIGHT
	help
	  This is for the flashlight driver IC (Mediatek MT6336).

	  Say Y here if you want a flashlight driver IC MT6336.
	  Select this only if your board has this IC.

	  Say M here if you want to compile this driver as a module.

config MTK_FLASHLIGHT_MT6370
	tristate "Mediatek flashlight with driver IC (Mediatek MT6370)"
	depends on MTK_FLASHLIGHT && RT_FLASHLIGHT
	help
	  This is for the flashlight driver IC (Mediatek MT6370).

	  Say Y here if you want a flashlight driver IC MT6370.
	  Select this only if your board has this IC.

	  Say M here if you want to compile this driver as a module.

config MTK_FLASHLIGHT_MT6360
	tristate "Mediatek flashlight with driver IC (Mediatek MT6360)"
	depends on MTK_FLASHLIGHT && RT_FLASHLIGHT
	help
	  This is for the flashlight driver IC (Mediatek MT6360).

	  Say Y here if you want a flashlight driver IC MT6360.
	  Select this only if your board has this IC.

	  Say M here if you want to compile this driver as a module.

config MTK_FLASHLIGHT_DUMMY
	tristate "Mediatek flashlight dummy driver"
	depends on MTK_FLASHLIGHT
	help
	  This is flashlight dummy driver for camera.

	  Say Y here if you want a dummy driver IC with I2C interface.
	  Select this only if your board has this IC.

	  Say M here if you want to compile this driver as a module.

config MTK_FLASHLIGHT_DUMMY_GPIO
	tristate "Mediatek flashlight dummy gpio driver"
	depends on MTK_FLASHLIGHT
	help
	  This is flashlight dummy gpio driver for camera.

	  Say Y here if you want a dummy driver IC with GPIO interface.
	  Select this only if your board has this IC.

	  Say M here if you want to compile this driver as a module.

config MTK_FLASHLIGHT_DEBUG
	bool "Mediatek flashlight debugging messages"
	depends on MTK_FLASHLIGHT
	help
	  Say Y here if you want the flashlight to produce a bunch of debug
	  messages to the system log.

	  Select this if you are having a problem with flashlight support
	  and want to see more of what is going on.

config MTK_FLASHLIGHT_PT
	bool "Mediatek flashlight power throttling"
	depends on MTK_FLASHLIGHT
	help
	  This is for flashlight power throttling.

	  Power throttling will limit flashlight function,
	  such as disable flashlight, decrease brightness level or
	  change flash mode to torch mode.

config MTK_FLASHLIGHT_PT_STRICT
	bool "Mediatek flashlight power throttling (strict)"
	depends on MTK_FLASHLIGHT_PT
	help
	  This is for flashlight strict power throttling.

	  Strict power throttling will disable flashlight when
	  over-current, low battary voltage and low battary percentage
	  situations.

config MTK_FLASHLIGHT_DLPT
	bool "Mediatek flashlight dynamic low power throttling"
	depends on MTK_FLASHLIGHT
	help
	  This is for flashlight dynamic low power throttling.

	  Dynamic low power throttling is a mechanism to monitor
	  the current of battary dynamicly. It will start by request
	  and notice user by kernel notifier.
```

## drivers/misc/mediatek/flashlight/richtek/Kconfig
```kconfig
config RT_FLASHLIGHT
	bool "Richtek Flashlight Device Class"
	help
	  Say Y to enable Richtek Flashlight Device Class
	  This Framework is good for
	  controling flashlight Leds.
	  Say N to disable Richtek Flahslight Device Class
```

## drivers/misc/mediatek/flashlight/v4l2/Kconfig
```kconfig
config MTK_VIDEO_LM3643
	tristate "LM3643 dual flash driver support"
	depends on I2C && VIDEO_V4L2 && MEDIA_CONTROLLER
	depends on MEDIA_CAMERA_SUPPORT
	select REGMAP_I2C
	help
	  This is a driver for the lm3643 dual flash controllers. It controls
	  flash, torch LEDs.

	  Say Y here if you want a flashlight driver IC LM3643.
	  Select this only if your board has this IC.
	  Say M here if you want to compile this driver as a module.

config MTK_VIDEO_LM3644
	tristate "LM3644 dual flash driver support"
	depends on I2C && VIDEO_V4L2 && MEDIA_CONTROLLER
	depends on MEDIA_CAMERA_SUPPORT
	select REGMAP_I2C
	help
	  This is a driver for the lm3644 dual flash controllers. It controls
	  flash, torch LEDs.

	  Say M here if you want to compile this driver as a module.

config MTK_VIDEO_SY7806
	tristate "SY7806 dual flash driver support"
	depends on I2C && VIDEO_V4L2 && MEDIA_CONTROLLER
	depends on MEDIA_CAMERA_SUPPORT
	select REGMAP_I2C
	help
	  This is a driver for the sy7806 dual flash controllers. It controls
	  flash, torch LEDs.

	  Say M here if you want to compile this driver as a module.

config MTK_VIDEO_KTD2687
	tristate "KTD2687 dual flash driver support"
	depends on I2C && VIDEO_V4L2 && MEDIA_CONTROLLER
	depends on MEDIA_CAMERA_SUPPORT
	select REGMAP_I2C
	help
	  This is a driver for the ktd2687 dual flash controllers. It controls
	  flash, torch LEDs.

	  Say M here if you want to compile this driver as a module.
```

## drivers/misc/mediatek/fmradio/Kconfig
```kconfig
config MTK_FMRADIO
  bool CONFIG_MTK_FMRADIO
  default n
  help
    CONFIG_MTK_FMRADIO
```

## drivers/misc/mediatek/freefall_sensor/Kconfig
```kconfig
config CUSTOM_KERNEL_FREEFALL_SENSOR
	bool "CUSTOM_KERNEL_FREEFALL_SENSOR"
	help
	  Kernel freefall sensor common driver.
```

## drivers/misc/mediatek/freqhopping/Kconfig
```kconfig
config MTK_FREQ_HOPPING
	tristate "MediaTek FREQHOPPING driver"
	default N
	help
	  FREQHOPPING driver support for MediaTek SOC
	  If you want to use MediaTek FREQHOPPING driver,
	  say Y or M here.
	  If unsure, say N.
```

## drivers/misc/mediatek/gamerotationvector/Kconfig
```kconfig
config CUSTOM_KERNEL_GRV_SENSOR
	bool "CUSTOM_KERNEL_GRV_SENSOR"
	help
	  Kernel space game rotation vector sensor driver.

source "drivers/misc/mediatek/gamerotationvector/gamerotvechub/Kconfig"
```

## drivers/misc/mediatek/gate_ic/Kconfig
```kconfig
config MTK_GATE_IC
	tristate "MediaTek Gate IC Support"
	help
	  This selects the MediaTek(R) Gate IC connected to MediaTek chips.
	  If you want to use MediaTek(R) Gate IC  support, say Y or M here.
	  If unsure, say N.
	  Mediatek GATE IC module includes display gate ic, backlight gate ic.

config RT4831A_I2C
	tristate "Support rt4831 gate ic board"
	help
	  I2C gate driver for RT4831 support.
	  Set y to support.
	  Set n to disable.
	  RT4831 I2C driver for display and backlight.
```

## drivers/misc/mediatek/geniezone/Kconfig
```kconfig
menu "GZ Kree"

config HAVE_MTK_ENABLE_GENIEZONE
	bool "HAVE_MTK_ENABLE_GENIEZONE"
	select TRUSTY_INTERRUPT_FIQ_ONLY
	select TRUSTY_INTERRUPT_MAP
	select MTK_GZ_KREE
	select VIRTIO
	select MT_GZ_TRUSTY_DEBUGFS if (MTK_ENG_BUILD)
	help
	  This is used to support MTK Geniezone.
	  It is used to control MTK_ENABLE_GENIEZONE
	  and it is used in the program for ifdef operations.
	  Use MTK_ENABLE_GENIEZONE instead of TRUSTY to
	  enable it.

config MTK_ENABLE_GENIEZONE
	tristate "MTK GenieZone enable"
	depends on HAVE_MTK_ENABLE_GENIEZONE
	help
	  This is used for Trusty to support MTK Geniezone
	  Irq will be masked in trusty irq handler
	  for irq routing to GenieZone.
	  Irq work will be put to global queue when cpu dead.
	  We move the GZ TIPC driver from drivers/trusty to
	  drivers/misc/mediatek/geniezone/gz-trusty. Use
	  MTK_ENABLE_GENIEZONE instead of TRUSTY to enable it.

config MTK_GZ_MAIN
	tristate "MTK GZ_MAIN enable"
	help
	  This is used for enabling gz basic drivers.
	  Add gz_main.o, gz_ut.o, gz_sec_storage_ut.o,
	  gz_chmem_ut.o, gz_shmem_ut.o, gz_rkp_ut.o,
	  and some files in mtee_kree subdirectory by this config.
	  Say Y if you would like to enable this feature.
	  If unsure, say N.

config MTK_GZ_LOG
	tristate "MTK GZ_LOG enable"
	depends on HAVE_MTK_GZ_LOG
	help
	  This is used for enabling trusty log.
	  Add gz-log.o by this config.
	  Say Y if you would like to enable this feature.
	  If unsure, say N.

config MTK_GZ_VIRTIO
	tristate "MTK GZ_VIRTIO enable"
	help
	  This is used for enabling Geniezone Trusty VIRTIO.
	  Add trusty-virtio.o and trusty-mem.o by this config.
	  Say Y if you would like to enable this feature.
	  If unsure, say N.

config MTK_GZ_VIRTIO_IPC
	tristate "MTK GZ_VIRTIO_IPC enable"
	help
	  This is used for enabling Geniezone TRUSTY VIRTIO IPC.
	  Add trusty-ipc by this config.
	  Say Y if you would like to enable this feature.
	  If unsure, say N.

config MTK_GZ_IRQ
	tristate "MTK GZ_IRQ enable"
	help
	  This is used for enabling Geniezone IRQ.
	  Add trusty-irq by this config.
	  Say Y if you would like to enable this feature.
	  If unsure, say N.

config MTK_GZ_KREE
	bool "MediaTek GenieZone support"
	help
	  Mediatek GenieZone kernel driver
	  with APIs based on MTEE framework
	  Note that user-space API requires
	  This module to be enabled.

config GZ_VPU_WITH_M4U
	bool "GenieZone support VPU with M4U"
	depends on MTK_GZ_KREE
	help
	  GZ control VPU at M4U map.
	  Because VPU is 32 bits, only see 4G
	  dram, need use M4U to enlarge dram
	  access over 4G.

config MTK_GZ_SUPPORT_SDSP
	bool "GenieZone support SDSP"
	depends on HAVE_MTK_ENABLE_GENIEZONE
	help
	  GZ smcall into mtee for sdsp on and off.
	  When switch normal/secure vpu, need add
	  smc call into mtee for setup security
	  realted register.

source "drivers/misc/mediatek/geniezone/gz-trusty/Kconfig"

endmenu

# GZ Kree
```
