## drivers/misc/mpbe/Kconfig
```kconfig
#
# Memory performance Booster Enging
#

comment "Memory performance Booster Enging"

config MI_MPBE_SUPPORT
	tristate "Memory performance Booster Enging"
	depends on BLOCK
	help
	  Enable MPBE at block driver, tag requester pid to
	  the accessing pages. This allows UFS Block IO log to obtian
	  IO statistics of each process. The MPBE also provides
	  utility functions to UFS Block IO log, such as throughput
	  calculation, log printing, and ring trace handling.
```

## drivers/misc/mpu3050/Kconfig
```kconfig
menu "Motion Sensors Support"

choice
    tristate "Motion Processing Unit"
    depends on I2C
    optional

config MPU_SENSORS_MPU3050
    tristate "MPU3050"
    help
      If you say yes here you get support for the MPU3050 Gyroscope driver
      This driver can also be built as a module.  If so, the module
      will be called mpu3050.

config MPU_SENSORS_MPU6000
    tristate "MPU6000"
    help
      If you say yes here you get support for the MPU6000 Gyroscope driver
      This driver can also be built as a module.  If so, the module
      will be called mpu6000.

endchoice

choice
    prompt "Accelerometer Type"
    depends on MPU_SENSORS_MPU3050
    optional

config MPU_SENSORS_KXTF9
    bool "Kionix KXTF9"
    help
      This enables support for the Kionix KXFT9 accelerometer

endchoice

choice
    prompt "Compass Type"
    depends on MPU_SENSORS_MPU6000 || MPU_SENSORS_MPU3050
    optional

config MPU_SENSORS_AK8975
    bool "AKM ak8975"
    help
      This enables support for the AKM ak8975 compass

endchoice

config MPU_SENSORS_TIMERIRQ
    tristate "Timer IRQ"
    help
    If you say yes here you get access to the timerirq device handle which
    can be used to select on. This can be used instead of IRQ's, sleeping,
    or timer threads. Reading from this device returns the same type of
    information as reading from the MPU and slave IRQ's.

config MPU_SENSORS_DEBUG
    bool "MPU debug"
    depends on MPU_SENSORS_MPU3050 || MPU_SENSORS_MPU6000 || MPU_SENSORS_TIMERIRQ
    help
      If you say yes here you get extra debug messages from the MPU3050
      and other slave sensors.

endmenu
```

## drivers/misc/ocp2131_bias/Kconfig
```kconfig
#
# OCP2131 bias IC driver configuration
#

config OCP2131_BIAS
	tristate "OCP2131 bias IC"
	default m
	help
	  Say Y here if you have OCP2131 bias IC.
	  If unsure, say N.
```

## drivers/misc/perf_helper/Kconfig
```kconfig
config PERF_HELPER
        tristate "Perf helper"
        default n
        help
          this module support some base functions for performance.
```

## drivers/misc/plaid/Kconfig
```kconfig
config XIAOMI_GPU_PLAID
	tristate "Enable gpu plaid mode"
	help
	  Say Y here if you enable gpu plaid mode.

	  If unsure, say N.

	  To compile this driver as a module, choose M here:
```

## drivers/misc/pwm/Kconfig
```kconfig
if PWM

config PWM_BYT_CORE
	tristate "Intel Baytrail SoC PWM Core Logic"
	help
	  Core logic for generic PWM framework driver for Intel Baytrail SoC.

	  To compile this driver as a module, choose M here: the module
	  will be called pwm_byt_core.

config PWM_BYT_PCI
	tristate "Intel Baytrail SoC PWM PCI support"
	depends on PWM && PWM_BYT_CORE
	help
	  PCI based generic PWM framework driver for Intel Baytrail SoC.

	  To compile this driver as a module, choose M here: the module
	  will be called pwm-byt.

config PWM_BYT_PLATFORM
	tristate "Intel Baytrail SoC PWM PCI support"
	depends on PWM && PWM_BYT_CORE
	help
	  Platform driver based generic PWM framework driver for Intel Baytrail SoC.

	  To compile this driver as a module, choose M here: the module
	  will be called pwm-byt.
endif
```

## drivers/misc/qcom/Kconfig
```kconfig
config MSM_QDSP6V2_CODECS
	bool "Audio QDSP6V2 APR support"
	depends on MSM_SMD
	help
	  Enable Audio codecs with APR IPC protocol support between
	  application processor and QDSP6 for B-family. APR is
	  used by audio driver to configure QDSP6's
	  ASM, ADM and AFE.

config MSM_ULTRASOUND
	bool "QDSP6V2 HW Ultrasound support"
	help
	  Enable HW Ultrasound support in QDSP6V2.
	  QDSP6V2 can support HW encoder & decoder and
	  ultrasound processing. It will enable
	  ultrasound data paths between
	  HW and services, calculating input events
	  upon the ultrasound data.

config MSM_MCU_TIME_SYNC
       tristate "MCU time sync with apq8009"
       depends on SYSFS
       help
         Say Y here if you want to get mcu and apq8009 data transfer
         with gpio.
```

## drivers/misc/qrc/Kconfig
```kconfig
# SPDX-License-Identifier: GPL-2.0-only
#
# QRC device driver configuration
#

menu "qrc device driver"

config QRC
	bool "QRC device driver for Robotic SDK MCU"
	help
	   This kernel configuration is used to enable robotic controller
	   device driver. Say Y here if you want to enable robotic
	   controller device driver.
	   When in doubt, say N.

config QRC_DEBUG
	bool "QRC Debugging"
	depends on QRC
	help
	  Say Y here if you want the robotic controller to produce
	  a bunch of debug messages to the system log. Select this if you
	  are having a problem with robotic controller support and want
	  to see more of what is going on.
	  When in doubt, say N.
endmenu
```

## drivers/misc/rtimd-i2c/Kconfig
```kconfig
#
# RAONTECH Micro Display I2C driver configuration
#

menu "RAONTECH Micro Display I2C support"

config RTIMD_I2C
	tristate "RTIMD-I2C"
	default n
	help
	  This module is created to add support for
	  RAONTECH Micro Display I2C support.
	  If you want RAONTECH Micro Display I2C support, you should say Y.
	  Here it says m to create a ko file which can then be executed from
	  adb shell.

if RTIMD_I2C
config RTIMD_I2C_DEBUG
	bool "RTIMD debugging messages"
	default n
	help
	  Say Y here if you want the RTIMD_I2C to produce a bunch of debug
	  messages to the system log.
	  Select this if you are having a problem with RTIMD_I2C support
	  and want to see more of what is going on.
	  This will display the debug messages to the system logs.

endif # RTIMD_I2C

endmenu
```

## drivers/misc/tegra-baseband/Kconfig
```kconfig
menu "Tegra Baseband Modem Drivers"
	depends on ARCH_TEGRA

config TEGRA_BB_SUPPORT
	bool "Tegra baseband support"
	---help---
	  Say Y here to get to see options for tegra baseband support.
	  This option alone does not add any kernel code.

	  If you say N, all options in this submenu will be skipped and disabled.

if TEGRA_BB_SUPPORT

config TEGRA_USB_MODEM_POWER
        bool "Tegra USB modem power driver"
	depends on USB
        ---help---
         Say Y if you want to use one of the following modems
          i450
          i500
          i500 Nemo

	 Disabled by default. Choose Y here if you want to build the driver.

config TEGRA_BB_POWER
	bool "Enable tegra baseband power driver"
	---help---
	 Adds power management driver for managing different baseband
	 modems with tegra processor.

	 This driver should work with at least the following devices:

            * OEM #1
            * ...

	 Disabled by default. Choose Y here if you want to build the driver.

config TEGRA_BB_OEM1
	bool "Enable driver for oem modem #1"
	---help---
	 Enables driver for oem modem #1.
	 Needs TEGRA_BB_SUPPORT to be enabled.
	 Disabled by default.
	 Choose Y here if you want to build the driver.

config TEGRA_BB_OEM2
	bool "Enable driver for oem modem #2"
	---help---
	 Enables driver for oem modem #2.
	 Needs TEGRA_BB_SUPPORT to be enabled.
	 Disabled by default.
	 Choose Y here if you want to build the driver.

endif # TEGRA_BB_SUPPORT

endmenu
```

## drivers/misc/tegra-cec/Kconfig
```kconfig
config TEGRA_CEC_SUPPORT
	bool "Tegra CEC support"
	depends on ARCH_TEGRA
	---help---
	 Enables HDMI-CEC driver for Tegra SoC.
```

## drivers/misc/tegra-profiler/Kconfig
```kconfig
config TEGRA_PROFILER
	bool "Enable Tegra profiler"
	depends on ARCH_TEGRA
	help
	  This option enables Tegra profiler
```

## drivers/misc/ti-st/Kconfig
```kconfig
#
# TI's shared transport line discipline and the protocol
# drivers (BT, FM and GPS)
#
menu "Texas Instruments shared transport line discipline"
config TI_ST
	tristate "Shared transport core driver"
	depends on NET && GPIOLIB && TTY
	select FW_LOADER
	help
	  This enables the shared transport core driver for TI
	  BT / FM and GPS combo chips. This enables protocol drivers
	  to register themselves with core and send data, the responses
	  are returned to relevant protocol drivers based on their
	  packet types.

config ST_GPS
	tristate "gps driver for ST"
	select TI_ST
	help
	  This enables the GPS driver for TI WL128x BT/FM/GPS combo devices.
	  It will provide a character device for the TI GPS host software to
	  access the GPS core on the WL128x.

config ST_HCI
	tristate "HCI TTY emulation driver for Bluetooth"
	depends on TI_ST
	help
	  This enables the TTY device like emulation for HCI used by
	  user-space Bluetooth stacks.
	  It will provide a character device for user space Bluetooth stack to
	  send/receive data over shared transport.

config ST_HOST_WAKE
	tristate "Host wake up driver for protocols registered with ST"
	depends on TI_ST
	help
	  This enables the host to wake up whenever a transaction is initiated
	  by the remote side.

config ST_HOST_WAKE_GPS
	bool "Enable Host wake up driver when GPS registers with ST"
	depends on ST_HOST_WAKE
	help
	  This enables the host to wake up whenever GPS transaction is initiated
	  by the remote side.

config ST_HOST_WAKE_FM
	bool "Enable Host wake up driver when FM registers with ST"
	depends on ST_HOST_WAKE
	help
	  This enables the host to wake up whenever FM transaction is initiated
	  by the remote side.

config ST_HOST_WAKE_NFC
	bool "Enable Host wake up driver when NFC registers with ST"
	depends on ST_HOST_WAKE
	help
	  This enables the host to wake up whenever NFC transaction is initiated
	  by the remote side.
endmenu
```

## drivers/misc/tmsdrv/Kconfig
```kconfig
#
# TMS devices
#

menu "TMS devices support"

config TMS_DEVICE
    tristate "TMS Driver"
    help
        Say Y here if you have TMS device.

config TMS_NFC_DEVICE
    tristate "TMS NFC Driver"
    depends on I2C
    help
        Say Y here if you have I2C device.

config TMS_GUIDE_DEVICE
    tristate "TMS Guide Driver"
    depends on I2C && TMS_DEVICE
    help
        Say Y here to compile guidev for guide device register.

config TMS_ESE_DEVICE
    tristate "TMS ESE Driver"
    depends on SPI
    help
        Say Y here if you have SPI device.

endmenu
```

## drivers/misc/ts27010mux/Kconfig
```kconfig
#
# TS 27.010 configuration
#

menu "TS 27.010 Mux driver"

config TS27010MUX
	tristate "TS 27.010 Mux driver"
	default n

endmenu
```

## drivers/misc/type-c/Kconfig
```kconfig
menu "Typec driver ic support"

config TYPEC_DRIVER
	tristate "typec driver support"
	default n

endmenu
```

## drivers/misc/vibrator/Kconfig
```kconfig
config LEDS_SC27XX_VIBRA
	tristate "Spreadtrum sc27xx vibrator support"
	depends on LEDS_CLASS
	depends on MFD_SC27XX_PMIC || MFD_UMP96XX_PMIC || COMPILE_TEST
	help
	  This option enables support for Spreadtrum sc27xx vibrator driver.

	  To compile this driver as a module, choose M here. The module will
	  be called sc27xx_vibra.
```

## drivers/misc/wifi_gpio/Kconfig
```kconfig
# SPDX-License-Identifier: GPL-2.0-only
#
# MI_WIFI_GPIO info
#
config MI_WIFI_GPIO
	tristate "GPIO testing mode driver for sar controler"
	default n
	help
	 Driver for a simple testing mode detection
```

## drivers/misc/xiaomi/sched/Kconfig
```kconfig
config SCHED_USF
	tristate "Support user sensitive factors"
	depends on SMP
	help
	  Select this option to enable the adjustment on the cpufreq with
	  the user sensitive factors.

	  If unsure, say N.
```

## drivers/misc/xiaomi_fs/Kconfig
```kconfig
config MI_FS
  bool "Enable Mi fs Driver"
  default n
  help
    MI fs information driver includes specific information about hardware info
```

## drivers/misc/xiaomi_headset_touch_notifier/Kconfig
```kconfig
#
# Xiaomi usb touch notifier driver configuration
#

config XIAOMI_HEADSET_TOUCH_NOTIFIER
        tristate "Xiaomi headset touch notifier"
        default m
        help
          Say Y here if you use xiaomi headset touch notifier.
          If unsure, say N.
```

## drivers/misc/xiaomi_panel_notifier/Kconfig
```kconfig
#
# Xiaomi panel notifier driver configuration
#

config XIAOMI_PANEL_NOTIFIER
	tristate "Xiaomi panel notifier"
	default m
	help
	  Say Y here if you use xiaomi panel notifier.
	  If unsure, say N.
```

## drivers/misc/xiaomi_touch_notifier/Kconfig
```kconfig
#
# Xiaomi touch notifier driver configuration
#

config XIAOMI_TOUCH_NOTIFIER
	tristate "Xiaomi touch notifier"
	default m
	help
	  Say Y here if you use xiaomi touch notifier.
	  If unsure, say N.
```

## drivers/misc/xiaomi_usb_touch_notifier/Kconfig
```kconfig
#
# Xiaomi usb touch notifier driver configuration
#

config XIAOMI_USB_TOUCH_NOTIFIER
	tristate "Xiaomi usb touch notifier"
	default m
	help
	  Say Y here if you use xiaomi usb touch notifier.
	  If unsure, say N.
```

## drivers/mmc/Kconfig
```kconfig
#
# MMC subsystem configuration
#

menuconfig MMC
	tristate "MMC/SD/SDIO card support"
	depends on HAS_IOMEM
	help
	  This selects MultiMediaCard, Secure Digital and Secure
	  Digital I/O support.

	  If you want MMC/SD/SDIO support, you should say Y here and
	  also to your specific host controller driver.

config MMC_PERF_PROFILING
	bool "MMC performance profiling"
	depends on MMC != n
	default n
	help
	  If you say Y here, support will be added for collecting
	  performance numbers at the MMC Queue and Host layers.

if MMC

source "drivers/mmc/core/Kconfig"

source "drivers/mmc/host/Kconfig"

endif # MMC
```
