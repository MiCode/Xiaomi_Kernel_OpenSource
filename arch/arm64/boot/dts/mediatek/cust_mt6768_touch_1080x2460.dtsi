/*
 * Copyright (C) 2010 - 2023 Novatek, Inc.
 *
 * $Revision$
 * $Date$
 *
 * This program is free software; you can redistribute it and/or modify
 * it under the terms of the GNU General Public License as published by
 * the Free Software Foundation; either version 2 of the License, or
 * (at your option) any later version.
 *
 * This program is distributed in the hope that it will be useful, but WITHOUT
 * ANY WARRANTY; without even the implied warranty of MERCHANTABILITY or
 * FITNESS FOR A PARTICULAR PURPOSE.  See the GNU General Public License for
 * more details.
 *
 */

&spi0 {
	status = "ok";

	/* Novatek and focatech device tree node */
	touchscreen@0 {
		compatible = "novatek,NVT-ts-spi", "focaltech,fts";
		reg = <0>; //Same as CS ID
		status = "ok";
		spi-max-frequency = <9600000>;	//4800000,9600000,15000000,19200000
		novatek,reset-gpio = <&pio 152 0x00>;
		novatek,irq-gpio = <&pio 1 0x2001>;

		focaltech,reset-gpio = <&pio 152 0x00>;
		focaltech,irq-gpio = <&pio 1 0x2001>;
		focaltech,max-touch-number = <10>;
		focaltech,display-coords =  <0 0 10800 24600>;

		//novatek,pen-support;

		//novatek,spi-rd-fast-addr = <0x03F310>;

		/* MP */
		novatek,mp-support-dt;

		/* for Xiaomi N19A NT36672C TM6.79" panel module */
		novatek-mp-criteria-5985@0 {
			#address-cells = <1>;
			#size-cells = <0>;
			compatible = "novatek-mp-criteria-5985";

			/* MP Config */
			IC_X_CFG_SIZE = <16>;
			IC_Y_CFG_SIZE = <36>;
			IC_KEY_CFG_SIZE = <4>;
			X_Channel = <16>;
			Y_Channel = <36>;
			AIN_X = <0 1 2 3 4 5 6 7 8 9 10 11 12 13 14 15>;
			AIN_Y = <0 1 2 3 4 5 6 7 8 9 10 11 12 13 14 15 16 17 18 19 20 21 22 23 24 25 26 27 28 29 30 31 32 33 34 35>;
			AIN_KEY = <0 1 2 0xFF>;

			/* MP Criteria */
			PS_Config_Lmt_Short_Rawdata_P = <
/* N19A code for HQ-354046 by p-huangyunbiao at 2024/1/8 start */
				14008	14008	14008	14008	14008	14008	14008	14008	14008	14008	14008	14008	14008	14008	14008	14008
				14008	14008	14008	14008	14008	14008	14008	14008	14008	14008	14008	14008	14008	14008	14008	14008
				14008	14008	14008	14008	14008	14008	14008	14008	14008	14008	14008	14008	14008	14008	14008	14008
				14008	14008	14008	14008	14008	14008	14008	14008	14008	14008	14008	14008	14008	14008	14008	14008
				14008	14008	14008	14008	14008	14008	14008	14008	14008	14008	14008	14008	14008	14008	14008	14008
				14008	14008	14008	14008	14008	14008	14008	14008	14008	14008	14008	14008	14008	14008	14008	14008
				14008	14008	14008	14008	14008	14008	14008	14008	14008	14008	14008	14008	14008	14008	14008	14008
				14008	14008	14008	14008	14008	14008	14008	14008	14008	14008	14008	14008	14008	14008	14008	14008
				14008	14008	14008	14008	14008	14008	14008	14008	14008	14008	14008	14008	14008	14008	14008	14008
				14008	14008	14008	14008	14008	14008	14008	14008	14008	14008	14008	14008	14008	14008	14008	14008
				14008	14008	14008	14008	14008	14008	14008	14008	14008	14008	14008	14008	14008	14008	14008	14008
				14008	14008	14008	14008	14008	14008	14008	14008	14008	14008	14008	14008	14008	14008	14008	14008
				14008	14008	14008	14008	14008	14008	14008	14008	14008	14008	14008	14008	14008	14008	14008	14008
				14008	14008	14008	14008	14008	14008	14008	14008	14008	14008	14008	14008	14008	14008	14008	14008
				14008	14008	14008	14008	14008	14008	14008	14008	14008	14008	14008	14008	14008	14008	14008	14008
				14008	14008	14008	14008	14008	14008	14008	14008	14008	14008	14008	14008	14008	14008	14008	14008
				14008	14008	14008	14008	14008	14008	14008	14008	14008	14008	14008	14008	14008	14008	14008	14008
				14008	14008	14008	14008	14008	14008	14008	14008	14008	14008	14008	14008	14008	14008	14008	14008
				14008	14008	14008	14008	14008	14008	14008	14008	14008	14008	14008	14008	14008	14008	14008	14008
				14008	14008	14008	14008	14008	14008	14008	14008	14008	14008	14008	14008	14008	14008	14008	14008
				14008	14008	14008	14008	14008	14008	14008	14008	14008	14008	14008	14008	14008	14008	14008	14008
				14008	14008	14008	14008	14008	14008	14008	14008	14008	14008	14008	14008	14008	14008	14008	14008
				14008	14008	14008	14008	14008	14008	14008	14008	14008	14008	14008	14008	14008	14008	14008	14008
				14008	14008	14008	14008	14008	14008	14008	14008	14008	14008	14008	14008	14008	14008	14008	14008
				14008	14008	14008	14008	14008	14008	14008	14008	14008	14008	14008	14008	14008	14008	14008	14008
				14008	14008	14008	14008	14008	14008	14008	14008	14008	14008	14008	14008	14008	14008	14008	14008
				14008	14008	14008	14008	14008	14008	14008	14008	14008	14008	14008	14008	14008	14008	14008	14008
				14008	14008	14008	14008	14008	14008	14008	14008	14008	14008	14008	14008	14008	14008	14008	14008
				14008	14008	14008	14008	14008	14008	14008	14008	14008	14008	14008	14008	14008	14008	14008	14008
				14008	14008	14008	14008	14008	14008	14008	14008	14008	14008	14008	14008	14008	14008	14008	14008
				14008	14008	14008	14008	14008	14008	14008	14008	14008	14008	14008	14008	14008	14008	14008	14008
				14008	14008	14008	14008	14008	14008	14008	14008	14008	14008	14008	14008	14008	14008	14008	14008
				14008	14008	14008	14008	14008	14008	14008	14008	14008	14008	14008	14008	14008	14008	14008	14008
				14008	14008	14008	14008	14008	14008	14008	14008	14008	14008	14008	14008	14008	14008	14008	14008
				14008	14008	14008	14008	14008	14008	14008	14008	14008	14008	14008	14008	14008	14008	14008	14008
				14008	14008	14008	14008	14008	14008	14008	14008	14008	14008	14008	14008	14008	14008	14008	14008
/* N19A code for HQ-354046 by p-huangyunbiao at 2024/1/8 end */
				14008 14008 14008>;

			PS_Config_Lmt_Short_Rawdata_N = <
/* N19A code for HQ-354046 by p-huangyunbiao at 2024/1/8 start */
				10100	10100	10100	10100	10100	10100	10100	10100	10100	10100	10100	10100	10100	10100	10100	10100
				10100	10100	10100	10100	10100	10100	10100	10100	10100	10100	10100	10100	10100	10100	10100	10100
				10100	10100	10100	10100	10100	10100	10100	10100	10100	10100	10100	10100	10100	10100	10100	10100
				10100	10100	10100	10100	10100	10100	10100	10100	10100	10100	10100	10100	10100	10100	10100	10100
				10100	10100	10100	10100	10100	10100	10100	10100	10100	10100	10100	10100	10100	10100	10100	10100
				10100	10100	10100	10100	10100	10100	10100	10100	10100	10100	10100	10100	10100	10100	10100	10100
				10100	10100	10100	10100	10100	10100	10100	10100	10100	10100	10100	10100	10100	10100	10100	10100
				10100	10100	10100	10100	10100	10100	10100	10100	10100	10100	10100	10100	10100	10100	10100	10100
				10100	10100	10100	10100	10100	10100	10100	10100	10100	10100	10100	10100	10100	10100	10100	10100
				10100	10100	10100	10100	10100	10100	10100	10100	10100	10100	10100	10100	10100	10100	10100	10100
				10100	10100	10100	10100	10100	10100	10100	10100	10100	10100	10100	10100	10100	10100	10100	10100
				10100	10100	10100	10100	10100	10100	10100	10100	10100	10100	10100	10100	10100	10100	10100	10100
				10100	10100	10100	10100	10100	10100	10100	10100	10100	10100	10100	10100	10100	10100	10100	10100
				10100	10100	10100	10100	10100	10100	10100	10100	10100	10100	10100	10100	10100	10100	10100	10100
				10100	10100	10100	10100	10100	10100	10100	10100	10100	10100	10100	10100	10100	10100	10100	10100
				10100	10100	10100	10100	10100	10100	10100	10100	10100	10100	10100	10100	10100	10100	10100	10100
				10100	10100	10100	10100	10100	10100	10100	10100	10100	10100	10100	10100	10100	10100	10100	10100
				10100	10100	10100	10100	10100	10100	10100	10100	10100	10100	10100	10100	10100	10100	10100	10100
				10100	10100	10100	10100	10100	10100	10100	10100	10100	10100	10100	10100	10100	10100	10100	10100
				10100	10100	10100	10100	10100	10100	10100	10100	10100	10100	10100	10100	10100	10100	10100	10100
				10100	10100	10100	10100	10100	10100	10100	10100	10100	10100	10100	10100	10100	10100	10100	10100
				10100	10100	10100	10100	10100	10100	10100	10100	10100	10100	10100	10100	10100	10100	10100	10100
				10100	10100	10100	10100	10100	10100	10100	10100	10100	10100	10100	10100	10100	10100	10100	10100
				10100	10100	10100	10100	10100	10100	10100	10100	10100	10100	10100	10100	10100	10100	10100	10100
				10100	10100	10100	10100	10100	10100	10100	10100	10100	10100	10100	10100	10100	10100	10100	10100
				10100	10100	10100	10100	10100	10100	10100	10100	10100	10100	10100	10100	10100	10100	10100	10100
				10100	10100	10100	10100	10100	10100	10100	10100	10100	10100	10100	10100	10100	10100	10100	10100
				10100	10100	10100	10100	10100	10100	10100	10100	10100	10100	10100	10100	10100	10100	10100	10100
				10100	10100	10100	10100	10100	10100	10100	10100	10100	10100	10100	10100	10100	10100	10100	10100
				10100	10100	10100	10100	10100	10100	10100	10100	10100	10100	10100	10100	10100	10100	10100	10100
				10100	10100	10100	10100	10100	10100	10100	10100	10100	10100	10100	10100	10100	10100	10100	10100
				10100	10100	10100	10100	10100	10100	10100	10100	10100	10100	10100	10100	10100	10100	10100	10100
				10100	10100	10100	10100	10100	10100	10100	10100	10100	10100	10100	10100	10100	10100	10100	10100
				10100	10100	10100	10100	10100	10100	10100	10100	10100	10100	10100	10100	10100	10100	10100	10100
				10100	10100	10100	10100	10100	10100	10100	10100	10100	10100	10100	10100	10100	10100	10100	10100
				10100	10100	10100	10100	10100	10100	10100	10100	10100	10100	10100	10100	10100	10100	10100	10100
/* N19A code for HQ-354046 by p-huangyunbiao at 2024/1/8 end */
				10000 10000 10000>;

			PS_Config_Lmt_Open_Rawdata_P = <
/* N19A code for HQ-354046 by p-huangyunbiao at 2024/2/6 start */
				2782	2821	2919	2964	2993	2997	3048	2860	2887	2995	3003	2972	2990	2929	2870	2818
				2855	2876	2979	3017	3055	3059	3102	3003	2975	3025	3032	3003	3021	2964	2909	2885
				2888	2923	3028	3076	3118	3111	3161	3111	3076	3079	3088	3056	3079	2996	2950	2918
				2930	2943	3049	3095	3136	3125	3175	3121	3108	3093	3108	3076	3100	3021	2976	2953
				2955	2978	3086	3132	3181	3171	3214	3160	3133	3108	3119	3091	3105	3024	2981	2958
				2982	2981	3101	3157	3214	3200	3240	3188	3206	3156	3186	3158	3177	3087	3045	3031
				2989	3020	3118	3165	3228	3219	3256	3196	3245	3220	3227	3188	3202	3118	3058	3051
				3023	3056	3142	3196	3272	3262	3303	3234	3286	3255	3245	3216	3221	3133	3081	3081
				3083	3128	3221	3258	3338	3315	3364	3287	3300	3254	3262	3207	3209	3115	3065	3058
				3087	3125	3226	3256	3342	3311	3366	3282	3381	3332	3335	3284	3279	3182	3130	3137
				3098	3158	3259	3275	3389	3366	3416	3335	3413	3373	3375	3304	3307	3220	3167	3174
				3132	3192	3282	3324	3405	3378	3430	3339	3389	3347	3353	3317	3289	3199	3146	3164
				3161	3228	3328	3370	3450	3437	3489	3380	3458	3410	3420	3364	3315	3237	3182	3189
				3202	3273	3373	3405	3501	3471	3525	3403	3473	3426	3436	3382	3340	3240	3192	3209
				3202	3283	3381	3415	3513	3479	3543	3415	3524	3473	3479	3436	3394	3276	3240	3247
				3233	3318	3413	3447	3552	3485	3581	3448	3542	3485	3493	3447	3398	3251	3240	3259
				3230	3328	3415	3448	3553	3520	3581	3445	3562	3518	3521	3478	3422	3303	3240	3273
				3258	3360	3436	3469	3580	3553	3598	3476	3604	3557	3566	3514	3459	3342	3244	3287
				3331	3228	3310	3314	3329	3312	3368	3356	3296	3382	3382	3333	3350	3310	3324	3245
				3378	3249	3319	3322	3342	3328	3381	3364	3339	3419	3426	3378	3394	3347	3361	3283
				3424	3331	3385	3382	3402	3373	3427	3374	3364	3433	3450	3402	3417	3373	3385	3261
				3408	3315	3373	3364	3394	3371	3430	3395	3366	3438	3455	3412	3429	3385	3389	3305
				3441	3370	3424	3419	3452	3424	3480	3445	3374	3443	3452	3423	3434	3384	3388	3298
				3448	3384	3436	3440	3464	3436	3490	3455	3396	3458	3472	3437	3451	3398	3402	3318
				3431	3384	3436	3433	3459	3433	3485	3447	3455	3510	3517	3485	3499	3457	3454	3364
				3438	3399	3443	3444	3475	3451	3493	3462	3450	3492	3506	3473	3489	3441	3438	3352
				3436	3408	3459	3458	3487	3458	3511	3475	3480	3520	3536	3499	3515	3461	3464	3361
				3445	3415	3469	3465	3494	3464	3514	3471	3511	3545	3559	3525	3542	3494	3493	3402
				3438	3431	3478	3487	3511	3482	3534	3485	3499	3534	3538	3513	3524	3473	3464	3368
				3482	3472	3518	3527	3548	3510	3562	3517	3486	3515	3522	3501	3515	3471	3459	3384
				3426	3440	3494	3496	3518	3490	3541	3487	3531	3556	3571	3536	3543	3504	3478	3396
				3469	3482	3539	3538	3557	3529	3566	3511	3527	3552	3562	3536	3550	3511	3490	3422
				3458	3480	3545	3545	3566	3532	3580	3518	3536	3555	3567	3543	3556	3514	3490	3413
				3492	3515	3590	3594	3609	3583	3636	3570	3598	3622	3629	3599	3611	3563	3532	3459
				3438	3507	3587	3595	3613	3594	3641	3578	3613	3641	3637	3618	3627	3584	3538	3436
				3087	3294	3450	3648	3667	3640	3688	3618	3592	3622	3622	3601	3613	3408	3207	3053
/* N19A code for HQ-354046 by p-huangyunbiao at 2024/2/6 end */
				5120 5120 5120>;

			PS_Config_Lmt_Open_Rawdata_N = <
/* N19A code for HQ-354046 by p-huangyunbiao at 2024/2/6 start */
				1192	1209	1251	1270	1283	1285	1306	1226	1237	1283	1287	1274	1282	1255	1230	1208
				1223	1232	1277	1293	1309	1311	1330	1287	1275	1297	1300	1287	1295	1270	1247	1237
				1238	1253	1298	1318	1336	1333	1355	1333	1318	1319	1324	1310	1319	1284	1264	1250
				1256	1261	1307	1327	1344	1339	1361	1337	1332	1325	1332	1318	1328	1295	1276	1265
				1267	1276	1322	1342	1363	1359	1378	1354	1343	1332	1337	1325	1331	1296	1277	1268
				1278	1277	1329	1353	1378	1372	1388	1366	1374	1352	1366	1354	1361	1323	1305	1299
				1281	1294	1336	1357	1384	1379	1396	1370	1391	1380	1383	1366	1372	1336	1310	1307
				1295	1310	1346	1370	1402	1398	1415	1386	1408	1395	1391	1378	1381	1343	1321	1321
				1321	1340	1381	1396	1430	1421	1442	1409	1414	1394	1398	1375	1375	1335	1313	1310
				1323	1339	1382	1396	1432	1419	1442	1406	1449	1428	1429	1408	1405	1364	1342	1345
				1328	1354	1397	1403	1453	1442	1464	1429	1463	1445	1447	1416	1417	1380	1357	1360
				1342	1368	1406	1424	1459	1448	1470	1431	1453	1435	1437	1421	1409	1371	1348	1356
				1355	1384	1426	1444	1478	1473	1495	1448	1482	1462	1466	1442	1421	1387	1364	1367
				1372	1403	1445	1459	1501	1487	1511	1459	1489	1468	1472	1450	1432	1388	1368	1375
				1372	1407	1449	1463	1505	1491	1519	1463	1510	1489	1491	1472	1454	1404	1388	1391
				1385	1422	1463	1477	1522	1493	1535	1478	1518	1493	1497	1477	1456	1393	1388	1397
				1384	1426	1463	1478	1523	1508	1535	1477	1526	1508	1509	1490	1466	1415	1388	1403
				1396	1440	1472	1487	1534	1523	1542	1490	1544	1525	1528	1506	1483	1432	1390	1409
				1427	1384	1418	1420	1427	1420	1444	1438	1412	1450	1450	1429	1436	1418	1424	1391
				1448	1393	1423	1424	1432	1426	1449	1442	1431	1465	1468	1448	1454	1435	1441	1407
				1468	1427	1451	1450	1458	1445	1469	1446	1442	1471	1478	1458	1465	1445	1451	1397
				1460	1421	1445	1442	1454	1445	1470	1455	1442	1474	1481	1462	1469	1451	1453	1417
				1475	1444	1468	1465	1480	1468	1492	1477	1446	1475	1480	1467	1472	1450	1452	1414
				1478	1450	1472	1474	1484	1472	1496	1481	1456	1482	1488	1473	1479	1456	1458	1422
				1471	1450	1472	1471	1483	1471	1493	1477	1481	1504	1507	1493	1499	1481	1480	1442
				1474	1457	1475	1476	1489	1479	1497	1484	1478	1496	1502	1489	1495	1475	1474	1436
				1472	1460	1483	1482	1495	1482	1505	1489	1492	1508	1516	1499	1507	1483	1484	1441
				1477	1463	1487	1485	1498	1484	1506	1487	1505	1519	1525	1511	1518	1498	1497	1458
				1474	1471	1490	1495	1505	1492	1514	1493	1499	1514	1516	1505	1510	1489	1484	1444
				1492	1488	1508	1511	1520	1504	1526	1507	1494	1507	1510	1501	1507	1487	1483	1450
				1468	1474	1498	1498	1508	1496	1517	1495	1513	1524	1531	1516	1519	1502	1490	1456
				1487	1492	1517	1516	1525	1513	1528	1505	1511	1522	1526	1516	1522	1505	1496	1466
				1482	1492	1519	1519	1528	1514	1534	1508	1516	1523	1529	1519	1524	1506	1496	1463
				1496	1507	1538	1540	1547	1535	1558	1530	1542	1552	1555	1543	1547	1527	1514	1483
				1474	1503	1537	1541	1549	1540	1561	1534	1549	1561	1559	1550	1555	1536	1516	1472
				1323	1412	1478	1564	1571	1560	1580	1550	1540	1552	1552	1543	1549	1460	1375	1309
/* N19A code for HQ-354046 by p-huangyunbiao at 2024/2/6 end */
				(-511) (-511) (-511)>;

			PS_Config_Lmt_FW_Rawdata_P = <
/* N19A code for HQ-354046 by p-huangyunbiao at 2024/2/6 start */
				1128	1119	1098	1106	1105	1096	1100	1105	1126	1126	1124	1124	1121	1123	1114	1130
				1110	1138	1131	1109	1137	1127	1130	1102	1121	1119	1124	1114	1130	1123	1131	1130
				1117	1117	1126	1141	1121	1134	1131	1144	1107	1113	1113	1109	1100	1100	1112	1144
				1105	1123	1110	1110	1126	1107	1113	1107	1119	1119	1120	1107	1114	1117	1123	1126
				1116	1099	1113	1114	1109	1119	1117	1123	1123	1099	1102	1116	1112	1102	1099	1131
				1099	1142	1137	1123	1123	1126	1116	1099	1089	1142	1138	1154	1110	1127	1145	1130
				1100	1131	1131	1127	1123	1128	1120	1126	1112	1113	1121	1120	1127	1124	1130	1098
				1107	1120	1117	1117	1114	1113	1112	1123	1107	1112	1112	1114	1119	1119	1113	1107
				1100	1131	1140	1142	1131	1128	1144	1145	1110	1138	1137	1133	1145	1140	1144	1114
				1102	1134	1144	1133	1133	1112	1117	1114	1105	1117	1130	1140	1140	1140	1135	1128
				1100	1085	1102	1082	1109	1082	1084	1086	1112	1100	1095	1098	1093	1099	1093	1128
				1110	1100	1107	1102	1119	1105	1114	1113	1135	1154	1133	1135	1142	1114	1105	1102
				1130	1089	1099	1099	1093	1102	1099	1119	1105	1114	1126	1131	1117	1114	1119	1119
				1128	1124	1074	1095	1091	1109	1107	1137	1109	1117	1109	1131	1127	1120	1114	1119
				1109	1110	1114	1131	1117	1089	1093	1110	1100	1095	1088	1095	1102	1123	1127	1099
				1134	1119	1110	1123	1121	1117	1114	1112	1112	1123	1114	1121	1110	1137	1140	1127
				1147	1082	1103	1121	1131	1126	1128	1124	1130	1121	1089	1163	1141	1152	1163	1117
				1137	1128	1107	1109	1109	1110	1126	1105	1103	1123	1124	1117	1113	1099	1124	1144
				1114	1106	1102	1092	1112	1103	1095	1109	1134	1120	1117	1095	1112	1103	1102	1117
				1116	1147	1116	1123	1112	1123	1119	1110	1140	1110	1112	1106	1106	1117	1126	1114
				1114	1117	1112	1121	1114	1116	1126	1124	1100	1155	1162	1128	1152	1135	1130	1141
				1131	1127	1117	1113	1128	1148	1100	1106	1117	1117	1106	1145	1116	1119	1128	1121
				1120	1089	1092	1084	1091	1117	1109	1102	1131	1144	1138	1119	1137	1137	1131	1128
				1113	1089	1081	1088	1124	1144	1098	1099	1123	1106	1116	1103	1121	1128	1131	1100
				1123	1110	1110	1110	1100	1112	1109	1099	1102	1105	1093	1121	1099	1096	1117	1117
				1119	1113	1126	1117	1119	1109	1123	1120	1120	1106	1112	1113	1113	1128	1114	1116
				1116	1126	1131	1117	1117	1124	1121	1121	1119	1119	1121	1109	1116	1134	1141	1131
				1106	1106	1117	1117	1103	1141	1107	1126	1103	1114	1114	1109	1110	1114	1110	1130
				1117	1131	1141	1123	1131	1100	1127	1106	1144	1152	1144	1138	1121	1109	1113	1105
				1114	1109	1127	1105	1114	1107	1121	1106	1110	1123	1126	1127	1123	1127	1133	1098
				1133	1107	1093	1133	1121	1128	1128	1112	1105	1109	1106	1112	1127	1107	1121	1117
				1134	1126	1116	1123	1105	1135	1133	1135	1100	1131	1134	1137	1137	1126	1134	1137
				1109	1120	1135	1124	1130	1114	1128	1117	1109	1107	1120	1116	1109	1120	1110	1114
				1114	1110	1109	1105	1105	1144	1093	1086	1102	1145	1137	1145	1145	1133	1126	1151
				1130	1082	1106	1110	1074	1120	1078	1100	1102	1105	1100	1096	1096	1116	1107	1131
				1134	1134	1112	1124	1138	1123	1130	1109	1110	1114	1131	1133	1135	1109	1096	1093
/* N19A code for HQ-354046 by p-huangyunbiao at 2024/2/6 end */
				3840 3840 3840>;

			PS_Config_Lmt_FW_Rawdata_N = <
/* N19A code for HQ-354046 by p-huangyunbiao at 2024/2/6 start */
				484	479	470	474	473	470	472	473	482	482	482	482	481	481	478	484
				476	488	485	475	487	483	484	472	481	479	482	478	484	481	485	484
				479	479	482	489	481	486	485	490	475	477	477	475	472	472	476	490
				473	481	476	476	482	475	477	475	479	479	480	475	478	479	481	482
				478	471	477	478	475	479	479	481	481	471	472	478	476	472	471	485
				471	490	487	481	481	482	478	471	467	490	488	494	476	483	491	484
				472	485	485	483	481	484	480	482	476	477	481	480	483	482	484	470
				475	480	479	479	478	477	476	481	475	476	476	478	479	479	477	475
				472	485	488	490	485	484	490	491	476	488	487	485	491	488	490	478
				472	486	490	485	485	476	479	478	473	479	484	488	488	488	487	484
				472	465	472	464	475	464	464	466	476	472	469	470	469	471	469	484
				476	472	475	472	479	473	478	477	487	494	485	487	490	478	473	472
				484	467	471	471	469	472	471	479	473	478	482	485	479	478	479	479
				484	482	460	469	467	475	475	487	475	479	475	485	483	480	478	479
				475	476	478	485	479	467	469	476	472	469	466	469	472	481	483	471
				486	479	476	481	481	479	478	476	476	481	478	481	476	487	488	483
				491	464	473	481	485	482	484	482	484	481	467	499	489	494	499	479
				487	484	475	475	475	476	482	473	473	481	482	479	477	471	482	490
				478	474	472	468	476	473	469	475	486	480	479	469	476	473	472	479
				478	491	478	481	476	481	479	476	488	476	476	474	474	479	482	478
				478	479	476	481	478	478	482	482	472	495	498	484	494	487	484	489
				485	483	479	477	484	492	472	474	479	479	474	491	478	479	484	481
				480	467	468	464	467	479	475	472	485	490	488	479	487	487	485	484
				477	467	463	466	482	490	470	471	481	474	478	473	481	484	485	472
				481	476	476	476	472	476	475	471	472	473	469	481	471	470	479	479
				479	477	482	479	479	475	481	480	480	474	476	477	477	484	478	478
				478	482	485	479	479	482	481	481	479	479	481	475	478	486	489	485
				474	474	479	479	473	489	475	482	473	478	478	475	476	478	476	484
				479	485	489	481	485	472	483	474	490	494	490	488	481	475	477	473
				478	475	483	473	478	475	481	474	476	481	482	483	481	483	485	470
				485	475	469	485	481	484	484	476	473	475	474	476	483	475	481	479
				486	482	478	481	473	487	485	487	472	485	486	487	487	482	486	487
				475	480	487	482	484	478	484	479	475	475	480	478	475	480	476	478
				478	476	475	473	473	490	469	466	472	491	487	491	491	485	482	493
				484	464	474	476	460	480	462	472	472	473	472	470	470	478	475	485
				486	486	476	482	488	481	484	475	476	478	485	485	487	475	470	469
/* N19A code for HQ-354046 by p-huangyunbiao at 2024/2/6 end */
				240 240 240>;

			PS_Config_Lmt_FW_CC_P = <
/* N19A code for HQ-354046 by p-huangyunbiao at 2024/2/6 start */
				52	52	52	52	52	52	52	52	54	54	54	52	54	52	52	52
				54	52	52	52	52	52	52	54	52	52	52	52	52	52	52	52
				52	52	52	52	52	52	52	52	52	52	52	52	52	52	52	52
				54	52	52	52	52	52	52	54	52	52	52	52	52	52	52	52
				52	52	52	52	52	52	52	52	52	52	52	52	52	52	52	52
				54	52	52	52	52	52	52	54	52	52	52	52	52	52	52	54
				52	52	52	52	52	52	52	52	52	52	52	52	52	52	52	54
				54	54	54	54	54	54	54	54	52	52	52	52	52	52	52	54
				54	52	52	52	52	52	52	52	54	52	52	52	52	52	52	54
				54	52	52	54	52	54	54	54	54	54	52	52	52	52	52	54
				54	54	52	54	52	54	54	54	54	54	54	54	54	54	54	54
				54	54	54	54	54	54	54	54	54	52	52	52	52	52	52	54
				54	52	52	52	52	52	52	52	54	54	52	52	52	52	52	54
				54	54	54	54	54	54	54	54	54	54	52	52	52	52	52	54
				54	54	54	54	54	54	54	54	54	54	54	54	54	52	52	54
				54	54	54	54	54	54	54	54	54	54	54	52	54	52	52	54
				54	52	52	52	52	54	54	54	52	52	54	52	52	52	52	54
				54	52	54	54	54	54	54	54	54	54	54	52	52	52	54	55
				54	54	52	52	52	52	52	52	52	52	52	52	52	52	52	54
				55	52	52	52	52	54	54	54	54	52	52	52	52	52	52	54
				54	52	52	52	52	52	52	52	54	52	52	52	52	52	52	54
				55	52	52	52	52	52	54	52	54	54	54	52	54	54	52	54
				54	52	52	52	52	52	52	52	52	52	52	52	52	52	52	54
				55	54	54	54	54	52	54	54	54	54	54	52	54	54	54	55
				54	54	54	52	52	52	52	52	54	52	54	52	54	54	54	54
				55	54	54	54	54	54	54	54	54	52	52	52	52	52	54	54
				54	52	52	52	52	52	52	52	52	52	54	52	54	54	54	54
				55	54	54	54	54	54	54	54	54	54	54	54	54	54	54	55
				55	54	54	54	54	52	54	52	52	52	52	52	52	52	54	54
				55	54	54	54	54	54	54	54	54	52	52	52	52	52	52	54
				54	54	54	52	52	52	52	52	52	52	52	52	52	54	54	54
				55	54	54	54	54	54	54	54	54	54	54	52	54	54	54	55
				54	52	52	52	52	52	52	52	54	54	54	54	54	54	54	55
				55	54	54	54	54	52	54	54	54	52	52	52	52	52	52	54
				54	54	54	52	54	52	54	52	54	54	54	54	54	54	54	54
				52	52	54	54	54	54	54	55	54	54	54	54	54	54	52	52
/* N19A code for HQ-354046 by p-huangyunbiao at 2024/2/6 end */
				314 314 314>;

			PS_Config_Lmt_FW_CC_N = <
/* N19A code for HQ-354046 by p-huangyunbiao at 2024/2/6 start */
				24	24	24	24	24	24	24	24	24	24	24	24	24	24	24	24
				24	24	24	24	24	24	24	24	24	24	24	24	24	24	24	24
				24	24	24	24	24	24	24	24	24	24	24	24	24	24	24	24
				24	24	24	24	24	24	24	24	24	24	24	24	24	24	24	24
				24	24	24	24	24	24	24	24	24	24	24	24	24	24	24	24
				24	24	24	24	24	24	24	24	24	24	24	24	24	24	24	24
				24	24	24	24	24	24	24	24	24	24	24	24	24	24	24	24
				24	24	24	24	24	24	24	24	24	24	24	24	24	24	24	24
				24	24	24	24	24	24	24	24	24	24	24	24	24	24	24	24
				24	24	24	24	24	24	24	24	24	24	24	24	24	24	24	24
				24	24	24	24	24	24	24	24	24	24	24	24	24	24	24	24
				24	24	24	24	24	24	24	24	24	24	24	24	24	24	24	24
				24	24	24	24	24	24	24	24	24	24	24	24	24	24	24	24
				24	24	24	24	24	24	24	24	24	24	24	24	24	24	24	24
				24	24	24	24	24	24	24	24	24	24	24	24	24	24	24	24
				24	24	24	24	24	24	24	24	24	24	24	24	24	24	24	24
				24	24	24	24	24	24	24	24	24	24	24	24	24	24	24	24
				24	24	24	24	24	24	24	24	24	24	24	24	24	24	24	25
				24	24	24	24	24	24	24	24	24	24	24	24	24	24	24	24
				25	24	24	24	24	24	24	24	24	24	24	24	24	24	24	24
				24	24	24	24	24	24	24	24	24	24	24	24	24	24	24	24
				25	24	24	24	24	24	24	24	24	24	24	24	24	24	24	24
				24	24	24	24	24	24	24	24	24	24	24	24	24	24	24	24
				25	24	24	24	24	24	24	24	24	24	24	24	24	24	24	25
				24	24	24	24	24	24	24	24	24	24	24	24	24	24	24	24
				25	24	24	24	24	24	24	24	24	24	24	24	24	24	24	24
				24	24	24	24	24	24	24	24	24	24	24	24	24	24	24	24
				25	24	24	24	24	24	24	24	24	24	24	24	24	24	24	25
				25	24	24	24	24	24	24	24	24	24	24	24	24	24	24	24
				25	24	24	24	24	24	24	24	24	24	24	24	24	24	24	24
				24	24	24	24	24	24	24	24	24	24	24	24	24	24	24	24
				25	24	24	24	24	24	24	24	24	24	24	24	24	24	24	25
				24	24	24	24	24	24	24	24	24	24	24	24	24	24	24	25
				25	24	24	24	24	24	24	24	24	24	24	24	24	24	24	24
				24	24	24	24	24	24	24	24	24	24	24	24	24	24	24	24
				24	24	24	24	24	24	24	25	24	24	24	24	24	24	24	24
/* N19A code for HQ-354046 by p-huangyunbiao at 2024/2/6 end */
				0 0 0>;

			PS_Config_Lmt_FW_Diff_P = <
/* N19A code for HQ-354046 by p-huangyunbiao at 2024/1/8 start */
				50	50	50	50	50	50	50	50	50	50	50	50	50	50	50	50
				50	50	50	50	50	50	50	50	50	50	50	50	50	50	50	50
				50	50	50	50	50	50	50	50	50	50	50	50	50	50	50	50
				50	50	50	50	50	50	50	50	50	50	50	50	50	50	50	50
				50	50	50	50	50	50	50	50	50	50	50	50	50	50	50	50
				50	50	50	50	50	50	50	50	50	50	50	50	50	50	50	50
				50	50	50	50	50	50	50	50	50	50	50	50	50	50	50	50
				50	50	50	50	50	50	50	50	50	50	50	50	50	50	50	50
				50	50	50	50	50	50	50	50	50	50	50	50	50	50	50	50
				50	50	50	50	50	50	50	50	50	50	50	50	50	50	50	50
				50	50	50	50	50	50	50	50	50	50	50	50	50	50	50	50
				50	50	50	50	50	50	50	50	50	50	50	50	50	50	50	50
				50	50	50	50	50	50	50	50	50	50	50	50	50	50	50	50
				50	50	50	50	50	50	50	50	50	50	50	50	50	50	50	50
				50	50	50	50	50	50	50	50	50	50	50	50	50	50	50	50
				50	50	50	50	50	50	50	50	50	50	50	50	50	50	50	50
				50	50	50	50	50	50	50	50	50	50	50	50	50	50	50	50
				50	50	50	50	50	50	50	50	50	50	50	50	50	50	50	50
				50	50	50	50	50	50	50	50	50	50	50	50	50	50	50	50
				50	50	50	50	50	50	50	50	50	50	50	50	50	50	50	50
				50	50	50	50	50	50	50	50	50	50	50	50	50	50	50	50
				50	50	50	50	50	50	50	50	50	50	50	50	50	50	50	50
				50	50	50	50	50	50	50	50	50	50	50	50	50	50	50	50
				50	50	50	50	50	50	50	50	50	50	50	50	50	50	50	50
				50	50	50	50	50	50	50	50	50	50	50	50	50	50	50	50
				50	50	50	50	50	50	50	50	50	50	50	50	50	50	50	50
				50	50	50	50	50	50	50	50	50	50	50	50	50	50	50	50
				50	50	50	50	50	50	50	50	50	50	50	50	50	50	50	50
				50	50	50	50	50	50	50	50	50	50	50	50	50	50	50	50
				50	50	50	50	50	50	50	50	50	50	50	50	50	50	50	50
				50	50	50	50	50	50	50	50	50	50	50	50	50	50	50	50
				50	50	50	50	50	50	50	50	50	50	50	50	50	50	50	50
				50	50	50	50	50	50	50	50	50	50	50	50	50	50	50	50
				50	50	50	50	50	50	50	50	50	50	50	50	50	50	50	50
				50	50	50	50	50	50	50	50	50	50	50	50	50	50	50	50
				50	50	50	50	50	50	50	50	50	50	50	50	50	50	50	50
/* N19A code for HQ-354046 by p-huangyunbiao at 2024/1/8 end */
				75 75 75>;

			PS_Config_Lmt_FW_Diff_N = <
/* N19A code for HQ-354046 by p-huangyunbiao at 2024/1/8 start */
				(-50)	(-50)	(-50)	(-50)	(-50)	(-50)	(-50)	(-50)	(-50)	(-50)	(-50)	(-50)	(-50)	(-50)	(-50)	(-50)
				(-50)	(-50)	(-50)	(-50)	(-50)	(-50)	(-50)	(-50)	(-50)	(-50)	(-50)	(-50)	(-50)	(-50)	(-50)	(-50)
				(-50)	(-50)	(-50)	(-50)	(-50)	(-50)	(-50)	(-50)	(-50)	(-50)	(-50)	(-50)	(-50)	(-50)	(-50)	(-50)
				(-50)	(-50)	(-50)	(-50)	(-50)	(-50)	(-50)	(-50)	(-50)	(-50)	(-50)	(-50)	(-50)	(-50)	(-50)	(-50)
				(-50)	(-50)	(-50)	(-50)	(-50)	(-50)	(-50)	(-50)	(-50)	(-50)	(-50)	(-50)	(-50)	(-50)	(-50)	(-50)
				(-50)	(-50)	(-50)	(-50)	(-50)	(-50)	(-50)	(-50)	(-50)	(-50)	(-50)	(-50)	(-50)	(-50)	(-50)	(-50)
				(-50)	(-50)	(-50)	(-50)	(-50)	(-50)	(-50)	(-50)	(-50)	(-50)	(-50)	(-50)	(-50)	(-50)	(-50)	(-50)
				(-50)	(-50)	(-50)	(-50)	(-50)	(-50)	(-50)	(-50)	(-50)	(-50)	(-50)	(-50)	(-50)	(-50)	(-50)	(-50)
				(-50)	(-50)	(-50)	(-50)	(-50)	(-50)	(-50)	(-50)	(-50)	(-50)	(-50)	(-50)	(-50)	(-50)	(-50)	(-50)
				(-50)	(-50)	(-50)	(-50)	(-50)	(-50)	(-50)	(-50)	(-50)	(-50)	(-50)	(-50)	(-50)	(-50)	(-50)	(-50)
				(-50)	(-50)	(-50)	(-50)	(-50)	(-50)	(-50)	(-50)	(-50)	(-50)	(-50)	(-50)	(-50)	(-50)	(-50)	(-50)
				(-50)	(-50)	(-50)	(-50)	(-50)	(-50)	(-50)	(-50)	(-50)	(-50)	(-50)	(-50)	(-50)	(-50)	(-50)	(-50)
				(-50)	(-50)	(-50)	(-50)	(-50)	(-50)	(-50)	(-50)	(-50)	(-50)	(-50)	(-50)	(-50)	(-50)	(-50)	(-50)
				(-50)	(-50)	(-50)	(-50)	(-50)	(-50)	(-50)	(-50)	(-50)	(-50)	(-50)	(-50)	(-50)	(-50)	(-50)	(-50)
				(-50)	(-50)	(-50)	(-50)	(-50)	(-50)	(-50)	(-50)	(-50)	(-50)	(-50)	(-50)	(-50)	(-50)	(-50)	(-50)
				(-50)	(-50)	(-50)	(-50)	(-50)	(-50)	(-50)	(-50)	(-50)	(-50)	(-50)	(-50)	(-50)	(-50)	(-50)	(-50)
				(-50)	(-50)	(-50)	(-50)	(-50)	(-50)	(-50)	(-50)	(-50)	(-50)	(-50)	(-50)	(-50)	(-50)	(-50)	(-50)
				(-50)	(-50)	(-50)	(-50)	(-50)	(-50)	(-50)	(-50)	(-50)	(-50)	(-50)	(-50)	(-50)	(-50)	(-50)	(-50)
				(-50)	(-50)	(-50)	(-50)	(-50)	(-50)	(-50)	(-50)	(-50)	(-50)	(-50)	(-50)	(-50)	(-50)	(-50)	(-50)
				(-50)	(-50)	(-50)	(-50)	(-50)	(-50)	(-50)	(-50)	(-50)	(-50)	(-50)	(-50)	(-50)	(-50)	(-50)	(-50)
				(-50)	(-50)	(-50)	(-50)	(-50)	(-50)	(-50)	(-50)	(-50)	(-50)	(-50)	(-50)	(-50)	(-50)	(-50)	(-50)
				(-50)	(-50)	(-50)	(-50)	(-50)	(-50)	(-50)	(-50)	(-50)	(-50)	(-50)	(-50)	(-50)	(-50)	(-50)	(-50)
				(-50)	(-50)	(-50)	(-50)	(-50)	(-50)	(-50)	(-50)	(-50)	(-50)	(-50)	(-50)	(-50)	(-50)	(-50)	(-50)
				(-50)	(-50)	(-50)	(-50)	(-50)	(-50)	(-50)	(-50)	(-50)	(-50)	(-50)	(-50)	(-50)	(-50)	(-50)	(-50)
				(-50)	(-50)	(-50)	(-50)	(-50)	(-50)	(-50)	(-50)	(-50)	(-50)	(-50)	(-50)	(-50)	(-50)	(-50)	(-50)
				(-50)	(-50)	(-50)	(-50)	(-50)	(-50)	(-50)	(-50)	(-50)	(-50)	(-50)	(-50)	(-50)	(-50)	(-50)	(-50)
				(-50)	(-50)	(-50)	(-50)	(-50)	(-50)	(-50)	(-50)	(-50)	(-50)	(-50)	(-50)	(-50)	(-50)	(-50)	(-50)
				(-50)	(-50)	(-50)	(-50)	(-50)	(-50)	(-50)	(-50)	(-50)	(-50)	(-50)	(-50)	(-50)	(-50)	(-50)	(-50)
				(-50)	(-50)	(-50)	(-50)	(-50)	(-50)	(-50)	(-50)	(-50)	(-50)	(-50)	(-50)	(-50)	(-50)	(-50)	(-50)
				(-50)	(-50)	(-50)	(-50)	(-50)	(-50)	(-50)	(-50)	(-50)	(-50)	(-50)	(-50)	(-50)	(-50)	(-50)	(-50)
				(-50)	(-50)	(-50)	(-50)	(-50)	(-50)	(-50)	(-50)	(-50)	(-50)	(-50)	(-50)	(-50)	(-50)	(-50)	(-50)
				(-50)	(-50)	(-50)	(-50)	(-50)	(-50)	(-50)	(-50)	(-50)	(-50)	(-50)	(-50)	(-50)	(-50)	(-50)	(-50)
				(-50)	(-50)	(-50)	(-50)	(-50)	(-50)	(-50)	(-50)	(-50)	(-50)	(-50)	(-50)	(-50)	(-50)	(-50)	(-50)
				(-50)	(-50)	(-50)	(-50)	(-50)	(-50)	(-50)	(-50)	(-50)	(-50)	(-50)	(-50)	(-50)	(-50)	(-50)	(-50)
				(-50)	(-50)	(-50)	(-50)	(-50)	(-50)	(-50)	(-50)	(-50)	(-50)	(-50)	(-50)	(-50)	(-50)	(-50)	(-50)
				(-50)	(-50)	(-50)	(-50)	(-50)	(-50)	(-50)	(-50)	(-50)	(-50)	(-50)	(-50)	(-50)	(-50)	(-50)	(-50)
/* N19A code for HQ-354046 by p-huangyunbiao at 2024/1/8 end */
				(-75) (-75) (-75)>;

			PS_Config_Diff_Test_Frame = <50>;
		};

/* N19A code for HQ-378484 by p-huangyunbiao at 2024/3/20 start */
		/* for Xiaomi N19A NT36672S Truly JDI 6.79" panel module */
		novatek-mp-criteria-598C@0 {
			#address-cells = <1>;
			#size-cells = <0>;
			compatible = "novatek-mp-criteria-598C";

			/* MP Config */
			IC_X_CFG_SIZE = <16>;
			IC_Y_CFG_SIZE = <36>;
			IC_KEY_CFG_SIZE = <4>;
			X_Channel = <16>;
			Y_Channel = <36>;
			AIN_X = <0 1 2 3 4 5 6 7 8 9 10 11 12 13 14 15>;
			AIN_Y = <0 1 2 3 4 5 6 7 8 9 10 11 12 13 14 15 16 17 18 19 20 21 22 23 24 25 26 27 28 29 30 31 32 33 34 35>;
			AIN_KEY = <0 1 2 0xFF>;

			/* MP Criteria */
			PS_Config_Lmt_Short_Rawdata_P = <
				14008 14008 14008 14008 14008 14008 14008 14008 14008 14008 14008 14008 14008 14008 14008 14008
				14008 14008 14008 14008 14008 14008 14008 14008 14008 14008 14008 14008 14008 14008 14008 14008
				14008 14008 14008 14008 14008 14008 14008 14008 14008 14008 14008 14008 14008 14008 14008 14008
				14008 14008 14008 14008 14008 14008 14008 14008 14008 14008 14008 14008 14008 14008 14008 14008
				14008 14008 14008 14008 14008 14008 14008 14008 14008 14008 14008 14008 14008 14008 14008 14008
				14008 14008 14008 14008 14008 14008 14008 14008 14008 14008 14008 14008 14008 14008 14008 14008
				14008 14008 14008 14008 14008 14008 14008 14008 14008 14008 14008 14008 14008 14008 14008 14008
				14008 14008 14008 14008 14008 14008 14008 14008 14008 14008 14008 14008 14008 14008 14008 14008
				14008 14008 14008 14008 14008 14008 14008 14008 14008 14008 14008 14008 14008 14008 14008 14008
				14008 14008 14008 14008 14008 14008 14008 14008 14008 14008 14008 14008 14008 14008 14008 14008
				14008 14008 14008 14008 14008 14008 14008 14008 14008 14008 14008 14008 14008 14008 14008 14008
				14008 14008 14008 14008 14008 14008 14008 14008 14008 14008 14008 14008 14008 14008 14008 14008
				14008 14008 14008 14008 14008 14008 14008 14008 14008 14008 14008 14008 14008 14008 14008 14008
				14008 14008 14008 14008 14008 14008 14008 14008 14008 14008 14008 14008 14008 14008 14008 14008
				14008 14008 14008 14008 14008 14008 14008 14008 14008 14008 14008 14008 14008 14008 14008 14008
				14008 14008 14008 14008 14008 14008 14008 14008 14008 14008 14008 14008 14008 14008 14008 14008
				14008 14008 14008 14008 14008 14008 14008 14008 14008 14008 14008 14008 14008 14008 14008 14008
				14008 14008 14008 14008 14008 14008 14008 14008 14008 14008 14008 14008 14008 14008 14008 14008
				14008 14008 14008 14008 14008 14008 14008 14008 14008 14008 14008 14008 14008 14008 14008 14008
				14008 14008 14008 14008 14008 14008 14008 14008 14008 14008 14008 14008 14008 14008 14008 14008
				14008 14008 14008 14008 14008 14008 14008 14008 14008 14008 14008 14008 14008 14008 14008 14008
				14008 14008 14008 14008 14008 14008 14008 14008 14008 14008 14008 14008 14008 14008 14008 14008
				14008 14008 14008 14008 14008 14008 14008 14008 14008 14008 14008 14008 14008 14008 14008 14008
				14008 14008 14008 14008 14008 14008 14008 14008 14008 14008 14008 14008 14008 14008 14008 14008
				14008 14008 14008 14008 14008 14008 14008 14008 14008 14008 14008 14008 14008 14008 14008 14008
				14008 14008 14008 14008 14008 14008 14008 14008 14008 14008 14008 14008 14008 14008 14008 14008
				14008 14008 14008 14008 14008 14008 14008 14008 14008 14008 14008 14008 14008 14008 14008 14008
				14008 14008 14008 14008 14008 14008 14008 14008 14008 14008 14008 14008 14008 14008 14008 14008
				14008 14008 14008 14008 14008 14008 14008 14008 14008 14008 14008 14008 14008 14008 14008 14008
				14008 14008 14008 14008 14008 14008 14008 14008 14008 14008 14008 14008 14008 14008 14008 14008
				14008 14008 14008 14008 14008 14008 14008 14008 14008 14008 14008 14008 14008 14008 14008 14008
				14008 14008 14008 14008 14008 14008 14008 14008 14008 14008 14008 14008 14008 14008 14008 14008
				14008 14008 14008 14008 14008 14008 14008 14008 14008 14008 14008 14008 14008 14008 14008 14008
				14008 14008 14008 14008 14008 14008 14008 14008 14008 14008 14008 14008 14008 14008 14008 14008
				14008 14008 14008 14008 14008 14008 14008 14008 14008 14008 14008 14008 14008 14008 14008 14008
				14008 14008 14008 14008 14008 14008 14008 14008 14008 14008 14008 14008 14008 14008 14008 14008
				14008 14008 14008>;

			PS_Config_Lmt_Short_Rawdata_N = <
				10000 10000 10000 10000 10000 10000 10000 10000 10000 10000 10000 10000 10000 10000 10000 10000
				10000 10000 10000 10000 10000 10000 10000 10000 10000 10000 10000 10000 10000 10000 10000 10000
				10000 10000 10000 10000 10000 10000 10000 10000 10000 10000 10000 10000 10000 10000 10000 10000
				10000 10000 10000 10000 10000 10000 10000 10000 10000 10000 10000 10000 10000 10000 10000 10000
				10000 10000 10000 10000 10000 10000 10000 10000 10000 10000 10000 10000 10000 10000 10000 10000
				10000 10000 10000 10000 10000 10000 10000 10000 10000 10000 10000 10000 10000 10000 10000 10000
				10000 10000 10000 10000 10000 10000 10000 10000 10000 10000 10000 10000 10000 10000 10000 10000
				10000 10000 10000 10000 10000 10000 10000 10000 10000 10000 10000 10000 10000 10000 10000 10000
				10000 10000 10000 10000 10000 10000 10000 10000 10000 10000 10000 10000 10000 10000 10000 10000
				10000 10000 10000 10000 10000 10000 10000 10000 10000 10000 10000 10000 10000 10000 10000 10000
				10000 10000 10000 10000 10000 10000 10000 10000 10000 10000 10000 10000 10000 10000 10000 10000
				10000 10000 10000 10000 10000 10000 10000 10000 10000 10000 10000 10000 10000 10000 10000 10000
				10000 10000 10000 10000 10000 10000 10000 10000 10000 10000 10000 10000 10000 10000 10000 10000
				10000 10000 10000 10000 10000 10000 10000 10000 10000 10000 10000 10000 10000 10000 10000 10000
				10000 10000 10000 10000 10000 10000 10000 10000 10000 10000 10000 10000 10000 10000 10000 10000
				10000 10000 10000 10000 10000 10000 10000 10000 10000 10000 10000 10000 10000 10000 10000 10000
				10000 10000 10000 10000 10000 10000 10000 10000 10000 10000 10000 10000 10000 10000 10000 10000
				10000 10000 10000 10000 10000 10000 10000 10000 10000 10000 10000 10000 10000 10000 10000 10000
				10000 10000 10000 10000 10000 10000 10000 10000 10000 10000 10000 10000 10000 10000 10000 10000
				10000 10000 10000 10000 10000 10000 10000 10000 10000 10000 10000 10000 10000 10000 10000 10000
				10000 10000 10000 10000 10000 10000 10000 10000 10000 10000 10000 10000 10000 10000 10000 10000
				10000 10000 10000 10000 10000 10000 10000 10000 10000 10000 10000 10000 10000 10000 10000 10000
				10000 10000 10000 10000 10000 10000 10000 10000 10000 10000 10000 10000 10000 10000 10000 10000
				10000 10000 10000 10000 10000 10000 10000 10000 10000 10000 10000 10000 10000 10000 10000 10000
				10000 10000 10000 10000 10000 10000 10000 10000 10000 10000 10000 10000 10000 10000 10000 10000
				10000 10000 10000 10000 10000 10000 10000 10000 10000 10000 10000 10000 10000 10000 10000 10000
				10000 10000 10000 10000 10000 10000 10000 10000 10000 10000 10000 10000 10000 10000 10000 10000
				10000 10000 10000 10000 10000 10000 10000 10000 10000 10000 10000 10000 10000 10000 10000 10000
				10000 10000 10000 10000 10000 10000 10000 10000 10000 10000 10000 10000 10000 10000 10000 10000
				10000 10000 10000 10000 10000 10000 10000 10000 10000 10000 10000 10000 10000 10000 10000 10000
				10000 10000 10000 10000 10000 10000 10000 10000 10000 10000 10000 10000 10000 10000 10000 10000
				10000 10000 10000 10000 10000 10000 10000 10000 10000 10000 10000 10000 10000 10000 10000 10000
				10000 10000 10000 10000 10000 10000 10000 10000 10000 10000 10000 10000 10000 10000 10000 10000
				10000 10000 10000 10000 10000 10000 10000 10000 10000 10000 10000 10000 10000 10000 10000 10000
				10000 10000 10000 10000 10000 10000 10000 10000 10000 10000 10000 10000 10000 10000 10000 10000
				10000 10000 10000 10000 10000 10000 10000 10000 10000 10000 10000 10000 10000 10000 10000 10000
				10000 10000 10000>;

			PS_Config_Lmt_Open_Rawdata_P = <
/* N19A code for HQ-378478 by p-huangyunbiao at 2024/5/7 start */
				3763 4213 4241 4262 4220 4233 4247 4104 4222 4397 4382 4364 4346 4292 4219 3732
				3792 4237 4254 4265 4225 4241 4256 4184 4228 4319 4302 4280 4265 4211 4158 3687
				4197 4230 4242 4255 4215 4229 4245 4250 4336 4349 4335 4314 4303 4246 4198 4140
				4105 4112 4123 4132 4089 4100 4116 4121 4266 4259 4242 4226 4219 4172 4129 4076
				4062 4072 4082 4089 4052 4061 4081 4087 4215 4205 4189 4173 4174 4130 4088 4036
				4073 4070 4095 4100 4061 4076 4088 4097 4226 4192 4201 4183 4188 4146 4105 4055
				4064 4086 4091 4098 4056 4069 4080 4087 4101 4095 4079 4062 4071 4035 3994 3948
				3993 4020 4003 4029 3990 4002 4015 4019 4066 4061 4025 4030 4044 4005 3969 3922
				3970 4002 4006 4009 3967 3977 3989 3991 4029 4026 4015 3998 4014 3979 3944 3900
				3932 3966 3969 3970 3935 3944 3956 3956 4002 4001 3991 3971 3996 3965 3932 3884
				3877 3915 3922 3899 3878 3890 3904 3898 4042 4042 4033 3995 4047 4011 3977 3932
				3842 3882 3882 3887 3844 3852 3864 3858 3937 3949 3937 3918 3953 3922 3889 3843
				3802 3844 3848 3852 3788 3815 3825 3821 3887 3890 3881 3865 3882 3875 3843 3801
				3777 3822 3827 3829 3783 3792 3802 3796 3829 3837 3829 3811 3854 3829 3802 3756
				3757 3803 3806 3810 3764 3774 3787 3778 3779 3787 3778 3760 3807 3782 3759 3715
				3718 3760 3770 3770 3725 3715 3744 3735 3719 3730 3722 3702 3746 3710 3706 3664
				3653 3693 3703 3705 3655 3668 3678 3666 3701 3713 3705 3687 3734 3716 3694 3654
				3646 3681 3695 3698 3647 3656 3658 3651 3639 3659 3647 3631 3678 3665 3636 3604
				3573 3608 3630 3648 3597 3602 3602 3604 3577 3584 3576 3563 3608 3609 3591 3559
				3547 3584 3607 3624 3573 3580 3590 3576 3541 3557 3546 3536 3580 3580 3571 3535
				3512 3550 3572 3590 3539 3547 3558 3530 3456 3467 3460 3453 3496 3497 3489 3439
				3479 3515 3539 3555 3504 3508 3518 3507 3430 3448 3438 3432 3475 3476 3469 3433
				3395 3432 3453 3472 3425 3425 3439 3421 3367 3384 3373 3365 3410 3411 3412 3376
				3364 3398 3419 3439 3389 3395 3407 3383 3310 3336 3325 3316 3361 3364 3365 3331
				3340 3375 3392 3414 3364 3367 3376 3361 3279 3291 3281 3277 3321 3325 3328 3299
				3258 3290 3308 3329 3282 3285 3295 3279 3241 3259 3250 3248 3291 3295 3299 3271
				3253 3279 3297 3316 3270 3272 3283 3265 3200 3217 3209 3205 3246 3249 3253 3238
				3180 3204 3222 3241 3200 3197 3209 3194 3122 3141 3131 3127 3174 3175 3177 3167
				3161 3180 3197 3214 3166 3163 3176 3159 3045 3063 3055 3049 3095 3100 3101 3090
				3108 3125 3142 3158 3111 3108 3123 3102 2993 3015 3008 3003 3052 3061 3062 3055
				3020 3040 3055 3070 3026 3023 3034 3024 2987 3000 2995 2993 3044 3051 3054 3050
				2970 2986 2999 3014 2973 2971 2981 2966 2909 2928 2924 2922 2968 2976 2979 2979
				2906 2924 2935 2950 2909 2907 2917 2899 2841 2861 2852 2853 2901 2905 2912 2913
				2961 2978 2984 2997 2954 2948 2960 2944 2835 2857 2850 2847 2899 2906 2910 2912
				2569 2838 2848 2861 2821 2817 2826 2808 2781 2800 2794 2791 2847 2853 2857 2595
				2490 2843 2845 2853 2813 2814 2820 2801 2694 2717 2711 2707 2764 2771 2777 2458
/* N19A code for HQ-378478 by p-huangyunbiao at 2024/5/7 end */
				5120 5120 5120>;

			PS_Config_Lmt_Open_Rawdata_N = <
/* N19A code for HQ-378478 by p-huangyunbiao at 2024/5/7 start */
				1612 1805 1817 1826 1808 1814 1820 1758 1809 1884 1878 1870 1862 1839 1808 1599
				1625 1816 1823 1828 1810 1817 1824 1793 1812 1851 1843 1834 1828 1804 1782 1580
				1799 1812 1818 1823 1806 1812 1819 1821 1858 1864 1857 1848 1844 1820 1799 1774
				1759 1762 1767 1771 1752 1757 1764 1766 1828 1825 1818 1811 1808 1788 1769 1747
				1741 1745 1749 1752 1736 1740 1749 1752 1806 1802 1795 1788 1789 1770 1752 1730
				1745 1744 1755 1757 1740 1747 1752 1756 1811 1796 1800 1793 1795 1776 1759 1738
				1741 1751 1753 1756 1738 1743 1748 1752 1757 1755 1748 1741 1744 1729 1711 1692
				1711 1723 1715 1726 1710 1715 1720 1722 1742 1740 1725 1727 1733 1716 1701 1681
				1701 1715 1717 1718 1700 1704 1709 1710 1726 1725 1720 1713 1720 1705 1690 1671
				1685 1700 1701 1701 1686 1690 1695 1695 1715 1714 1710 1701 1712 1699 1685 1665
				1661 1678 1680 1671 1662 1667 1673 1670 1732 1732 1728 1712 1734 1719 1704 1685
				1646 1664 1663 1665 1647 1651 1656 1653 1687 1692 1687 1679 1694 1680 1667 1647
				1629 1647 1649 1651 1623 1635 1639 1638 1665 1667 1663 1656 1664 1660 1647 1629
				1619 1638 1640 1641 1621 1625 1629 1627 1641 1644 1641 1633 1651 1641 1629 1610
				1610 1629 1631 1633 1613 1617 1623 1619 1620 1623 1619 1611 1631 1621 1611 1592
				1593 1611 1615 1615 1596 1592 1605 1600 1594 1598 1595 1587 1605 1590 1588 1570
				1565 1582 1587 1587 1566 1572 1576 1571 1586 1591 1587 1580 1600 1592 1583 1566
				1563 1578 1583 1585 1563 1567 1567 1564 1559 1568 1563 1556 1576 1570 1558 1544
				1531 1546 1555 1563 1541 1543 1543 1545 1533 1536 1532 1527 1546 1546 1539 1525
				1520 1536 1545 1553 1531 1534 1538 1532 1517 1524 1519 1515 1534 1534 1530 1515
				1505 1521 1531 1538 1517 1520 1524 1512 1481 1485 1483 1479 1498 1498 1495 1473
				1491 1506 1516 1523 1502 1503 1507 1503 1470 1477 1473 1471 1489 1490 1487 1471
				1455 1471 1480 1488 1468 1468 1473 1466 1443 1450 1445 1442 1461 1462 1462 1447
				1441 1456 1465 1474 1452 1455 1460 1449 1418 1429 1425 1421 1440 1441 1442 1427
				1431 1446 1453 1463 1442 1443 1447 1440 1405 1410 1406 1404 1423 1425 1426 1414
				1396 1410 1418 1426 1406 1407 1412 1405 1389 1397 1392 1392 1410 1412 1414 1401
				1394 1405 1413 1421 1401 1402 1407 1399 1371 1378 1375 1373 1391 1392 1394 1387
				1363 1373 1381 1389 1371 1370 1375 1369 1338 1346 1342 1340 1360 1360 1361 1357
				1355 1363 1370 1377 1357 1355 1361 1354 1305 1312 1309 1306 1326 1328 1329 1324
				1332 1339 1346 1353 1333 1332 1338 1329 1282 1292 1289 1287 1308 1311 1312 1309
				1294 1302 1309 1315 1297 1295 1300 1296 1280 1285 1283 1282 1304 1307 1309 1307
				1273 1279 1285 1292 1274 1273 1277 1271 1246 1255 1253 1252 1272 1275 1276 1276
				1245 1253 1258 1264 1246 1246 1250 1242 1217 1226 1222 1223 1243 1245 1248 1248
				1269 1276 1279 1284 1266 1263 1268 1262 1215 1224 1221 1220 1242 1245 1247 1248
				1101 1216 1220 1226 1209 1207 1211 1203 1192 1200 1197 1196 1220 1222 1224 1112
				1067 1218 1219 1222 1205 1206 1208 1200 1154 1164 1161 1160 1184 1187 1190 1053
/* N19A code for HQ-378478 by p-huangyunbiao at 2024/5/7 end */
				(-511) (-511) (-511)>;

			PS_Config_Lmt_FW_Rawdata_P = <
/* N19A code for HQ-378478 by p-huangyunbiao at 2024/5/7 start */
				1126 1123 1096 1103 1109 1117 1089 1107 1101 1141 1122 1119 1127 1135 1127 1117
				1098 1120 1100 1117 1097 1134 1120 1117 1110 1113 1099 1119 1098 1098 1075 1136
				1100 1143 1127 1132 1127 1098 1097 1102 1151 1161 1142 1122 1124 1139 1134 1109
				1090 1144 1134 1136 1126 1132 1123 1133 1118 1105 1098 1105 1096 1109 1118 1113
				1095 1130 1123 1124 1117 1140 1117 1116 1102 1121 1086 1096 1090 1109 1113 1110
				1097 1125 1134 1119 1131 1141 1113 1159 1124 1138 1153 1154 1131 1148 1141 1150
				1099 1122 1133 1119 1134 1109 1112 1107 1120 1097 1146 1118 1127 1143 1135 1118
				1123 1110 1103 1107 1106 1113 1094 1140 1113 1129 1127 1158 1154 1150 1144 1126
				1098 1125 1123 1132 1126 1125 1122 1125 1113 1111 1107 1099 1090 1079 1091 1112
				1127 1169 1164 1150 1174 1150 1172 1114 1110 1099 1123 1118 1103 1120 1113 1134
				1132 1157 1153 1141 1137 1143 1154 1145 1110 1090 1105 1097 1101 1108 1099 1094
				1124 1049 1081 1059 1078 1076 1070 1111 1140 1137 1146 1140 1124 1152 1143 1132
				1131 1119 1119 1125 1134 1133 1129 1129 1122 1108 1139 1119 1112 1119 1108 1120
				1148 1141 1106 1134 1118 1125 1132 1108 1091 1111 1108 1114 1116 1132 1116 1131
				1122 1089 1113 1086 1117 1108 1117 1097 1088 1080 1114 1083 1072 1116 1134 1095
				1101 1124 1148 1137 1142 1127 1130 1167 1101 1112 1118 1140 1156 1116 1144 1103
				1160 1149 1103 1134 1121 1133 1139 1138 1118 1136 1146 1133 1113 1131 1112 1135
				1126 1121 1120 1137 1131 1121 1126 1131 1097 1089 1085 1156 1160 1158 1152 1096
				1131 1101 1111 1125 1116 1133 1137 1137 1080 1126 1121 1140 1117 1123 1112 1128
				1117 1126 1061 1118 1083 1077 1081 1111 1100 1084 1081 1096 1095 1100 1099 1127
				1122 1151 1108 1127 1122 1134 1105 1103 1087 1090 1151 1159 1144 1105 1160 1110
				1108 1131 1128 1112 1106 1120 1119 1122 1143 1119 1118 1108 1113 1123 1113 1140
				1147 1133 1137 1097 1113 1125 1094 1119 1126 1138 1124 1111 1115 1111 1108 1122
				1135 1140 1148 1145 1139 1092 1083 1097 1105 1129 1129 1105 1091 1105 1126 1100
				1115 1112 1107 1120 1113 1114 1139 1138 1145 1108 1099 1115 1124 1119 1113 1099
				1073 1091 1090 1101 1094 1114 1121 1143 1112 1100 1108 1120 1110 1128 1160 1122
				1098 1136 1103 1106 1103 1123 1133 1113 1119 1110 1153 1152 1141 1144 1155 1113
				1143 1131 1117 1120 1141 1137 1126 1114 1113 1150 1084 1100 1111 1113 1095 1116
				1156 1126 1136 1160 1105 1114 1173 1145 1102 1121 1138 1119 1107 1132 1128 1132
				1123 1113 1126 1120 1116 1125 1161 1101 1089 1122 1103 1071 1101 1077 1092 1110
				1107 1130 1109 1117 1100 1097 1107 1109 1116 1131 1102 1089 1119 1099 1125 1116
				1125 1120 1118 1134 1142 1122 1113 1109 1115 1124 1105 1117 1115 1123 1123 1133
				1104 1095 1108 1113 1127 1105 1106 1106 1123 1140 1124 1115 1089 1088 1105 1119
				1163 1114 1122 1127 1116 1107 1168 1151 1106 1110 1092 1100 1093 1094 1095 1126
				1130 1147 1153 1153 1131 1148 1149 1157 1133 1147 1105 1114 1126 1131 1131 1131
				1103 1124 1095 1085 1095 1091 1129 1154 1154 1136 1106 1107 1106 1121 1113 1138
/* N19A code for HQ-378478 by p-huangyunbiao at 2024/5/7 end */
				3840 3840 3840>;

			PS_Config_Lmt_FW_Rawdata_N = <
/* N19A code for HQ-378478 by p-huangyunbiao at 2024/5/7 start */
				482 481 469 472 475 478 466 474 472 489 481 479 483 486 483 478
				470 480 471 478 470 486 480 479 475 477 471 479 470 470 460 487
				471 489 483 485 483 470 470 472 493 497 489 481 481 488 486 475
				467 490 486 486 482 485 481 485 479 473 470 473 469 475 479 477
				469 484 481 481 478 488 478 478 472 480 465 470 467 475 477 475
				470 482 486 479 484 489 477 496 481 488 494 494 484 492 489 493
				471 481 485 479 486 475 476 474 480 470 491 479 483 489 486 479
				481 475 473 474 474 477 468 488 477 484 483 496 494 493 490 482
				470 482 481 485 482 482 481 482 477 476 474 471 467 462 467 476
				483 501 499 492 503 493 502 477 476 471 481 479 473 480 477 486
				485 495 494 489 487 490 494 490 475 467 473 470 471 475 471 469
				482 449 463 454 462 461 458 476 488 487 491 488 482 493 490 485
				484 479 479 482 486 485 484 484 481 475 488 479 476 479 474 480
				492 489 474 486 479 482 485 475 467 476 475 477 478 485 478 484
				481 467 477 465 478 475 479 470 466 463 477 464 459 478 486 469
				472 481 492 487 489 483 484 500 472 476 479 488 495 478 490 473
				497 492 473 486 480 485 488 487 479 487 491 485 477 484 476 486
				482 480 480 487 484 480 482 484 470 467 465 495 497 496 493 469
				484 471 476 482 478 485 487 487 463 482 480 488 478 481 476 483
				478 482 455 479 464 461 463 476 471 464 463 469 469 471 471 483
				481 493 474 483 481 486 473 473 465 467 493 497 490 473 497 476
				474 485 483 476 474 480 479 481 490 479 479 474 477 481 477 488
				491 485 487 470 477 482 469 479 482 487 481 476 478 476 475 480
				486 488 492 490 488 468 464 470 473 484 484 473 467 473 482 471
				478 476 474 480 477 477 488 487 490 475 471 478 481 479 477 471
				459 467 467 471 469 477 480 490 476 471 474 480 475 483 497 481
				470 486 473 474 472 481 485 477 479 476 494 493 489 490 495 477
				490 484 478 480 489 487 482 477 477 493 464 471 476 477 469 478
				495 482 487 497 473 477 502 490 472 480 487 479 474 485 483 485
				481 477 482 480 478 482 497 472 466 481 472 459 472 461 468 475
				474 484 475 478 471 470 474 475 478 484 472 466 479 471 482 478
				482 480 479 486 489 481 477 475 478 482 473 478 478 481 481 485
				473 469 475 477 483 473 474 474 481 488 481 477 467 466 473 479
				498 477 480 483 478 474 500 493 474 475 468 471 468 468 469 482
				484 491 494 494 484 492 492 495 485 491 473 477 482 484 484 484
				473 481 469 465 469 467 484 494 494 486 474 474 474 480 477 487
/* N19A code for HQ-378478 by p-huangyunbiao at 2024/5/7 end */
				240 240 240>;

			PS_Config_Lmt_FW_CC_P = <
/* N19A code for HQ-378478 by p-huangyunbiao at 2024/5/7 start */
				43 42 42 42 42 42 42 42 43 42 42 42 42 42 42 43
				44 43 43 43 43 42 42 43 43 43 43 43 43 43 43 43
				43 42 42 42 42 42 42 42 42 42 42 42 42 42 42 42
				44 43 43 43 43 43 42 42 43 43 43 43 43 43 43 43
				43 42 42 42 42 42 42 42 42 42 43 42 42 42 42 42
				43 43 43 43 43 43 43 43 43 43 43 43 43 43 43 43
				43 42 42 42 42 42 42 42 42 42 42 42 42 42 42 43
				43 43 43 43 43 43 43 43 43 43 43 43 43 43 43 43
				43 42 42 42 42 42 42 42 43 42 42 42 42 42 42 43
				44 43 43 43 43 43 43 44 43 43 43 43 43 43 43 43
				43 43 43 42 43 43 43 43 43 43 43 43 43 43 43 43
				43 43 43 43 43 43 43 43 43 43 43 43 43 43 43 43
				43 42 42 42 42 42 43 42 43 43 42 43 43 42 42 43
				44 43 44 43 43 43 43 44 44 44 44 43 43 43 43 43
				43 43 43 43 43 43 43 43 43 43 42 43 43 42 42 43
				44 43 43 43 43 43 43 43 43 43 43 43 43 43 43 43
				42 42 42 42 42 43 43 43 43 43 42 43 43 42 42 43
				44 43 43 43 43 43 43 44 43 44 44 43 43 43 43 43
				43 43 43 43 43 43 43 43 44 43 43 43 43 43 43 43
				44 43 44 43 44 44 44 44 43 44 44 43 44 43 43 44
				43 42 43 43 43 43 43 43 43 43 42 42 42 43 42 43
				44 43 44 44 44 44 44 44 43 44 44 44 44 44 43 43
				43 43 43 44 43 43 44 44 43 43 43 43 43 43 43 43
				44 43 43 43 43 44 44 44 44 44 43 44 44 44 43 43
				43 42 43 43 43 43 43 43 43 43 43 43 43 43 43 43
				44 43 43 43 43 43 44 44 44 44 44 44 44 44 43 44
				43 42 43 43 43 43 43 43 43 43 42 42 42 42 42 43
				43 43 43 43 43 43 44 44 44 44 43 44 44 44 44 44
				44 43 44 44 44 43 44 44 44 43 43 43 43 43 43 43
				44 43 43 44 44 43 44 44 44 44 43 44 44 44 43 44
				43 43 43 43 43 43 43 43 44 43 43 43 43 43 43 43
				43 43 43 43 43 43 44 44 44 44 43 43 44 43 43 44
				43 43 43 43 43 43 43 43 43 43 43 43 43 43 43 43
				44 44 44 44 44 44 44 44 44 44 43 43 44 44 44 44
				43 43 43 43 42 42 43 43 43 43 43 43 43 43 43 43
				44 44 44 44 44 44 44 44 44 44 44 44 44 43 43 44
/* N19A code for HQ-378478 by p-huangyunbiao at 2024/5/7 end */
				314 314 314>;

			PS_Config_Lmt_FW_CC_N = <
/* N19A code for HQ-378478 by p-huangyunbiao at 2024/5/7 start */
				19 19 19 19 19 19 19 19 19 19 19 19 19 19 19 19
				19 19 19 19 19 19 19 19 19 19 19 19 19 19 19 19
				19 19 19 19 19 19 19 19 19 18 19 19 19 18 18 19
				19 19 19 19 19 19 19 19 19 19 19 19 19 19 19 19
				19 19 19 19 19 18 19 19 19 19 19 19 19 19 19 19
				19 19 19 19 19 19 19 19 19 19 19 19 19 19 19 19
				19 19 19 19 19 19 19 19 19 19 19 19 19 19 19 19
				19 19 19 19 19 19 19 19 19 19 19 19 19 19 19 19
				19 19 19 19 19 19 19 19 19 19 19 19 19 19 19 19
				19 19 19 19 19 19 19 19 19 19 19 19 19 19 19 19
				19 19 19 19 19 19 19 19 19 19 19 19 19 19 19 19
				19 19 19 19 19 19 19 19 19 19 19 19 19 19 19 19
				19 19 19 19 19 19 19 19 19 19 19 19 19 19 19 19
				19 19 19 19 19 19 19 19 19 19 19 19 19 19 19 19
				19 19 19 19 19 19 19 19 19 19 19 19 19 19 19 19
				19 19 19 19 19 19 19 19 19 19 19 19 19 19 19 19
				19 19 19 19 19 19 19 19 19 19 19 19 19 19 19 19
				19 19 19 19 19 19 19 19 19 19 19 19 19 19 19 19
				19 19 19 19 19 19 19 19 19 19 19 19 19 19 19 19
				19 19 19 19 19 19 19 19 19 19 19 19 19 19 19 19
				19 19 19 19 19 19 19 19 19 19 19 19 19 19 19 19
				19 19 19 19 19 19 19 20 19 19 19 19 19 19 19 19
				19 19 19 19 19 19 19 19 19 19 19 19 19 19 19 19
				19 19 19 19 19 19 20 20 19 19 19 19 19 19 19 19
				19 19 19 19 19 19 19 19 19 19 19 19 19 19 19 19
				19 19 19 19 19 19 19 19 19 20 19 19 19 19 19 19
				19 19 19 19 19 19 19 19 19 19 19 19 19 19 19 19
				19 19 19 19 19 19 19 19 19 19 19 19 19 19 19 19
				19 19 19 19 19 19 19 19 19 19 19 19 19 19 19 19
				19 19 19 19 19 19 19 20 19 19 19 19 19 19 19 19
				19 19 19 19 19 19 19 19 19 19 19 19 19 19 19 19
				19 19 19 19 19 19 19 19 19 19 19 19 19 19 19 19
				19 19 19 19 19 19 19 19 19 19 19 19 19 19 19 19
				19 19 19 19 19 19 19 20 19 19 19 19 19 19 19 19
				19 19 19 19 19 19 19 19 19 19 19 19 19 19 19 19
				20 19 19 19 19 19 20 20 19 19 19 19 19 19 19 19
/* N19A code for HQ-378478 by p-huangyunbiao at 2024/5/7 end */
				0 0 0>;

			PS_Config_Lmt_FW_Diff_P = <
/* N19A code for HQ-378478 by p-huangyunbiao at 2024/5/7 start */
				50 50 50 50 50 50 50 50 50 50 50 50 50 50 50 50
				50 50 50 50 50 50 50 50 50 50 50 50 50 50 50 50
				50 50 50 50 50 50 50 50 50 50 50 50 50 50 50 50
				50 50 50 50 50 50 50 50 50 50 50 50 50 50 50 50
				50 50 50 50 50 50 50 50 50 50 50 50 50 50 50 50
				50 50 50 50 50 50 50 50 50 50 50 50 50 50 50 50
				50 50 50 50 50 50 50 50 50 50 50 50 50 50 50 50
				50 50 50 50 50 50 50 50 50 50 50 50 50 50 50 50
				50 50 50 50 50 50 50 50 50 50 50 50 50 50 50 50
				50 50 50 50 50 50 50 50 50 50 50 50 50 50 50 50
				50 50 50 50 50 50 50 50 50 50 50 50 50 50 50 50
				50 50 50 50 50 50 50 50 50 50 50 50 50 50 50 50
				50 50 50 50 50 50 50 50 50 50 50 50 50 50 50 50
				50 50 50 50 50 50 50 50 50 50 50 50 50 50 50 50
				50 50 50 50 50 50 50 50 50 50 50 50 50 50 50 50
				50 50 50 50 50 50 50 50 50 50 50 50 50 50 50 50
				50 50 50 50 50 50 50 50 50 50 50 50 50 50 50 50
				50 50 50 50 50 50 50 50 50 50 50 50 50 50 50 50
				50 50 50 50 50 50 50 50 50 50 50 50 50 50 50 50
				50 50 50 50 50 50 50 50 50 50 50 50 50 50 50 50
				50 50 50 50 50 50 50 50 50 50 50 50 50 50 50 50
				50 50 50 50 50 50 50 50 50 50 50 50 50 50 50 50
				50 50 50 50 50 50 50 50 50 50 50 50 50 50 50 50
				50 50 50 50 50 50 50 50 50 50 50 50 50 50 50 50
				50 50 50 50 50 50 50 50 50 50 50 50 50 50 50 50
				50 50 50 50 50 50 50 50 50 50 50 50 50 50 50 50
				50 50 50 50 50 50 50 50 50 50 50 50 50 50 50 50
				50 50 50 50 50 50 50 50 50 50 50 50 50 50 50 50
				50 50 50 50 50 50 50 50 50 50 50 50 50 50 50 50
				50 50 50 50 50 50 50 50 50 50 50 50 50 50 50 50
				50 50 50 50 50 50 50 50 50 50 50 50 50 50 50 50
				50 50 50 50 50 50 50 50 50 50 50 50 50 50 50 50
				50 50 50 50 50 50 50 50 50 50 50 50 50 50 50 50
				50 50 50 50 50 50 50 50 50 50 50 50 50 50 50 50
				50 50 50 50 50 50 50 50 50 50 50 50 50 50 50 50
				50 50 50 50 50 50 50 50 50 50 50 50 50 50 50 50
/* N19A code for HQ-378478 by p-huangyunbiao at 2024/5/7 end */
				75 75 75>;

			PS_Config_Lmt_FW_Diff_N = <
/* N19A code for HQ-378478 by p-huangyunbiao at 2024/5/7 start */
				(-50) (-50) (-50) (-50) (-50) (-50) (-50) (-50) (-50) (-50) (-50) (-50) (-50) (-50) (-50) (-50)
				(-50) (-50) (-50) (-50) (-50) (-50) (-50) (-50) (-50) (-50) (-50) (-50) (-50) (-50) (-50) (-50)
				(-50) (-50) (-50) (-50) (-50) (-50) (-50) (-50) (-50) (-50) (-50) (-50) (-50) (-50) (-50) (-50)
				(-50) (-50) (-50) (-50) (-50) (-50) (-50) (-50) (-50) (-50) (-50) (-50) (-50) (-50) (-50) (-50)
				(-50) (-50) (-50) (-50) (-50) (-50) (-50) (-50) (-50) (-50) (-50) (-50) (-50) (-50) (-50) (-50)
				(-50) (-50) (-50) (-50) (-50) (-50) (-50) (-50) (-50) (-50) (-50) (-50) (-50) (-50) (-50) (-50)
				(-50) (-50) (-50) (-50) (-50) (-50) (-50) (-50) (-50) (-50) (-50) (-50) (-50) (-50) (-50) (-50)
				(-50) (-50) (-50) (-50) (-50) (-50) (-50) (-50) (-50) (-50) (-50) (-50) (-50) (-50) (-50) (-50)
				(-50) (-50) (-50) (-50) (-50) (-50) (-50) (-50) (-50) (-50) (-50) (-50) (-50) (-50) (-50) (-50)
				(-50) (-50) (-50) (-50) (-50) (-50) (-50) (-50) (-50) (-50) (-50) (-50) (-50) (-50) (-50) (-50)
				(-50) (-50) (-50) (-50) (-50) (-50) (-50) (-50) (-50) (-50) (-50) (-50) (-50) (-50) (-50) (-50)
				(-50) (-50) (-50) (-50) (-50) (-50) (-50) (-50) (-50) (-50) (-50) (-50) (-50) (-50) (-50) (-50)
				(-50) (-50) (-50) (-50) (-50) (-50) (-50) (-50) (-50) (-50) (-50) (-50) (-50) (-50) (-50) (-50)
				(-50) (-50) (-50) (-50) (-50) (-50) (-50) (-50) (-50) (-50) (-50) (-50) (-50) (-50) (-50) (-50)
				(-50) (-50) (-50) (-50) (-50) (-50) (-50) (-50) (-50) (-50) (-50) (-50) (-50) (-50) (-50) (-50)
				(-50) (-50) (-50) (-50) (-50) (-50) (-50) (-50) (-50) (-50) (-50) (-50) (-50) (-50) (-50) (-50)
				(-50) (-50) (-50) (-50) (-50) (-50) (-50) (-50) (-50) (-50) (-50) (-50) (-50) (-50) (-50) (-50)
				(-50) (-50) (-50) (-50) (-50) (-50) (-50) (-50) (-50) (-50) (-50) (-50) (-50) (-50) (-50) (-50)
				(-50) (-50) (-50) (-50) (-50) (-50) (-50) (-50) (-50) (-50) (-50) (-50) (-50) (-50) (-50) (-50)
				(-50) (-50) (-50) (-50) (-50) (-50) (-50) (-50) (-50) (-50) (-50) (-50) (-50) (-50) (-50) (-50)
				(-50) (-50) (-50) (-50) (-50) (-50) (-50) (-50) (-50) (-50) (-50) (-50) (-50) (-50) (-50) (-50)
				(-50) (-50) (-50) (-50) (-50) (-50) (-50) (-50) (-50) (-50) (-50) (-50) (-50) (-50) (-50) (-50)
				(-50) (-50) (-50) (-50) (-50) (-50) (-50) (-50) (-50) (-50) (-50) (-50) (-50) (-50) (-50) (-50)
				(-50) (-50) (-50) (-50) (-50) (-50) (-50) (-50) (-50) (-50) (-50) (-50) (-50) (-50) (-50) (-50)
				(-50) (-50) (-50) (-50) (-50) (-50) (-50) (-50) (-50) (-50) (-50) (-50) (-50) (-50) (-50) (-50)
				(-50) (-50) (-50) (-50) (-50) (-50) (-50) (-50) (-50) (-50) (-50) (-50) (-50) (-50) (-50) (-50)
				(-50) (-50) (-50) (-50) (-50) (-50) (-50) (-50) (-50) (-50) (-50) (-50) (-50) (-50) (-50) (-50)
				(-50) (-50) (-50) (-50) (-50) (-50) (-50) (-50) (-50) (-50) (-50) (-50) (-50) (-50) (-50) (-50)
				(-50) (-50) (-50) (-50) (-50) (-50) (-50) (-50) (-50) (-50) (-50) (-50) (-50) (-50) (-50) (-50)
				(-50) (-50) (-50) (-50) (-50) (-50) (-50) (-50) (-50) (-50) (-50) (-50) (-50) (-50) (-50) (-50)
				(-50) (-50) (-50) (-50) (-50) (-50) (-50) (-50) (-50) (-50) (-50) (-50) (-50) (-50) (-50) (-50)
				(-50) (-50) (-50) (-50) (-50) (-50) (-50) (-50) (-50) (-50) (-50) (-50) (-50) (-50) (-50) (-50)
				(-50) (-50) (-50) (-50) (-50) (-50) (-50) (-50) (-50) (-50) (-50) (-50) (-50) (-50) (-50) (-50)
				(-50) (-50) (-50) (-50) (-50) (-50) (-50) (-50) (-50) (-50) (-50) (-50) (-50) (-50) (-50) (-50)
				(-50) (-50) (-50) (-50) (-50) (-50) (-50) (-50) (-50) (-50) (-50) (-50) (-50) (-50) (-50) (-50)
				(-50) (-50) (-50) (-50) (-50) (-50) (-50) (-50) (-50) (-50) (-50) (-50) (-50) (-50) (-50) (-50)
/* N19A code for HQ-378478 by p-huangyunbiao at 2024/5/7 end */
				(-75) (-75) (-75)>;

			PS_Config_Diff_Test_Frame = <50>;
		};
/* N19A code for HQ-378484 by p-huangyunbiao at 2024/3/20 end */
	};
};
