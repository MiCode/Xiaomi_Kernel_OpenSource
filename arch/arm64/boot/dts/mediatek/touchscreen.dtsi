/*
 * Copyright (C) 2010 - 2023 Novatek, Inc.
 *
 * $Revision$
 * $Date$
 *
 * This program is free software; you can redistribute it and/or modify
 * it under the terms of the GNU General Public License as published by
 * the Free Software Foundation; either version 2 of the License, or
 * (at your option) any later version.
 *
 * This program is distributed in the hope that it will be useful, but WITHOUT
 * ANY WARRANTY; without even the implied warranty of MERCHANTABILITY or
 * FITNESS FOR A PARTICULAR PURPOSE.  See the GNU General Public License for
 * more details.
 *
 */


&spi3 {
	status = "okay";
        #address-cells = <1>;
	#size-cells = <0>;
	touch@0 {
		compatible = "novatek,NVT-ts-spi","focaltech,fts","chipone-tddi";
		reg = <0>; //Same as CS ID
		status = "ok";
		spi-max-frequency = <9600000>;	//4800000,9600000,15000000,19200000
 /*************** Chipone TDDI touchscreen driver device tree source include file ***************/
		//interrupt-parent = <&pio>;
		//interrupts = <0 IRQ_TYPE_EDGE_FALLING 0 0>;
		chipone,rst-gpio = <&pio 174 0x00>;
		chipone,irq-gpio = <&pio 0 0x00>;
		chipone,x-res = <719>;
		chipone,y-res = <1649>;
		/* selftest settings */
		chipone,test-reset-pin;
		chipone,test-int-pin;
		chipone,test-rawdata;
		chipone,test-rawdata-frames = <1>;
		chipone,rawdata-min              = <1100>;
		chipone,rawdata-max              = <3000>;
		chipone,test-noise;
		chipone,test-noise-frames        = <50>;
		chipone,noise-max                = <145>;
		chipone,test-open;
		chipone,open-min                 = <1850>;
		chipone,test-short;
		chipone,short-min                = <1450>;
		chipone,test-compensate-cap;
		chipone,compensate-cap-min       = <1>;
		chipone,compensate-cap-max       = <127>;
                /* Charger detect */
		chipone,touch-charger-detect-enable;
		chipone,touch-charger-detect-type = "notify"; /* notify, poll */
		chipone,touch-charger-detect-psy-name = "mtk_charger_type";
		chipone,touch-charger-detect-psp = "POWER_SUPPLY_PROP_ONLINE";
		chipone,touch-charger-detect-psp-poll-interval = <1000>;
		/* Earjack detect */
		chipone,touch-earjack-detect-enable;
		/* MTK:  /sys/bus/platform/drivers/Accdet_Driver/state,
		Sprd: /sys/kernel/headset/state
		QCOM: None, and disable it */
		chipone,touch-earjack-state-filepath = "/sys/bus/platform/drivers/Accdet_Driver/state";
		chipone,touch-earjack-poll-interval = <1000>;

        /*************** Focaltech FT8057 device tree ***************/
                focaltech,reset-gpio = <&pio 174 0x00>;
          	focaltech,irq-gpio = <&pio 0 0x2001>;
		focaltech,max-touch-number = <10>;
		focaltech,display-coords =  <0 0 719 1649>;
/*************** Novatek NT36528 device tree ***************/
		novatek,reset-gpio = <&pio 174 0x00>;
		novatek,irq-gpio = <&pio 0 0x2001>;

		/* MP */
		novatek,mp-support-dt;

		/* for Xiaomi C3Y NT36528 Truly 6.708" panel module */
		novatek-mp-criteria-5980@0 {
			#address-cells = <1>;
			#size-cells = <0>;
			compatible = "novatek-mp-criteria-5980";

			/* MP Config */
			IC_X_CFG_SIZE = <18>;
			IC_Y_CFG_SIZE = <32>;
			IC_KEY_CFG_SIZE = <4>;
			X_Channel = <18>;
			Y_Channel = <32>;
			AIN_X = <0 1 2 3 4 5 6 7 8 9 10 11 12 13 14 15 16 17>;
			AIN_Y = <0 1 2 3 4 5 6 7 8 9 10 11 12 13 14 15 16 17 18 19 20 21 22 23 24 25 26 27 28 29 30 31>;
			AIN_KEY = <0 1 2 0xFF>;

			/* MP Criteria */
			PS_Config_Lmt_Short_Rawdata_P = <
				14008 14008 14008 14008 14008 14008 14008 14008 14008 14008 14008 14008 14008 14008 14008 14008 14008 14008
				14008 14008 14008 14008 14008 14008 14008 14008 14008 14008 14008 14008 14008 14008 14008 14008 14008 14008
				14008 14008 14008 14008 14008 14008 14008 14008 14008 14008 14008 14008 14008 14008 14008 14008 14008 14008
				14008 14008 14008 14008 14008 14008 14008 14008 14008 14008 14008 14008 14008 14008 14008 14008 14008 14008
				14008 14008 14008 14008 14008 14008 14008 14008 14008 14008 14008 14008 14008 14008 14008 14008 14008 14008
				14008 14008 14008 14008 14008 14008 14008 14008 14008 14008 14008 14008 14008 14008 14008 14008 14008 14008
				14008 14008 14008 14008 14008 14008 14008 14008 14008 14008 14008 14008 14008 14008 14008 14008 14008 14008
				14008 14008 14008 14008 14008 14008 14008 14008 14008 14008 14008 14008 14008 14008 14008 14008 14008 14008
				14008 14008 14008 14008 14008 14008 14008 14008 14008 14008 14008 14008 14008 14008 14008 14008 14008 14008
				14008 14008 14008 14008 14008 14008 14008 14008 14008 14008 14008 14008 14008 14008 14008 14008 14008 14008
				14008 14008 14008 14008 14008 14008 14008 14008 14008 14008 14008 14008 14008 14008 14008 14008 14008 14008
				14008 14008 14008 14008 14008 14008 14008 14008 14008 14008 14008 14008 14008 14008 14008 14008 14008 14008
				14008 14008 14008 14008 14008 14008 14008 14008 14008 14008 14008 14008 14008 14008 14008 14008 14008 14008
				14008 14008 14008 14008 14008 14008 14008 14008 14008 14008 14008 14008 14008 14008 14008 14008 14008 14008
				14008 14008 14008 14008 14008 14008 14008 14008 14008 14008 14008 14008 14008 14008 14008 14008 14008 14008
				14008 14008 14008 14008 14008 14008 14008 14008 14008 14008 14008 14008 14008 14008 14008 14008 14008 14008
				14008 14008 14008 14008 14008 14008 14008 14008 14008 14008 14008 14008 14008 14008 14008 14008 14008 14008
				14008 14008 14008 14008 14008 14008 14008 14008 14008 14008 14008 14008 14008 14008 14008 14008 14008 14008
				14008 14008 14008 14008 14008 14008 14008 14008 14008 14008 14008 14008 14008 14008 14008 14008 14008 14008
				14008 14008 14008 14008 14008 14008 14008 14008 14008 14008 14008 14008 14008 14008 14008 14008 14008 14008
				14008 14008 14008 14008 14008 14008 14008 14008 14008 14008 14008 14008 14008 14008 14008 14008 14008 14008
				14008 14008 14008 14008 14008 14008 14008 14008 14008 14008 14008 14008 14008 14008 14008 14008 14008 14008
				14008 14008 14008 14008 14008 14008 14008 14008 14008 14008 14008 14008 14008 14008 14008 14008 14008 14008
				14008 14008 14008 14008 14008 14008 14008 14008 14008 14008 14008 14008 14008 14008 14008 14008 14008 14008
				14008 14008 14008 14008 14008 14008 14008 14008 14008 14008 14008 14008 14008 14008 14008 14008 14008 14008
				14008 14008 14008 14008 14008 14008 14008 14008 14008 14008 14008 14008 14008 14008 14008 14008 14008 14008
				14008 14008 14008 14008 14008 14008 14008 14008 14008 14008 14008 14008 14008 14008 14008 14008 14008 14008
				14008 14008 14008 14008 14008 14008 14008 14008 14008 14008 14008 14008 14008 14008 14008 14008 14008 14008
				14008 14008 14008 14008 14008 14008 14008 14008 14008 14008 14008 14008 14008 14008 14008 14008 14008 14008
				14008 14008 14008 14008 14008 14008 14008 14008 14008 14008 14008 14008 14008 14008 14008 14008 14008 14008
				14008 14008 14008 14008 14008 14008 14008 14008 14008 14008 14008 14008 14008 14008 14008 14008 14008 14008
				14008 14008 14008 14008 14008 14008 14008 14008 14008 14008 14008 14008 14008 14008 14008 14008 14008 14008
				14008 14008 14008>;

			PS_Config_Lmt_Short_Rawdata_N = <
				10100	10100	10100	10100	10100	10100	10100	10100	10100	10100	10100	10100	10100	10100	10100	10100	10100	10100
				10100	10100	10100	10100	10100	10100	10100	10100	10100	10100	10100	10100	10100	10100	10100	10100	10100	10100
				10100	10100	10100	10100	10100	10100	10100	10100	10100	10100	10100	10100	10100	10100	10100	10100	10100	10100
				10100	10100	10100	10100	10100	10100	10100	10100	10100	10100	10100	10100	10100	10100	10100	10100	10100	10100
				10100	10100	10100	10100	10100	10100	10100	10100	10100	10100	10100	10100	10100	10100	10100	10100	10100	10100
				10100	10100	10100	10100	10100	10100	10100	10100	10100	10100	10100	10100	10100	10100	10100	10100	10100	10100
				10100	10100	10100	10100	10100	10100	10100	10100	10100	10100	10100	10100	10100	10100	10100	10100	10100	10100
				10100	10100	10100	10100	10100	10100	10100	10100	10100	10100	10100	10100	10100	10100	10100	10100	10100	10100
				10100	10100	10100	10100	10100	10100	10100	10100	10100	10100	10100	10100	10100	10100	10100	10100	10100	10100
				10100	10100	10100	10100	10100	10100	10100	10100	10100	10100	10100	10100	10100	10100	10100	10100	10100	10100
				10100	10100	10100	10100	10100	10100	10100	10100	10100	10100	10100	10100	10100	10100	10100	10100	10100	10100
				10100	10100	10100	10100	10100	10100	10100	10100	10100	10100	10100	10100	10100	10100	10100	10100	10100	10100
				10100	10100	10100	10100	10100	10100	10100	10100	10100	10100	10100	10100	10100	10100	10100	10100	10100	10100
				10100	10100	10100	10100	10100	10100	10100	10100	10100	10100	10100	10100	10100	10100	10100	10100	10100	10100
				10100	10100	10100	10100	10100	10100	10100	10100	10100	10100	10100	10100	10100	10100	10100	10100	10100	10100
				10100	10100	10100	10100	10100	10100	10100	10100	10100	10100	10100	10100	10100	10100	10100	10100	10100	10100
				10100	10100	10100	10100	10100	10100	10100	10100	10100	10100	10100	10100	10100	10100	10100	10100	10100	10100
				10100	10100	10100	10100	10100	10100	10100	10100	10100	10100	10100	10100	10100	10100	10100	10100	10100	10100
				10100	10100	10100	10100	10100	10100	10100	10100	10100	10100	10100	10100	10100	10100	10100	10100	10100	10100
				10100	10100	10100	10100	10100	10100	10100	10100	10100	10100	10100	10100	10100	10100	10100	10100	10100	10100
				10100	10100	10100	10100	10100	10100	10100	10100	10100	10100	10100	10100	10100	10100	10100	10100	10100	10100
				10100	10100	10100	10100	10100	10100	10100	10100	10100	10100	10100	10100	10100	10100	10100	10100	10100	10100
				10100	10100	10100	10100	10100	10100	10100	10100	10100	10100	10100	10100	10100	10100	10100	10100	10100	10100
				10100	10100	10100	10100	10100	10100	10100	10100	10100	10100	10100	10100	10100	10100	10100	10100	10100	10100
				10100	10100	10100	10100	10100	10100	10100	10100	10100	10100	10100	10100	10100	10100	10100	10100	10100	10100
				10100	10100	10100	10100	10100	10100	10100	10100	10100	10100	10100	10100	10100	10100	10100	10100	10100	10100
				10100	10100	10100	10100	10100	10100	10100	10100	10100	10100	10100	10100	10100	10100	10100	10100	10100	10100
				10100	10100	10100	10100	10100	10100	10100	10100	10100	10100	10100	10100	10100	10100	10100	10100	10100	10100
				10100	10100	10100	10100	10100	10100	10100	10100	10100	10100	10100	10100	10100	10100	10100	10100	10100	10100
				10100	10100	10100	10100	10100	10100	10100	10100	10100	10100	10100	10100	10100	10100	10100	10100	10100	10100
				10100	10100	10100	10100	10100	10100	10100	10100	10100	10100	10100	10100	10100	10100	10100	10100	10100	10100
				10100	10100	10100	10100	10100	10100	10100	10100	10100	10100	10100	10100	10100	10100	10100	10100	10100	10100
				10000 10000 10000>;

			PS_Config_Lmt_Open_Rawdata_P = <
				4038	4010	3945	3853	3769	3709	3634	3517	65535	65535	3157	3261	3303	3339	3392	3430	3487	3553
				3828	3818	3744	3664	3591	3525	3468	3417	3356	3437	3473	3515	3553	3601	3639	3668	3727	3791
				4088	4073	4004	3926	3850	3779	3717	3660	3592	3276	3314	3346	3389	3436	3471	3500	3546	3623
				3912	3914	3842	3756	3676	3601	3543	3486	3423	3494	3532	3570	3613	3654	3696	3732	3781	3851
				4084	4098	4024	3949	3870	3794	3737	3672	3609	3374	3417	3451	3494	3539	3574	3606	3658	3724
				3951	3975	3899	3826	3751	3678	3620	3559	3497	3606	3648	3685	3727	3772	3809	3843	3893	3963
				4094	4042	3958	3888	3807	3738	3692	3634	3570	3416	3457	3500	3529	3583	3619	3644	3713	3639
				3914	3851	3776	3699	3615	3541	3494	3438	3381	3678	3714	3753	3781	3833	3875	3909	3977	3930
				4140	4077	3997	3924	3843	3774	3734	3671	3613	3525	3566	3604	3639	3685	3727	3758	3819	3781
				3989	3924	3844	3767	3686	3615	3573	3508	3451	3732	3773	3818	3846	3899	3941	3983	4045	4024
				4276	4201	4120	4053	3973	3905	3853	3795	3739	3556	3592	3634	3658	3710	3751	3777	3849	3843
				4073	4000	3916	3844	3763	3697	3648	3591	3529	3898	3940	3977	4007	4054	4101	4131	4208	4210
				4364	4287	4208	4134	4060	3991	3942	3889	3815	3693	3731	3777	3801	3853	3896	3917	3984	3993
				4159	4085	3998	3923	3851	3777	3731	3681	3611	3885	3927	3965	3987	4033	4073	4098	4171	4196
				4502	4417	4332	4260	4182	4106	4061	3998	3927	3706	3751	3784	3819	3867	3905	3933	4005	4050
				4333	4253	4168	4096	4017	3947	3902	3842	3776	3963	4007	4042	4077	4122	4161	4200	4267	4318
				4588	4502	4418	4346	4266	4190	4141	4073	4011	3829	3871	3914	3947	3998	4036	4064	4134	4200
				4428	4341	4256	4183	4099	4028	3977	3910	3846	4022	4067	4112	4148	4201	4245	4278	4344	4409
				4658	4575	4497	4417	4340	4271	4214	4159	4087	3874	3916	3966	3996	4047	4094	4124	4189	4249
				4508	4423	4346	4262	4179	4109	4050	3993	3919	4171	4215	4255	4291	4339	4388	4418	4493	4571
				4775	4694	4609	4530	4451	4385	4330	4273	4196	3986	4031	4068	4105	4155	4197	4232	4304	4378
				4630	4547	4472	4389	4311	4232	4185	4123	4046	4264	4315	4358	4388	4445	4486	4519	4579	4652
				4880	4795	4712	4640	4558	4487	4432	4365	4295	4080	4134	4173	4213	4259	4304	4341	4411	4488
				4747	4661	4585	4514	4434	4360	4304	4241	4172	4376	4430	4469	4509	4560	4598	4634	4696	4768
				5033	4953	4864	4788	4705	4621	4564	4498	4425	4147	4189	4234	4266	4312	4360	4390	4460	4526
				4862	4788	4703	4620	4540	4467	4411	4354	4280	4448	4502	4544	4584	4640	4682	4717	4785	4861
				5082	5008	4921	4840	4759	4687	4631	4568	4486	4238	4283	4325	4367	4416	4456	4488	4561	4637
				5008	4927	4843	4761	4672	4602	4546	4473	4397	4509	4554	4605	4647	4697	4752	4791	4861	4938
				5212	5137	5055	4980	4899	4819	4763	4697	4619	4353	4404	4448	4493	4544	4588	4623	4690	4767
				4575	4910	4834	4752	4672	4598	4539	4467	4399	4633	4682	4732	4778	4827	4871	4911	4969	4654
				4841	5167	5097	5019	4941	4862	4802	4738	4662	4427	4474	4519	4553	4603	4655	4690	4752	4508
				4763	5079	5047	4963	4882	4798	4735	4668	4591	4697	4749	4801	4845	4897	4948	4988	5011	4738
				5120 5120 5120>;

			PS_Config_Lmt_Open_Rawdata_N = <
				1730	1718	1691	1651	1615	1589	1558	1507	(-65535)	(-65535)	1353	1397	1415	1431	1454	1470	1495	1523
				1640	1636	1604	1570	1539	1511	1486	1465	1438	1473	1489	1507	1523	1543	1559	1572	1597	1625        
				1752	1745	1716	1682	1650	1619	1593	1568	1540	1404	1420	1434	1453	1472	1487	1500	1520	1553        
				1676	1678	1646	1610	1576	1543	1519	1494	1467	1498	1514	1530	1549	1566	1584	1600	1621	1651        
				1750	1756	1724	1693	1658	1626	1601	1574	1547	1446	1465	1479	1498	1517	1532	1546	1568	1596        
				1693	1703	1671	1640	1607	1576	1552	1525	1499	1546	1564	1579	1597	1616	1633	1647	1669	1699        
				1754	1732	1696	1666	1631	1602	1582	1558	1530	1464	1481	1500	1513	1535	1551	1562	1591	1559        
				1678	1651	1618	1585	1549	1517	1498	1474	1449	1576	1592	1609	1621	1643	1661	1675	1705	1684        
				1774	1747	1713	1682	1647	1618	1600	1573	1549	1511	1528	1544	1559	1579	1597	1610	1637	1621        
				1709	1682	1648	1615	1580	1549	1531	1504	1479	1600	1617	1636	1648	1671	1689	1707	1733	1724        
				1832	1801	1766	1737	1703	1673	1651	1627	1603	1524	1540	1558	1568	1590	1607	1619	1649	1647        
				1745	1714	1678	1648	1613	1585	1564	1539	1513	1670	1688	1705	1717	1738	1757	1771	1804	1804        
				1870	1837	1804	1772	1740	1711	1690	1667	1635	1583	1599	1619	1629	1651	1670	1679	1708	1711        
				1783	1751	1714	1681	1651	1619	1599	1577	1547	1665	1683	1699	1709	1729	1745	1756	1787	1798        
				1930	1893	1856	1826	1792	1760	1741	1714	1683	1588	1607	1622	1637	1657	1673	1685	1717	1736        
				1857	1823	1786	1756	1721	1691	1672	1646	1618	1699	1717	1732	1747	1766	1783	1800	1829	1850        
				1966	1930	1894	1862	1828	1796	1775	1745	1719	1641	1659	1678	1691	1714	1730	1742	1772	1800        
				1898	1861	1824	1793	1757	1726	1705	1676	1648	1724	1743	1762	1778	1801	1819	1834	1862	1889        
				1996	1961	1927	1893	1860	1831	1806	1783	1751	1660	1678	1700	1712	1735	1754	1768	1795	1821        
				1932	1895	1862	1826	1791	1761	1736	1711	1679	1787	1807	1823	1839	1859	1880	1894	1925	1959        
				2047	2012	1975	1942	1907	1879	1856	1831	1798	1708	1727	1744	1759	1781	1799	1814	1844	1876        
				1984	1949	1916	1881	1847	1814	1793	1767	1734	1828	1849	1868	1880	1905	1922	1937	1963	1994        
				2092	2055	2020	1988	1954	1923	1900	1871	1841	1748	1772	1789	1805	1825	1844	1861	1891	1924        
				2035	1997	1965	1934	1900	1868	1844	1817	1788	1876	1898	1915	1933	1954	1970	1986	2012	2044        
				2157	2123	2084	2052	2017	1981	1956	1928	1897	1777	1795	1814	1828	1848	1868	1882	1912	1940        
				2084	2052	2015	1980	1946	1915	1891	1866	1834	1906	1930	1948	1964	1988	2006	2021	2051	2083        
				2178	2146	2109	2074	2039	2009	1985	1958	1922	1816	1835	1853	1871	1892	1910	1924	1955	1987        
				2146	2111	2075	2041	2002	1972	1948	1917	1885	1933	1952	1973	1991	2013	2036	2053	2083	2116        
				2234	2201	2167	2134	2099	2065	2041	2013	1979	1865	1888	1906	1925	1948	1966	1981	2010	2043        
				1961	2104	2072	2036	2002	1970	1945	1915	1885	1985	2006	2028	2048	2069	2087	2105	2129	1994        
				2075	2215	2185	2151	2117	2084	2058	2030	1998	1897	1918	1937	1951	1973	1995	2010	2036	1932        
				2041	2177	2163	2127	2092	2056	2029	2000	1967	2013	2035	2057	2077	2099	2120	2138	2147	2030        
				(-511) (-511) (-511)>;

			PS_Config_Lmt_FW_Rawdata_P = <
				1116	1112	1124	1109	1138	1124	1133	1137	65535	65535	1107	1121	1135	1107	1130	1120	1135	1120
				1119	1126	1119	1116	1128	1113	1135	1123	1133	1112	1131	1119	1114	1119	1117	1119	1112	1137
				1123	1127	1124	1117	1121	1112	1114	1103	1127	1121	1131	1112	1142	1109	1131	1127	1113	1120
				1112	1120	1117	1117	1133	1126	1120	1137	1135	1105	1113	1114	1135	1106	1142	1103	1121	1102
				1117	1128	1116	1124	1113	1116	1116	1117	1117	1112	1123	1112	1124	1107	1123	1123	1128	1121
				1127	1128	1123	1117	1119	1126	1131	1120	1127	1107	1112	1112	1127	1109	1127	1117	1135	1114
				1114	1119	1103	1124	1137	1128	1123	1113	1127	1110	1119	1131	1100	1131	1112	1112	1145	1130
				1120	1119	1124	1126	1109	1134	1114	1117	1109	1126	1119	1128	1127	1128	1126	1117	1123	1110
				1117	1123	1126	1128	1134	1116	1099	1135	1123	1135	1113	1142	1114	1116	1145	1109	1113	1113
				1109	1116	1112	1134	1124	1127	1128	1114	1123	1121	1113	1140	1138	1117	1130	1116	1124	1127
				1116	1127	1116	1124	1112	1121	1120	1121	1100	1116	1126	1117	1130	1121	1114	1117	1130	1103
				1107	1127	1124	1107	1126	1121	1130	1110	1124	1128	1107	1120	1120	1127	1112	1113	1138	1127
				1119	1131	1109	1123	1124	1128	1126	1100	1124	1117	1134	1113	1127	1106	1114	1119	1120	1112
				1124	1119	1147	1123	1137	1116	1124	1116	1126	1120	1116	1126	1126	1109	1126	1114	1121	1107
				1120	1128	1119	1124	1126	1120	1123	1112	1120	1114	1126	1128	1116	1117	1126	1128	1119	1116
				1120	1121	1114	1152	1126	1128	1116	1114	1123	1121	1124	1109	1119	1138	1121	1116	1117	1133
				1116	1112	1130	1138	1126	1117	1123	1127	1114	1119	1131	1128	1119	1107	1112	1128	1128	1124
				1121	1116	1106	1120	1120	1130	1126	1103	1130	1107	1133	1110	1127	1116	1116	1112	1123	1126
				1117	1116	1110	1131	1126	1127	1120	1092	1137	1112	1117	1103	1113	1121	1124	1116	1120	1121
				1124	1123	1124	1119	1110	1123	1126	1109	1126	1120	1110	1113	1119	1130	1133	1123	1103	1121
				1124	1120	1113	1128	1127	1116	1127	1099	1119	1112	1135	1114	1116	1112	1110	1116	1110	1127
				1114	1110	1110	1127	1120	1116	1116	1123	1116	1133	1140	1092	1096	1109	1131	1117	1126	1120
				1107	1130	1113	1126	1144	1134	1142	1110	1120	1117	1117	1133	1133	1107	1120	1121	1140	1109
				1126	1117	1126	1114	1117	1127	1119	1123	1137	1121	1130	1092	1105	1114	1119	1127	1126	1116
				1124	1126	1109	1121	1128	1114	1103	1128	1112	1149	1147	1100	1117	1124	1112	1121	1110	1099
				1123	1123	1128	1114	1105	1123	1123	1113	1127	1128	1126	1102	1109	1120	1123	1126	1110	1119
				1130	1128	1117	1105	1134	1126	1110	1106	1103	1114	1117	1105	1099	1103	1126	1131	1110	1123
				1127	1109	1133	1138	1109	1107	1141	1142	1135	1114	1107	1112	1121	1120	1121	1117	1120	1121
				1124	1113	1121	1124	1112	1117	1124	1119	1133	1114	1131	1116	1110	1106	1127	1119	1135	1123
				1121	1124	1120	1123	1114	1110	1113	1130	1127	1126	1142	1109	1114	1110	1116	1117	1141	1113
				1113	1126	1117	1110	1107	1099	1113	1130	1106	1120	1134	1107	1113	1112	1112	1113	1126	1126
				1124	1131	1117	1130	1130	1127	1126	1119	1130	1107	1096	1107	1113	1095	1109	1120	1126	1127
				3840 3840 3840>;

			PS_Config_Lmt_FW_Rawdata_N = <
				478	476	482	475	488	482	485	487	(-65535)	(-65535)	475	481	487	475	484	480	487	480
				479	482	479	478	484	477	487	481	485	476	485	479	478	479	479	479	476	487            
				481	483	482	479	481	476	478	473	483	481	485	476	490	475	485	483	477	480            
				476	480	479	479	485	482	480	487	487	473	477	478	487	474	490	473	481	472            
				479	484	478	482	477	478	478	479	479	476	481	476	482	475	481	481	484	481            
				483	484	481	479	479	482	485	480	483	475	476	476	483	475	483	479	487	478            
				478	479	473	482	487	484	481	477	483	476	479	485	472	485	476	476	491	484            
				480	479	482	482	475	486	478	479	475	482	479	484	483	484	482	479	481	476            
				479	481	482	484	486	478	471	487	481	487	477	490	478	478	491	475	477	477            
				475	478	476	486	482	483	484	478	481	481	477	488	488	479	484	478	482	483            
				478	483	478	482	476	481	480	481	472	478	482	479	484	481	478	479	484	473            
				475	483	482	475	482	481	484	476	482	484	475	480	480	483	476	477	488	483            
				479	485	475	481	482	484	482	472	482	479	486	477	483	474	478	479	480	476            
				482	479	491	481	487	478	482	478	482	480	478	482	482	475	482	478	481	475            
				480	484	479	482	482	480	481	476	480	478	482	484	478	479	482	484	479	478            
				480	481	478	494	482	484	478	478	481	481	482	475	479	488	481	478	479	485            
				478	476	484	488	482	479	481	483	478	479	485	484	479	475	476	484	484	482            
				481	478	474	480	480	484	482	473	484	475	485	476	483	478	478	476	481	482            
				479	478	476	485	482	483	480	468	487	476	479	473	477	481	482	478	480	481            
				482	481	482	479	476	481	482	475	482	480	476	477	479	484	485	481	473	481            
				482	480	477	484	483	478	483	471	479	476	487	478	478	476	476	478	476	483            
				478	476	476	483	480	478	478	481	478	485	488	468	470	475	485	479	482	480            
				475	484	477	482	490	486	490	476	480	479	479	485	485	475	480	481	488	475            
				482	479	482	478	479	483	479	481	487	481	484	468	473	478	479	483	482	478            
				482	482	475	481	484	478	473	484	476	493	491	472	479	482	476	481	476	471            
				481	481	484	478	473	481	481	477	483	484	482	472	475	480	481	482	476	479            
				484	484	479	473	486	482	476	474	473	478	479	473	471	473	482	485	476	481            
				483	475	485	488	475	475	489	490	487	478	475	476	481	480	481	479	480	481            
				482	477	481	482	476	479	482	479	485	478	485	478	476	474	483	479	487	481            
				481	482	480	481	478	476	477	484	483	482	490	475	478	476	478	479	489	477            
				477	482	479	476	475	471	477	484	474	480	486	475	477	476	476	477	482	482            
				482	485	479	484	484	483	482	479	484	475	470	475	477	469	475	480	482	483            
				240 240 240>;

			PS_Config_Lmt_FW_CC_P = <
				126	124	120	119	116	116	115	112	65535	65535	113	116	117	117	120	121	124	127
				123	121	119	117	116	115	113	112	110	110	112	113	115	116	117	119	121	124    
				127	127	123	123	121	120	119	116	116	115	115	116	119	120	120	121	124	127    
				126	124	123	121	120	117	116	115	115	112	113	115	116	117	119	120	123	126    
				126	126	123	123	121	120	119	116	116	116	116	119	120	121	123	123	126	127    
				127	126	124	123	121	120	119	117	116	116	116	117	120	121	123	123	126	127    
				128	126	124	119	117	116	115	113	112	113	115	116	117	119	120	126	128	128    
				127	124	121	116	115	113	113	112	110	110	113	113	115	116	117	121	124	126    
				127	124	123	119	117	116	116	115	113	115	116	117	119	119	120	124	127	128    
				126	124	121	117	116	115	115	113	112	113	115	115	116	117	117	121	124	126    
				131	126	123	119	117	116	116	116	113	115	116	117	117	119	120	123	126	130    
				127	124	121	117	116	116	115	115	112	116	119	119	119	119	120	124	126	128    
				128	126	123	119	119	117	117	117	115	119	120	121	120	121	123	126	127	131    
				128	124	121	120	117	117	117	116	115	115	116	117	117	119	119	121	124	126    
				132	127	124	121	121	120	120	119	117	120	121	123	123	123	124	126	130	134    
				128	126	123	121	121	120	119	117	117	120	121	121	123	123	123	126	127	131    
				132	128	126	124	123	123	123	121	120	120	121	123	123	123	123	126	127	132    
				131	127	124	123	123	121	121	120	119	120	121	123	123	123	124	126	128	132    
				134	130	127	124	124	124	123	123	123	123	124	126	126	126	126	127	131	132    
				134	128	126	124	124	123	123	123	121	124	124	126	126	126	127	127	131	135    
				135	132	128	128	127	127	126	126	124	126	127	127	128	128	130	130	134	137    
				137	134	131	128	128	127	127	126	126	124	126	127	127	127	127	128	132	135    
				142	139	137	137	135	135	135	134	134	134	134	135	135	135	135	137	139	141    
				141	138	135	135	135	134	134	132	132	134	134	135	135	135	135	137	139	142    
				144	141	138	138	137	137	137	135	137	135	135	135	135	135	137	138	141	142    
				142	139	137	137	137	135	135	135	135	135	135	135	135	135	137	137	139	141    
				145	144	141	141	139	139	139	139	139	138	137	138	138	138	138	139	142	144    
				144	144	141	139	139	139	138	138	138	137	137	138	138	138	138	138	142	144    
				146	142	139	139	139	139	139	139	139	141	139	141	139	141	141	141	144	146    
				144	142	139	139	139	139	139	138	139	139	139	139	139	139	141	141	144	146    
				146	144	142	142	142	142	142	141	142	142	141	142	141	141	142	141	144	146    
				148	145	144	144	144	144	144	144	144	141	139	139	139	139	139	139	142	145    
				314 314 314>;

			PS_Config_Lmt_FW_CC_N = <
				56	56	54	53	52	52	51	50	(-65535)	(-65535)	51	52	53	53	54	55	56	57
				55	55	53	53	52	51	51	50	50	50	50	51	51	52	53	53	55	56            
				57	57	55	55	55	54	53	52	52	51	51	52	53	54	54	55	56	57            
				56	56	55	55	54	53	52	51	51	50	51	51	52	53	53	54	55	56            
				56	56	55	55	55	54	53	52	52	52	52	53	54	55	55	55	56	57            
				57	56	56	55	55	54	53	53	52	52	52	53	54	55	55	55	56	57            
				58	56	56	53	53	52	51	51	50	51	51	52	53	53	54	56	58	58            
				57	56	55	52	51	51	51	50	50	50	51	51	51	52	53	55	56	56            
				57	56	55	53	53	52	52	51	51	51	52	53	53	53	54	56	57	58            
				56	56	55	53	52	51	51	51	50	51	51	51	52	53	53	55	56	56            
				59	56	55	53	53	52	52	52	51	51	52	53	53	53	54	55	56	58            
				57	56	55	53	52	52	51	51	50	52	53	53	53	53	54	56	56	58            
				58	56	55	53	53	53	53	53	51	53	54	55	54	55	55	56	57	59            
				58	56	55	54	53	53	53	52	51	51	52	53	53	53	53	55	56	56            
				60	57	56	55	55	54	54	53	53	54	55	55	55	55	56	56	58	60            
				58	56	55	55	55	54	53	53	53	54	55	55	55	55	55	56	57	59            
				60	58	56	56	55	55	55	55	54	54	55	55	55	55	55	56	57	60            
				59	57	56	55	55	55	55	54	53	54	55	55	55	55	56	56	58	60            
				60	58	57	56	56	56	55	55	55	55	56	56	56	56	56	57	59	60            
				60	58	56	56	56	55	55	55	55	56	56	56	56	56	57	57	59	61            
				61	60	58	58	57	57	56	56	56	56	57	57	58	58	58	58	60	61            
				61	60	59	58	58	57	57	56	56	56	56	57	57	57	57	58	60	61            
				64	63	61	61	61	61	61	60	60	60	60	61	61	61	61	61	63	63            
				63	62	61	61	61	60	60	60	60	60	60	61	61	61	61	61	63	64            
				64	63	62	62	61	61	61	61	61	61	61	61	61	61	61	62	63	64            
				64	63	61	61	61	61	61	61	61	61	61	61	61	61	61	61	63	63            
				65	64	63	63	63	63	63	63	63	62	61	62	62	62	62	63	64	64            
				64	64	63	63	63	63	62	62	62	61	61	62	62	62	62	62	64	64            
				66	64	63	63	63	63	63	63	63	63	63	63	63	63	63	63	64	66            
				64	64	63	63	63	63	63	62	63	63	63	63	63	63	63	63	64	66            
				66	64	64	64	64	64	64	63	64	64	63	64	63	63	64	63	64	66            
				66	65	64	64	64	64	64	64	64	63	63	63	63	63	63	63	64	65            
				0 0 0>;

			PS_Config_Lmt_FW_Diff_P = <
				50	50	50	50	50	50	50	50	65535	65535	50	50	50	50	50	50	50	50
				50	50	50	50	50	50	50	50	50	50	50	50	50	50	50	50	50	50    
				50	50	50	50	50	50	50	50	50	50	50	50	50	50	50	50	50	50    
				50	50	50	50	50	50	50	50	50	50	50	50	50	50	50	50	50	50    
				50	50	50	50	50	50	50	50	50	50	50	50	50	50	50	50	50	50    
				50	50	50	50	50	50	50	50	50	50	50	50	50	50	50	50	50	50    
				50	50	50	50	50	50	50	50	50	50	50	50	50	50	50	50	50	50    
				50	50	50	50	50	50	50	50	50	50	50	50	50	50	50	50	50	50    
				50	50	50	50	50	50	50	50	50	50	50	50	50	50	50	50	50	50    
				50	50	50	50	50	50	50	50	50	50	50	50	50	50	50	50	50	50    
				50	50	50	50	50	50	50	50	50	50	50	50	50	50	50	50	50	50    
				50	50	50	50	50	50	50	50	50	50	50	50	50	50	50	50	50	50    
				50	50	50	50	50	50	50	50	50	50	50	50	50	50	50	50	50	50    
				50	50	50	50	50	50	50	50	50	50	50	50	50	50	50	50	50	50    
				50	50	50	50	50	50	50	50	50	50	50	50	50	50	50	50	50	50    
				50	50	50	50	50	50	50	50	50	50	50	50	50	50	50	50	50	50    
				50	50	50	50	50	50	50	50	50	50	50	50	50	50	50	50	50	50    
				50	50	50	50	50	50	50	50	50	50	50	50	50	50	50	50	50	50    
				50	50	50	50	50	50	50	50	50	50	50	50	50	50	50	50	50	50    
				50	50	50	50	50	50	50	50	50	50	50	50	50	50	50	50	50	50    
				50	50	50	50	50	50	50	50	50	50	50	50	50	50	50	50	50	50    
				50	50	50	50	50	50	50	50	50	50	50	50	50	50	50	50	50	50    
				50	50	50	50	50	50	50	50	50	50	50	50	50	50	50	50	50	50    
				50	50	50	50	50	50	50	50	50	50	50	50	50	50	50	50	50	50    
				50	50	50	50	50	50	50	50	50	50	50	50	50	50	50	50	50	50    
				50	50	50	50	50	50	50	50	50	50	50	50	50	50	50	50	50	50    
				50	50	50	50	50	50	50	50	50	50	50	50	50	50	50	50	50	50    
				50	50	50	50	50	50	50	50	50	50	50	50	50	50	50	50	50	50    
				50	50	50	50	50	50	50	50	50	50	50	50	50	50	50	50	50	50    
				50	50	50	50	50	50	50	50	50	50	50	50	50	50	50	50	50	50    
				50	50	50	50	50	50	50	50	50	50	50	50	50	50	50	50	50	50    
				50	50	50	50	50	50	50	50	50	50	50	50	50	50	50	50	50	50    
				75 75 75>;

			PS_Config_Lmt_FW_Diff_N = <
				(-50)	(-50)	(-50)	(-50)	(-50)	(-50)	(-50)	(-50)	(-65535)	(-65535)	(-50)	(-50)	(-50)	(-50)	(-50)	(-50)	(-50)	(-50)
				(-50)	(-50)	(-50)	(-50)	(-50)	(-50)	(-50)	(-50)	(-50)	(-50)	(-50)	(-50)	(-50)	(-50)	(-50)	(-50)	(-50)	(-50)        
				(-50)	(-50)	(-50)	(-50)	(-50)	(-50)	(-50)	(-50)	(-50)	(-50)	(-50)	(-50)	(-50)	(-50)	(-50)	(-50)	(-50)	(-50)        
				(-50)	(-50)	(-50)	(-50)	(-50)	(-50)	(-50)	(-50)	(-50)	(-50)	(-50)	(-50)	(-50)	(-50)	(-50)	(-50)	(-50)	(-50)        
				(-50)	(-50)	(-50)	(-50)	(-50)	(-50)	(-50)	(-50)	(-50)	(-50)	(-50)	(-50)	(-50)	(-50)	(-50)	(-50)	(-50)	(-50)        
				(-50)	(-50)	(-50)	(-50)	(-50)	(-50)	(-50)	(-50)	(-50)	(-50)	(-50)	(-50)	(-50)	(-50)	(-50)	(-50)	(-50)	(-50)        
				(-50)	(-50)	(-50)	(-50)	(-50)	(-50)	(-50)	(-50)	(-50)	(-50)	(-50)	(-50)	(-50)	(-50)	(-50)	(-50)	(-50)	(-50)        
				(-50)	(-50)	(-50)	(-50)	(-50)	(-50)	(-50)	(-50)	(-50)	(-50)	(-50)	(-50)	(-50)	(-50)	(-50)	(-50)	(-50)	(-50)        
				(-50)	(-50)	(-50)	(-50)	(-50)	(-50)	(-50)	(-50)	(-50)	(-50)	(-50)	(-50)	(-50)	(-50)	(-50)	(-50)	(-50)	(-50)        
				(-50)	(-50)	(-50)	(-50)	(-50)	(-50)	(-50)	(-50)	(-50)	(-50)	(-50)	(-50)	(-50)	(-50)	(-50)	(-50)	(-50)	(-50)        
				(-50)	(-50)	(-50)	(-50)	(-50)	(-50)	(-50)	(-50)	(-50)	(-50)	(-50)	(-50)	(-50)	(-50)	(-50)	(-50)	(-50)	(-50)        
				(-50)	(-50)	(-50)	(-50)	(-50)	(-50)	(-50)	(-50)	(-50)	(-50)	(-50)	(-50)	(-50)	(-50)	(-50)	(-50)	(-50)	(-50)        
				(-50)	(-50)	(-50)	(-50)	(-50)	(-50)	(-50)	(-50)	(-50)	(-50)	(-50)	(-50)	(-50)	(-50)	(-50)	(-50)	(-50)	(-50)        
				(-50)	(-50)	(-50)	(-50)	(-50)	(-50)	(-50)	(-50)	(-50)	(-50)	(-50)	(-50)	(-50)	(-50)	(-50)	(-50)	(-50)	(-50)        
				(-50)	(-50)	(-50)	(-50)	(-50)	(-50)	(-50)	(-50)	(-50)	(-50)	(-50)	(-50)	(-50)	(-50)	(-50)	(-50)	(-50)	(-50)        
				(-50)	(-50)	(-50)	(-50)	(-50)	(-50)	(-50)	(-50)	(-50)	(-50)	(-50)	(-50)	(-50)	(-50)	(-50)	(-50)	(-50)	(-50)        
				(-50)	(-50)	(-50)	(-50)	(-50)	(-50)	(-50)	(-50)	(-50)	(-50)	(-50)	(-50)	(-50)	(-50)	(-50)	(-50)	(-50)	(-50)        
				(-50)	(-50)	(-50)	(-50)	(-50)	(-50)	(-50)	(-50)	(-50)	(-50)	(-50)	(-50)	(-50)	(-50)	(-50)	(-50)	(-50)	(-50)        
				(-50)	(-50)	(-50)	(-50)	(-50)	(-50)	(-50)	(-50)	(-50)	(-50)	(-50)	(-50)	(-50)	(-50)	(-50)	(-50)	(-50)	(-50)        
				(-50)	(-50)	(-50)	(-50)	(-50)	(-50)	(-50)	(-50)	(-50)	(-50)	(-50)	(-50)	(-50)	(-50)	(-50)	(-50)	(-50)	(-50)        
				(-50)	(-50)	(-50)	(-50)	(-50)	(-50)	(-50)	(-50)	(-50)	(-50)	(-50)	(-50)	(-50)	(-50)	(-50)	(-50)	(-50)	(-50)        
				(-50)	(-50)	(-50)	(-50)	(-50)	(-50)	(-50)	(-50)	(-50)	(-50)	(-50)	(-50)	(-50)	(-50)	(-50)	(-50)	(-50)	(-50)        
				(-50)	(-50)	(-50)	(-50)	(-50)	(-50)	(-50)	(-50)	(-50)	(-50)	(-50)	(-50)	(-50)	(-50)	(-50)	(-50)	(-50)	(-50)        
				(-50)	(-50)	(-50)	(-50)	(-50)	(-50)	(-50)	(-50)	(-50)	(-50)	(-50)	(-50)	(-50)	(-50)	(-50)	(-50)	(-50)	(-50)        
				(-50)	(-50)	(-50)	(-50)	(-50)	(-50)	(-50)	(-50)	(-50)	(-50)	(-50)	(-50)	(-50)	(-50)	(-50)	(-50)	(-50)	(-50)        
				(-50)	(-50)	(-50)	(-50)	(-50)	(-50)	(-50)	(-50)	(-50)	(-50)	(-50)	(-50)	(-50)	(-50)	(-50)	(-50)	(-50)	(-50)        
				(-50)	(-50)	(-50)	(-50)	(-50)	(-50)	(-50)	(-50)	(-50)	(-50)	(-50)	(-50)	(-50)	(-50)	(-50)	(-50)	(-50)	(-50)        
				(-50)	(-50)	(-50)	(-50)	(-50)	(-50)	(-50)	(-50)	(-50)	(-50)	(-50)	(-50)	(-50)	(-50)	(-50)	(-50)	(-50)	(-50)        
				(-50)	(-50)	(-50)	(-50)	(-50)	(-50)	(-50)	(-50)	(-50)	(-50)	(-50)	(-50)	(-50)	(-50)	(-50)	(-50)	(-50)	(-50)        
				(-50)	(-50)	(-50)	(-50)	(-50)	(-50)	(-50)	(-50)	(-50)	(-50)	(-50)	(-50)	(-50)	(-50)	(-50)	(-50)	(-50)	(-50)        
				(-50)	(-50)	(-50)	(-50)	(-50)	(-50)	(-50)	(-50)	(-50)	(-50)	(-50)	(-50)	(-50)	(-50)	(-50)	(-50)	(-50)	(-50)        
				(-50)	(-50)	(-50)	(-50)	(-50)	(-50)	(-50)	(-50)	(-50)	(-50)	(-50)	(-50)	(-50)	(-50)	(-50)	(-50)	(-50)	(-50)        
				(-75) (-75) (-75)>;

			PS_Config_Diff_Test_Frame = <50>;
		};
	};
};
