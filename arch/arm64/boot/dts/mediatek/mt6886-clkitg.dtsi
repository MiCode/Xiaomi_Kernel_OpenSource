// SPDX-License-Identifier: GPL-2.0-only OR BSD-2-Clause
/*
 * Copyright (C) 2022 MediaTek Inc.
 * Author: Chong-ming Wei <chong-ming.wei@mediatek.com>
 */

&clkitg {
	status = "okay";
	bring-up {
		compatible = "mediatek,clk-bring-up";
		clocks =
			<&clk26m>;
	};

	bring-up-pd-ufs0_phy {
		compatible = "mediatek,scpsys-bring-up";
		power-domains = <&scpsys MT6886_POWER_DOMAIN_UFS0_PHY>;
	};

};
