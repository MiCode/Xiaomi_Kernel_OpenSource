// SPDX-License-Identifier: (GPL-2.0 OR MIT)
/*
 * Copyright (C) 2022 MediaTek Inc.
 * Author: Owen Chen <owen.chen@mediatek.com>
 */

&clkitg {
	status = "okay";
	bring-up {
		compatible = "mediatek,clk-bring-up";
		clocks =
			<&topckgen_clk CLK_TOP_PWRAP_ULPOSC_SEL>,
			<&topckgen_clk CLK_TOP_ATB_SEL>,
			<&topckgen_clk CLK_TOP_DPMAIF_MAIN_SEL>,
			<&infracfg_ao_clk CLK_IFRAO_PMIC_TMR>,
			<&infracfg_ao_clk CLK_IFRAO_PMIC_AP>,
			<&infracfg_ao_clk CLK_IFRAO_THERM>,
			<&infracfg_ao_clk CLK_IFRAO_BTIF>,
			<&infracfg_ao_clk CLK_IFRAO_CCIF1_AP>,
			<&infracfg_ao_clk CLK_IFRAO_CCIF1_MD>,
			<&infracfg_ao_clk CLK_IFRAO_CCIF_AP>,
			<&infracfg_ao_clk CLK_IFRAO_DEBUGSYS>,
			<&infracfg_ao_clk CLK_IFRAO_CCIF_MD>,
			<&infracfg_ao_clk CLK_IFRAO_CLDMA_BCLK>,
			<&infracfg_ao_clk CLK_IFRAO_CCIF5_MD>,
			<&infracfg_ao_clk CLK_IFRAO_CCIF2_AP>,
			<&infracfg_ao_clk CLK_IFRAO_CCIF2_MD>,
			<&infracfg_ao_clk CLK_IFRAO_CCIF4_AP>,
			<&infracfg_ao_clk CLK_IFRAO_CCIF4_MD>,
			<&infracfg_ao_clk CLK_IFRAO_66MP_BUS_MCLK_CKP>;
	};
};
