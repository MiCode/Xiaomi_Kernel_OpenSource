// SPDX-License-Identifier: GPL-2.0
//
// Copyright (c) 2021 MediaTek Inc.

&i2c5 {
	rt6160@75 {
		compatible = "richtek,rt6160";
		reg = <0x75>;
		//enable-gpios = <&gpio26 2 0>;
		regulator-name = "rt6160-buckboost";
		regulator-min-microvolt = <2025000>;
		regulator-max-microvolt = <5200000>;
		regulator-always-on;
	};
};
