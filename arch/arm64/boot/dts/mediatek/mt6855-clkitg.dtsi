// SPDX-License-Identifier: (GPL-2.0 OR MIT)
/*
 * Copyright (C) 2021 MediaTek Inc.
 * Author: Owen Chen <owen.chen@mediatek.com>
 */

&clkitg {
	status = "okay";
	bring-up {
		compatible = "mediatek,clk-bring-up";
		clocks =
			<&topckgen_clk CLK_TOP_AXI_SEL>,
			<&topckgen_clk CLK_TOP_AXIP_SEL>,
			<&topckgen_clk CLK_TOP_AXI_U_SEL>,
			<&topckgen_clk CLK_TOP_BUS_AXIMEM_SEL>,
			<&topckgen_clk CLK_TOP_MDP0_SEL>,
			<&topckgen_clk CLK_TOP_MMINFRA_SEL>,
			<&topckgen_clk CLK_TOP_ATB_SEL>,
			<&topckgen_clk CLK_TOP_DISP_PWM_SEL>,
			<&topckgen_clk CLK_TOP_DXCC_SEL>,
			<&topckgen_clk CLK_TOP_DPMAIF_MAIN_SEL>,
			<&topckgen_clk CLK_TOP_MCUPM_SEL>,
			<&topckgen_clk CLK_TOP_MEM_SUB_SEL>,
			<&topckgen_clk CLK_TOP_MEM_SUBP_SEL>,
			<&topckgen_clk CLK_TOP_MEM_SUB_U_SEL>,
			<&topckgen_clk CLK_TOP_EMI_N_SEL>,
			<&topckgen_clk CLK_TOP_AP2CONN_HOST_SEL>,
			<&infracfg_ao_clk CLK_IFRAO_THERM>,
			<&infracfg_ao_clk CLK_IFRAO_CQ_DMA_FPC>,
			<&infracfg_ao_clk CLK_IFRAO_TRNG>,
			<&infracfg_ao_clk CLK_IFRAO_CCIF1_AP>,
			<&infracfg_ao_clk CLK_IFRAO_CCIF1_MD>,
			<&infracfg_ao_clk CLK_IFRAO_CCIF_AP>,
			<&infracfg_ao_clk CLK_IFRAO_DEBUGSYS>,
			<&infracfg_ao_clk CLK_IFRAO_CCIF_MD>,
			<&infracfg_ao_clk CLK_IFRAO_DXCC_AO>,
			<&infracfg_ao_clk CLK_IFRAO_DBG_TRACE>,
			<&infracfg_ao_clk CLK_IFRAO_CLDMA_BCLK>,
			<&infracfg_ao_clk CLK_IFRAO_CQ_DMA>,
			<&infracfg_ao_clk CLK_IFRAO_CCIF5_AP>,
			<&infracfg_ao_clk CLK_IFRAO_CCIF5_MD>,
			<&infracfg_ao_clk CLK_IFRAO_CCIF2_AP>,
			<&infracfg_ao_clk CLK_IFRAO_CCIF2_MD>,
			<&infracfg_ao_clk CLK_IFRAO_CCIF3_AP>,
			<&infracfg_ao_clk CLK_IFRAO_CCIF3_MD>,
			<&infracfg_ao_clk CLK_IFRAO_DEVICE_APC_SYNC>,
			<&infracfg_ao_clk CLK_IFRAO_DPMAIF_MAIN>,
			<&infracfg_ao_clk CLK_IFRAO_CCIF4_AP>,
			<&infracfg_ao_clk CLK_IFRAO_CCIF4_MD>,
			<&infracfg_ao_clk CLK_IFRAO_RG_MMW_DPMAIF26M_CK>,
			<&infracfg_ao_clk CLK_IFRAO_RG_MEM_SUB_CK>,
			<&vlp_cksys_clk CLK_VLP_CK_SCP_SEL>,
			<&vlp_cksys_clk CLK_VLP_CK_PWRAP_ULPOSC_SEL>,
			<&vlp_cksys_clk CLK_VLP_CK_DXCC_VLP_SEL>,
			<&vlp_cksys_clk CLK_VLP_CK_SPMI_P_MST_SEL>,
			<&vlp_cksys_clk CLK_VLP_CK_SPMI_M_MST_SEL>,
			<&vlp_cksys_clk CLK_VLP_CK_DVFSRC_SEL>,
			<&vlp_cksys_clk CLK_VLP_CK_PWM_VLP_SEL>,
			<&vlp_cksys_clk CLK_VLP_CK_AXI_VLP_SEL>,
			<&vlp_cksys_clk CLK_VLP_CK_DBGAO_26M_SEL>,
			<&vlp_cksys_clk CLK_VLP_CK_SYSTIMER_26M_SEL>,
			<&vlp_cksys_clk CLK_VLP_CK_SSPM_SEL>,
			<&vlp_cksys_clk CLK_VLP_CK_SSPM_F26M_SEL>,
			<&vlp_cksys_clk CLK_VLP_CK_SRCK_SEL>,
			<&vlp_cksys_clk CLK_VLP_CK_SRAMRC_SEL>,
			<&mminfra_config_clk CLK_MMINFRA_GCE_D>,
			<&mminfra_config_clk CLK_MMINFRA_GCE_M>,
			<&mminfra_config_clk CLK_MMINFRA_SMI>,
			<&mminfra_config_clk CLK_MMINFRA_GCE_26M>;
	};

	bring-up-pd-mm_infra {
		compatible = "mediatek,scpsys-bring-up";
		power-domains = <&scpsys MT6855_POWER_DOMAIN_MM_INFRA>;
	};
};
