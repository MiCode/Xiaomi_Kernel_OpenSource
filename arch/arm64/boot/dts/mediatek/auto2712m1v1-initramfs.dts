/*
 * Copyright (c) 2017 MediaTek Inc.
 * Author: Eddie Huang <eddie.huang@mediatek.com>
 *
 * This program is free software; you can redistribute it and/or modify
 * it under the terms of the GNU General Public License version 2 as
 * published by the Free Software Foundation.
 *
 * This program is distributed in the hope that it will be useful,
 * but WITHOUT ANY WARRANTY; without even the implied warranty of
 * MERCHANTABILITY or FITNESS FOR A PARTICULAR PURPOSE.  See the
 * GNU General Public License for more details.
 */

/dts-v1/;
#include "mt2712e.dtsi"
#include "auto2712m1v1-common.dtsi"

/ {
	chosen {
		bootargs = "console=ttyS0,921600n1 root=/dev/ram initrd=0x45000000,90M debugshell=1 \
printk.disable_uart=0 rootwait initcall_debug=1 loglevel=8 clk_ignore_unused earlycon=uart8250,mmio32,0x11002000";
	};

	memory@40000000 {
		device_type = "memory";
		reg = <0 0x40000000 0 0x40000000>;
	};
};
