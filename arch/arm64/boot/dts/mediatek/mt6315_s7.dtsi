/* SPDX-License-Identifier: GPL-2.0 */
/*
 * Copyright (c) 2019 MediaTek Inc.
*/

&mt6315_7_regulator {
	compatible = "mediatek,mt6315_7-regulator";
	interrupt-controller;
	#interrupt-cells = <2>;

	mt6315_7_vbuck1: 7_vbuck1 {
		regulator-name = "7_vbuck1";
		regulator-min-microvolt = <300000>;
		regulator-max-microvolt = <1193750>;
		regulator-enable-ramp-delay = <256>;
	};
	mt6315_7_vbuck3: 7_vbuck3 {
		regulator-name = "7_vbuck3";
		regulator-min-microvolt = <300000>;
		regulator-max-microvolt = <1193750>;
		regulator-enable-ramp-delay = <256>;
	};
	mt6315_7_vbuck4: 7_vbuck4 {
		regulator-name = "7_vbuck4";
		regulator-min-microvolt = <300000>;
		regulator-max-microvolt = <1193750>;
		regulator-enable-ramp-delay = <256>;
	};
};
