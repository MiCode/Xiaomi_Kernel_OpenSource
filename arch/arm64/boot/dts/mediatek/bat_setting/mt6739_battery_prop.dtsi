/* SPDX-License-Identifier: GPL-2.0 */
/*
 * Copyright (c) 2019 MediaTek Inc.
*/

bat_gm30: battery{
	compatible = "mediatek,bat_gm30";
	/*	Charging termination current.*/
	DIFFERENCE_FULLOCV_ITH = <(200)>;
	/*If ui_soc shows 1% more than X minites, system will shutdown.*/
	SHUTDOWN_1_TIME = <(60)>;
	/*The ui_soc will keep 100% until SOC drop X percents after unplugged.*/
	KEEP_100_PERCENT = <(1)>;
	/*	R_sense resistance.*/
	R_FG_VALUE = <(10)>;
	/*	Configures whether using embedded battery or not.*/
	EMBEDDED_SEL = <(0)>;
	/*	System shutdown current.*/
	PMIC_SHUTDOWN_CURRENT = <(20)>;
	/*	The resistance of PCB*/
	FG_METER_RESISTANCE = <(75)>;
	/*	Tune value for current measurement.*/
	CAR_TUNE_VALUE = <(100)>;
	/*	Battery temperature T0*/
	PMIC_MIN_VOL = <(33500)>;
	/*	vboot voltage for gauge 0%.*/
	POWERON_SYSTEM_IBOOT = <(500)>;
	/*	power on system iboot*/
	SHUTDOWN_GAUGE0_VOLTAGE = <(34000)>;
	/*	shutdown gauge 0% voltage*/
	TEMPERATURE_T0 = <(25)>;
	/*	Battery temperature T1*/
	TEMPERATURE_T1 = <(10)>;
	/*	Battery temperature T2*/
	TEMPERATURE_T2 = <(0)>;
	/*	Battery temperature T3*/
	TEMPERATURE_T3 = <(-10)>;
	/*	Pseudo 100% percentage at T0.*/
	g_FG_PSEUDO100_T0 = <(100)>;
	/*	Pseudo 100% percentage at T1.*/
	g_FG_PSEUDO100_T1 = <(100)>;
	/*	Pseudo 100% percentage at T2.*/
	g_FG_PSEUDO100_T2 = <(100)>;
	/*	Pseudo 100% percentage at T3.*/
	g_FG_PSEUDO100_T3 = <(100)>;
	/*	System shut down voltage.*/
	Q_MAX_SYS_VOLTAGE_BAT0 = <(3350)>;
	/*	System shut down voltage.*/
	Q_MAX_SYS_VOLTAGE_BAT1 = <(3350)>;
	/*	System shut down voltage.*/
	Q_MAX_SYS_VOLTAGE_BAT2 = <(3350)>;
	/*	System shut down voltage.*/
	Q_MAX_SYS_VOLTAGE_BAT3 = <(3350)>;
#include "mt6739_battery_table.dtsi"
};
