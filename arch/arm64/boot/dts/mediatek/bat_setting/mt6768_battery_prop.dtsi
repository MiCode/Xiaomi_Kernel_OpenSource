/*
 * Copyright (C) 2018 MediaTek Inc.
 *
 * This program is free software; you can redistribute it and/or modify
 * it under the terms of the GNU General Public License version 2 as
 * published by the Free Software Foundation.
 *
 * This program is distributed in the hope that it will be useful,
 * but WITHOUT ANY WARRANTY; without even the implied warranty of
 * MERCHANTABILITY or FITNESS FOR A PARTICULAR PURPOSE.
 * See http://www.gnu.org/licenses/gpl-2.0.html for more details.
 */
bat_gm30: battery{
	compatible = "mediatek,bat_gm30";
	io-channels = <&auxadc 2>;
	io-channel-names = "batteryID-channel";
	DIFFERENCE_FULLOCV_ITH = <(200)>;			/*	Charging termination current*/

	SHUTDOWN_1_TIME = <(5)>;					/*	If ui_soc shows 1% more than X minites, system will shutdown*/

	KEEP_100_PERCENT = <(1)>;					/*	The ui_soc will keep 100% until SOC drop X percents after unplugged*/
/*K19A HQ-123457 K19A charger of profile by wangqi at 2021/4/22 start*/
	R_FG_VALUE = <(5)>;						/*	R_sense resistance*/
/*K19A HQ-123457 K19A charger of profile by wangqi at 2021/4/22 end*/
	EMBEDDED_SEL = <(1)>;						/*	Configures whether using embedded battery or not*/

	PMIC_SHUTDOWN_CURRENT = <(20)>;				/*	System shutdown current*/

	FG_METER_RESISTANCE = <(75)>;				/*	The resistance of PCB*/

	CAR_TUNE_VALUE = <(99)>;					/*	Tune value for current measurement*/

	PMIC_MIN_VOL = <(33500)>;					/*	vboot voltage for gauge 0%*/

	POWERON_SYSTEM_IBOOT = <(500)>;				/*	power on system iboot*/

	SHUTDOWN_GAUGE0_VOLTAGE = <(33500)>;		/*	shutdown gauge 0% voltage*/

	TEMPERATURE_T0 = <(50)>;					/*	Battery temperature T0*/

	TEMPERATURE_T1 = <(25)>;					/*	Battery temperature T1*/

	TEMPERATURE_T2 = <(10)>;					/*	Battery temperature T2*/

	TEMPERATURE_T3 = <(0)>;						/*	Battery temperature T3*/

	TEMPERATURE_T4 = <(-10)>;					/*	Battery temperature T4*/

	g_FG_PSEUDO100_T0 = <(95)>;				/*	Pseudo 100% percentage at T0*/

	g_FG_PSEUDO100_T1 = <(95)>;				/*	Pseudo 100% percentage at T1*/

	g_FG_PSEUDO100_T2 = <(95)>;				/*	Pseudo 100% percentage at T2*/

	g_FG_PSEUDO100_T3 = <(95)>;				/*	Pseudo 100% percentage at T3*/

	g_FG_PSEUDO100_T4 = <(95)>;				/*	Pseudo 100% percentage at T4*/

	Q_MAX_SYS_VOLTAGE_BAT0 = <(3550)>;			/*	Pseudo1 for hide percentage*/

	Q_MAX_SYS_VOLTAGE_BAT1 = <(3550)>;			/*	Pseudo1 for hide percentage*/

	Q_MAX_SYS_VOLTAGE_BAT2 = <(3550)>;			/*	Pseudo1 for hide percentage*/

	Q_MAX_SYS_VOLTAGE_BAT3 = <(3550)>;			/*	Pseudo1 for hide percentage*/

	COM_FG_METER_RESISTANCE = <(100)>;			/*	compensate The resistance of PCB*/

	COM_R_FG_VALUE = <(0)>;						/*	compensate R_sense resistance*/

	enable_tmp_intr_suspend = <(0)>;			/* Enable update temp when suspend */

	ACTIVE_TABLE = <(5)>;						/* Table numbers per battery*/

	MULTI_TEMP_GAUGE0 = <(1)>;					/* Multi gauge0 enable*/
/*K19A HQ-123457 K19A charger of profile by wangqi at 2021/4/22 start*/
#include "mt6769_battery_table_ext.dtsi"
/*K19A HQ-123457 K19A charger of profile by wangqi at 2021/4/22 end*/
};
