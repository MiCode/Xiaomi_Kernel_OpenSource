/*
 * Mediatek's mt6771 SoC device tree source
 *
 * Copyright (C) 2016 MediaTek Inc.
 *
 * This program is free software; you can redistribute it and/or modify
 * it under the terms of the GNU General Public License version 2 as
 * published by the Free Software Foundation.
 *
 * This program is distributed in the hope that it will be useful,
 * but WITHOUT ANY WARRANTY; without even the implied warranty of
 * MERCHANTABILITY or FITNESS FOR A PARTICULAR PURPOSE.
 * See http://www.gnu.org/licenses/gpl-2.0.html for more details.
 */
/dts-v1/;
#include <dt-bindings/clock/mt6771-clk.h>
#include <dt-bindings/interrupt-controller/arm-gic.h>
#include <dt-bindings/interrupt-controller/irq.h>
#include <dt-bindings/mmc/mt6771-msdc.h>
#include <dt-bindings/pinctrl/mt6771-pinfunc.h>
#include <dt-bindings/iio/mt635x-auxadc.h>
#include <dt-bindings/mfd/mt6358-irq.h>
#include <dt-bindings/gce/mt6771-gce.h>
#include <generated/autoconf.h>

/ {
	model = "mt6771";
	compatible = "mediatek,mt6771";
	interrupt-parent = <&sysirq>;
	#address-cells = <2>;
	#size-cells = <2>;

	/* chosen */
	chosen: chosen {
		bootargs = "console=tty0 console=ttyS0,921600n1 \
vmalloc=400M slub_debug=OFZPU swiotlb=noforce page_owner=on \
cgroup.memory=nosocket,nokmem \
androidboot.hardware=mt6771 \
firmware_class.path=/vendor/firmware loop.max_part=7";
		kaslr-seed = <0 0>;
	};

	cpus {
		#address-cells = <1>;
		#size-cells = <0>;

		cpu0: cpu@000 {
			device_type = "cpu";
			compatible = "arm,cortex-a53";
			reg = <0x000>;
			enable-method = "psci";
			clock-frequency = <2340000000>;
			cpu-idle-states = <&STANDBY &MCDI_CPU &MCDI_CLUSTER>,
					  <&SODI &SODI3 &DPIDLE &SUSPEND>;
		};

		cpu1: cpu@001 {
			device_type = "cpu";
			compatible = "arm,cortex-a53";
			reg = <0x001>;
			enable-method = "psci";
			clock-frequency = <2340000000>;
			cpu-idle-states = <&STANDBY &MCDI_CPU &MCDI_CLUSTER>,
					  <&SODI &SODI3 &DPIDLE &SUSPEND>;
		};

		cpu2: cpu@002 {
			device_type = "cpu";
			compatible = "arm,cortex-a53";
			reg = <0x002>;
			enable-method = "psci";
			clock-frequency = <2340000000>;
			cpu-idle-states = <&STANDBY &MCDI_CPU &MCDI_CLUSTER>,
					  <&SODI &SODI3 &DPIDLE &SUSPEND>;
		};

		cpu3: cpu@003 {
			device_type = "cpu";
			compatible = "arm,cortex-a53";
			reg = <0x003>;
			enable-method = "psci";
			clock-frequency = <2340000000>;
			cpu-idle-states = <&STANDBY &MCDI_CPU &MCDI_CLUSTER>,
					  <&SODI &SODI3 &DPIDLE &SUSPEND>;
		};

		cpu4: cpu@100 {
			device_type = "cpu";
			compatible = "arm,cortex-a73";
			reg = <0x100>;
			enable-method = "psci";
			clock-frequency = <2340000000>;
			cpu-idle-states = <&STANDBY &MCDI_CPU &MCDI_CLUSTER>,
					  <&SODI &SODI3 &DPIDLE &SUSPEND>;
		};

		cpu5: cpu@101 {
			device_type = "cpu";
			compatible = "arm,cortex-a73";
			reg = <0x101>;
			enable-method = "psci";
			clock-frequency = <2340000000>;
			cpu-idle-states = <&STANDBY &MCDI_CPU &MCDI_CLUSTER>,
					  <&SODI &SODI3 &DPIDLE &SUSPEND>;
		};

		cpu6: cpu@102 {
			device_type = "cpu";
			compatible = "arm,cortex-a73";
			reg = <0x102>;
			enable-method = "psci";
			clock-frequency = <2340000000>;
			cpu-idle-states = <&STANDBY &MCDI_CPU &MCDI_CLUSTER>,
					  <&SODI &SODI3 &DPIDLE &SUSPEND>;
		};

		cpu7: cpu@103 {
			device_type = "cpu";
			compatible = "arm,cortex-a73";
			reg = <0x103>;
			enable-method = "psci";
			clock-frequency = <2340000000>;
			cpu-idle-states = <&STANDBY &MCDI_CPU &MCDI_CLUSTER>,
					  <&SODI &SODI3 &DPIDLE &SUSPEND>;
		};

		cpu-map {
			cluster0 {
				core0 {
					cpu = <&cpu0>;
				};
				core1 {
					cpu = <&cpu1>;
				};
				core2 {
					cpu = <&cpu2>;
				};
				core3 {
					cpu = <&cpu3>;
				};
			};

			cluster1 {
				core0 {
					cpu = <&cpu4>;
				};
				core1 {
					cpu = <&cpu5>;
				};
				core2 {
					cpu = <&cpu6>;
				};
				core3 {
					cpu = <&cpu7>;
				};
			};
		};

		idle-states {
			entry-method = "arm,psci";

			STANDBY: standby {
				compatible = "arm,idle-state";
				arm,psci-suspend-param = <0x00000001>;
				entry-latency-us = <600>;
				exit-latency-us = <600>;
				min-residency-us = <1200>;
			};

			MCDI_CPU: mcdi-cpu {
				compatible = "arm,idle-state";
				arm,psci-suspend-param = <0x00010001>;
				entry-latency-us = <600>;
				exit-latency-us = <600>;
				min-residency-us = <1200>;
			};

			MCDI_CLUSTER: mcdi-cluster {
				compatible = "arm,idle-state";
				arm,psci-suspend-param = <0x01010001>;
				entry-latency-us = <600>;
				exit-latency-us = <600>;
				min-residency-us = <1200>;
			};

			SODI: sodi {
				compatible = "arm,idle-state";
				arm,psci-suspend-param = <0x01010002>;
				entry-latency-us = <800>;
				exit-latency-us = <1000>;
				min-residency-us = <2000>;
			};

			SODI3: sodi3 {
				compatible = "arm,idle-state";
				arm,psci-suspend-param = <0x01010003>;
				entry-latency-us = <800>;
				exit-latency-us = <1000>;
				min-residency-us = <2000>;
			};

			DPIDLE: dpidle {
				compatible = "arm,idle-state";
				arm,psci-suspend-param = <0x01010004>;
				entry-latency-us = <800>;
				exit-latency-us = <1000>;
				min-residency-us = <2000>;
			};

			SUSPEND: suspend {
				compatible = "arm,idle-state";
				arm,psci-suspend-param = <0x01010005>;
				entry-latency-us = <800>;
				exit-latency-us = <1000>;
				min-residency-us = <2000>;
			};
		};
	};

	psci {
		compatible      = "arm,psci-1.0";
		method          = "smc";
	};

	pmu {
		compatible = "arm,armv8-pmuv3";
		interrupt-parent = <&gic>;
		interrupts = <GIC_PPI 7 IRQ_TYPE_LEVEL_LOW>;
	};

	memory {
		device_type = "memory";
		reg = <0 0x40000000 0 0x1e605000>;
	};

	cpu_dbgapb: cpu_dbgapb@0d410000 {
		compatible = "mediatek,hw_dbg";
		num = <8>;
		reg =	<0 0x0d410000 0 0x1000>,
			<0 0x0d510000 0 0x1000>,
			<0 0x0d610000 0 0x1000>,
			<0 0x0d710000 0 0x1000>,
			<0 0x0d810000 0 0x1000>,
			<0 0x0d910000 0 0x1000>,
			<0 0x0da10000 0 0x1000>,
			<0 0x0db10000 0 0x1000>;
	};

	/* ATF logger SW IRQ number 277 = 32 + 245 */
	atf_logger {
		compatible = "mediatek,atf_logger";
		interrupts = <GIC_SPI 245 IRQ_TYPE_EDGE_RISING>;
	};

	/* AMMS SW IRQ number GIC:338 = DTS:306 +32 */
	amms_control {
		compatible = "mediatek,amms";
		interrupts = <GIC_SPI 306 IRQ_TYPE_EDGE_RISING>;
	};

	/* Microtrust SW IRQ number 296(328) ~ 301(333) */
	utos {
		compatible = "microtrust,utos";
		interrupts = <GIC_SPI 296 IRQ_TYPE_EDGE_RISING>,
			<GIC_SPI 297 IRQ_TYPE_EDGE_RISING>;
	};
	utos_tester {
		compatible = "microtrust,tester-v1";
	};

	msdc0:msdc@11230000 {
		compatible = "mediatek,msdc";
		reg = <0x0 0x11230000 0x0 0x10000>;
		interrupts = <GIC_SPI 77 IRQ_TYPE_LEVEL_LOW>;
	};

	msdc1:msdc@11240000 {
		compatible = "mediatek,msdc";
		reg = <0x0 0x11240000 0x0 0x10000>;
		interrupts = <GIC_SPI 78 IRQ_TYPE_LEVEL_LOW>;
	};

	msdc0_top@11f50000 {
		compatible = "mediatek,msdc0_top";
		reg = <0 0x11f50000 0 0x1000>;
	};

	msdc1_top@11e10000 {
		compatible = "mediatek,msdc1_top";
		reg = <0 0x11e10000 0 0x1000>;
	};

	reserved_memory: reserved-memory {
		#address-cells = <2>;
		#size-cells = <2>;
		ranges;

		zmc-default {
			compatible = "mediatek,zone_movable_cma";
			size = <0 0x2d000000>;
			alignment = <0 0x1000000>;
			alloc-ranges = <0 0xc0000000 1 0x80000000>;
		};

		/*TODO: add reserved memory node here*/
		reserve-memory-sspm_share {
			compatible = "mediatek,reserve-memory-sspm_share";
			no-map;
			status = "okay";
#ifdef CONFIG_MTK_GMO_RAM_OPTIMIZE
			size = <0 0x110000>; /* 1M + 64K */
#else
			size = <0 0x510000>; /* 5M + 64K */
#endif
			alignment = <0 0x10000>;
			alloc-ranges = <0 0x40000000 0 0x60000000>;
		};
		reserve-memory-scp_share {
			compatible = "mediatek,reserve-memory-scp_share";
			no-map;
			size = <0 0x00380000>;
			alignment = <0 0x1000000>;
			alloc-ranges = <0 0x40000000 0 0x50000000>; /*0x4000_0000~0x8FFF_FFFF*/
		};
		consys-reserve-memory {
			compatible = "mediatek,consys-reserve-memory";
			no-map;
			size = <0 0x200000>;
			alignment = <0 0x200000>;
			alloc-ranges = <0 0x40000000 0 0x80000000>;
		};
		ion-carveout-heap {
			compatible = "mediatek,ion-carveout-heap";
			no-map;
			size = <0 0x5000>;
			alignment = <0 0x1000>;
			alloc-ranges = <0 0xc0000000 0 0x10000000>;
		};
#ifdef CONFIG_MICROTRUST_TEE_SUPPORT
		soter-shared-mem {
			compatible = "microtrust,shared_mem";
			no-map;
#if defined(CONFIG_MTK_SEC_VIDEO_PATH_SUPPORT) || \
	defined(CONFIG_MTK_CAM_SECURITY_SUPPORT)
			size = <0 0x800000>;
			alignment = <0 0x1000000>;
#else
			size = <0 0x200000>;
			alignment = <0 0x200000>;
#endif
			alloc-ranges = <0 0x40000000 0 0x50000000>;
		};
#endif
	};

	gic: interrupt-controller@0c000000 {
		compatible = "arm,gic-v3";
		#interrupt-cells = <3>;
		#address-cells = <2>;
		#size-cells = <2>;
		#redistributor-regions = <1>;
		interrupt-parent = <&gic>;
		interrupt-controller;
		reg = <0 0x0c000000 0 0x40000>, // distributor
		      <0 0x0c100000 0 0x200000>, // redistributor
		      <0 0x0c530a80 0 0x50>; // intpol
		interrupts = <GIC_PPI 9 IRQ_TYPE_LEVEL_HIGH>;
	};

	sysirq: intpol-controller@0c530620 {
		compatible = "mediatek,mt6771-sysirq",
			     "mediatek,mt6577-sysirq";
		interrupt-controller;
		#interrupt-cells = <3>;
		interrupt-parent = <&gic>;
		reg = <0 0x0c530a80 0 0x50>;
	};

	mobicore {
		compatible = "trustonic,mobicore";
		interrupts = <GIC_SPI 304 IRQ_TYPE_EDGE_RISING>;
	};

	chipid@08000000 {
		compatible = "mediatek,chipid";
		reg = <0 0x08000000 0 0x0004>,
		      <0 0x08000004 0 0x0004>,
		      <0 0x08000008 0 0x0004>,
		      <0 0x0800000c 0 0x0004>;
	};

	timer: timer {
		compatible = "arm,armv8-timer";
		interrupt-parent = <&gic>;
		interrupts = <GIC_PPI 13 IRQ_TYPE_LEVEL_LOW>,
				<GIC_PPI 14 IRQ_TYPE_LEVEL_LOW>,
				<GIC_PPI 11 IRQ_TYPE_LEVEL_LOW>,
				<GIC_PPI 10 IRQ_TYPE_LEVEL_LOW>;
		clock-frequency = <13000000>;
	};

	clocks {
		clk_null: clk_null {
			compatible = "fixed-clock";
			#clock-cells = <0>;
			clock-frequency = <0>;
		};

		clk26m: clk26m {
			compatible = "fixed-clock";
			#clock-cells = <0>;
			clock-frequency = <26000000>;
		};

		clk32k: clk32k {
			compatible = "fixed-clock";
			#clock-cells = <0>;
			clock-frequency = <32000>;
		};
	};

	topckgen: topckgen@10000000 {
		compatible = "mediatek,topckgen", "syscon";
		reg = <0 0x10000000 0 0x1000>;
		#clock-cells = <1>;
	};

	infracfg_ao: infracfg_ao@10001000 {
		compatible = "mediatek,infracfg_ao", "syscon";
		reg = <0 0x10001000 0 0x1000>;
		interrupts = <GIC_SPI 150 IRQ_TYPE_EDGE_RISING>;
		#clock-cells = <1>;
	};

	scpsys: scpsys@10001000 {
		compatible = "mediatek,scpsys";
		reg = <0 0x10001000 0 0x1000>,
				<0 0x10006000 0 0x1000>,
				<0 0x1020e000 0 0x1000>,
				<0 0x10000000 0 0x1000>,
				<0 0x1a001000 0 0x1000>,
				<0 0x14019000 0 0x1000>;
		#clock-cells = <1>;
	};

	pericfg@10003000 {
		compatible = "mediatek,pericfg";
		reg = <0 0x10003000 0 0x1000>;
	};

	gpio_usage_mapping:gpio {
		compatible = "mediatek,gpio_usage_mapping";
	};

	gpio: gpio@10005000 {
		compatible = "mediatek,gpio", "syscon";
		reg = <0 0x10005000 0 0x1000>;
	};

	iocfg_0: iocfg_0@11f20000 {
		compatible = "mediatek,iocfg_0", "syscon";
		reg = <0 0x11f20000 0 0x1000>;
	};

	iocfg_1: iocfg_1@11e80000 {
		compatible = "mediatek,iocfg_1", "syscon";
		reg = <0 0x11e80000 0 0x1000>;
	};

	iocfg_2: iocfg_2@11e70000 {
		compatible = "mediatek,iocfg_2", "syscon";
		reg = <0 0x11e70000 0 0x1000>;
	};

	iocfg_3: iocfg_3@11e90000 {
		compatible = "mediatek,iocfg_3", "syscon";
		reg = <0 0x11e90000 0 0x1000>;
	};

	iocfg_4: iocfg_4@11d30000 {
		compatible = "mediatek,iocfg_4", "syscon";
		reg = <0 0x11d30000 0 0x1000>;
	};

	iocfg_5: iocfg_5@11d20000 {
		compatible = "mediatek,iocfg_5", "syscon";
		reg = <0 0x11d20000 0 0x1000>;
	};

	iocfg_6: iocfg_6@11c50000 {
		compatible = "mediatek,iocfg_6", "syscon";
		reg = <0 0x11c50000 0 0x1000>;
	};

	iocfg_7: iocfg_7@11f30000 {
		compatible = "mediatek,iocfg_7", "syscon";
		reg = <0 0x11f30000 0 0x1000>;
	};

	pio: 1000b000.pinctrl {
		compatible = "mediatek,mt6771-pinctrl";
		reg_bases = <&gpio>,
			<&iocfg_0>,
			<&iocfg_1>,
			<&iocfg_2>,
			<&iocfg_3>,
			<&iocfg_4>,
			<&iocfg_5>,
			<&iocfg_6>,
			<&iocfg_7>;
		reg_base_eint = <&eint>;
		pins-are-numbered;
		gpio-controller;
		gpio-ranges = <&pio 0 0 191>;
		#gpio-cells = <2>;
		interrupt-controller;
		#interrupt-cells = <4>;
		interrupts = <GIC_SPI 177 IRQ_TYPE_LEVEL_HIGH>;
	};

	i2c_common: i2c_common {
		compatible = "mediatek,i2c_common";
		dma_support = /bits/ 8 <2>;
		idvfs = /bits/ 8 <1>;
		set_dt_div = /bits/ 8 <1>;
		check_max_freq = /bits/ 8 <1>;
		ver = /bits/ 8 <2>;
		set_ltiming = /bits/ 8 <1>;
		ext_time_config = /bits/ 16 <0x1801>;
		cnt_constraint = /bits/ 8 <1>;
	};

	i2c0: i2c@11007000 {
		compatible = "mediatek,i2c";
		id = <0>;
		reg = <0 0x11007000 0 0x1000>,
			<0 0x11000080 0 0x80>;
		interrupts = <GIC_SPI 81 IRQ_TYPE_LEVEL_LOW>;
		clocks = <&infracfg_ao INFRACFG_AO_I2C0_CG>,
			 <&infracfg_ao INFRACFG_AO_AP_DMA_CG>;
		clock-names = "main", "dma";
		clock-div = <5>;
		mediatek,hs_only;
		mediatek,skip_scp_sema;
	};

	i2c1: i2c@11011000 {
		compatible = "mediatek,i2c";
		id = <1>;
		reg = <0 0x11011000 0 0x1000>,
			<0 0x11000480 0 0x80>;
		interrupts = <GIC_SPI 85 IRQ_TYPE_LEVEL_LOW>;
		clocks = <&infracfg_ao INFRACFG_AO_I2C4_CG>,
			 <&infracfg_ao INFRACFG_AO_AP_DMA_CG>;
		clock-names = "main", "dma";
		clock-div = <5>;
		mediatek,hs_only;
		mediatek,skip_scp_sema;
	};

	i2c2: i2c@11009000 {
		compatible = "mediatek,i2c";
		id = <2>;
		reg = <0 0x11009000 0 0x1000>,
			<0 0x11000280 0 0x80>;
		interrupts = <GIC_SPI 83 IRQ_TYPE_LEVEL_LOW>;
		clocks = <&infracfg_ao INFRACFG_AO_I2C2_CG>,
			 <&infracfg_ao INFRACFG_AO_AP_DMA_CG>,
			 <&infracfg_ao INFRACFG_AO_I2C2_ARBITER_CG>;
		clock-names = "main", "dma", "arb";
		clock-div = <5>;
		ch_offset_default = <0x100>;
		ccu-ch-offset = <0x200>;
		mediatek,hs_only;
	};

	i2c3: i2c@1100f000 {
		compatible = "mediatek,i2c";
		id = <3>;
		reg = <0 0x1100f000 0 0x1000>,
			<0 0x11000400 0 0x80>;
		interrupts = <GIC_SPI 84 IRQ_TYPE_LEVEL_LOW>;
		clocks = <&infracfg_ao INFRACFG_AO_I2C3_CG>,
			 <&infracfg_ao INFRACFG_AO_AP_DMA_CG>;
		clock-names = "main", "dma";
		clock-div = <5>;
		mediatek,hs_only;
	};

	i2c4: i2c@11008000 {
		compatible = "mediatek,i2c";
		id = <4>;
		reg = <0 0x11008000 0 0x1000>,
			<0 0x11000100 0 0x80>;
		interrupts = <GIC_SPI 82 IRQ_TYPE_LEVEL_LOW>;
		clocks = <&infracfg_ao INFRACFG_AO_I2C1_CG>,
			 <&infracfg_ao INFRACFG_AO_AP_DMA_CG>,
			 <&infracfg_ao INFRACFG_AO_I2C1_ARBITER_CG>;
		clock-names = "main", "dma", "arb";
		clock-div = <5>;
		ch_offset_default = <0x100>;
		ccu-ch-offset = <0x200>;
		mediatek,hs_only;
	};

	i2c5: i2c@11017000 {
		compatible = "mediatek,i2c";
		id = <5>;
		reg = <0 0x11017000 0 0x1000>,
			<0 0x11000580 0 0x80>;
		interrupts = <GIC_SPI 133 IRQ_TYPE_LEVEL_LOW>;
		clocks = <&infracfg_ao INFRACFG_AO_I2C5_IMM_CG>,
			 <&infracfg_ao INFRACFG_AO_AP_DMA_CG>,
			 <&infracfg_ao INFRACFG_AO_I2C5_ARBITER_CG>;
		clock-names = "main", "dma", "arb";
		clock-div = <5>;
		mediatek,hs_only;
	};

	i2c6: i2c@11005000 {
		compatible = "mediatek,i2c";
		id = <6>;
		reg = <0 0x11005000 0 0x1000>,
			<0 0x11000600 0 0x80>;
		interrupts = <GIC_SPI 87 IRQ_TYPE_LEVEL_LOW>;
		clocks = <&infracfg_ao INFRACFG_AO_I2C6_CG>,
			 <&infracfg_ao INFRACFG_AO_AP_DMA_CG>;
		clock-names = "main", "dma";
		clock-div = <5>;
		mediatek,hs_only;
	};

	i2c7: i2c@1101a000 {
		compatible = "mediatek,i2c";
		id = <7>;
		reg = <0 0x1101a000 0 0x1000>,
			<0 0x11000680 0 0x80>;
		interrupts = <GIC_SPI 88 IRQ_TYPE_LEVEL_LOW>;
		clocks = <&infracfg_ao INFRACFG_AO_I2C7_CG>,
			 <&infracfg_ao INFRACFG_AO_AP_DMA_CG>;
		clock-names = "main", "dma";
		clock-div = <5>;
		mediatek,hs_only;
	};

	i2c8: i2c@1101b000 {
		compatible = "mediatek,i2c";
		id = <8>;
		reg = <0 0x1101b000 0 0x1000>,
			<0 0x11000700 0 0x80>;
		interrupts = <GIC_SPI 89 IRQ_TYPE_LEVEL_LOW>;
		clocks = <&infracfg_ao INFRACFG_AO_I2C8_CG>,
			 <&infracfg_ao INFRACFG_AO_AP_DMA_CG>;
		clock-names = "main", "dma";
		clock-div = <5>;
		mediatek,hs_only;
	};

	i2c9: i2c@11014000 {
		compatible = "mediatek,i2c";
		id = <9>;
		reg = <0 0x11014000 0 0x1000>,
			<0 0x11000180 0 0x80>;
		interrupts = <GIC_SPI 131 IRQ_TYPE_LEVEL_LOW>;
		clocks = <&infracfg_ao INFRACFG_AO_I2C1_IMM_CG>,
			 <&infracfg_ao INFRACFG_AO_AP_DMA_CG>,
			 <&infracfg_ao INFRACFG_AO_I2C1_ARBITER_CG>;
		clock-names = "main", "dma", "arb";
		clock-div = <5>;
		mediatek,hs_only;
	};

	i2c10: i2c@11015000 {
		compatible = "mediatek,i2c";
		id = <10>;
		reg = <0 0x11015000 0 0x1000>,
			<0 0x11000300 0 0x80>;
		interrupts = <GIC_SPI 132 IRQ_TYPE_LEVEL_LOW>;
		clocks = <&infracfg_ao INFRACFG_AO_I2C2_IMM_CG>,
			 <&infracfg_ao INFRACFG_AO_AP_DMA_CG>,
			 <&infracfg_ao INFRACFG_AO_I2C2_ARBITER_CG>;
		clock-names = "main", "dma", "arb";
		clock-div = <5>;
		mediatek,hs_only;
	};

	i2c11: i2c@11016000 {
		compatible = "mediatek,i2c";
		id = <11>;
		reg = <0 0x11016000 0 0x1000>,
			<0 0x11000500 0 0x80>;
		interrupts = <GIC_SPI 86 IRQ_TYPE_LEVEL_LOW>;
		clocks = <&infracfg_ao INFRACFG_AO_I2C5_CG>,
			 <&infracfg_ao INFRACFG_AO_AP_DMA_CG>,
			 <&infracfg_ao INFRACFG_AO_I2C5_ARBITER_CG>;
		clock-names = "main", "dma", "arb";
		clock-div = <5>;
		mediatek,hs_only;
	};

	sspm@10440000 {
		compatible = "mediatek,sspm";
		reg = <0 0x10440000 0 0x10000>,
			<0 0x10450000 0 0x100>,
			<0 0x10451000 0 0x8>,
			<0 0x10460000 0 0x100>,
			<0 0x10461000 0 0x8>,
			<0 0x10470000 0 0x100>,
			<0 0x10471000 0 0x8>,
			<0 0x10480000 0 0x100>,
			<0 0x10481000 0 0x8>,
			<0 0x10490000 0 0x100>,
			<0 0x10491000 0 0x8>;

		reg-names = "cfgreg",
			"mbox0_base",
			"mbox0_ctrl",
			"mbox1_base",
			"mbox1_ctrl",
			"mbox2_base",
			"mbox2_ctrl",
			"mbox3_base",
			"mbox3_ctrl",
			"mbox4_base",
			"mbox4_ctrl";

		interrupts = <GIC_SPI 208 IRQ_TYPE_LEVEL_HIGH>,
			<GIC_SPI 211 IRQ_TYPE_LEVEL_HIGH>,
			<GIC_SPI 212 IRQ_TYPE_LEVEL_HIGH>,
			<GIC_SPI 213 IRQ_TYPE_LEVEL_HIGH>,
			<GIC_SPI 214 IRQ_TYPE_LEVEL_HIGH>,
			<GIC_SPI 215 IRQ_TYPE_LEVEL_HIGH>;

		interrupt-names = "ipc",
			"mbox0",
			"mbox1",
			"mbox2",
			"mbox3",
			"mbox4";
	};

	sleep@10006000 {
		compatible = "mediatek,sleep";
		reg = <0 0x10006000 0 0x1000>;
		interrupts = <GIC_SPI 187 IRQ_TYPE_LEVEL_LOW>;
		wakeup-source = <&keypad 0 (1 << 2)>,
				<&consys 1 (1 << 5)>,
				<&mdcldma 3 (1 << 25)>;
	};

	toprgu@10007000 {
		compatible = "mediatek,toprgu";
		reg = <0 0x10007000 0 0x1000>;
		interrupts = <GIC_SPI 142 IRQ_TYPE_NONE>;
	};

	apxgpt@10008000 {
		compatible = "mediatek,apxgpt";
		reg = <0 0x10008000 0 0x100>;
		interrupts = <GIC_SPI 176 IRQ_TYPE_LEVEL_LOW>;
		clocks =
			<&clk32k>;
	};

	rsvd@10009000 {
		compatible = "mediatek,rsvd";
		reg = <0 0x10009000 0 0x1000>;
	};

	hacc@1000a000 {
		compatible = "mediatek,hacc";
		reg = <0 0x1000a000 0 0x1000>;
		interrupts = <GIC_SPI 195 IRQ_TYPE_LEVEL_LOW>;
	};

	eint: apirq@1000b000 {
		compatible = "mediatek,apirq";
		reg = <0 0x1000b000 0 0x1000>;
		interrupts = <GIC_SPI 177 IRQ_TYPE_LEVEL_HIGH>;
	};

	apmixed: apmixed@1000c000 {
		compatible = "mediatek,apmixed", "syscon";
		reg = <0 0x1000c000 0 0x1000>;
		#clock-cells = <1>;
	};

	fhctl@1000ce00 {
		compatible = "mediatek,fhctl";
		reg = <0 0x1000ce00 0 0x1000>;
	};

	pwrap: pwrap@1000d000 {
		compatible = "mediatek,pwrap";
		reg = <0 0x1000d000 0 0x1000>;
		reg-names = "pwrap";
		interrupts = <GIC_SPI 185 IRQ_TYPE_LEVEL_HIGH>;
		clocks = <&clk26m>, <&clk26m>;
		clock-names = "spi", "wrap";

		main_pmic: mt6358-pmic {
			interrupt-parent = <&pio>;
			interrupts = <182 IRQ_TYPE_LEVEL_HIGH 182 0>;
			status = "okay";
		};
	};

	pwraph: pwraphal@ {
		compatible = "mediatek,pwraph";
		mediatek,pwrap-regmap = <&pwrap>;
	};

	pwrap_mpu@1000d000 {
		compatible = "mediatek,pwrap_mpu";
		reg = <0 0x1000d000 0 0x1000>;
	};

	pwrap_p2p@1005e000 {
		compatible = "mediatek,pwrap_p2p";
		reg = <0 0x105cb000 0 0x1000>;
	};

	pwrap_md32@10448000 {
		compatible = "mediatek,pwrap_md32";
		reg = <0 0x10448000 0 0x1000>;
	};

	sleep_reg_md@1000f000 {
		compatible = "mediatek,sleep_reg_md";
		reg = <0 0x1000f000 0 0x1000>;
	};

	keypad: kp@10010000 {
		compatible = "mediatek,kp";
		reg = <0 0x10010000 0 0x1000>;
		interrupts = <GIC_SPI 186 IRQ_TYPE_EDGE_FALLING>;
	};

	mrdump_ext_rst: mrdump_ext_rst {
		compatible = "mediatek, mrdump_ext_rst-eint";
		force_mode = "EINT";
		mode = "IRQ";
		status = "okay";
	};

	topmisc@10011000 {
		compatible = "mediatek,topmisc";
		reg = <0 0x10011000 0 0x1000>;
	};

	dvfsrc_top@10012000 {
		compatible = "mediatek,dvfsrc_top";
		reg = <0 0x10012000 0 0x1000>,
		      <0 0x0011bb80 0 0x80>;
	};

	apcldmain_ao@10014000 {
		compatible = "mediatek,apcldmain_ao";
		reg = <0 0x10014000 0 0x1000>;
	};

	apcldmaout_ao@10014400 {
		compatible = "mediatek,apcldmaout_ao";
		reg = <0 0x10014400 0 0x1000>;
	};

	apcldmamisc_ao@10014800 {
		compatible = "mediatek,apcldmamisc_ao";
		reg = <0 0x10014800 0 0x1000>;
	};

	devapc_mpu_ao@10015000 {
		compatible = "mediatek,devapc_mpu_ao";
		reg = <0 0x10015000 0 0x1000>;
	};

	aes_top0@10016000 {
		compatible = "mediatek,aes_top0";
		reg = <0 0x10016000 0 0x1000>;
	};

	sys_timer@10017000 {
		compatible = "mediatek,sys_timer";
		reg =
			/* system timer register base */
			<0 0x10017000 0 0x1000>;
		reg-names =
			"sys_timer_base";
		interrupts = <GIC_SPI 202 IRQ_TYPE_LEVEL_HIGH>;
	};

	modem_temp_share@10018000 {
		compatible = "mediatek,modem_temp_share";
		reg = <0 0x10018000 0 0x1000>;
	};

	mbist_ao@10013000 {
		compatible = "mediatek,mbist_ao";
		reg = <0 0x10013000 0 0x1000>;
	};

	security_ao@1001a000 {
		compatible = "mediatek,security_ao";
		reg = <0 0x1001a000 0 0x1000>;
	};

	topckgen_ao@1001b000 {
		compatible = "mediatek,topckgen_ao";
		reg = <0 0x1001b000 0 0x1000>;
	};

	scp: scp@10500000 {
		compatible = "mediatek,scp";
		status = "okay";
		reg = <0 0x10500000 0 0x80000>,
			<0 0x105c0000 0 0x3000>,
			<0 0x105c4000 0 0x1000>,
			<0 0x105d4000 0 0x6000>;
		interrupts = <GIC_SPI 174 IRQ_TYPE_LEVEL_HIGH>;
	};
	scp_cfgreg@105c0000 {
		compatible = "mediatek,scp_cfgreg";
		reg = <0 0x105c0000 0 0x1000>;
	};

	scp_mad@105c1000 {
		compatible = "mediatek,scp_mad";
		reg = <0 0x105c1000 0 0x1000>;
	};

	scp_intc@105c2000 {
		compatible = "mediatek,scp_intc";
		reg = <0 0x105c2000 0 0x1000>;
	};

	scp_timer@105c3000 {
		compatible = "mediatek,scp_timer";
		reg = <0 0x105c3000 0 0x1000>;
	};

	scp_clk_ctrl@105c4000 {
		compatible = "mediatek,scp_clk_ctrl";
		reg = <0 0x105c4000 0 0x1000>;
	};

	scp_i2c0@105c5000 {
		compatible = "mediatek,scp_i2c0";
		reg = <0 0x105c5000 0 0x1000>;
	};

	scp_i2c1@105c6000 {
		compatible = "mediatek,scp_i2c1";
		reg = <0 0x105c6000 0 0x1000>;
	};

	scp_i2c2@105c7000 {
		compatible = "mediatek,scp_i2c2";
		reg = <0 0x105c7000 0 0x1000>;
	};

	scp_gpio@105c8000 {
		compatible = "mediatek,scp_gpio";
		reg = <0 0x105c8000 0 0x1000>;
	};

	scp_uart@105c9000 {
		compatible = "mediatek,scp_uart";
		reg = <0 0x105c9000 0 0x1000>;
	};

	scp_cirq_eint@105ca000 {
		compatible = "mediatek,scp_cirq_eint";
		reg = <0 0x105ca000 0 0x1000>;
	};

	scp_dma@105cd000 {
		compatible = "mediatek,scp_dma";
		reg = <0 0x105cd000 0 0x1000>;
	};

	scp_uart1@105ce000 {
		compatible = "mediatek,scp_uart1";
		reg = <0 0x105ce000 0 0x1000>;
	};

	scp_spi0@105cf000 {
		compatible = "mediatek,scp_spi0";
		reg = <0 0x105cf000 0 0x1000>;
	};

	scp_spi1@105d0000 {
		compatible = "mediatek,scp_spi1";
		reg = <0 0x105d0000 0 0x1000>;
	};

	scp_spi2@105d1000 {
		compatible = "mediatek,scp_spi2";
		reg = <0 0x105d1000 0 0x1000>;
	};

	dbgapb@0d000000 {
		compatible = "mediatek,dbgapb";
		reg = <0 0x0d000000 0 0x1000>;
	};

	mcucfg@0c530000 {
		compatible = "mediatek,mcucfg";
		reg = <0 0x0c530000 0 0x1000>;
		interrupts = <GIC_SPI 0 IRQ_TYPE_LEVEL_LOW>;
	};

	mp0_cpucfg@0c530000 {
		compatible = "mediatek,mp0_cpucfg";
		reg = <0 0x0c530000 0 0x1000>;
	};

	mp1_cpucfg@0c530200 {
		compatible = "mediatek,mp1_cpucfg";
		reg = <0 0x0c530200 0 0x1000>;
	};

	mcu_misccfg@0c530400 {
		compatible = "mediatek,mcu_misccfg";
		reg = <0 0x0c530400 0 0x1000>;
	};

	mcu_misc1cfg@0c530800 {
		compatible = "mediatek,mcu_misc1cfg";
		reg = <0 0x0c530800 0 0x1000>;
	};

	mp2_ca15m_config@0c532000 {
		compatible = "mediatek,mp2_ca15m_config";
		reg = <0 0x0c532000 0 0x1000>;
	};

	mcucfg_mp0_counter@0c530000 {
		compatible = "mediatek,mcucfg_mp0_counter";
		reg = <0 0x0c530000 0 0x2000>;
	};

	mcucfg_mp2_counter@0c532000 {
		compatible = "mediatek,mcucfg_mp2_counter";
		reg = <0 0x0c532000 0 0x1000>;
	};

	infracfg@1020e000 {
		compatible = "mediatek,infracfg";
		reg = <0 0x1020e000 0 0x1000>;
	};

	sramrom@10214000 {
		compatible = "mediatek,sramrom";
		reg = <0 0x10214000 0 0x1000>;
	};

	emi@10219000 {
		compatible = "mediatek,emi";
		reg = <0 0x10219000 0 0x1000>, /* CEN EMI */
			<0 0x10226000 0 0x1000>, /* EMI MPU */
			<0 0x1022d000 0 0x1000>, /* CHA EMI */
			<0 0x10235000 0 0x1000>; /* CHB EMI */
		interrupts = <GIC_SPI 147 IRQ_TYPE_LEVEL_LOW>, /* MPU */
				<GIC_SPI 148 IRQ_TYPE_LEVEL_HIGH>, /* CGM */
				<GIC_SPI 155 IRQ_TYPE_LEVEL_HIGH>; /* ELM */
	};

	sys_cirq@10204000 {
		compatible = "mediatek,sys_cirq";
		reg = <0 0x10204000 0 0x1000>;
		mediatek,cirq_num = <231>;
		mediatek,spi_start_offset = <72>;
		interrupts = <GIC_SPI 303 IRQ_TYPE_LEVEL_LOW>;
	};

	m4u@10205000 {
		cell-index = <0>;
		compatible = "mediatek,m4u";
		reg = <0 0x10205000 0 0x1000>;
		interrupts = <GIC_SPI 166 IRQ_TYPE_LEVEL_LOW>;
	};

	devapc@10207000 {
		compatible = "mediatek,devapc";
		reg = <0 0x10207000 0 0x1000>,
			<0 0x1000E000 0 0x1000>;
		interrupts = <GIC_SPI 145 IRQ_TYPE_LEVEL_LOW>;
		clocks = <&infracfg_ao INFRACFG_AO_DEVICE_APC_CG>;
		clock-names = "devapc-infra-clock";
	};

	bus_dbg@10208000 {
		compatible = "mediatek,bus_dbg-v2";
		reg = <0 0x10208000 0 0x1000>;
		interrupts = <GIC_SPI 144 IRQ_TYPE_LEVEL_LOW>;
	};

	ap_ccif0@10209000 {
		compatible = "mediatek,ap_ccif0";
		reg = <0 0x10209000 0 0x1000>;
		interrupts = <GIC_SPI 151 IRQ_TYPE_LEVEL_LOW>;
	};

	md_ccif0@1020a000 {
		compatible = "mediatek,md_ccif0";
		reg = <0 0x1020a000 0 0x1000>;
	};

	ap_ccif1@1020b000 {
		compatible = "mediatek,ap_ccif1";
		reg = <0 0x1020b000 0 0x1000>;
		interrupts = <GIC_SPI 153 IRQ_TYPE_LEVEL_LOW>;
	};

	md_ccif1@1020c000 {
		compatible = "mediatek,md_ccif1";
		reg = <0 0x1020c000 0 0x1000>;
	};

	ap_ccif2@1023c000 {
		compatible = "mediatek,ap_ccif2";
		reg = <0 0x1023c000 0 0x1000>;
		interrupts = <GIC_SPI 156 IRQ_TYPE_LEVEL_LOW>;
	};

	md_ccif2@1023d000 {
		compatible = "mediatek,md_ccif2";
		reg = <0 0x1023d000 0 0x1000>;
	};

	ap_ccif3@1023e000 {
		compatible = "mediatek,ap_ccif3";
		reg = <0 0x1023e000 0 0x1000>;
		interrupts = <GIC_SPI 157 IRQ_TYPE_LEVEL_LOW>;
	};

	md_ccif3@1023f000 {
		compatible = "mediatek,md_ccif3";
		reg = <0 0x1023f000 0 0x1000>;
	};

	infra_mbist@1020d000 {
		compatible = "mediatek,infra_mbist";
		reg = <0 0x1020d000 0 0x1000>;
	};

	hwrng: hwrng {
		compatible = "mediatek,mt67xx-rng";
	};

	dxcc_sec@10210000 {
		compatible = "mediatek,dxcc_sec";
		reg = <0 0x10210000 0 0x1000>;
		interrupts = <GIC_SPI 170 IRQ_TYPE_LEVEL_HIGH>;
	};

	smi_common_ao@10211000 {
		compatible = "mediatek,smi_common_ao";
		reg = <0 0x10211000 0 0x1000>;
	};

	cq_dma@10212000 {
		compatible = "mediatek,mt-cqdma-v1";
		reg = <0 0x10212000 0 0x80>,
			<0 0x10212080 0 0x80>,
			<0 0x10212100 0 0x80>;
		interrupts = <GIC_SPI 115 IRQ_TYPE_LEVEL_LOW>,
			<GIC_SPI 116 IRQ_TYPE_LEVEL_LOW>,
			<GIC_SPI 117 IRQ_TYPE_LEVEL_LOW>;
		nr_channel = <3>;
		clocks = <&infracfg_ao INFRACFG_AO_CQ_DMA_CG>;
		clock-names = "cqdma";
	};

	wifi: wifi@180f0000 {
		compatible = "mediatek,wifi";
		reg = <0 0x180f0000 0 0x1100>, /* WIFI-HIF base */
		      <0 0x10212180 0 0x006c>, /* DMA base */
		      <0 0x10001000 0 0x1000>, /* INFRACFG_AO_BASE */
		      <0 0x180e0000 0 0x0070>; /* CONN remap config base */
		interrupts = <GIC_SPI 290 IRQ_TYPE_LEVEL_LOW>, /* WIFI-HIF IRQ */
			     <GIC_SPI 118 IRQ_TYPE_LEVEL_LOW>; /* DMA IRQ */
		clocks = <&infracfg_ao INFRACFG_AO_CQ_DMA_CG>;
		clock-names = "wifi-dma";
		hardware-values = <0x00000788>, /* HW code */
				  <0x000a5800>, /* FW load addr */
				  <0x000a5800>; /* FW start addr */
	};

	mipi_tx0@11e50000 {
		compatible = "mediatek,mipi_tx0";
		reg = <0 0x11e50000 0 0x1000>;
	};

	mipi_tx1@10216000 {
		compatible = "mediatek,mipi_tx1";
		reg = <0 0x10216000 0 0x1000>;
	};

	mipi_rx_ana_csi0a@11c80000 {
		compatible = "mediatek,mipi_rx_ana_csi0a";
		reg = <0 0x11c80000 0 0x1000>;
	};

	mipi_rx_ana_csi0b@11c81000 {
		compatible = "mediatek,mipi_rx_ana_csi0b";
		reg = <0 0x11c81000 0 0x1000>;
	};

	mipi_rx_ana_csi1a@11c82000 {
		compatible = "mediatek,mipi_rx_ana_csi1a";
		reg = <0 0x11c82000 0 0x1000>;
	};

	mipi_rx_ana_csi1b@11c83000 {
		compatible = "mediatek,mipi_rx_ana_csi1b";
		reg = <0 0x11c83000 0 0x1000>;
	};

	mipi_rx_ana_csi2a@11c84000 {
		compatible = "mediatek,mipi_rx_ana_csi2a";
		reg = <0 0x11c84000 0 0x1000>;
	};

	mipi_rx_ana_csi2b@11c85000 {
		compatible = "mediatek,mipi_rx_ana_csi2b";
		reg = <0 0x11c85000 0 0x1000>;
	};

	gcpu_rsa@1021a000 {
		compatible = "mediatek,gcpu_rsa";
		reg = <0 0x1021a000 0 0x1000>;
	};

	apcldmain@1021b000 {
		compatible = "mediatek,apcldmain";
		reg = <0 0x1021b000 0 0x1000>;
	};

	apcldmaout@1021b400 {
		compatible = "mediatek,apcldmaout";
		reg = <0 0x1021b400 0 0x1000>;
	};

	apcldmamisc@1021b800 {
		compatible = "mediatek,apcldmamisc";
		reg = <0 0x1021b800 0 0x1000>;
		interrupts = <GIC_SPI 173 IRQ_TYPE_LEVEL_HIGH>;
	};

	mdcldmain@1021c000 {
		compatible = "mediatek,mdcldmain";
		reg = <0 0x1021c000 0 0x1000>;
	};

	mdcldmaout@1021c400 {
		compatible = "mediatek,mdcldmaout";
		reg = <0 0x1021c400 0 0x1000>;
	};

	mdcldmamisc@1021c800 {
		compatible = "mediatek,mdcldmamisc";
		reg = <0 0x1021c800 0 0x1000>;
	};

	infra_md@1021d000 {
		compatible = "mediatek,infra_md";
		reg = <0 0x1021d000 0 0x1000>;
	};

	mdcldma:mdcldma@10014000 {
		compatible = "mediatek,mdcldma";
		reg =	<0 0x10014000 0 0x1000>, /*AP_CLDMA_AO "mediatek,apcldmain_ao"*/
			<0 0x1021b000 0 0x1000>, /*AP_CLDMA_PDN "mediatek,apcldmain"*/
			<0 0x10209000 0 0x1000>, /*AP_CCIF_BASE "mediatek,ap_ccif0"*/
			<0 0x1020a000 0 0x1000>; /*MD_CCIF_BASE  "mediatek,md_ccif0"*/
		interrupts = <GIC_SPI 173 IRQ_TYPE_LEVEL_HIGH>, /*IRQ_CLDMA "mediatek,apcldmamisc"*/
			     <GIC_SPI 151 IRQ_TYPE_LEVEL_LOW>, /*IRQ_CCIF0 "mediatek,ap_ccif0"*/
			     <GIC_SPI 152 IRQ_TYPE_LEVEL_LOW>, /*IRQ_CCIF1*/
			     <GIC_SPI 283 IRQ_TYPE_EDGE_FALLING>; /*IRQ_MDWDT "mediatek,md_rgu"*/
		mediatek,md_id = <0>;
		mediatek,cldma_capability = <6>;
		clocks = <&scpsys SCP_SYS_MD1>,
			<&infracfg_ao INFRACFG_AO_CLDMA_BCLK_CK>,
			<&infracfg_ao INFRACFG_AO_CCIF_AP_CG>,
			<&infracfg_ao INFRACFG_AO_CCIF_MD_CG>,
			<&infracfg_ao INFRACFG_AO_CCIF1_AP_CG>,
			<&infracfg_ao INFRACFG_AO_CCIF1_MD_CG>,
			<&infracfg_ao INFRACFG_AO_CCIF2_AP_CG>,
			<&infracfg_ao INFRACFG_AO_CCIF2_MD_CG>;
		clock-names = "scp-sys-md1-main",
			"infra-cldma-bclk",
			"infra-ccif-ap",
			"infra-ccif-md",
			"infra-ccif1-ap",
			"infra-ccif1-md",
			"infra-ccif2-ap",
			"infra-ccif2-md";
	};

	md_auxadc:md_auxadc {
		compatible = "mediatek,md_auxadc";
		io-channels = <&auxadc 2>;
		io-channel-names = "md-channel";
	};

	infra_md_cfg@1021d000 {
		compatible = "mediatek,infra_md_cfg";
		reg = <0 0x1021d000 0 0x1000>;
	};

	bpi_bsi_slv0@1021e000 {
		compatible = "mediatek,bpi_bsi_slv0";
		reg = <0 0x1021e000 0 0x1000>;
	};

	bpi_bsi_slv1@1021f000 {
		compatible = "mediatek,bpi_bsi_slv1";
		reg = <0 0x1021f000 0 0x1000>;
	};

	bpi_bsi_slv2@10225000 {
		compatible = "mediatek,bpi_bsi_slv2";
		reg = <0 0x10225000 0 0x1000>;
	};

	dvfsp@10227000 {
		compatible = "mediatek,dvfsp";
		reg = <0 0x10227000 0 0x1000>;
		interrupts = <GIC_SPI 171 IRQ_TYPE_LEVEL_LOW>;
	};

	dvfsp@0011bc00 {
		compatible = "mediatek,mt6771-dvfsp";
		reg = <0 0x0011bc00 0 0x1400>,
		      <0 0x0011bc00 0 0x1400>;
	};

	mcdi@0011b000 {
		compatible = "mediatek,mt6771-mcdi";
		reg = <0 0x0011b000 0 0x800>;
	};

	dramc@1022a000 {
		compatible = "mediatek,dramc";
		reg = <0 0x1022a000 0 0x2000>, /* DRAMC AO CHA */
			<0 0x10232000 0 0x2000>, /* DRAMC AO CHB */
			<0 0x1022c000 0 0x1000>, /* DRAMC NAO CHA */
			<0 0x10234000 0 0x1000>, /* DRAMC NAO CHB */
			<0 0x10228000 0 0x2000>, /* DDRPHY AO CHA */
			<0 0x10230000 0 0x2000>, /* DDRPHY AO CHB */
			<0 0x1022e000 0 0x1000>, /* DDRPHY NAO CHA */
			<0 0x10236000 0 0x1000>; /* DDRPHY NAO CHB */
	};

	fmem_smi@10238000 {
		compatible = "mediatek,fmem_smi";
		reg = <0 0x10238000 0 0x1000>;
	};

	gce@10238000 {
		compatible = "mediatek,gce";
		reg = <0 0x10238000 0 0x4000>;
		interrupts = <GIC_SPI 162 IRQ_TYPE_LEVEL_LOW>,
			<GIC_SPI 163 IRQ_TYPE_LEVEL_LOW>;
		disp_mutex_reg = <0x14016000 0x1000>;
		g3d_config_base = <0x13000000 0 0xffff0000>;
		mmsys_config_base = <0x14000000 1 0xffff0000>;
		disp_dither_base = <0x14010000 2 0xffff0000>;
		mm_na_base = <0x14020000 3 0xffff0000>;
		imgsys_base = <0x15020000 4 0xffff0000>;
		vdec_gcon_base = <0x18800000 5 0xffff0000>;
		venc_gcon_base = <0x18810000 6 0xffff0000>;
		conn_peri_base = <0x18820000 7 0xffff0000>;
		topckgen_base = <0x18830000 8 0xffff0000>;
		kp_base = <0x18840000 9 0xffff0000>;
		scp_sram_base = <0x10000000 10 0xffff0000>;
		infra_na3_base = <0x10010000 11 0xffff0000>;
		infra_na4_base = <0x10020000 12 0xffff0000>;
		scp_base = <0x10030000 13 0xffff0000>;
		mcucfg_base = <0x10040000 14 0xffff0000>;
		gcpu_base = <0x10050000 15 0xffff0000>;
		usb0_base = <0x10200000 16 0xffff0000>;
		usb_sif_base = <0x10280000 17 0xffff0000>;
		audio_base = <0x17000000 18 0xffff0000>;
		vdec_base = <0x17010000 19 0xffff0000>;
		msdc2_base = <0x17020000 20 0xffff0000>;
		vdec1_base = <0x17030000 21 0xffff0000>;
		msdc3_base = <0x18000000 22 0xffff0000>;
		ap_dma_base = <0x18010000 23 0xffff0000>;
		gce_base = <0x18020000 24 0xffff0000>;
		vdec2_base = <0x18040000 25 0xffff0000>;
		vdec3_base = <0x18050000 26 0xffff0000>;
		camsys_base = <0x18080000 27 0xffff0000>;
		camsys1_base = <0x180a0000 28 0xffff0000>;
		camsys2_base = <0x180b0000 29 0xffff0000>;
		pwm_sw_base = <0x11000000 99 0xffff0000>;
		disp_rdma0_sof = <0>;
		disp_rdma1_sof = <1>;
		mdp_rdma0_sof = <2>;
		mdp_rsz0_sof = <4>;
		mdp_rsz1_sof = <5>;
		mdp_tdshp_sof = <6>;
		mdp_wrot0_sof = <7>;
		mdp_wdma_sof = <8>;
		disp_ovl0_sof = <9>;
		disp_2l_ovl0_sof = <10>;
		disp_2l_ovl1_sof = <11>;
		disp_wdma0_sof = <12>;
		disp_color0_sof = <13>;
		disp_ccorr0_sof = <14>;
		disp_aal0_sof = <15>;
		disp_gamma0_sof = <16>;
		disp_dither0_sof = <17>;
		disp_pwm0_sof = <18>;
		disp_dsi0_sof = <19>;
		disp_dpi0_sof = <20>;
		disp_rsz0_sof = <22>;
		mdp_aal_sof = <23>;
		mdp_ccorr_sof = <24>;
		disp_dbi0_sof = <25>;
		disp_rdma0_frame_done = <26>;
		disp_rdma1_frame_done = <27>;
		mdp_rdma0_frame_done = <28>;
		mdp_rsz0_frame_done = <30>;
		mdp_rsz1_frame_done = <31>;
		mdp_tdshp_frame_done = <32>;
		mdp_wrot0_write_frame_done = <33>;
		mdp_wdma_frame_done = <34>;
		disp_ovl0_frame_done = <35>;
		disp_2l_ovl0_frame_done = <36>;
		disp_2l_ovl1_frame_done = <37>;
		disp_wdma0_frame_done = <38>;
		disp_color0_frame_done = <39>;
		disp_ccorr0_frame_done = <40>;
		disp_aal0_frame_done = <41>;
		disp_gamma0_frame_done = <42>;
		disp_dither0_frame_done = <43>;
		disp_dsi0_frame_done = <44>;
		disp_dpi0_frame_done = <45>;
		disp_rsz0_frame_done = <47>;
		mdp_aal_frame_done = <48>;
		mdp_ccorr_frame_done = <49>;
		disp_dbi0_frame_done = <50>;
		stream_done_0 = <130>;
		stream_done_1 = <131>;
		stream_done_2 = <132>;
		stream_done_3 = <133>;
		stream_done_4 = <134>;
		stream_done_5 = <135>;
		stream_done_6 = <136>;
		stream_done_7 = <137>;
		stream_done_8 = <138>;
		stream_done_9 = <139>;
		stream_done_10 = <140>;
		stream_done_11 = <141>;
		buf_underrun_event_0 = <142>;
		buf_underrun_event_1 = <143>;
		dsi0_te_event = <144>;
		dsi0_irq_event = <145>;
		dsi0_done_event = <146>;
		disp_wdma0_rst_done = <150>;
		mdp_wdma_rst_done = <151>;
		mdp_wrot0_rst_done = <152>;
		mdp_rdma0_rst_done = <154>;
		disp_ovl0_frame_rst_done_pusle = <155>;
		disp_ovl0_2l_frame_rst_done_pusle = <156>;
		disp_ovl1_2l_frame_rst_done_pusle = <157>;
		dip_cq_thread0_frame_done = <257>;
		dip_cq_thread1_frame_done = <258>;
		dip_cq_thread2_frame_done = <259>;
		dip_cq_thread3_frame_done = <260>;
		dip_cq_thread4_frame_done = <261>;
		dip_cq_thread5_frame_done = <262>;
		dip_cq_thread6_frame_done = <263>;
		dip_cq_thread7_frame_done = <264>;
		dip_cq_thread8_frame_done = <265>;
		dip_cq_thread9_frame_done = <266>;
		dip_cq_thread10_frame_done = <267>;
		dip_cq_thread11_frame_done = <268>;
		dip_cq_thread12_frame_done = <269>;
		dip_cq_thread13_frame_done = <270>;
		dip_cq_thread14_frame_done = <271>;
		dip_cq_thread15_frame_done = <272>;
		dip_cq_thread16_frame_done = <273>;
		dip_cq_thread17_frame_done = <274>;
		dip_cq_thread18_frame_done = <275>;
		amd_frame_done = <276>;
		dve_frame_done = <277>;
		wmf_frame_done = <278>;
		rsc_frame_done = <279>;
		mfb_done = <280>;
		wpe_a_frame_done = <281>;
		wpe_b_frame_done = <282>;
		occ_done = <283>;
		venc_done = <289>;
		jpgenc_done = <290>;
		jpgdec_done = <291>;
		venc_mb_done = <292>;
		venc_128byte_cnt_done = <293>;
		isp_frame_done_a = <321>;
		isp_frame_done_b = <322>;
		camsv_0_pass1_done = <323>;
		camsv_1_pass1_done = <324>;
		camsv_2_pass1_done = <325>;
		tsf_done = <326>;
		seninf_0_fifo_full = <327>;
		seninf_1_fifo_full = <328>;
		seninf_2_fifo_full = <329>;
		seninf_3_fifo_full = <330>;
		seninf_4_fifo_full = <331>;
		seninf_5_fifo_full = <332>;
		seninf_6_fifo_full = <333>;
		seninf_7_fifo_full = <334>;
		ipu_done_0 = <353>;
		ipu_done_1 = <354>;
		ipu_done_2 = <355>;
		ipu_done_3 = <356>;
		ipu_done_1_0 = <385>;
		ipu_done_1_1 = <386>;
		ipu_done_1_2 = <387>;
		ipu_done_1_3 = <388>;
		max_prefetch_cnt = <4>;
		prefetch_size = <160 32 32 32>;
		sram_size_cpr_64 = <136>;
		mmsys_config = <&mmsys_config>;
		mm_mutex = <&disp_mutex>;
		mdp_rdma0 = <&mdp_rdma0>;
		mdp_rdma1 = <&mdp_rdma1>;
		mdp_rsz0 = <&mdp_rsz0>;
		mdp_rsz1 = <&mdp_rsz1>;
		mdp_wrot0 = <&mdp_wrot0>;
		mdp_wdma0 = <&mdp_wdma>;
		mdp_tdshp0 = <&mdp_tdshp>;
		mdp_aal0 = <&mdp_aal>;
		mdp_ccorr0 = <&mdp_ccorr>;
		mdp_color0 = <&disp_color0>;
		venc = <&venc>;
		msdc0 = <&msdc0>;
		audio = <&audio>;
		uart = <&apuart0>;
		smi_larb0 = <&smi_larb0>;
		sram_share_cnt = <1>;
		sram_share_engine = <24>;
		sram_share_event = <710>;
		clocks = <&infracfg_ao INFRACFG_AO_GCE_CG>,
			<&infracfg_ao INFRACFG_AO_GCE_26M_CG>;
		clock-names = "GCE", "GCE_TIMER";
		mediatek,mailbox-gce = <&gce_mbox>;
		secure_thread = <8 10>;
		mboxes = <&gce_mbox 0 0 CMDQ_THR_PRIO_4>,
			<&gce_mbox 1 0 CMDQ_THR_PRIO_4>,
			<&gce_mbox 2 0 CMDQ_THR_PRIO_5>,
			<&gce_mbox 3 0 CMDQ_THR_PRIO_4>,
			<&gce_mbox 4 0 CMDQ_THR_PRIO_4>,
			<&gce_mbox 5 0 CMDQ_THR_PRIO_4>,
			<&gce_mbox 6 0 CMDQ_THR_PRIO_3>,
			<&gce_mbox 7 CMDQ_NO_TIMEOUT CMDQ_THR_PRIO_2>,
#if defined(CONFIG_MTK_SEC_VIDEO_PATH_SUPPORT) || \
	defined(CONFIG_MTK_CAM_SECURITY_SUPPORT)
			<&gce_mbox_svp 8 0 CMDQ_THR_PRIO_4>,
			<&gce_mbox_svp 9 0 CMDQ_THR_PRIO_4>,
			<&gce_mbox_svp 10 0 CMDQ_THR_PRIO_1>,
#else
			<&gce_mbox 8 0 CMDQ_THR_PRIO_1>,
			<&gce_mbox 9 0 CMDQ_THR_PRIO_1>,
			<&gce_mbox 10 0 CMDQ_THR_PRIO_1>,
#endif
			<&gce_mbox 11 0 CMDQ_THR_PRIO_1>,
			<&gce_mbox 12 0 CMDQ_THR_PRIO_1>,
			<&gce_mbox 13 0 CMDQ_THR_PRIO_1>,
			<&gce_mbox 14 0 CMDQ_THR_PRIO_1>,
#if defined(CONFIG_MTK_SEC_VIDEO_PATH_SUPPORT) || \
	defined(CONFIG_MTK_CAM_SECURITY_SUPPORT)
			<&gce_mbox 15 CMDQ_NO_TIMEOUT CMDQ_THR_PRIO_1>;
#else
			<&gce_mbox 15 0 CMDQ_THR_PRIO_1>;
#endif
	};

	gce_mbox: gce_mbox@10238000 {
		compatible = "mediatek,mt6771-gce";
		reg = <0 0x10238000 0 0x1000>;
		interrupts = <GIC_SPI 162 IRQ_TYPE_LEVEL_LOW>,
			<GIC_SPI 163 IRQ_TYPE_LEVEL_LOW>;
		#mbox-cells = <3>;
		#gce-event-cells = <1>;
		#gce-subsys-cells = <2>;
		default_tokens = /bits/ 16 <CMDQ_SYNC_TOKEN_GPR_SET_0>,
			/bits/ 16 <CMDQ_SYNC_TOKEN_GPR_SET_1>,
			/bits/ 16 <CMDQ_SYNC_TOKEN_GPR_SET_2>,
			/bits/ 16 <CMDQ_SYNC_TOKEN_GPR_SET_3>,
			/bits/ 16 <CMDQ_SYNC_TOKEN_GPR_SET_4>,
			/bits/ 16 <CMDQ_SYNC_RESOURCE_WROT0>,
			/bits/ 16 <CMDQ_SYNC_RESOURCE_WROT1>;
		clocks = <&infracfg_ao INFRACFG_AO_GCE_CG>,
			<&infracfg_ao INFRACFG_AO_GCE_26M_CG>;
		clock-names = "gce", "gce-timer";
	};

#if defined(CONFIG_MTK_SEC_VIDEO_PATH_SUPPORT) || \
	defined(CONFIG_MTK_CAM_SECURITY_SUPPORT)
	gce_mbox_svp: gce_mbox_svp@10238000 {
		compatible = "mediatek,mailbox-gce-svp";
		reg = <0 0x10238000 0 0x4000>;
		interrupts = <GIC_SPI 162 IRQ_TYPE_LEVEL_LOW>,
			<GIC_SPI 163 IRQ_TYPE_LEVEL_LOW>;
		#mbox-cells = <3>;
		clocks = <&infracfg_ao INFRACFG_AO_GCE_CG>,
			<&infracfg_ao INFRACFG_AO_GCE_26M_CG>;
		clock-names = "gce", "gce-timer";
	};
#endif

	gic@1023a000 {
		compatible = "mediatek,gic";
		reg = <0 0x1023a000 0 0x1000>;
	};

	ap_dma@11000000 {
		compatible = "mediatek,ap_dma";
		reg = <0 0x11000000 0 0x1000>;
		interrupts = <GIC_SPI 94 IRQ_TYPE_LEVEL_LOW>;
	};

	auxadc: auxadc@11001000 {
		compatible = "mediatek,auxadc";
		reg = <0 0x11001000 0 0x1000>;
		interrupts = <GIC_SPI 74 IRQ_TYPE_EDGE_FALLING>;
		clocks = <&infracfg_ao INFRACFG_AO_AUXADC_CG>;
		clock-names = "auxadc-main";
	};

	apdma: dma-controller@11000780 {
		compatible = "mediatek,mt6577-uart-dma";
		reg = <0 0x11000780 0 0x80>,
		      <0 0x11000800 0 0x80>,
		      <0 0x11000880 0 0x80>,
		      <0 0x11000900 0 0x80>,
		      <0 0x11000980 0 0x80>,
		      <0 0x11000A00 0 0x80>;
		interrupts = <GIC_SPI 108 IRQ_TYPE_LEVEL_LOW>,
			     <GIC_SPI 109 IRQ_TYPE_LEVEL_LOW>,
			     <GIC_SPI 110 IRQ_TYPE_LEVEL_LOW>,
			     <GIC_SPI 111 IRQ_TYPE_LEVEL_LOW>,
			     <GIC_SPI 112 IRQ_TYPE_LEVEL_LOW>,
			     <GIC_SPI 113 IRQ_TYPE_LEVEL_LOW>;
		clocks = <&infracfg_ao INFRACFG_AO_AP_DMA_CG>;
		clock-names = "apdma";
		#dma-cells = <1>;
		dma-bits = <34>;
	};

	apuart0: serial@11002000 {
		compatible = "mediatek,mt6577-uart";
		reg = <0 0x11002000 0 0x1000>; /* UART base */
		interrupts = <GIC_SPI 91 IRQ_TYPE_LEVEL_LOW>; /* UART IRQ */
		clocks = <&clk26m>, <&infracfg_ao INFRACFG_AO_UART0_CG>;
		clock-names = "baud", "bus";
		dmas = <&apdma 0
				&apdma 1>;
		dma-names = "tx", "rx";
	};

	apuart1: serial@11003000 {
		compatible = "mediatek,mt6577-uart";
		reg = <0 0x11003000 0 0x1000>;/* UART base */
		interrupts = <GIC_SPI 92 IRQ_TYPE_LEVEL_LOW>; /* UART IRQ */
		clocks =  <&clk26m>, <&infracfg_ao INFRACFG_AO_UART1_CG>;
		clock-names = "baud", "bus";
		dmas = <&apdma 2
				&apdma 3>;
		dma-names = "tx", "rx";
	};

	apuart2: serial@11004000 {
		compatible = "mediatek,mt6577-uart";
		reg = <0 0x11004000 0 0x1000>; /* UART base */
		interrupts = <GIC_SPI 93 IRQ_TYPE_LEVEL_LOW>;/* UART IRQ */
		clocks = <&clk26m>, <&infracfg_ao INFRACFG_AO_UART2_CG>;
		clock-names = "baud", "bus";
		dmas = <&apdma 4
				&apdma 5>;
		dma-names = "tx", "rx";
	};

	i2c6@11005000 {
		compatible = "mediatek,i2c6";
		reg = <0 0x11005000 0 0x1000>;
		interrupts = <GIC_SPI 87 IRQ_TYPE_LEVEL_LOW>;
	};

	pwm@11006000 {
		compatible = "mediatek,pwm";
		reg = <0 0x11006000 0 0x1000>;
		interrupts = <GIC_SPI 75 IRQ_TYPE_LEVEL_LOW>;
		clocks = <&infracfg_ao INFRACFG_AO_PWM1_CG>,
			<&infracfg_ao INFRACFG_AO_PWM2_CG>,
			<&infracfg_ao INFRACFG_AO_PWM3_CG>,
			<&infracfg_ao INFRACFG_AO_PWM4_CG>,
			<&infracfg_ao INFRACFG_AO_PWM_HCLK_CG>,
			<&infracfg_ao INFRACFG_AO_PWM_CG>;
		clock-names = "PWM1-main",
			"PWM2-main",
			"PWM3-main",
			"PWM4-main",
			"PWM-HCLK-main",
			"PWM-main";
	};

	spi0: spi0@1100a000 {
		compatible = "mediatek,mt6765-spi";
		mediatek,pad-select = <0>;
		reg = <0 0x1100a000 0 0x1000>;
		interrupts = <GIC_SPI 120 IRQ_TYPE_LEVEL_LOW>;
		clocks = <&topckgen TOP_SYSPLL_D5_D2>,
			 <&topckgen TOP_MUX_SPI>,
			 <&infracfg_ao INFRACFG_AO_SPI0_CG>;
		clock-names = "parent-clk", "sel-clk", "spi-clk";
	};

	spi1: spi1@11010000 {
		compatible = "mediatek,mt6765-spi";
		mediatek,pad-select = <0>;
		reg = <0 0x11010000 0 0x1000>;
		interrupts = <GIC_SPI 124 IRQ_TYPE_LEVEL_LOW>;
		clocks = <&topckgen TOP_SYSPLL_D5_D2>,
			 <&topckgen TOP_MUX_SPI>,
			 <&infracfg_ao INFRACFG_AO_SPI1_CG>;
		clock-names = "parent-clk", "sel-clk", "spi-clk";
	};

	spi2: spi2@11012000 {
		compatible = "mediatek,mt6765-spi";
		mediatek,pad-select = <0>;
		reg = <0 0x11012000 0 0x1000>;
		interrupts = <GIC_SPI 129 IRQ_TYPE_LEVEL_LOW>;
		clocks = <&topckgen TOP_SYSPLL_D5_D2>,
			 <&topckgen TOP_MUX_SPI>,
			 <&infracfg_ao INFRACFG_AO_SPI2_CG>;
		clock-names = "parent-clk", "sel-clk", "spi-clk";
	};

	spi3: spi3@11013000 {
		compatible = "mediatek,mt6765-spi";
		mediatek,pad-select = <0>;
		reg = <0 0x11013000 0 0x1000>;
		interrupts = <GIC_SPI 130 IRQ_TYPE_LEVEL_LOW>;
		clocks = <&topckgen TOP_SYSPLL_D5_D2>,
			 <&topckgen TOP_MUX_SPI>,
			 <&infracfg_ao INFRACFG_AO_SPI3_CG>;
		clock-names = "parent-clk", "sel-clk", "spi-clk";
	};

	spi4: spi4@11018000 {
		compatible = "mediatek,mt6765-spi";
		mediatek,pad-select = <0>;
		reg = <0 0x11018000 0 0x1000>;
		interrupts = <GIC_SPI 134 IRQ_TYPE_LEVEL_LOW>;
		clocks = <&topckgen TOP_SYSPLL_D5_D2>,
			 <&topckgen TOP_MUX_SPI>,
			 <&infracfg_ao INFRACFG_AO_SPI4_CG>;
		clock-names = "parent-clk", "sel-clk", "spi-clk";
	};

	spi5: spi5@11019000 {
		compatible = "mediatek,mt6765-spi";
		mediatek,pad-select = <0>;
		reg = <0 0x11019000 0 0x1000>;
		interrupts = <GIC_SPI 135 IRQ_TYPE_LEVEL_LOW>;
		clocks = <&topckgen TOP_SYSPLL_D5_D2>,
			 <&topckgen TOP_MUX_SPI>,
			 <&infracfg_ao INFRACFG_AO_SPI5_CG>;
		clock-names = "parent-clk", "sel-clk", "spi-clk";
	};

	therm_ctrl@1100b000 {
		compatible = "mediatek,therm_ctrl";
		reg = <0 0x1100b000 0 0x1000>;
		interrupts = <GIC_SPI 76 IRQ_TYPE_LEVEL_LOW>;
		clocks = <&infracfg_ao INFRACFG_AO_THERM_CG>;
		clock-names = "therm-main";
	};

	eem_fsm@1100b000 {
		compatible = "mediatek,eem_fsm";
		reg = <0 0x1100b000 0 0x1000>;
		interrupts = <GIC_SPI 127 IRQ_TYPE_LEVEL_LOW>;
	};

	btif@1100c000 {
		compatible = "mediatek,btif";
		reg = <0 0x1100c000 0 0x1000>,	/*btif base*/
		    <0 0x11000a80 0 0x80>,	/*btif tx dma base*/
		    <0 0x11000b00 0 0x80>;	/*btif rx dma base*/
		interrupts = <GIC_SPI 114 IRQ_TYPE_LEVEL_LOW>,	/*btif irq*/
			   <GIC_SPI 139 IRQ_TYPE_LEVEL_LOW>,	/*btif tx dma irq*/
			   <GIC_SPI 140 IRQ_TYPE_LEVEL_LOW>;	/*btif rx dma irq*/
		clocks = <&infracfg_ao INFRACFG_AO_BTIF_CG>,	/*btif clock*/
		       <&infracfg_ao INFRACFG_AO_AP_DMA_CG>;		/*ap dma clock*/
		clock-names = "btifc","apdmac";
	};

	consys: consys@18070000 {
		compatible = "mediatek,mt6771-consys";
		reg = <0 0x18070000 0 0x1000>,	/*CONN_MCU_CONFIG_BASE */
		    <0 0x10007000 0 0x0100>,	/*TOP_RGU_BASE */
		    <0 0x10001000 0 0x1000>,	/*INFRACFG_AO_BASE */
		    <0 0x10006000 0 0x1000>;	/*SPM_BASE */
		interrupts = <GIC_SPI 289 IRQ_TYPE_LEVEL_LOW>,	/*BGF_EINT */
			   <GIC_SPI 291 IRQ_TYPE_LEVEL_LOW>;	/*WDT_EINT */
		clocks = <&scpsys SCP_SYS_CONN>;
		clock-names = "conn";
	};

	irtx@1100d000 {
		compatible = "mediatek,irtx";
		reg = <0 0x1100d000 0 0x1000>;
	};

	irtx_pwm:irtx_pwm {
		compatible = "mediatek,irtx-pwm";
		pwm_ch = <0>;
		pwm_data_invert = <0>;
	};

	disp_pwm0@1100e000 {
		compatible = "mediatek,disp_pwm0";
		reg = <0 0x1100e000 0 0x1000>;
		interrupts = <GIC_SPI 128 IRQ_TYPE_LEVEL_LOW>;
	};

	usb0: usb3@11200000 {
		compatible = "mediatek,mt6771-mtu3";
		reg = <0 0x11201000 0 0x3000>,
		      <0 0x11203e00 0 0x100>;
		reg-names = "mac", "ippc";
		interrupts = <GIC_SPI 72 IRQ_TYPE_LEVEL_LOW>;
		interrupt-names = "ssusb_mac";
		clocks = <&infracfg_ao INFRACFG_AO_USB_CG>,
			   <&infracfg_ao INFRACFG_AO_UNIPRO_SCK_CG>;
		clock-names = "sys_ck", "rel_clk";
		phy-cells = <1>;
		phys = <&usb0phy 0>;
		phy-names = "port0_phy";
		extcon = <&extcon_usb>;
		dr_mode = "otg";
		/* vusb33-supply = <&mt_pmic_vusb33_ldo_reg>; */
		/* vusb10-supply = <&mt_pmic_va10_ldo_reg>; */
	};

	xhci0: usb3_xhci@11200000 {
		compatible = "mediatek,mt67xx-xhci";
		reg = <0 0x11200000 0 0x1000>;
		reg-names = "mac";
		interrupts = <GIC_SPI 73 IRQ_TYPE_LEVEL_LOW>;
		interrupt-names = "xhci";
		clocks = <&infracfg_ao INFRACFG_AO_UNIPRO_SCK_CG>;
		clock-names = "sys_ck";
		phys = <&usb0phy 0>;
		phy-names = "port0_phy";
	};

	usb0phy: usb0phy@11f40000 {
		compatible = "mediatek,mt6771-phy";
		reg = <0 0x11f40000 0 0x10000>,
			  <0 0x11203e00 0 0x100>;
		reg-names = "sif_base", "ippc";
		#phy-cells = <1>;
	};

	extcon_usb: extcon_usb {
		compatible = "mediatek,extcon-usb";
	};

	usb_boost: usb_boost_manager {
		compatible = "mediatek,usb_boost";
		boost_period = <30>;
	};

	audio: audio@11220000 {
		compatible = "mediatek,audio", "syscon";
		reg = <0 0x11220000 0 0x1000>;
		#clock-cells = <1>;
		mediatek,btcvsd_snd = <&btcvsd_snd>;
	};

	audgpio: mt_soc_dl1_pcm@11220000 {
		compatible = "mediatek,mt_soc_pcm_dl1";
		reg = <0 0x11220000 0 0x1000>;
		interrupts = <GIC_SPI 161 IRQ_TYPE_LEVEL_LOW>;
		clocks = <&audio AUDIO_AFE>,
			<&audio AUDIO_DAC>,
			<&audio AUDIO_DAC_PREDIS>,
			<&audio AUDIO_ADC>,
			<&audio AUDIO_PDN_ADDA6_ADC>,
			<&audio AUDIO_22M>,
			<&audio AUDIO_24M>,
			<&audio AUDIO_APLL_TUNER>,
			<&audio AUDIO_APLL2_TUNER>,
			<&audio AUDIO_TML>,
			<&scpsys SCP_SYS_AUDIO>,
			<&infracfg_ao INFRACFG_AO_AUDIO_CG>,
			<&infracfg_ao INFRACFG_AO_AUDIO_26M_BCLK_CK>,
			<&topckgen TOP_MUX_AUDIO>,
			<&topckgen TOP_MUX_AUD_INTBUS>,
			<&topckgen TOP_SYSPLL_D2_D4>,
			<&topckgen TOP_MUX_AUD_1>,
			<&topckgen TOP_APLL1_CK>,
			<&topckgen TOP_MUX_AUD_2>,
			<&topckgen TOP_APLL2_CK>,
			<&topckgen TOP_MUX_AUD_ENG1>,
			<&topckgen TOP_APLL1_D8>,
			<&topckgen TOP_MUX_AUD_ENG2>,
			<&topckgen TOP_APLL2_D8>,
			<&clk26m>;
		clock-names = "aud_afe_clk",
			"aud_dac_clk",
			"aud_dac_predis_clk",
			"aud_adc_clk",
			"aud_adc_adda6_clk",
			"aud_apll22m_clk",
			"aud_apll24m_clk",
			"aud_apll1_tuner_clk",
			"aud_apll2_tuner_clk",
			"aud_tml_clk",
			"scp_sys_audio",
			"aud_infra_clk",
			"mtkaif_26m_clk",
			"top_mux_audio",
			"top_mux_audio_int",
			"top_syspll_d2_d4",
			"top_mux_aud_1",
			"top_apll1_ck",
			"top_mux_aud_2",
			"top_apll2_ck",
			"top_mux_aud_eng1",
			"top_apll1_d8",
			"top_mux_aud_eng2",
			"top_apll2_d8",
			"top_clk26m_clk";
	};

	audio_sram@11221000 {
		compatible = "mediatek,audio_sram";
		reg = <0 0x11221000 0 0xc000>;
	};

	btcvsd_snd: mtk-btcvsd-snd@18000000 {
		compatible = "mediatek,mtk-btcvsd-snd";
		reg=<0 0x18000000 0 0x1000>, /*PKV_PHYSICAL_BASE*/
		    <0 0x18080000 0 0x10000>; /*SRAM_BANK2*/
		interrupts = <GIC_SPI 288 IRQ_TYPE_LEVEL_LOW>;
		mediatek,infracfg = <&infracfg_ao>;
		/*INFRA MISC, conn_bt_cvsd_mask*/
		/*cvsd_mcu_read, write, packet_indicator*/
		mediatek,offset =<0xf00 0x800 0xfd0 0xfd4 0xfd8>;
		disable_write_silence = <0>;
	};

	ufshci:ufshci@11270000 {
		compatible = "mediatek,ufshci";
		reg = <0 0x11270000 0 0x2300>;
		interrupts = <GIC_SPI 80 IRQ_TYPE_LEVEL_LOW>;

		clocks =
			<&infracfg_ao INFRACFG_AO_UFS_CG>,
			<&infracfg_ao INFRACFG_AO_UNIPRO_SCK_CG>,
			<&infracfg_ao INFRACFG_AO_UFS_MP_SAP_BCLK_CG>,
			<&infracfg_ao INFRACFG_AO_AES_UFSFDE_CG>;
		clock-names =
			"ufs0-clock",
			"ufs0-unipro-clk",
			"ufs0-mp-clk",
			"ufs0-aes-clk";
		freq-table-hz =
			<0 0>,
			<0 0>,
			<0 0>,
			<0 0>;

		/* Regulators */
		/* In MT67xx, only VCC is available to be controlled by UFS */
		/* driver */
		/* VCCQ2:  Provided by external LDO. SW control is not */
		/* necessary */
		/* VCCQ: Not supported by current UFS devices */
		vcc-supply = <&mt_pmic_vemc_ldo_reg>;
		vcc-fixed-regulator;

		/* Number of lanes available per direction - either 1 or 2 */
		lanes-per-direction = <1>;

		/* Auto-Hibern8 Timer. Unit: ms	(0 means disabled) */
		mediatek,auto-hibern8-timer = <10>;

		/* System Suspend Level */
		mediatek,spm-level = <3>;

		/* Runtime Suspend Configuration */
		/* 1. Runtime PM on/off (on: 1, off: 0) */
		mediatek,rpm-enable = <1>;

		/* 2. Auto Suspend Delay. Unit: ms */
		mediatek,rpm-autosuspend-delay = <2000>;

		/* 3. Runtime Suspend Level */
		mediatek,rpm-level = <3>;

		/* spm resource request use sw mode */
		mediatek,spm_sw_mode;
	};

	ca9peri@10e00000 {
		compatible = "mediatek,ca9peri";
		reg = <0 0x10e00000 0 0x1000>;
	};

	l2c@10f00000 {
		compatible = "mediatek,l2c";
		reg = <0 0x10f00000 0 0x1000>;
	};

	efusec@11f10000 {
		compatible = "mediatek,efusec";
		reg = <0 0x11f10000 0 0x1000>;
	};

	ufs_mphy@11fa0000 {
		compatible = "mediatek,ufs_mphy";
		reg = <0 0x11fa0000 0 0xc000>;
	};

	mfgcfg: mfgcfg@13000000 {
		compatible = "mediatek,mfgcfg", "syscon";
		reg = <0 0x13000000 0 0x1000>, /* MFG_BASE */
			<0 0x10001000 0 0x1000>, /* INFRA_AO_BASE */
			<0 0x10006000 0 0x1000>, /* SPM_BASE */
			<0 0x1020e000 0 0x1000>, /* INFRA_BASE */
			<0 0x0d000000 0 0xf0000>;
		#clock-cells = <1>;
	};

	mali@13040000 {
		compatible = "mediatek,mali", "arm,mali-midgard", "arm,mali-bifrost";
		reg = <0 0x13040000 0 0x4000>;
		interrupts =
			<GIC_SPI 278 IRQ_TYPE_LEVEL_LOW>,
			<GIC_SPI 279 IRQ_TYPE_LEVEL_LOW>,
			<GIC_SPI 280 IRQ_TYPE_LEVEL_LOW>;
		interrupt-names =
			"GPU",
			"MMU",
			"JOB";
	};

	gpufreq {
		compatible = "mediatek,mt6771-gpufreq";
		clocks =
			<&topckgen TOP_MUX_MFG>,
			<&topckgen TOP_MFGPLL_CK>,
			<&clk26m>,
			<&mfgcfg MFGCFG_BG3D>,
			<&scpsys SCP_SYS_MFG_ASYNC>,
			<&scpsys SCP_SYS_MFG>,
			<&scpsys SCP_SYS_MFG_CORE0>,
			<&scpsys SCP_SYS_MFG_CORE1>,
			<&scpsys SCP_SYS_MFG_2D>;
		clock-names =
			"clk_mux",
			"clk_main_parent",
			"clk_sub_parent",
			"subsys_mfg_cg",
			"mtcmos_mfg_async",
			"mtcmos_mfg",
			"mtcmos_mfg_core0",
			"mtcmos_mfg_core1",
			"mtcmos_mfg_core2";
	};

	mali_tb@1307f000 {
		compatible = "mediatek,mali_tb";
		reg = <0 0x1307f000 0 0x1000>;
	};

	mfg_dfp_60@13020000 {
		compatible = "mediatek,mfg_dfp_60";
		reg = <0 0x13020000 0 0x1000>;
		interrupts = <GIC_SPI 282 IRQ_TYPE_LEVEL_LOW>;
	};

	mfg_tb@13ffef00 {
		compatible = "mediatek,mfg_tb";
		reg = <0 0x13ffef00 0 0x1000>;
	};

	mmsys_config: mmsys_config@14000000 {
		compatible = "mediatek,mmsys_config", "syscon";
		reg = <0 0x14000000 0 0x1000>;
		interrupts = <GIC_SPI 239 IRQ_TYPE_LEVEL_LOW>;
		#clock-cells = <1>;
		clocks = <&mmsys_config MMSYS_MDP_DL_TXCK>,
			<&mmsys_config MMSYS_MDP_DL_RX_CK>,
			<&mmsys_config MMSYS_IPU_DL_TXCK>,
			<&mmsys_config MMSYS_IPU_DL_RX_CK>;
		clock-names = "CAM_MDP_TX", "CAM_MDP_RX", "CAM_MDP2_TX", "CAM_MDP2_RX";
	};

	touch: touch {
		compatible = "mediatek,touch";
	};

	accdet: accdet {
		compatible = "mediatek,pmic-accdet";
		/* ACCDET GPIO standardization for AP EINT */
		/*
		 * pinctrl-names = "default", "state_eint_as_int";
		 * pinctrl-0 = <&accdet_pins_default>;
		 * pinctrl-1 = <&accdet_pins_eint_as_int>;
		 */
	};
	/*
	 *&pio {
	 *	accdet_pins_default: accdetdefault {
	 *	};
	 *	accdet_pins_eint_as_int: accdeteint@0 {
	 *		pins_cmd_dat {
	 *			pinmux = <PINMUX_GPIO9__FUNC_GPIO9>;
	 *			slew-rate = <0>;
	 *			bias-disable;
	 *		};
	 *	};
	 *};
	 */

	mt6358_gauge {
		compatible = "mediatek,mt6358_gauge";
		gauge_name = "gauge";
		alias_name = "MT6358";
	};

	gauge_timer {
		compatible = "mediatek,gauge_timer_service";
	};

#if (CONFIG_MTK_GAUGE_VERSION == 30)
	#if (CONFIG_MTK_ADDITIONAL_BATTERY_TABLE == 1)
		#include "mediatek/bat_setting/mt6771_battery_prop_ext.dtsi"
	#else
		#include "mediatek/bat_setting/mt6771_battery_prop.dtsi"
	#endif
#endif

	mdp_rdma0: mdp_rdma0@14001000 {
		compatible = "mediatek,mdp_rdma0";
		reg = <0 0x14001000 0 0x1000>;
		interrupts = <GIC_SPI 218 IRQ_TYPE_LEVEL_LOW>;
		clocks = <&mmsys_config MMSYS_MDP_RDMA0>;
		clock-names = "MDP_RDMA0";
	};

	mdp_rdma1: mdp_rdma1@14002000 {
		compatible = "mediatek,mdp_rdma1";
		reg = <0 0x14002000 0 0x1000>;
		interrupts = <GIC_SPI 219 IRQ_TYPE_LEVEL_LOW>;
	};

	mdp_rsz0: mdp_rsz0@14003000 {
		compatible = "mediatek,mdp_rsz0";
		reg = <0 0x14003000 0 0x1000>;
		interrupts = <GIC_SPI 220 IRQ_TYPE_LEVEL_LOW>;
		clocks = <&mmsys_config MMSYS_MDP_RSZ0>;
		clock-names = "MDP_RSZ0";
	};

	mdp_rsz1: mdp_rsz1@14004000 {
		compatible = "mediatek,mdp_rsz1";
		reg = <0 0x14004000 0 0x1000>;
		interrupts = <GIC_SPI 221 IRQ_TYPE_LEVEL_LOW>;
		clocks = <&mmsys_config MMSYS_MDP_RSZ1>;
		clock-names = "MDP_RSZ1";
	};

	mdp_wrot0: mdp_wrot0@14005000 {
		compatible = "mediatek,mdp_wrot0";
		reg = <0 0x14005000 0 0x1000>;
		interrupts = <GIC_SPI 223 IRQ_TYPE_LEVEL_LOW>;
		clocks = <&mmsys_config MMSYS_MDP_WROT0>;
		clock-names = "MDP_WROT0";
	};

	mdp_wdma: mdp_wdma@14006000 {
		compatible = "mediatek,mdp_wdma";
		reg = <0 0x14006000 0 0x1000>;
		interrupts = <GIC_SPI 224 IRQ_TYPE_LEVEL_LOW>;
		clocks = <&mmsys_config MMSYS_MDP_WDMA0>;
		clock-names = "MDP_WDMA";
	};

	mdp_tdshp: mdp_tdshp@14007000 {
		compatible = "mediatek,mdp_tdshp";
		reg = <0 0x14007000 0 0x1000>;
		interrupts = <GIC_SPI 222 IRQ_TYPE_LEVEL_LOW>;
		clocks = <&mmsys_config MMSYS_MDP_TDSHP>;
		clock-names = "MDP_TDSHP";
	};

	mtkfb: mtkfb@0 {
		compatible = "mediatek,mtkfb";
	};

	dispsys {
		compatible = "mediatek,dispsys";

		clocks = <&scpsys SCP_SYS_DIS>,
			<&mmsys_config MMSYS_SMI_COMMON>,
			<&mmsys_config MMSYS_SMI_LARB0>,
			<&mmsys_config MMSYS_SMI_LARB1>,
			<&mmsys_config MMSYS_GALS_COMM0>,
			<&mmsys_config MMSYS_GALS_COMM1>,
			<&mmsys_config MMSYS_DISP_OVL0>,
			<&mmsys_config MMSYS_DISP_OVL0_2L>,
			<&mmsys_config MMSYS_DISP_OVL1_2L>,
			<&mmsys_config MMSYS_DISP_RDMA0>,
			<&mmsys_config MMSYS_DISP_RDMA1>,
			<&mmsys_config MMSYS_DISP_WDMA0>,
			<&mmsys_config MMSYS_DISP_COLOR0>,
			<&mmsys_config MMSYS_DISP_CCORR0>,
			<&mmsys_config MMSYS_DISP_AAL0>,
			<&mmsys_config MMSYS_DISP_GAMMA0>,
			<&mmsys_config MMSYS_DISP_DITHER0>,
			<&mmsys_config MMSYS_DSI0_MM_CK>,
			<&mmsys_config MMSYS_DSI0_IF_CK>,
			<&mmsys_config MMSYS_DPI_MM_CK>,
			<&mmsys_config MMSYS_DPI_IF_CK>,
			<&mmsys_config MMSYS_DBI_MM_CK>,
			<&mmsys_config MMSYS_DBI_IF_CK>,
			<&mmsys_config MMSYS_26M>,
			<&mmsys_config MMSYS_DISP_RSZ>,
			<&topckgen TOP_MUX_MM>,
			<&topckgen TOP_MUX_DISP_PWM>,
			<&infracfg_ao INFRACFG_AO_DISP_PWM_CG>,
			<&clk26m>,
			<&topckgen TOP_UNIVPLL_D3_D2>,
			<&topckgen TOP_UNIVPLL_D3_D4>,
			<&topckgen TOP_OSC_D2>,
			<&topckgen TOP_OSC_D4>,
			<&topckgen TOP_OSC_D16>,
			<&topckgen TOP_MUX_DPI0>,
			<&topckgen TOP_TVDPLL_D2>,
			<&topckgen TOP_TVDPLL_D4>,
			<&topckgen TOP_TVDPLL_D8>,
			<&topckgen TOP_TVDPLL_D16>,
			<&topckgen TOP_TVDPLL_CK>;

		clock-names = "MMSYS_MTCMOS",
			"MMSYS_SMI_COMMON",
			"MMSYS_SMI_LARB0",
			"MMSYS_SMI_LARB1",
			"MMSYS_GALS_COMM0",
			"MMSYS_GALS_COMM1",
			"MMSYS_DISP_OVL0",
			"MMSYS_DISP_OVL0_2L",
			"MMSYS_DISP_OVL1_2L",
			"MMSYS_DISP_RDMA0",
			"MMSYS_DISP_RDMA1",
			"MMSYS_DISP_WDMA0",
			"MMSYS_DISP_COLOR0",
			"MMSYS_DISP_CCORR0",
			"MMSYS_DISP_AAL0",
			"MMSYS_DISP_GAMMA0",
			"MMSYS_DISP_DITHER0",
			"MMSYS_DSI0_MM_CK",
			"MMSYS_DSI0_IF_CK",
			"MMSYS_DPI_MM_CK",
			"MMSYS_DPI_IF_CK",
			"MMSYS_DBI_MM_CK",
			"MMSYS_DBI_IF_CK",
			"MMSYS_26M",
			"MMSYS_DISP_RSZ",
			"TOP_MUX_MM",
			"TOP_MUX_DISP_PWM",
			"DISP_PWM",
			"TOP_26M",
			"TOP_UNIVPLL_D3_D2",
			"TOP_UNIVPLL_D3_D4",
			"TOP_OSC_D2",
			"TOP_OSC_D4",
			"TOP_OSC_D16",
			"MUX_DPI0",
			"TVDPLL_D2",
			"TVDPLL_D4",
			"TVDPLL_D8",
			"TVDPLL_D16",
			"DPI_CK";
	};

	dsi_te: dsi_te {
		compatible = "mediatek, DSI_TE-eint";
		status = "disabled";
	};

	mhl:mhl@0 {
		compatible = "mediatek,extd_dev";
	};

	disp_ovl0@14008000 {
		compatible = "mediatek,disp_ovl0";
		reg = <0 0x14008000 0 0x1000>;
		interrupts = <GIC_SPI 225 IRQ_TYPE_LEVEL_LOW>;
	};

	disp_ovl0_2l@14009000 {
		compatible = "mediatek,disp_ovl0_2l";
		reg = <0 0x14009000 0 0x1000>;
		interrupts = <GIC_SPI 226 IRQ_TYPE_LEVEL_LOW>;
	};

	disp_ovl1_2l@1400a000 {
		compatible = "mediatek,disp_ovl1_2l";
		reg = <0 0x1400a000 0 0x1000>;
		interrupts = <GIC_SPI 227 IRQ_TYPE_LEVEL_LOW>;
	};

	disp_rdma0@1400b000 {
		compatible = "mediatek,disp_rdma0";
		reg = <0 0x1400b000 0 0x1000>;
		interrupts = <GIC_SPI 228 IRQ_TYPE_LEVEL_LOW>;
	};

	disp_rdma1@1400c000 {
		compatible = "mediatek,disp_rdma1";
		reg = <0 0x1400c000 0 0x1000>;
		interrupts = <GIC_SPI 229 IRQ_TYPE_LEVEL_LOW>;
	};

	disp_wdma0@1400d000 {
		compatible = "mediatek,disp_wdma0";
		reg = <0 0x1400d000 0 0x1000>;
		interrupts = <GIC_SPI 230 IRQ_TYPE_LEVEL_LOW>;
	};

	disp_color0: disp_color0@1400e000 {
		compatible = "mediatek,disp_color0";
		reg = <0 0x1400e000 0 0x1000>;
		interrupts = <GIC_SPI 231 IRQ_TYPE_LEVEL_LOW>;
		clocks = <&mmsys_config MMSYS_DISP_COLOR0>;
		clock-names = "MDP_COLOR";
	};

	disp_ccorr0@1400f000 {
		compatible = "mediatek,disp_ccorr0";
		reg = <0 0x1400f000 0 0x1000>;
		interrupts = <GIC_SPI 232 IRQ_TYPE_LEVEL_LOW>;
	};

	disp_aal0:disp_aal0@14010000 {
		compatible = "mediatek,disp_aal0";
		reg = <0 0x14010000 0 0x1000>;
		interrupts = <GIC_SPI 233 IRQ_TYPE_LEVEL_LOW>;
		aal_support = <1>;
	};

	disp_gamma0@14011000 {
		compatible = "mediatek,disp_gamma0";
		reg = <0 0x14011000 0 0x1000>;
		interrupts = <GIC_SPI 234 IRQ_TYPE_LEVEL_LOW>;
	};

	disp_dither0@14012000 {
		compatible = "mediatek,disp_dither0";
		reg = <0 0x14012000 0 0x1000>;
		interrupts = <GIC_SPI 235 IRQ_TYPE_LEVEL_LOW>;
	};

	disp_split@14013000 {
		compatible = "mediatek,disp_split";
		reg = <0 0x14013000 0 0x1000>;
	};

	dsi0@14014000 {
		compatible = "mediatek,dsi0";
		reg = <0 0x14014000 0 0x1000>;
		interrupts = <GIC_SPI 236 IRQ_TYPE_LEVEL_LOW>;
	};

	dpi0@14015000 {
		compatible = "mediatek,dpi0";
		reg = <0 0x14015000 0 0x1000>;
		interrupts = <GIC_SPI 237 IRQ_TYPE_LEVEL_LOW>;
	};

	disp_mutex: disp_mutex@14016000 {
		compatible = "mediatek,disp_mutex";
		reg = <0 0x14016000 0 0x1000>;
		interrupts = <GIC_SPI 217 IRQ_TYPE_LEVEL_LOW>;
	};

	smi_larb0: smi_larb0@14017000 {
		compatible = "mediatek,smi_larb0", "mediatek,smi_larb";
		reg = <0 0x14017000 0 0x1000>;
		interrupts = <GIC_SPI 240 IRQ_TYPE_LEVEL_LOW>;
		clocks = <&scpsys SCP_SYS_DIS>, <&mmsys_config MMSYS_SMI_LARB0>;
		clock-names = "mtcmos-mm", "mm-larb0";
		mediatek,smi-id = <0>;
	};

	smi_common@14019000 {
		compatible = "mediatek,smi_common";
		reg = <0 0x14019000 0 0x1000>;
		clocks = <&scpsys SCP_SYS_DIS>,
			<&mmsys_config MMSYS_GALS_COMM0>,
			<&mmsys_config MMSYS_GALS_COMM1>,
			<&mmsys_config MMSYS_SMI_COMMON>;
		clock-names = "mtcmos-mm",
			"smi-common-gals-comm0",
			"smi-common-gals-comm1",
			"smi-common";
		mediatek,smi-id = <7>;
		mmsys_config = <&mmsys_config>;
	};

	mmdvfs_pmqos {
		compatible = "mediatek,mmdvfs_pmqos";
		mm_step0 = <450 1 0 6>;
		mm_step1 = <312 1 0 7>;
		cam_step0 = <546 1 1 3>;
		cam_step1 = <364 1 1 4>;
		img_step0 = <525 1 2 5>;
		img_step1 = <364 1 2 4>;
		vopp_steps = <0 1>;
		disp_freq = "mm_step0", "mm_step1";
		mdp_freq = "mm_step0", "mm_step1";
		cam_freq = "cam_step0","cam_step1";
		img_freq = "img_step0","img_step1";
		vdec_freq = "mm_step0","mm_step1";
		venc_freq = "mm_step0","mm_step1";
		clocks = <&topckgen TOP_MUX_MM>,	/* 0 */
			<&topckgen TOP_MUX_CAM>,	/* 1 */
			<&topckgen TOP_MUX_IMG>,	/* 2 */
			<&topckgen TOP_SYSPLL_D2>,	/* 3 */
			<&topckgen TOP_SYSPLL_D3>,	/* 4 */
			<&topckgen TOP_MMPLL_D6>,	/* 5 */
			<&topckgen TOP_MMPLL_D7>,	/* 6 */
			<&topckgen TOP_UNIVPLL_D2_D2>;	/* 7 */
		clock-names = "mmdvfs_clk_mux_top_mm_sel",	/* 0 */
			"mmdvfs_clk_mux_top_cam_sel",		/* 1 */
			"mmdvfs_clk_mux_top_img_sel",		/* 2 */
			"mmdvfs_clk_syspll_d2_ck",		/* 3 */
			"mmdvfs_clk_syspll_d3_ck",		/* 4 */
			"mmdvfs_clk_mmpll_d6_ck",		/* 5 */
			"mmdvfs_clk_mmpll_d7_ck",		/* 6 */
			"mmdvfs_clk_univpll_d2_d2_ck";		/* 7 */
	};

	disp_rsz@1401a000 {
		compatible = "mediatek,disp_rsz";
		reg = <0 0x1401a000 0 0x1000>;
		interrupts = <GIC_SPI 241 IRQ_TYPE_LEVEL_LOW>;
	};

	mdp_aal: mdp_aal@1401b000 {
		compatible = "mediatek,mdp_aal";
		reg = <0 0x1401b000 0 0x1000>;
		interrupts = <GIC_SPI 242 IRQ_TYPE_LEVEL_LOW>;
		clocks = <&mmsys_config MMSYS_MDP_AAL>;
		clock-names = "MDP_AAL";
	};

	mdp_ccorr: mdp_ccorr@1401c000 {
		compatible = "mediatek,mdp_ccorr";
		reg = <0 0x1401c000 0 0x1000>;
		interrupts = <GIC_SPI 243 IRQ_TYPE_LEVEL_LOW>;
		clocks = <&mmsys_config MMSYS_MDP_CCORR>;
		clock-names = "MDP_CCORR";
	};

	dbi@1401d000 {
		compatible = "mediatek,dbi";
		reg = <0 0x1401d000 0 0x1000>;
		interrupts = <GIC_SPI 244 IRQ_TYPE_LEVEL_LOW>;
	};

	i2c@1401e000 {
		compatible = "mediatek,i2c";
		reg = <0 0x1401e000 0 0x1000>;
	};

	dsi1@1401f000 {
		compatible = "mediatek,dsi1";
		reg = <0 0x1401f000 0 0x1000>;
	};

	mdp_wrot1@14020000 {
		compatible = "mediatek,mdp_wrot1";
		reg = <0 0x14020000 0 0x1000>;
	};

	vdec_gcon: vdec_gcon@16000000 {
		compatible = "mediatek,vdec_gcon", "syscon";
		reg = <0 0x16000000 0 0x1000>;
		clocks =
			<&scpsys SCP_SYS_DIS> ,
			<&scpsys SCP_SYS_VDE> ,
			<&scpsys SCP_SYS_VEN> ,
			<&vdec_gcon VDEC_VDEC> ,
			<&venc_gcon VENC_GCON_VENC>;
		clock-names =
			"MT_SCP_SYS_DIS" ,
			"MT_SCP_SYS_VDE" ,
			"MT_SCP_SYS_VEN" ,
			"MT_CG_VDEC"     ,
			"MT_CG_VENC";
		#clock-cells = <1>;
	};

	smi_larb1@16010000 {
		compatible = "mediatek,smi_larb1", "mediatek,smi_larb";
		reg = <0 0x16010000 0 0x1000>;
		interrupts = <GIC_SPI 295 IRQ_TYPE_LEVEL_LOW>;
		clocks = <&scpsys SCP_SYS_VDE>,
			<&vdec_gcon VDEC_LARB1>, <&vdec_gcon VDEC_VDEC>;
		clock-names = "mtcmos-vde", "vdec-larb1", "vdec-vdec";
		mediatek,smi-id = <1>;
	};

	vdec@16020000 {
		compatible = "mediatek,vdec";
		reg = <0 0x16020000 0 0x10000>;
		interrupts = <GIC_SPI 250 IRQ_TYPE_LEVEL_LOW>;
	};

	vdtop@16020000 {
		compatible = "mediatek,vdtop";
		reg = <0 0x16020000 0 0x1000>;
	};

	vld@16021000 {
		compatible = "mediatek,vld";
		reg = <0 0x16021000 0 0x1000>;
	};

	vld_top@16021800 {
		compatible = "mediatek,vld_top";
		reg = <0 0x16021800 0 0x1000>;
	};

	mc@16022000 {
		compatible = "mediatek,mc";
		reg = <0 0x16022000 0 0x1000>;
	};

	avc_vld@16023000 {
		compatible = "mediatek,avc_vld";
		reg = <0 0x16023000 0 0x1000>;
	};

	avc_mv@16024000 {
		compatible = "mediatek,avc_mv";
		reg = <0 0x16024000 0 0x1000>;
	};

	vdec_pp@16025000 {
		compatible = "mediatek,vdec_pp";
		reg = <0 0x16025000 0 0x1000>;
	};

	hevc_vld@16028000 {
		compatible = "mediatek,hevc_vld";
		reg = <0 0x16028000 0 0x1000>;
	};

	vp8_vld@16026800 {
		compatible = "mediatek,vp8_vld";
		reg = <0 0x16026800 0 0x1000>;
	};

	vp6@16027000 {
		compatible = "mediatek,vp6";
		reg = <0 0x16027000 0 0x1000>;
	};

	vld2@16027800 {
		compatible = "mediatek,vld2";
		reg = <0 0x16027800 0 0x1000>;
	};

	mc_vmmu@16028000 {
		compatible = "mediatek,mc_vmmu";
		reg = <0 0x16028000 0 0x1000>;
	};

	pp_vmmu@16029000 {
		compatible = "mediatek,pp_vmmu";
		reg = <0 0x16029000 0 0x1000>;
	};

	venc_gcon: venc_gcon@17000000 {
		compatible = "mediatek,venc_gcon", "syscon";
		reg = <0 0x17000000 0 0x1000>;
		#clock-cells = <1>;
	};

	smi_larb4@17010000 {
		compatible = "mediatek,smi_larb4", "mediatek,smi_larb";
		reg = <0 0x17010000 0 0x1000>;
		interrupts = <GIC_SPI 248 IRQ_TYPE_LEVEL_LOW>;
		clocks = <&scpsys SCP_SYS_VEN>,
			<&venc_gcon VENC_GCON_LARB>,
			<&venc_gcon VENC_GCON_VENC>,
			<&venc_gcon VENC_GCON_JPGENC>;
		clock-names = "mtcmos-ven",
			"venc-larb4", "venc-venc", "venc-jpgenc";
		mediatek,smi-id = <4>;
	};

	venc: venc@17020000 {
		compatible = "mediatek,venc";
		reg = <0 0x17020000 0 0x1000>;
		interrupts = <GIC_SPI 247 IRQ_TYPE_LEVEL_LOW>;
	};

	venc_jpg@17030000 {
		compatible = "mediatek,venc_jpg";
		reg =	<0 0x17030000 0 0x1000>;
		interrupts = <GIC_SPI 249 IRQ_TYPE_LEVEL_LOW>;
			clocks =
				<&venc_gcon VENC_GCON_JPGENC>;

			clock-names =
				"MT_CG_VENC_JPGENC";
	};

	mbist@17040000 {
		compatible = "mediatek,mbist";
		reg = <0 0x17040000 0 0x1000>;
	};

	mjc_config@12000000 {
		compatible = "mediatek,mjc_config";
		reg = <0 0x12000000 0 0x1000>;
	};

	mjc_top@12001000 {
		compatible = "mediatek,mjc_top";
		reg = <0 0x12001000 0 0x1000>;
	};

	imgsys1_dfp@1502e000 {
		compatible = "mediatek,imgsys1_dfp";
		reg = <0 0x1502e000 0 0x1000>;
	};

	imgsys: imgsys@15020000 {
		compatible = "mediatek,imgsys", "syscon";
		reg = <0 0x15020000 0 0x1000>;
		#clock-cells = <1>;
		clocks =
				<&imgsys IMG_LARB5>,
				<&imgsys IMG_DIP>;
		clock-names =
				"DIP_CG_IMG_LARB5",
				"DIP_CG_IMG_DIP";
	};

	imgsyscq@15020000 {
		compatible = "mediatek,imgsyscq";
		reg = <0 0x15020000 0 0x10>;
	};

	smi_larb2@1502f000 {
		compatible = "mediatek,smi_larb2", "mediatek,smi_larb";
		reg = <0 0x1502f000 0 0x1000>;
		interrupts = <GIC_SPI 263 IRQ_TYPE_LEVEL_LOW>;
		clocks = <&scpsys SCP_SYS_ISP>,
			<&mmsys_config MMSYS_GALS_IPU2MM>, <&imgsys IMG_LARB2>;
		clock-names = "mtcmos-isp", "gals-ipu2mm", "img-larb2";
		mediatek,smi-id = <2>;
	};

	smi_larb5@15021000 {
		compatible = "mediatek,smi_larb5", "mediatek,smi_larb";
		reg = <0 0x15021000 0 0x1000>;
		interrupts = <GIC_SPI 267 IRQ_TYPE_LEVEL_LOW>;
		clocks = <&scpsys SCP_SYS_ISP>,
			<&mmsys_config MMSYS_GALS_IMG2MM>, <&imgsys IMG_LARB5>;
		clock-names = "mtcmos-isp", "gals-img2mm", "img-larb5";
		mediatek,smi-id = <5>;
	};

	dip1@15022000 {
		compatible = "mediatek,dip1";
		reg = <0 0x15022000 0 0x6000>;
		interrupts = <GIC_SPI 268 IRQ_TYPE_LEVEL_LOW>;
	};

	dip2@15023000 {
		compatible = "mediatek,dip2";
		reg = <0 0x15023000 0 0x1000>;
	};

	dip3@15024000 {
		compatible = "mediatek,dip3";
		reg = <0 0x15024000 0 0x1000>;
	};

	dip4@15025000 {
		compatible = "mediatek,dip4";
		reg = <0 0x15025000 0 0x1000>;
	};

	dip5@15026000 {
		compatible = "mediatek,dip5";
		reg = <0 0x15026000 0 0x1000>;
	};

	dip6@15027000 {
		compatible = "mediatek,dip6";
		reg = <0 0x15027000 0 0x1000>;
	};

	dpe@15028000 {
		compatible = "mediatek,dpe";
		reg = <0 0x15028000 0 0x1000>;
		interrupts = <GIC_SPI 270 IRQ_TYPE_LEVEL_LOW>;

		clocks = <&imgsys IMG_DPE>;
		clock-names = "DPE_CG_IMG_DPE";
	};

	dpe_dma@15028000 {
		compatible = "mediatek,dpe_dma";
		reg = <0 0x15028000 0 0x1000>;
	};

	rsc@15029000 {
		compatible = "mediatek,rsc";
		reg = <0 0x15029000 0 0x1000>;
		interrupts = <GIC_SPI 271 IRQ_TYPE_LEVEL_LOW>;

		clocks = <&imgsys IMG_RSC>;
		clock-names = "RSC_CLK_IMG_RSC";
	};

	wpe_a@1502a000 {
		compatible = "mediatek,wpe_a";
		reg = <0 0x1502a000 0 0x1000>;
		interrupts = <GIC_SPI 273 IRQ_TYPE_LEVEL_LOW>;

		clocks = <&imgsys IMG_WPE_A>;
		clock-names = "WPE_CLK_IMG_WPE_A";
	};

	wpe_b@1502d000 {
		compatible = "mediatek,wpe_b";
		reg = <0 0x1502d000 0 0x1000>;
		interrupts = <GIC_SPI 274 IRQ_TYPE_LEVEL_LOW>;

		clocks = <&imgsys IMG_WPE_B>;
		clock-names = "WPE_CLK_IMG_WPE_B";
	};

	fdvt@1502b000 {
		compatible = "mediatek,fdvt";
		reg = <0 0x1502b000 0 0x1000>;
		interrupts = <GIC_SPI 269 IRQ_TYPE_LEVEL_LOW>;

		clocks = <&imgsys IMG_FDVT>;
		clock-names = "FD_CLK_IMG_FDVT";
	};

	fdvt_dma@1502b000 {
		compatible = "mediatek,fdvt_dma";
		reg = <0 0x1502b000 0 0x1000>;
	};

	mfb@1502e000 {
		compatible = "mediatek,mfb";
		reg = <0 0x1502e000 0 0x1000>;
		interrupts = <GIC_SPI 276 IRQ_TYPE_LEVEL_LOW>;

		clocks = <&imgsys IMG_MFB>;
		clock-names = "MFB_CLK_IMG_MFB";
	};

	tsf@1a0a1000 {
		compatible = "mediatek,tsf";
		reg = <0 0x1a0a1000 0 0x1000>;
		interrupts = <GIC_SPI 265 IRQ_TYPE_LEVEL_LOW>;

		clocks = <&camsys CAMSYS_CCU_CGPDN>;
		clock-names = "TSF_CAMSYS_TSF_CGPDN";
	};

	owe@1502c000 {
		compatible = "mediatek,owe";
		reg = <0 0x1502c000 0 0x1000>;
		interrupts = <GIC_SPI 277 IRQ_TYPE_LEVEL_LOW>;

		clocks = <&imgsys IMG_OWE>;
		clock-names = "OWE_CLK_IMG_OWE";
	};

	owe_dma@1502c000 {
		compatible = "mediatek,owe_dma";
		reg = <0 0x1502c000 0 0x1000>;
	};

	eaf@1502d000 {
		compatible = "mediatek,eaf";
		reg = <0 0x1502d000 0 0x1000>;
	};

	imgsys1_vad@1502e000 {
		compatible = "mediatek,imgsys1_vad";
		reg = <0 0x1502e000 0 0x1000>;
	};

	camsys: camsys@1a000000 {
		compatible = "mediatek,camsys", "syscon";
		reg = <0 0x1a000000 0 0x1000>;
		#clock-cells = <1>;
		/* Camera CCF */
		clocks = <&scpsys SCP_SYS_DIS>,
				<&scpsys SCP_SYS_ISP>,
				<&scpsys SCP_SYS_CAM>,
				<&camsys CAMSYS_CAM_CGPDN>,
				<&camsys CAMSYS_CAMTG_CGPDN>,
				<&camsys CAMSYS_CAMSV0_CGPDN>,
				<&camsys CAMSYS_CAMSV1_CGPDN>,
				<&camsys CAMSYS_CAMSV2_CGPDN>;
		clock-names = "ISP_SCP_SYS_DIS",
				"ISP_SCP_SYS_ISP",
				"ISP_SCP_SYS_CAM",
				"CAMSYS_CAM_CGPDN",
				"CAMSYS_CAMTG_CGPDN",
				"CAMSYS_CAMSV0_CGPDN",
				"CAMSYS_CAMSV1_CGPDN",
				"CAMSYS_CAMSV2_CGPDN";
	};

	ipu_conn: ipu_conn@19000000 {
		compatible = "mediatek,ipu_conn", "syscon";
		reg = <0 0x19000000 0 0x1000>;
		#clock-cells = <1>;
	};
	ipu_adl: ipu_adl@19010000 {
		compatible = "mediatek,ipu_adl", "syscon";
		reg = <0 0x19010000 0 0x1000>;
		#clock-cells = <1>;
	};
	ipu0: ipu0@19180000 {
		compatible = "mediatek,ipu0", "syscon";
		reg = <0 0x19180000 0 0x1000>;
		interrupts = <GIC_SPI 292 IRQ_TYPE_LEVEL_LOW>;
		#clock-cells = <1>;
	};
	ipu1: ipu1@19280000 {
		compatible = "mediatek,ipu1", "syscon";
		reg = <0 0x19280000 0 0x1000>;
		interrupts = <GIC_SPI 293 IRQ_TYPE_LEVEL_LOW>;
		#clock-cells = <1>;
	};

	vpu_core0@0x19100000  {
		compatible = "mediatek,vpu_core0";
		reg = <0 0x19100000 0 0x94000>;
		interrupts = <GIC_SPI 292 IRQ_TYPE_LEVEL_LOW>;
		clocks =  <&topckgen TOP_MUX_DSP>,
			<&topckgen TOP_MUX_DSP1>,
			<&topckgen TOP_MUX_DSP2>,
			<&topckgen TOP_MUX_IPU_IF>,
			<&ipu0 IPU_CORE0_JTAG_CG>,
			<&ipu0 IPU_CORE0_AXI_M_CG>,
			<&ipu0 IPU_CORE0_IPU_CG>,
			<&ipu1 IPU_CORE1_JTAG_CG>,
			<&ipu1 IPU_CORE1_AXI_M_CG>,
			<&ipu1 IPU_CORE1_IPU_CG>,
			<&ipu_conn IPU_ADL_CABGEN>,
			<&ipu_conn IPU_CONN_DAP_RX_CG>,
			<&ipu_conn IPU_CONN_APB2AXI_CG>,
			<&ipu_conn IPU_CONN_APB2AHB_CG>,
			<&ipu_conn IPU_CONN_IPU_CAB1TO2>,
			<&ipu_conn IPU_CONN_IPU1_CAB1TO2>,
			<&ipu_conn IPU_CONN_IPU2_CAB1TO2>,
			<&ipu_conn IPU_CONN_CAB3TO3>,
			<&ipu_conn IPU_CONN_CAB2TO1>,
			<&ipu_conn IPU_CONN_CAB3TO1_SLICE>,
			<&ipu_conn IPU_CONN_IPU_CG>,
			<&ipu_conn IPU_CONN_AHB_CG>,
			<&ipu_conn IPU_CONN_AXI_CG>,
			<&ipu_conn IPU_CONN_ISP_CG>,
			<&ipu_conn IPU_CONN_CAM_ADL_CG>,
			<&ipu_conn IPU_CONN_IMG_ADL_CG>,
			<&topckgen TOP_MMPLL_D6>,
			<&topckgen TOP_MMPLL_D7>,
			<&topckgen TOP_UNIVPLL_D3>,
			<&topckgen TOP_SYSPLL_D3>,
			<&topckgen TOP_UNIVPLL_D2_D2>,
			<&topckgen TOP_SYSPLL_D2_D2>,
			<&topckgen TOP_UNIVPLL_D3_D2>,
			<&topckgen TOP_SYSPLL_D3_D2>,
			<&mmsys_config MMSYS_GALS_IPU2MM>,
			<&mmsys_config MMSYS_GALS_IPU12MM>,
			<&mmsys_config MMSYS_GALS_COMM1>,
			<&mmsys_config MMSYS_GALS_COMM0>,
			<&mmsys_config MMSYS_SMI_COMMON>,
			<&scpsys SCP_SYS_DIS>,
			<&scpsys SCP_SYS_VPU_TOP>,
			<&scpsys SCP_SYS_VPU_CORE0_DORMANT>,
			<&scpsys SCP_SYS_VPU_CORE0_SHUTDOWN>,
			<&scpsys SCP_SYS_VPU_CORE1_DORMANT>,
			<&scpsys SCP_SYS_VPU_CORE1_SHUTDOWN>;
		clock-names = "clk_top_dsp_sel",
			"clk_top_dsp1_sel",
			"clk_top_dsp2_sel",
			"clk_top_ipu_if_sel",
			"clk_ipu_core0_jtag_cg",
			"clk_ipu_core0_axi_m_cg",
			"clk_ipu_core0_ipu_cg",
			"clk_ipu_core1_jtag_cg",
			"clk_ipu_core1_axi_m_cg",
			"clk_ipu_core1_ipu_cg",
			"clk_ipu_adl_cabgen",
			"clk_ipu_conn_dap_rx_cg",
			"clk_ipu_conn_apb2axi_cg",
			"clk_ipu_conn_apb2ahb_cg",
			"clk_ipu_conn_ipu_cab1to2",
			"clk_ipu_conn_ipu1_cab1to2",
			"clk_ipu_conn_ipu2_cab1to2",
			"clk_ipu_conn_cab3to3",
			"clk_ipu_conn_cab2to1",
			"clk_ipu_conn_cab3to1_slice",
			"clk_ipu_conn_ipu_cg",
			"clk_ipu_conn_ahb_cg",
			"clk_ipu_conn_axi_cg",
			"clk_ipu_conn_isp_cg",
			"clk_ipu_conn_cam_adl_cg",
			"clk_ipu_conn_img_adl_cg",
			"clk_top_mmpll_d6",
			"clk_top_mmpll_d7",
			"clk_top_univpll_d3",
			"clk_top_syspll_d3",
			"clk_top_univpll_d2_d2",
			"clk_top_syspll_d2_d2",
			"clk_top_univpll_d3_d2",
			"clk_top_syspll_d3_d2",
			"clk_mmsys_gals_ipu2mm",
			"clk_mmsys_gals_ipu12mm",
			"clk_mmsys_gals_comm1",
			"clk_mmsys_gals_comm0",
			"clk_mmsys_smi_common",
			"mtcmos_dis",
			"mtcmos_vpu_top",
			"mtcmos_vpu_core0_dormant",
			"mtcmos_vpu_core0_shutdown",
			"mtcmos_vpu_core1_dormant",
			"mtcmos_vpu_core1_shutdown";
	};

	vpu_core1@0x19200000  {
		compatible = "mediatek,vpu_core1";
		reg = <0 0x19200000 0 0x94000>;
		interrupts = <GIC_SPI 293 IRQ_TYPE_LEVEL_LOW>;
	};

	smi_larb3@1a002000 {
		compatible = "mediatek,smi_larb3", "mediatek,smi_larb";
		reg = <0 0x1a002000 0 0x1000>;
		clocks = <&scpsys SCP_SYS_CAM>,
			<&mmsys_config MMSYS_GALS_IPU12MM>,
			<&camsys CAMSYS_LARB3_CGPDN>;
		clock-names = "mtcmos-cam", "gals-ipu12mm", "cam-larb3";
		mediatek,smi-id = <3>;
	};

	smi_larb6@1a001000 {
		compatible = "mediatek,smi_larb6", "mediatek,smi_larb";
		reg = <0 0x1a001000 0 0x1000>;
		clocks = <&scpsys SCP_SYS_CAM>,
			<&mmsys_config MMSYS_GALS_CAM2MM>,
			<&camsys CAMSYS_LARB6_CGPDN>;
		clock-names = "mtcmos-cam", "gals-cam2mm", "cam-larb6";
		mediatek,smi-id = <6>;
	};

	cam1@1a003000 {
		compatible = "mediatek,cam1";
		reg = <0 0x1a003000 0 0x1000>;
		interrupts = <GIC_SPI 253 IRQ_TYPE_LEVEL_LOW>;
	};

	cam2@1a004000 {
		compatible = "mediatek,cam2";
		reg = <0 0x1a004000 0 0x2000>;
		interrupts = <GIC_SPI 254 IRQ_TYPE_LEVEL_LOW>;
	};

	cam3@1a006000 {
		compatible = "mediatek,cam3";
		reg = <0 0x1a006000 0 0x2000>;
		interrupts = <GIC_SPI 255 IRQ_TYPE_LEVEL_LOW>;
	};

	cam4@1a008000 {
		compatible = "mediatek,cam4";
		reg = <0 0x1a008000 0 0x2000>;
		interrupts = <GIC_SPI 256 IRQ_TYPE_LEVEL_LOW>;
	};

	camsv1@1a050000 {
		compatible = "mediatek,camsv1";
		reg = <0 0x1a050000 0 0x1000>;
		interrupts = <GIC_SPI 258 IRQ_TYPE_LEVEL_LOW>;
	};

	camsv2@1a051000 {
		compatible = "mediatek,camsv2";
		reg = <0 0x1a051000 0 0x1000>;
		interrupts = <GIC_SPI 259 IRQ_TYPE_LEVEL_LOW>;
	};

	camsv3@1a052000 {
		compatible = "mediatek,camsv3";
		reg = <0 0x1a052000 0 0x1000>;
		interrupts = <GIC_SPI 260 IRQ_TYPE_LEVEL_LOW>;
	};

	camsv4@1a053000 {
		compatible = "mediatek,camsv4";
		reg = <0 0x1a053000 0 0x1000>;
		interrupts = <GIC_SPI 261 IRQ_TYPE_LEVEL_LOW>;
	};

	camsv5@1a054000 {
		compatible = "mediatek,camsv5";
		reg = <0 0x1a054000 0 0x1000>;
	};

	camsv6@1a055000 {
		compatible = "mediatek,camsv6";
		reg = <0 0x1a055000 0 0x1000>;
	};

	seninf1@1a040000 {
		compatible = "mediatek,seninf1";
		reg = <0 0x1a040000 0 0x1000>;
	};

	seninf2@1a041000 {
		compatible = "mediatek,seninf2";
		reg = <0 0x1a041000 0 0x1000>;
	};

	seninf3@1a042000 {
		compatible = "mediatek,seninf3";
		reg = <0 0x1a042000 0 0x1000>;
	};

	seninf4@1a043000 {
		compatible = "mediatek,seninf4";
		reg = <0 0x1a043000 0 0x1000>;
	};

	seninf5@1a044000 {
		compatible = "mediatek,seninf5";
		reg = <0 0x1a044000 0 0x1000>;
	};

	seninf6@1a045000 {
		compatible = "mediatek,seninf6";
		reg = <0 0x1a045000 0 0x1000>;
	};

	seninf7@1a046000 {
		compatible = "mediatek,seninf7";
		reg = <0 0x1a046000 0 0x1000>;
	};

	seninf8@1a047000 {
		compatible = "mediatek,seninf8";
		reg = <0 0x1a047000 0 0x1000>;
	};

	seninf_top@1a040000 {
		compatible = "mediatek,seninf_top";
		reg = <0 0x1a040000 0 0x1000>;
#if 0
		interrupts = <GIC_SPI 251 IRQ_TYPE_LEVEL_LOW>;
#endif
		clocks = <&scpsys SCP_SYS_DIS>,
			<&scpsys SCP_SYS_CAM>,
			<&camsys CAMSYS_SENINF_CGPDN>,
			<&topckgen TOP_MUX_SENINF>,
			<&topckgen TOP_MUX_CAMTG>,
			<&topckgen TOP_MUX_CAMTG2>,
			<&topckgen TOP_MUX_CAMTG3>,
			<&topckgen TOP_MUX_CAMTG4>,
			<&clk26m>,
			<&topckgen TOP_UNIVP_192M_D8>,
			<&topckgen TOP_UNIVPLL_D3_D8>,
			<&topckgen TOP_UNIVP_192M_D4>,
			<&topckgen TOP_F26M_CK_D2>,
			<&topckgen TOP_UNIVP_192M_D16>,
			<&topckgen TOP_UNIVP_192M_D32>;
		clock-names = "SCP_SYS_DIS",
			"SCP_SYS_CAM",
			"CAMSYS_SENINF_CGPDN",
			"TOP_MUX_SENINF",
			"TOP_MUX_CAMTG",
			"TOP_MUX_CAMTG2",
			"TOP_MUX_CAMTG3",
			"TOP_MUX_CAMTG4",
			"TOP_CLK26M",
			"TOP_UNIVP_192M_D8",
			"TOP_UNIVPLL_D3_D8",
			"TOP_UNIVP_192M_D4",
			"TOP_F26M_CK_D2",
			"TOP_UNIVP_192M_D16",
			"TOP_UNIVP_192M_D32";
	};

	kd_camera_hw1:kd_camera_hw1@1a040000 {
		compatible = "mediatek,imgsensor";
	};

	flashlight_core: flashlight_core {
		compatible = "mediatek,flashlight_core";
	};

	flashlights_mt6370: flashlights_mt6370 {
		compatible = "mediatek,flashlights_mt6370";
		decouple = <0>;
		channel@1 {
			type = <0>;
			ct = <0>;
			part = <0>;
		};
		channel@2 {
			type = <0>;
			ct = <1>;
			part = <0>;
		};
	};

	ccu@1a0a0000 {
		compatible = "mediatek,ccu";
		reg = <0 0x1a0a1000 0 0x1000>;
		interrupts = <GIC_SPI 264 IRQ_TYPE_LEVEL_LOW>;

		clocks = <&camsys CAMSYS_CCU_CGPDN>,
			 <&mmsys_config MMSYS_GALS_CCU2MM>;
		clock-names = "CCU_CLK_CAM_CCU",
			      "CCU_CLK_MMSYS_CCU";
	};

	alc@60000000 {
		compatible = "mediatek,alc";
		reg = <0 0x60000000 0 0x1000>;
	};

	md_config@80000000 {
		compatible = "mediatek,md_config";
		reg = <0 0x80000000 0 0x1000>;
	};

	md_uart0@80010000 {
		compatible = "mediatek,md_uart0";
		reg = <0 0x80010000 0 0x1000>;
	};

	md_p_dma@80020000 {
		compatible = "mediatek,md_p_dma";
		reg = <0 0x80020000 0 0x1000>;
	};

	md_gpt@80030000 {
		compatible = "mediatek,md_gpt";
		reg = <0 0x80030000 0 0x1000>;
	};

	simif1@80040000 {
		compatible = "mediatek,simif1";
		reg = <0 0x80040000 0 0x1000>;
	};

	simif2@80050000 {
		compatible = "mediatek,simif2";
		reg = <0 0x80050000 0 0x1000>;
	};

	md_peri_misc@80060000 {
		compatible = "mediatek,md_peri_misc";
		reg = <0 0x80060000 0 0x1000>;
	};

	md_cirq@f0070000 {
		compatible = "mediatek,md_cirq";
		reg = <0 0xf0070000 0 0x1000>;
	};

	md_debug1@80080000 {
		compatible = "mediatek,md_debug1";
		reg = <0 0x80080000 0 0x1000>;
	};

	md_debug2@80090000 {
		compatible = "mediatek,md_debug2";
		reg = <0 0x80090000 0 0x1000>;
	};

	md_debug3@800a0000 {
		compatible = "mediatek,md_debug3";
		reg = <0 0x800a0000 0 0x1000>;
	};

	mdpar_dbgmon@800b0000 {
		compatible = "mediatek,mdpar_dbgmon";
		reg = <0 0x800b0000 0 0x1000>;
	};

	md_peri_clk_ctl@800c0000 {
		compatible = "mediatek,md_peri_clk_ctl";
		reg = <0 0x800c0000 0 0x1000>;
	};

	md_topsm@f00d0000 {
		compatible = "mediatek,md_topsm";
		reg = <0 0xf00d0000 0 0x1000>;
	};

	md_ost@f00e0000 {
		compatible = "mediatek,md_ost";
		reg = <0 0xf00e0000 0 0x1000>;
	};

	md_rgu@f00f0000 {
		compatible = "mediatek,md_rgu";
		reg = <0 0xf00f0000 0 0x1000>;
		interrupts = <GIC_SPI 283 IRQ_TYPE_EDGE_FALLING>;
	};

	md_i2c@80100000 {
		compatible = "mediatek,md_i2c";
		reg = <0 0x80100000 0 0x1000>;
	};

	md_eint@80110000 {
		compatible = "mediatek,md_eint";
		reg = <0 0x80110000 0 0x1000>;
	};

	md_clkctl@80120000 {
		compatible = "mediatek,md_clkctl";
		reg = <0 0x80120000 0 0x1000>;
	};

	md_global_con_dcm@80130000 {
		compatible = "mediatek,md_global_con_dcm";
		reg = <0 0x80130000 0 0x1000>;
	};

	md_pll_mixedsys@80140000 {
		compatible = "mediatek,md_pll_mixedsys";
		reg = <0 0x80140000 0 0x1000>;
	};

	md_clksw@80150000 {
		compatible = "mediatek,md_clksw";
		reg = <0 0x80150000 0 0x1000>;
	};

	a7_ost@f0160000 {
		compatible = "mediatek,a7_ost";
		reg = <0 0xf0160000 0 0x1000>;
	};

	md_lite_gpt@80170000 {
		compatible = "mediatek,md_lite_gpt";
		reg = <0 0x80170000 0 0x1000>;
	};

	mdperi_mbist_config@801a0000 {
		compatible = "mediatek,mdperi_mbist_config";
		reg = <0 0x801a0000 0 0x1000>;
	};

	md_sdf_top@801b0000 {
		compatible = "mediatek,md_sdf_top";
		reg = <0 0x801b0000 0 0x1000>;
	};

	psmcu_misc@80200000 {
		compatible = "mediatek,psmcu_misc";
		reg = <0 0x80200000 0 0x1000>;
	};

	psmcu_busmon@80210000 {
		compatible = "mediatek,psmcu_busmon";
		reg = <0 0x80210000 0 0x1000>;
	};

	md_pcm@80220000 {
		compatible = "mediatek,md_pcm";
		reg = <0 0x80220000 0 0x1000>;
	};

	psmcu_mbist_config@80240000 {
		compatible = "mediatek,psmcu_mbist_config";
		reg = <0 0x80240000 0 0x1000>;
	};

	md_elm@80250000 {
		compatible = "mediatek,md_elm";
		reg = <0 0x80250000 0 0x1000>;
	};

	md_abm@80260000 {
		compatible = "mediatek,md_abm";
		reg = <0 0x80260000 0 0x1000>;
	};

	md_soe@80310000 {
		compatible = "mediatek,md_soe";
		reg = <0 0x80310000 0 0x1000>;
		interrupts = <GIC_SPI 286 IRQ_TYPE_LEVEL_LOW>;
	};

	md_infra_busmon@80320000 {
		compatible = "mediatek,md_infra_busmon";
		reg = <0 0x80320000 0 0x1000>;
	};

	md_uart1@80330000 {
		compatible = "mediatek,md_uart1";
		reg = <0 0x80330000 0 0x1000>;
	};

	md_uart2@80340000 {
		compatible = "mediatek,md_uart2";
		reg = <0 0x80340000 0 0x1000>;
	};

	mdinfra_mbist_config@80350000 {
		compatible = "mediatek,mdinfra_mbist_config";
		reg = <0 0x80350000 0 0x1000>;
	};

	mdsys_mbist_config@80360000 {
		compatible = "mediatek,mdsys_mbist_config";
		reg = <0 0x80360000 0 0x1000>;
	};

	mdsmicfg@803a0000 {
		compatible = "mediatek,mdsmicfg";
		reg = <0 0x803a0000 0 0x1000>;
	};

	mdinfra_misc@803b0000 {
		compatible = "mediatek,mdinfra_misc";
		reg = <0 0x803b0000 0 0x1000>;
	};

	md_bus_recoder@803c0000 {
		compatible = "mediatek,md_bus_recoder";
		reg = <0 0x803c0000 0 0x1000>;
	};

	md_ppc_top@803d0000 {
		compatible = "mediatek,md_ppc_top";
		reg = <0 0x803d0000 0 0x1000>;
	};

	a7_wdt@f0400000 {
		compatible = "mediatek,a7_wdt";
		reg = <0 0xf0400000 0 0x1000>;
	};

	a7_mbist_config@f0410000 {
		compatible = "mediatek,a7_mbist_config";
		reg = <0 0xf0410000 0 0x1000>;
	};

	a7_cirq@f0420000 {
		compatible = "mediatek,a7_cirq";
		reg = <0 0xf0420000 0 0x1000>;
	};

	pf_bsi_apb1@80200000 {
		compatible = "mediatek,pf_bsi_apb1";
		reg = <0 0x80200000 0 0x1000>;
	};

	pf_bsi_apb2@80201000 {
		compatible = "mediatek,pf_bsi_apb2";
		reg = <0 0x80201000 0 0x1000>;
	};

	rfic1_bsispi@80202000 {
		compatible = "mediatek,rfic1_bsispi";
		reg = <0 0x80202000 0 0x1000>;
	};

	rfic2_bsispi@80203000 {
		compatible = "mediatek,rfic2_bsispi";
		reg = <0 0x80203000 0 0x1000>;
	};

	mipi0_bsispi@80205000 {
		compatible = "mediatek,mipi0_bsispi";
		reg = <0 0x80205000 0 0x1000>;
	};

	mipi1_bsispi@80206000 {
		compatible = "mediatek,mipi1_bsispi";
		reg = <0 0x80206000 0 0x1000>;
	};

	idc_suart@80207000 {
		compatible = "mediatek,idc_suart";
		reg = <0 0x80207000 0 0x1000>;
	};

	mdm_psys_misc@8020d000 {
		compatible = "mediatek,mdm_psys_misc";
		reg = <0 0x8020d000 0 0x1000>;
	};

	mdm_psys_mbistcon@8020e000 {
		compatible = "mediatek,mdm_psys_mbistcon";
		reg = <0 0x8020e000 0 0x1000>;
	};

	md1_abb_mixedsys@8020c000 {
		compatible = "mediatek,md1_abb_mixedsys";
		reg = <0 0x8020c000 0 0x1000>;
	};

	md2_abb_mixedsys@8020c000 {
		compatible = "mediatek,md2_abb_mixedsys";
		reg = <0 0x8020c000 0 0x1000>;
	};

	idma@82000000 {
		compatible = "mediatek,idma";
		reg = <0 0x82000000 0 0x1000>;
	};

	ahb2dspio@82800000 {
		compatible = "mediatek,ahb2dspio";
		reg = <0 0x82800000 0 0x1000>;
	};

	md2g_confg@82c00000 {
		compatible = "mediatek,md2g_confg";
		reg = <0 0x82c00000 0 0x1000>;
	};

	apc@82c30000 {
		compatible = "mediatek,apc";
		reg = <0 0x82c30000 0 0x1000>;
	};

	csd_acc@82c70000 {
		compatible = "mediatek,csd_acc";
		reg = <0 0x82c70000 0 0x1000>;
	};

	share_d1@82ca0000 {
		compatible = "mediatek,share_d1";
		reg = <0 0x82ca0000 0 0x1000>;
	};

	irdma@82cb0000 {
		compatible = "mediatek,irdma";
		reg = <0 0x82cb0000 0 0x1000>;
	};

	patch@82cc0000 {
		compatible = "mediatek,patch";
		reg = <0 0x82cc0000 0 0x1000>;
	};

	mdafe@82cd0000 {
		compatible = "mediatek,mdafe";
		reg = <0 0x82cd0000 0 0x1000>;
	};

	bfe@82ce0000 {
		compatible = "mediatek,bfe";
		reg = <0 0x82ce0000 0 0x1000>;
	};

	modem_lite_confg@83000000 {
		compatible = "mediatek,modem_lite_confg";
		reg = <0 0x83000000 0 0x1000>;
	};

	modem_lite_topsm@83010000 {
		compatible = "mediatek,modem_lite_topsm";
		reg = <0 0x83010000 0 0x1000>;
	};

	tdma@83020000 {
		compatible = "mediatek,tdma";
		reg = <0 0x83020000 0 0x1000>;
	};

	shreg2@83030000 {
		compatible = "mediatek,shreg2";
		reg = <0 0x83030000 0 0x1000>;
	};

	divider@83040000 {
		compatible = "mediatek,divider";
		reg = <0 0x83040000 0 0x1000>;
	};

	fcs@83050000 {
		compatible = "mediatek,fcs";
		reg = <0 0x83050000 0 0x1000>;
	};

	gcu@83060000 {
		compatible = "mediatek,gcu";
		reg = <0 0x83060000 0 0x1000>;
	};

	bsi_2g@83070000 {
		compatible = "mediatek,bsi_2g";
		reg = <0 0x83070000 0 0x1000>;
	};

	bpi_2g@83080000 {
		compatible = "mediatek,bpi_2g";
		reg = <0 0x83080000 0 0x1000>;
	};

	afc_2g@83090000 {
		compatible = "mediatek,afc_2g";
		reg = <0 0x83090000 0 0x1000>;
	};

	tdd@84000000 {
		compatible = "mediatek,tdd";
		reg = <0 0x84000000 0 0x1000>;
	};

	l2ulsbdma@85000000 {
		compatible = "mediatek,l2ulsbdma";
		reg = <0 0x85000000 0 0x1000>;
	};

	l2ulhbdma@85010000 {
		compatible = "mediatek,l2ulhbdma";
		reg = <0 0x85010000 0 0x1000>;
	};

	l2dlsbdma@85020000 {
		compatible = "mediatek,l2dlsbdma";
		reg = <0 0x85020000 0 0x1000>;
	};

	l2dlhbdma@85030000 {
		compatible = "mediatek,l2dlhbdma";
		reg = <0 0x85030000 0 0x1000>;
	};

	l2mbist@85040000 {
		compatible = "mediatek,l2mbist";
		reg = <0 0x85040000 0 0x1000>;
	};

	l2pseuphy@85050000 {
		compatible = "mediatek,l2pseuphy";
		reg = <0 0x85050000 0 0x1000>;
	};

	l2hwlog@85058000 {
		compatible = "mediatek,l2hwlog";
		reg = <0 0x85058000 0 0x1000>;
	};

	l2soindma@85060000 {
		compatible = "mediatek,l2soindma";
		reg = <0 0x85060000 0 0x1000>;
	};

	l2sooutdma@85070000 {
		compatible = "mediatek,l2sooutdma";
		reg = <0 0x85070000 0 0x1000>;
	};

	l2ullmac@85080000 {
		compatible = "mediatek,l2ullmac";
		reg = <0 0x85080000 0 0x1000>;
	};

	l2dllmac@85090000 {
		compatible = "mediatek,l2dllmac";
		reg = <0 0x85090000 0 0x1000>;
	};

	l2calmac@85098000 {
		compatible = "mediatek,l2calmac";
		reg = <0 0x85098000 0 0x1000>;
	};

	l2ulfifomng@850a0000 {
		compatible = "mediatek,l2ulfifomng";
		reg = <0 0x850a0000 0 0x1000>;
	};

	l2dlfifomng@850a4000 {
		compatible = "mediatek,l2dlfifomng";
		reg = <0 0x850a4000 0 0x1000>;
	};

	l2sofifomng@850a8000 {
		compatible = "mediatek,l2sofifomng";
		reg = <0 0x850a8000 0 0x1000>;
	};

	l2sec@850b0000 {
		compatible = "mediatek,l2sec";
		reg = <0 0x850b0000 0 0x1000>;
	};

	l2ulsecctl@850b4000 {
		compatible = "mediatek,l2ulsecctl";
		reg = <0 0x850b4000 0 0x1000>;
	};

	l2dlsecctl@850b8000 {
		compatible = "mediatek,l2dlsecctl";
		reg = <0 0x850b8000 0 0x1000>;
	};

	l2sosecctl@850bc000 {
		compatible = "mediatek,l2sosecctl";
		reg = <0 0x850bc000 0 0x1000>;
	};

	l2misc@850c0000 {
		compatible = "mediatek,l2misc";
		reg = <0 0x850c0000 0 0x1000>;
	};

	l2ulbuf@850e0000 {
		compatible = "mediatek,l2ulbuf";
		reg = <0 0x850e0000 0 0x1000>;
	};

	l2dlbuf@850f0000 {
		compatible = "mediatek,l2dlbuf";
		reg = <0 0x850f0000 0 0x1000>;
	};

	mdl1ao@f60f0000 {
		compatible = "mediatek,mdl1ao";
		reg = <0 0xf60f0000 0 0x1000>;
	};

	modem_confg@87000000 {
		compatible = "mediatek,modem_confg";
		reg = <0 0x87000000 0 0x1000>;
	};

	modem_topsm@87010000 {
		compatible = "mediatek,modem_topsm";
		reg = <0 0x87010000 0 0x1000>;
	};

	bsi_3g@87070000 {
		compatible = "mediatek,bsi_3g";
		reg = <0 0x87070000 0 0x1000>;
	};

	bpi_3g@87080000 {
		compatible = "mediatek,bpi_3g";
		reg = <0 0x87080000 0 0x1000>;
	};

	afc_3g@87090000 {
		compatible = "mediatek,afc_3g";
		reg = <0 0x87090000 0 0x1000>;
	};

	wcdma_timer@870a0000 {
		compatible = "mediatek,wcdma_timer";
		reg = <0 0x870a0000 0 0x1000>;
	};

	dpa_bc@870b0000 {
		compatible = "mediatek,dpa_bc";
		reg = <0 0x870b0000 0 0x1000>;
	};

	pfc_encode@870c0000 {
		compatible = "mediatek,pfc_encode";
		reg = <0 0x870c0000 0 0x1000>;
	};

	pfc_decode@870d0000 {
		compatible = "mediatek,pfc_decode";
		reg = <0 0x870d0000 0 0x1000>;
	};

	hspasys_1_confg@87200000 {
		compatible = "mediatek,hspasys_1_confg";
		reg = <0 0x87200000 0 0x1000>;
	};

	hseq@87210000 {
		compatible = "mediatek,hseq";
		reg = <0 0x87210000 0 0x1000>;
	};

	hsce@87220000 {
		compatible = "mediatek,hsce";
		reg = <0 0x87220000 0 0x1000>;
	};

	hspasys_1_mbist@87230000 {
		compatible = "mediatek,hspasys_1_mbist";
		reg = <0 0x87230000 0 0x1000>;
	};

	hspasys_2_confg@87400000 {
		compatible = "mediatek,hspasys_2_confg";
		reg = <0 0x87400000 0 0x1000>;
	};

	hseq_dc@87410000 {
		compatible = "mediatek,hseq_dc";
		reg = <0 0x87410000 0 0x1000>;
	};

	hsce_dc@87420000 {
		compatible = "mediatek,hsce_dc";
		reg = <0 0x87420000 0 0x1000>;
	};

	rake_dc@87430000 {
		compatible = "mediatek,rake_dc";
		reg = <0 0x87430000 0 0x1000>;
	};

	hspasys_2_mbist@87440000 {
		compatible = "mediatek,hspasys_2_mbist";
		reg = <0 0x87440000 0 0x1000>;
	};

	uea_uia_u0@87600000 {
		compatible = "mediatek,uea_uia_u0";
		reg = <0 0x87600000 0 0x1000>;
	};

	uea_uia_u1@87610000 {
		compatible = "mediatek,uea_uia_u1";
		reg = <0 0x87610000 0 0x1000>;
	};

	dpa_rlc@87620000 {
		compatible = "mediatek,dpa_rlc";
		reg = <0 0x87620000 0 0x1000>;
	};

	dpa_mac@87630000 {
		compatible = "mediatek,dpa_mac";
		reg = <0 0x87630000 0 0x1000>;
	};

	upa@f0920000 {
		compatible = "mediatek,upa";
		reg = <0 0xf0920000 0 0x1000>;
	};

	h_rxbrp@87650000 {
		compatible = "mediatek,h_rxbrp";
		reg = <0 0x87650000 0 0x1000>;
	};

	rxbrp@87660000 {
		compatible = "mediatek,rxbrp";
		reg = <0 0x87660000 0 0x1000>;
	};

	hspasys_3_confg@f0910000 {
		compatible = "mediatek,hspasys_3_confg";
		reg = <0 0xf0910000 0 0x1000>;
	};

	txbrp@87680000 {
		compatible = "mediatek,txbrp";
		reg = <0 0x87680000 0 0x1000>;
	};

	txcrp@87690000 {
		compatible = "mediatek,txcrp";
		reg = <0 0x87690000 0 0x1000>;
	};

	h_txbrp@876a0000 {
		compatible = "mediatek,h_txbrp";
		reg = <0 0x876a0000 0 0x1000>;
	};

	txupc@876b0000 {
		compatible = "mediatek,txupc";
		reg = <0 0x876b0000 0 0x1000>;
	};

	bc@876c0000 {
		compatible = "mediatek,bc";
		reg = <0 0x876c0000 0 0x1000>;
	};

	dbg_tx@876d0000 {
		compatible = "mediatek,dbg_tx";
		reg = <0 0x876d0000 0 0x1000>;
	};

	hspasys_3_mbist@876e0000 {
		compatible = "mediatek,hspasys_3_mbist";
		reg = <0 0x876e0000 0 0x1000>;
	};

	rxsrp@87800000 {
		compatible = "mediatek,rxsrp";
		reg = <0 0x87800000 0 0x1000>;
	};

	indec@87810000 {
		compatible = "mediatek,indec";
		reg = <0 0x87810000 0 0x1000>;
	};

	rake_0@87820000 {
		compatible = "mediatek,rake_0";
		reg = <0 0x87820000 0 0x1000>;
	};

	rake_1@87830000 {
		compatible = "mediatek,rake_1";
		reg = <0 0x87830000 0 0x1000>;
	};

	rake_2@87840000 {
		compatible = "mediatek,rake_2";
		reg = <0 0x87840000 0 0x1000>;
	};

	searcher@87850000 {
		compatible = "mediatek,searcher";
		reg = <0 0x87850000 0 0x1000>;
	};

	rxdfe@87860000 {
		compatible = "mediatek,rxdfe";
		reg = <0 0x87860000 0 0x1000>;
	};

	hspasys_4_confg@87870000 {
		compatible = "mediatek,hspasys_4_confg";
		reg = <0 0x87870000 0 0x1000>;
	};

	dbg@87880000 {
		compatible = "mediatek,dbg";
		reg = <0 0x87880000 0 0x1000>;
	};

	dwrap0@87890000 {
		compatible = "mediatek,dwrap0";
		reg = <0 0x87890000 0 0x1000>;
	};

	log3g@878a0000 {
		compatible = "mediatek,log3g";
		reg = <0 0x878a0000 0 0x1000>;
	};

	hspasys_4_mbist@878b0000 {
		compatible = "mediatek,hspasys_4_mbist";
		reg = <0 0x878b0000 0 0x1000>;
	};

	dwrap1@878c0000 {
		compatible = "mediatek,dwrap1";
		reg = <0 0x878c0000 0 0x1000>;
	};

	c2ksys@38000000 {
		compatible = "mediatek,c2ksys";
		reg = <0 0x38000000 0 0x1000>;
	};

	mt_soc_deep_buffer_dl_pcm {
		compatible = "mediatek,mt_soc_pcm_deep_buffer_dl";
	};

	mt_soc_ul1_pcm {
		compatible = "mediatek,mt_soc_pcm_capture";
	};

	mt_soc_voice_md1 {
		compatible = "mediatek,mt_soc_pcm_voice_md1";
	};

	mt_soc_hdmi_pcm {
		compatible = "mediatek,mt_soc_pcm_hdmi";
	};

	mt_soc_uldlloopback_pcm {
		compatible = "mediatek,mt_soc_pcm_uldlloopback";
	};

	mt_soc_i2s0_pcm {
		compatible = "mediatek,mt_soc_pcm_dl1_i2s0";
	};

	mt_soc_mrgrx_pcm {
		compatible = "mediatek,mt_soc_pcm_mrgrx";
	};

	mt_soc_mrgrx_awb_pcm {
		compatible = "mediatek,mt_soc_pcm_mrgrx_awb";
	};

	mt_soc_fm_i2s_pcm {
		compatible = "mediatek,mt_soc_pcm_fm_i2s";
	};

	mt_soc_fm_i2s_awb_pcm {
		compatible = "mediatek,mt_soc_pcm_fm_i2s_awb";
	};

	mt_soc_i2s0dl1_pcm {
		compatible = "mediatek,mt_soc_pcm_dl1_i2s0dl1";
	};

	mt_soc_dl1_awb_pcm {
		compatible = "mediatek,mt_soc_pcm_dl1_awb";
	};

	mt_soc_voice_md1_bt {
		compatible = "mediatek,mt_soc_pcm_voice_md1_bt";
	};

	mt_soc_voip_bt_out {
		compatible = "mediatek,mt_soc_pcm_dl1_bt";
	};

	mt_soc_voip_bt_in {
		compatible = "mediatek,mt_soc_pcm_bt_dai";
	};

	mt_soc_tdmrx_pcm {
		compatible = "mediatek,mt_soc_tdm_capture";
	};

	mt_soc_fm_mrgtx_pcm {
		compatible = "mediatek,mt_soc_pcm_fmtx";
	};

	mt_soc_ul2_pcm {
		compatible = "mediatek,mt_soc_pcm_capture2";
	};

	mt_soc_i2s0_awb_pcm {
		compatible = "mediatek,mt_soc_pcm_i2s0_awb";
	};

	mt_soc_voice_md2 {
		compatible = "mediatek,mt_soc_pcm_voice_md2";
	};
	mt_soc_pcm_dl1_scp_spk {
		compatible = "mediatek,mt_soc_pcm_dl1_scp_spk";
	};
	mt_soc_pcm_voice_scp {
		compatible = "mediatek,mt_soc_pcm_voice_scp";
	};
	mt_soc_routing_pcm {
		compatible = "mediatek,mt_soc_pcm_routing";
		/*i2s1clk-gpio = <7 6>;*/
		/*i2s1dat-gpio = <5 6>;*/
		/*i2s1mclk-gpio = <9 6>;*/
		/*i2s1ws-gpio = <6 6>;*/
	};

	mt_soc_voice_md2_bt {
		compatible = "mediatek,mt_soc_pcm_voice_md2_bt";
	};

	mt_soc_hp_impedance_pcm {
		compatible = "mediatek,mt_soc_pcm_hp_impedance";
	};

	mt_soc_codec_name {
		compatible = "mediatek,mt_soc_codec_63xx";
		use_hp_depop_flow = <0>; /* select 1: use, 0: not use */
		use_ul_260k = <0>; /* select 1: use, 0: not use */
		pcbinfo = <&pio 175 0>,
			  <&pio 111 0>;
	};

	mt_soc_dummy_pcm {
		compatible = "mediatek,mt_soc_pcm_dummy";
	};

	mt_soc_codec_dummy_name {
		compatible = "mediatek,mt_soc_codec_dummy";
	};

	mt_soc_routing_dai_name {
		compatible = "mediatek,mt_soc_dai_routing";
	};

	mt_soc_dai_name {
		compatible = "mediatek,mt_soc_dai_stub";
	};

	mt_soc_dl2_pcm {
		compatible = "mediatek,mt_soc_pcm_dl2";
	};

	mt_soc_anc_pcm {
		compatible = "mediatek,mt_soc_pcm_anc";
	};

	mt_soc_pcm_voice_ultra {
		compatible = "mediatek,mt_soc_pcm_voice_ultra";
	};

	mt_soc_pcm_voice_usb {
		compatible = "mediatek,mt_soc_pcm_voice_usb";
	};

	mt_soc_pcm_voice_usb_echoref {
		compatible = "mediatek,mt_soc_pcm_voice_usb_echoref";
	};

	odm: odm{
		compatible = "simple-bus";
		/* reserved for overlay by odm */
	};

	memory_ssmr_features: memory-ssmr-features {
		compatible = "mediatek,memory-ssmr-features";
		svp-size = <0 0x10000000>;
		iris-recognition-size = <0 0x10000000>;
		2d_fr-size = <0 0x8000000>;
		tui-size = <0 0x4000000>;
		wfd-size = <0 0x4000000>;
		prot-sharedmem-size = <0 0x8000000>;
		ta-elf-size = <0 0x1000000>;
		ta-stack-heap-size = <0 0x6000000>;
		sdsp-tee-sharedmem-size = <0 0x1000000>;
		sdsp-firmware-size = <0 0x1000000>;
	};

	radio_md_cfg: radio_md_cfg {
		compatible = "mediatek,radio_md_cfg";
	};

	dynamic_options: dynamic_options {
		compatible = "mediatek,dynamic_options";
	};

	mt_charger: mt_charger {
		compatible = "mediatek,mt-charger";
	};

	lk_charger: lk_charger {
		compatible = "mediatek,lk_charger";
		enable_anime;
		enable_pe_plus;
		enable_pd20_reset;
		power_path_support;
		max_charger_voltage = <6500000>;
		fast_charge_voltage = <3000000>;

		/* charging current */
		usb_charger_current = <500000>;
		ac_charger_current = <2050000>;
		ac_charger_input_current = <3200000>;
		non_std_ac_charger_current = <500000>;
		charging_host_charger_current = <1500000>;
		ta_ac_charger_current = <3000000>;
		pd_charger_current = <500000>;

		/* battery temperature protection */
		temp_t4_threshold = <50>;
		temp_t3_threshold = <45>;
		temp_t1_threshold = <0>;
	};

	charger: charger {
		compatible = "mediatek,charger";
		algorithm_name = "SwitchCharging";
		/* enable_sw_jeita; */
		enable_pe_plus;
		enable_pe_2;
		enable_pe_3;
		enable_pe_4;
		enable_type_c;
		power_path_support;
		enable_dynamic_mivr;

		/* common */
		battery_cv = <4350000>;
		max_charger_voltage = <6500000>;
		min_charger_voltage = <4600000>;

		/* dynamic mivr */
		min_charger_voltage_1 = <4400000>;
		min_charger_voltage_2 = <4200000>;
		max_dmivr_charger_current = <1400000>;

		/* charging current */
		usb_charger_current_suspend = <0>;
		usb_charger_current_unconfigured = <70000>;
		usb_charger_current_configured = <500000>;
		usb_charger_current = <500000>;
		ac_charger_current = <2050000>;
		ac_charger_input_current = <3200000>;
		non_std_ac_charger_current = <500000>;
		charging_host_charger_current = <1500000>;
		apple_1_0a_charger_current = <650000>;
		apple_2_1a_charger_current = <800000>;
		ta_ac_charger_current = <3000000>;

		/* sw jeita */
		jeita_temp_above_t4_cv = <4240000>;
		jeita_temp_t3_to_t4_cv = <4240000>;
		jeita_temp_t2_to_t3_cv = <4340000>;
		jeita_temp_t1_to_t2_cv = <4240000>;
		jeita_temp_t0_to_t1_cv = <4040000>;
		jeita_temp_below_t0_cv = <4040000>;
		temp_t4_thres = <50>;
		temp_t4_thres_minus_x_degree = <47>;
		temp_t3_thres = <45>;
		temp_t3_thres_minus_x_degree = <39>;
		temp_t2_thres = <10>;
		temp_t2_thres_plus_x_degree = <16>;
		temp_t1_thres = <0>;
		temp_t1_thres_plus_x_degree = <6>;
		temp_t0_thres = <0>;
		temp_t0_thres_plus_x_degree = <0>;
		temp_neg_10_thres = <0>;

		/* battery temperature protection */
		enable_min_charge_temp;
		min_charge_temp = <0>;
		min_charge_temp_plus_x_degree = <6>;
		max_charge_temp = <50>;
		max_charge_temp_minus_x_degree = <47>;

		/* PE */
		ta_12v_support;
		ta_9v_support;
		pe_ichg_level_threshold = <1000000>; /* uA */
		ta_ac_12v_input_current = <3200000>;
		ta_ac_9v_input_current = <3200000>;
		ta_ac_7v_input_current = <3200000>;

		/* PE 2.0 */
		pe20_ichg_level_threshold = <1000000>; /* uA */
		ta_start_battery_soc = <0>;
		ta_stop_battery_soc = <85>;

		/* PE 4.0 */
		high_temp_to_leave_pe40 = <46>;
		high_temp_to_enter_pe40 = <39>;
		low_temp_to_leave_pe40 = <10>;
		low_temp_to_enter_pe40 = <16>;

		/* PE 4.0 single charger*/
		pe40_single_charger_input_current = <3000000>;
		pe40_single_charger_current = <3000000>;

		/* PE 4.0 dual charger*/
		pe40_dual_charger_input_current = <3000000>;
		pe40_dual_charger_chg1_current = <2000000>;
		pe40_dual_charger_chg2_current = <2000000>;
		pe40_stop_battery_soc = <80>;

		/* PE 4.0 cable impedance (mohm) */
		pe40_r_cable_1a_lower = <500>;
		pe40_r_cable_2a_lower = <351>;
		pe40_r_cable_3a_lower = <240>;

		/* dual charger */
		chg1_ta_ac_charger_current = <1500000>;
		chg2_ta_ac_charger_current = <1500000>;
		slave_mivr_diff = <100000>;
		dual_polling_ieoc = <450000>;

		/* cable measurement impedance */
		cable_imp_threshold = <699>;
		vbat_cable_imp_threshold = <3900000>; /* uV */

		/* bif */
		bif_threshold1 = <4250000>;
		bif_threshold2 = <4300000>;
		bif_cv_under_threshold2 = <4450000>;

		/* PD */
		pd_vbus_low_bound = <5000000>;
		pd_vbus_upper_bound = <5000000>;
		pd_ichg_level_threshold = <1000000>; /* uA */
		pd_stop_battery_soc = <80>;

		ibus_err = <14>;
		vsys_watt = <5000000>;
	};

	pd_adapter: pd_adapter {
		compatible = "mediatek,pd_adapter";
		adapter_name = "pd_adapter";
	};

	rt9465_slave_chr: rt9465_slave_chr {
		compatible = "richtek,rt9465";
	};

	rt-pd-manager {
		compatible = "mediatek,rt-pd-manager";
	};

	subpmic_pmu_eint: mt6370_pmu_eint {
	};

	goodix_fp: fingerprint {
		compatible = "mediatek,goodix-fp";
	};

	tcpc_pd: mt6370_pd_eint {
	};

	scp_dvfs {
		compatible = "mediatek,scp_dvfs";
		clocks =
			<&topckgen TOP_MUX_SCP>,
			<&clk26m>,
			<&topckgen TOP_UNIVPLL_D2_D8>,
			<&topckgen TOP_SYSPLL_D5>,
			<&topckgen TOP_SYSPLL_D2_D2>,
			<&topckgen TOP_UNIVPLL_D2_D2>,
			<&topckgen TOP_SYSPLL_D3>,
			<&topckgen TOP_UNIVPLL_D3>;

		clock-names =
			"clk_mux",
			"clk_pll_0",
			"clk_pll_1",
			"clk_pll_2",
			"clk_pll_3",
			"clk_pll_4",
			"clk_pll_5",
			"clk_pll_6";
	};

	rt5081_pmu_eint: rt5081_pmu_eint {
	};

	rt5081_pd: rt5081_pd_eint {
	};

	pmic_clock_buffer_ctrl: pmic_clock_buffer_ctrl {
		compatible = "mediatek,pmic_clock_buffer";
		mediatek,clkbuf-quantity = <7>;
		mediatek,clkbuf-config = <2 1 1 2 0 0 1>;
		mediatek,clkbuf-driving-current = <(1) (1) (1) (1) (1) (1) (1)>;
	};

	msdc1_ins: msdc1_ins {
	};

	gyro: gyro {
	};

	mse: mse {
	};

	als: als {
	};

	otg_iddig: otg_iddig {
		compatible = "mediatek,usb_iddig_bi_eint";
	};
	/* NFC start */
	nfc:nfc {
		compatible = "mediatek,nfc-gpio-v2";
		gpio-rst = <19>;
		gpio-rst-std = <&pio 19 0x0>;
		gpio-irq = <20>;
		gpio-irq-std = <&pio 20 0x0>;
	};

	irq_nfc: irq_nfc {
		compatible = "mediatek,irq_nfc-eint";
	};
	/* NFC end */

	smart_pa: smart_pa {
	};

	md1_sim1_hot_plug_eint: md1_sim1_hot_plug_eint {
	};

	md1_sim2_hot_plug_eint: md1_sim2_hot_plug_eint {
	};

	usb_c_pinctrl: usb_c_pinctrl {
	};

	ssusb_ip_sleep: ssusb_ip_sleep {
		compatible = "mediatek,usb_ipsleep";
		interrupt-parent = <&pio>;
		interrupts = <179 IRQ_TYPE_LEVEL_LOW 187 0>;
		status = "okay";
	};

};

#include "mediatek/mt6358.dtsi"
#include "mediatek/cust_mt6771_msdc.dtsi"
#include "mediatek/mt6370.dtsi"
#include "mediatek/mt6370_pd.dtsi"
#ifdef CONFIG_CHARGER_RT9471
#include "mediatek/rt9471.dtsi"
#endif
#ifdef CONFIG_MTK_ENABLE_GENIEZONE
#include "mediatek/trusty.dtsi"
#endif
