&hq_chg_manager {
    hq,thermal-enable;
    hq,pd-thermal-mitigation = <6000 5400 5000 4500 4000
                                3500 3000 2700 2500 2300
                                2100 1800 1500 900 500
                                300>;
    hq,qc2-thermal-mitigation = <3600 2700 2500 2300 2100
                                1900 1700 1500 1000 1000
                                1000 1000 1000 900 500
                                300>;
};