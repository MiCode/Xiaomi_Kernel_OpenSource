// SPDX-License-Identifier: (GPL-2.0 OR MIT)
/*
 * Copyright (C) 2020 MediaTek Inc.
 * Author: Chun-Hung Wu <chun-hung.wu@mediatek.com>
 */
/dts-v1/;
/plugin/;

&gpio_usage_mapping {
	GPIO_SIM1_HOT_PLUG = <&pio 43 0>;
	GPIO_SIM2_SCLK = <&pio 45 0>;
	GPIO_SIM2_SRST = <&pio 46 0>;
	GPIO_SIM2_SIO = <&pio 47 0>;
	GPIO_SIM1_SIO = <&pio 48 0>;
	GPIO_SIM1_SRST = <&pio 49 0>;
	GPIO_SIM1_SCLK = <&pio 50 0>;
	GPIO_FDD_BAND_SUPPORT_DETECT_1ST_PIN = <&pio 63 0>;
	GPIO_FDD_BAND_SUPPORT_DETECT_2ND_PIN = <&pio 64 0>;
	GPIO_FDD_BAND_SUPPORT_DETECT_3RD_PIN = <&pio 65 0>;
	GPIO_FDD_BAND_SUPPORT_DETECT_4TH_PIN = <&pio 66 0>;
};

&gpio{
	gpio_init_default = <0 0 0 0 1 1 1>,
		<1 0 0 0 1 0 1>,
		<2 0 0 0 1 0 1>,
		<3 0 0 0 1 0 1>,
		<4 0 0 0 1 1 1>,
		<5 0 1 0 1 0 1>,
		<6 0 1 0 1 0 1>,
		<7 0 1 0 1 0 1>,
		<8 0 1 0 1 0 1>,
		<9 0 1 0 1 0 1>,
		<10 0 1 0 1 0 0>,
		<11 0 0 0 1 0 0>,
		<12 0 0 0 1 1 0>,
		<13 0 0 0 1 0 0>,
		<14 0 1 0 1 0 0>,
		<15 0 0 0 1 0 0>,
		<16 6 0 0 1 0 1>,
		<17 6 0 0 0 0 1>,
		<18 1 0 0 1 0 1>,
		<19 0 0 0 1 0 1>,
		<20 0 1 0 1 0 1>,
		<21 0 0 0 1 1 1>,
		<22 0 0 0 1 0 1>,
		<23 0 0 0 1 1 1>,
		<24 0 0 0 1 1 1>,
		<25 0 0 0 1 1 1>,
		<26 0 1 0 1 0 1>,
		<27 0 1 1 1 0 1>,
		<28 0 1 0 1 0 1>,
		<29 0 1 0 1 0 1>,
		<30 0 1 0 1 0 1>,
		<31 0 0 0 1 1 1>,
		<32 1 0 0 0 0 1>,
		<33 1 0 0 0 0 1>,
		<34 1 0 0 1 0 1>,
		<35 1 0 0 0 0 1>,
		<36 4 0 0 1 1 0>,
		<37 4 0 0 0 0 0>,
		<38 4 0 0 1 1 0>,
		<39 4 0 0 0 0 0>,
		<40 1 0 0 0 0 1>,
		<41 1 0 0 1 0 1>,
		<42 1 0 0 0 0 0>,
		<43 1 0 0 1 1 1>,
		<44 0 0 0 1 0 1>,
		<45 1 0 0 0 0 1>,
		<46 1 0 0 0 0 1>,
		<47 1 0 0 1 1 1>,
		<48 1 0 0 1 1 1>,
		<49 1 0 0 0 0 1>,
		<50 1 0 0 0 0 1>,
		<51 1 0 0 0 0 1>,
		<52 1 0 0 1 1 1>,
		<53 1 0 0 1 1 1>,
		<54 1 0 0 1 1 1>,
		<55 1 0 0 1 1 1>,
		<56 1 0 0 1 1 1>,
		<57 1 0 0 0 0 0>,
		<58 1 0 0 1 0 0>,
		<59 1 0 0 1 0 1>,
		<60 1 0 0 1 0 1>,
		<61 1 0 0 1 0 1>,
		<62 1 0 0 1 0 1>,
		<63 0 0 0 1 0 0>,
		<64 0 0 0 1 0 0>,
		<65 0 0 0 1 0 0>,
		<66 0 0 0 1 0 0>,
		<67 1 0 0 0 0 0>,
		<68 1 0 0 0 0 0>,
		<69 1 0 0 0 0 0>,
		<70 1 0 0 0 0 0>,
		<71 1 0 0 0 0 0>,
		<72 1 0 0 0 0 0>,
		<73 1 0 0 0 0 0>,
		<74 1 0 0 0 0 0>,
		<75 1 0 0 0 0 0>,
		<76 1 0 0 0 0 0>,
		<77 1 0 0 0 0 0>,
		<78 1 0 0 0 0 0>,
		<79 1 0 0 0 0 0>,
		<80 1 0 0 0 0 0>,
		<81 1 0 0 0 0 0>,
		<82 1 0 0 0 0 0>,
		<83 1 0 0 0 0 0>,
		<84 1 0 0 0 0 0>,
		<85 1 0 0 0 0 0>,
		<86 1 0 0 1 0 0>,
		<87 1 0 0 0 0 0>,
		<88 1 0 0 1 0 0>,
		<89 1 0 0 0 0 1>,
		<90 1 0 0 0 0 1>,
		<92 1 0 0 1 1 0>,
		<93 1 0 0 0 0 0>,
		<94 1 0 0 1 1 0>,
		<95 1 0 0 0 0 0>,
		<96 7 0 0 1 0 0>,
		<97 7 0 0 1 0 0>,
		<98 7 0 0 1 0 0>,
		<99 7 0 0 0 0 0>,
		<100 7 0 0 1 0 0>,
		<101 7 0 0 1 0 0>,
		<102 7 0 0 1 0 0>,
		<103 7 0 0 0 0 0>,
		<104 7 0 0 1 0 0>,
		<105 7 0 0 1 0 0>,
		<106 7 0 0 1 0 0>,
		<107 7 0 0 1 0 0>,
		<108 7 0 0 1 0 0>,
		<109 7 0 0 1 0 0>,
		<110 0 1 0 1 0 0>,
		<111 0 1 0 1 0 0>,
		<112 0 1 0 1 0 0>,
		<113 0 1 0 1 0 0>,
		<114 2 0 0 1 0 0>,
		<115 2 0 0 0 0 0>,
		<116 2 0 0 0 0 0>,
		<117 2 0 0 0 0 0>,
		<118 2 0 0 1 1 1>,
		<119 2 0 0 1 1 1>,
		<120 1 0 0 1 1 1>,
		<121 1 0 0 1 1 1>,
		<122 1 0 0 1 1 1>,
		<123 1 0 0 1 1 1>,
		<124 1 0 0 1 1 1>,
		<125 1 0 0 1 1 1>,
		<126 4 0 0 1 0 0>,
		<127 4 0 0 1 0 0>,
		<128 0 1 0 1 0 0>,
		<129 0 1 0 1 0 0>,
		<130 1 0 0 1 0 0>,
		<131 1 0 0 0 0 0>,
		<132 1 0 0 1 0 0>,
		<133 0 1 0 1 0 0>,
		<134 0 1 0 1 0 0>,
		<135 0 1 0 1 0 0>,
		<136 1 0 0 0 0 0>,
		<137 0 1 0 1 0 0>,
		<138 0 1 0 1 0 0>,
		<139 1 0 0 1 1 1>,
		<140 1 0 0 1 1 1>,
		<141 1 0 0 1 1 1>,
		<142 1 0 0 1 1 1>,
		<143 0 1 0 1 0 0>,
		<144 0 1 0 1 0 0>,
		<145 0 1 0 1 0 0>,
		<146 0 1 0 1 0 0>,
		<147 0 1 0 1 0 0>,
		<148 0 1 0 1 0 0>,
		<149 1 0 0 0 0 0>,
		<150 1 0 0 0 0 0>,
		<151 1 0 0 0 0 0>,
		<152 0 0 0 1 0 0>,
		<153 1 0 0 1 0 0>,
		<154 1 0 0 1 1 0>,
		<155 0 0 0 0 0 0>,
		<156 1 0 0 0 0 0>,
		<157 1 0 0 0 0 0>,
		<158 1 0 0 1 0 0>,
		<159 1 0 0 0 0 0>,
		<160 1 0 0 1 1 1>,
		<161 1 0 0 1 1 1>,
		<162 0 0 0 1 0 0>,
		<163 0 0 0 1 0 0>,
		<164 0 0 0 1 0 0>,
		<165 1 0 0 1 0 0>,
		<166 1 0 0 1 0 0>,
		<167 0 0 0 1 0 0>,
		<168 6 0 0 1 0 0>,
		<169 6 0 0 1 0 0>,
		<170 0 1 0 1 0 0>,
		<171 0 1 0 1 0 0>,
		<172 0 0 0 1 0 0>,
		<173 0 0 0 1 0 0>,
		<174 0 0 0 1 0 0>,
		<175 0 0 0 1 0 0>,
		<176 0 0 0 1 0 0>,
		<177 0 0 0 1 0 0>,
		<178 0 0 0 1 0 0>,
		<179 0 0 0 1 0 0>,
		<180 0 0 0 1 0 0>,
		<181 0 0 0 1 0 0>,
		<182 0 0 0 1 0 0>,
		<195 1 0 0 0 0 1>,
		<196 1 0 0 0 0 1>,
		<197 1 0 0 0 0 1>,
		<198 1 0 0 0 0 1>,
		<199 1 0 0 1 0 1>,
		<200 1 0 0 1 1 1>,
		<201 1 0 0 1 1 1>,
		<202 1 0 0 1 1 1>,
		<203 1 0 0 1 1 1>,
		<204 6 0 0 1 0 1>,
		<205 6 0 0 1 0 1>,
		<206 1 0 0 0 0 1>,
		<207 1 0 0 0 0 1>,
		<208 1 0 0 0 0 0>,
		<209 1 0 0 1 0 0>,
		<210 1 0 0 0 0 0>,
		<211 1 0 0 1 0 0>,
		<212 1 0 0 0 0 0>,
		<213 1 0 0 1 0 1>,
		<214 1 0 0 0 0 1>,
		<215 1 0 0 0 0 1>,
		<216 1 0 0 0 0 1>,
		<217 1 0 0 0 0 1>,
		<218 1 0 0 1 0 1>,
		<219 1 0 0 1 0 1>,
		<220 0 0 0 1 0 0>,
		<221 0 0 0 1 0 0>,
		<222 0 0 0 1 0 0>,
		<223 0 0 0 1 0 0>,
		<224 0 0 0 1 0 0>,
		<225 0 0 0 1 0 0>,
		<226 0 0 0 1 0 0>,
		<227 0 0 0 1 0 0>;
};
/*End of this file, DO NOT ADD ANYTHING HERE*/
