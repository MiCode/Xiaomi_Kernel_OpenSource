&i2c6 {
/* AWINIC AW87XXX Smart K PA */
	aw87xxx_pa_36@36 {
		compatible = "awinic,aw87xxx_pa";
		reg = <0x36>;
		//reset-gpio = <&pio 63 0>;
		pa-channel = < 0 >;
		status = "okay";
	};
/*
	aw87xxx_pa_5b@5b {
		compatible = "awinic,aw87xxx_pa";
		reg = <0x5b>;
		reset-gpio = <&pio 1 0>;
		pa-channel = < 1 >;
		status = "okay";
	};

*/
/* AWINIC AW87XXX Smart K PA End */
};
