// SPDX-License-Identifier: (GPL-2.0 OR MIT)
/*
 * Copyright (C) 2021 MediaTek Inc.
 * Author: Ren-Ting Wang <ren-ting.wang@mediatek.com>
 */

&clkitg {
	status = "okay";
	bring-up {
		compatible = "mediatek,clk-bring-up";
		clocks =
			<&clk26m>;
	};
};
