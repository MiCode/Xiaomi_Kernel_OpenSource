/*
 * Copyright (C) 2010 - 2022 Novatek, Inc.
 *
 * $Revision$
 * $Date$
 *
 * This program is free software; you can redistribute it and/or modify
 * it under the terms of the GNU General Public License as published by
 * the Free Software Foundation; either version 2 of the License, or
 * (at your option) any later version.
 *
 * This program is distributed in the hope that it will be useful, but WITHOUT
 * ANY WARRANTY; without even the implied warranty of MERCHANTABILITY or
 * FITNESS FOR A PARTICULAR PURPOSE.  See the GNU General Public License for
 * more details.
 *
 */


&spi0 {
	status = "ok";
/*
	focaltech@1 {
		compatible = "focaltech,fts";
		reg = <1>;
		status = "ok";
		spi-max-frequency = <6000000>;
		interrupt-parent = <&pio>;
		interrupts = <1 0x2>;
		focaltech,reset-gpio =  <&pio 92 0x00>;
		focaltech,irq-gpio = <&pio 1 0x2001>;
		focaltech,max-touch-number = <10>;
		focaltech,display-coords =  <0 0 720 1650>;
	};
*/
	/* Novatek device tree node */
	novatek@0 {
		compatible = "novatek,NVT-ts-spi","focaltech,fts","chipone-tddi";
		reg = <0>; //Same as CS ID
		status = "ok";

		spi-max-frequency = <9600000>;	//4800000,9600000,15000000,19200000
		novatek,reset-gpio = <&pio 92 0x00>;
		novatek,irq-gpio = <&pio 1 0x2001>;

		focaltech,reset-gpio = <&pio 92 0x00>;
                focaltech,irq-gpio = <&pio 1 0x2001>;
                focaltech,max-touch-number = <10>;
		/*C3T code for HQ-234222 by chenzimo at 2022/10/20 start*/
                focaltech,display-coords =  <0 0 719 1649>;
		/*C3T code for HQ-234222 by chenzimo at 2022/10/20 end*/
                
                chipone,rst-gpio = <&pio 92 0x00>;
                chipone,irq-gpio = <&pio 1 0x2001>;
                //chipone,cs-gpio = <&pio 8 0>;
		/*C3T code for HQ-253995 by zhangkexin at 2022/10/08 start*/
                chipone,x-res = <719>;
                chipone,y-res = <1649>;
		/*C3T code for HQ-253995 by zhangkexin at 2022/10/08 end*/
                /* Charger detect */
                chipone,touch-charger-detect-enable;
                chipone,touch-charger-detect-type = "notify"; /* notify, poll */
                chipone,touch-charger-detect-psy-name = "charger";
        	chipone,touch-charger-detect-psp = "POWER_SUPPLY_PROP_ONLINE";
        	chipone,touch-charger-detect-psp-poll-interval = <1000>;

        	/* Earjack detect */
        	chipone,touch-earjack-detect-enable;
        	/* MTK:  /sys/bus/platform/drivers/Accdet_Driver/state,
         	  Sprd: /sys/kernel/headset/state
          	 QCOM: None, and disable it */
        	chipone,touch-earjack-state-filepath = "/sys/bus/platform/drivers/Accdet_Driver/state";
        	chipone,touch-earjack-poll-interval = <1000>;

        	/* For tp selftest */
		chipone,test-reset-pin;
		//chipone,test-int-pin;
		chipone,test-rawdata;
		chipone,test-rawdata-frames      = <1>;
		chipone,rawdata-min              = <1200>;	//base2000, ±40%
		chipone,rawdata-max              = <2800>;
		chipone,test-noise;
		chipone,test-noise-frames        = <50>;
		chipone,noise-max                = <80>;
		chipone,test-open;
		chipone,open-min                 = <1980>;
		chipone,test-short;
		chipone,short-min                = <500>;
		chipone,test-compensate-cap;
		chipone,compensate-cap-min       = <1>;
		chipone,compensate-cap-max       = <126>;       

		//novatek,pen-support;
		//novatek,stylus-resol-double;

		/* 525 */
		//novatek,swrst-n8-addr = <0x01F01A>;

		/* 672A, 525B, 675, 526, 672C, 523 */
		novatek,swrst-n8-addr = <0x03F0FE>;
		novatek,spi-rd-fast-addr = <0x03F310>;

		/* MP */
		novatek,mp-support-dt;

		/* for Xiaomi C3T NT36525B TRULY6.708" */
		novatek-mp-criteria-5970@0 {
			#address-cells = <1>;
			#size-cells = <0>;
			compatible = "novatek-mp-criteria-5970";

			/* MP Config */
			IC_X_CFG_SIZE = <18>;
			IC_Y_CFG_SIZE = <32>;
			IC_KEY_CFG_SIZE = <4>;
			X_Channel = <18>;
			Y_Channel = <32>;
			AIN_X = <0 1 2 3 4 5 6 7 8 9 10 11 12 13 14 15 16 17>;
			AIN_Y = <0 1 2 3 4 5 6 7 8 9 10 11 12 13 14 15 16 17 18 19 20 21 22 23 24 25 26 27 28 29 30 31>;
			AIN_KEY = <0 1 2 0xFF>;
			/*C3T code for HQ-223848 by chenzimo at 2022/9/16 start*/
			/* MP Criteria */
			PS_Config_Lmt_Short_Rawdata_P = <
				14008 14008 14008 14008 14008 14008 14008 14008 14008 14008 14008 14008 14008 14008 14008 14008 14008 14008
				14008 14008 14008 14008 14008 14008 14008 14008 14008 14008 14008 14008 14008 14008 14008 14008 14008 14008
				14008 14008 14008 14008 14008 14008 14008 14008 14008 14008 14008 14008 14008 14008 14008 14008 14008 14008
				14008 14008 14008 14008 14008 14008 14008 14008 14008 14008 14008 14008 14008 14008 14008 14008 14008 14008
				14008 14008 14008 14008 14008 14008 14008 14008 14008 14008 14008 14008 14008 14008 14008 14008 14008 14008
				14008 14008 14008 14008 14008 14008 14008 14008 14008 14008 14008 14008 14008 14008 14008 14008 14008 14008
				14008 14008 14008 14008 14008 14008 14008 14008 14008 14008 14008 14008 14008 14008 14008 14008 14008 14008
				14008 14008 14008 14008 14008 14008 14008 14008 14008 14008 14008 14008 14008 14008 14008 14008 14008 14008
				14008 14008 14008 14008 14008 14008 14008 14008 14008 14008 14008 14008 14008 14008 14008 14008 14008 14008
				14008 14008 14008 14008 14008 14008 14008 14008 14008 14008 14008 14008 14008 14008 14008 14008 14008 14008
				14008 14008 14008 14008 14008 14008 14008 14008 14008 14008 14008 14008 14008 14008 14008 14008 14008 14008
				14008 14008 14008 14008 14008 14008 14008 14008 14008 14008 14008 14008 14008 14008 14008 14008 14008 14008
				14008 14008 14008 14008 14008 14008 14008 14008 14008 14008 14008 14008 14008 14008 14008 14008 14008 14008
				14008 14008 14008 14008 14008 14008 14008 14008 14008 14008 14008 14008 14008 14008 14008 14008 14008 14008
				14008 14008 14008 14008 14008 14008 14008 14008 14008 14008 14008 14008 14008 14008 14008 14008 14008 14008
				14008 14008 14008 14008 14008 14008 14008 14008 14008 14008 14008 14008 14008 14008 14008 14008 14008 14008
				14008 14008 14008 14008 14008 14008 14008 14008 14008 14008 14008 14008 14008 14008 14008 14008 14008 14008
				14008 14008 14008 14008 14008 14008 14008 14008 14008 14008 14008 14008 14008 14008 14008 14008 14008 14008
				14008 14008 14008 14008 14008 14008 14008 14008 14008 14008 14008 14008 14008 14008 14008 14008 14008 14008
				14008 14008 14008 14008 14008 14008 14008 14008 14008 14008 14008 14008 14008 14008 14008 14008 14008 14008
				14008 14008 14008 14008 14008 14008 14008 14008 14008 14008 14008 14008 14008 14008 14008 14008 14008 14008
				14008 14008 14008 14008 14008 14008 14008 14008 14008 14008 14008 14008 14008 14008 14008 14008 14008 14008
				14008 14008 14008 14008 14008 14008 14008 14008 14008 14008 14008 14008 14008 14008 14008 14008 14008 14008
				14008 14008 14008 14008 14008 14008 14008 14008 14008 14008 14008 14008 14008 14008 14008 14008 14008 14008
				14008 14008 14008 14008 14008 14008 14008 14008 14008 14008 14008 14008 14008 14008 14008 14008 14008 14008
				14008 14008 14008 14008 14008 14008 14008 14008 14008 14008 14008 14008 14008 14008 14008 14008 14008 14008
				14008 14008 14008 14008 14008 14008 14008 14008 14008 14008 14008 14008 14008 14008 14008 14008 14008 14008
				14008 14008 14008 14008 14008 14008 14008 14008 14008 14008 14008 14008 14008 14008 14008 14008 14008 14008
				14008 14008 14008 14008 14008 14008 14008 14008 14008 14008 14008 14008 14008 14008 14008 14008 14008 14008
				14008 14008 14008 14008 14008 14008 14008 14008 14008 14008 14008 14008 14008 14008 14008 14008 14008 14008
				14008 14008 14008 14008 14008 14008 14008 14008 14008 14008 14008 14008 14008 14008 14008 14008 14008 14008
				14008 14008 14008 14008 14008 14008 14008 14008 14008 14008 14008 14008 14008 14008 14008 14008 14008 14008
				14008 14008 14008>;

			PS_Config_Lmt_Short_Rawdata_N = <
				11376	11376	11376	11376	11376	11376	11376	11376	11376	11376	11376	11376	11376	11376	11376	11376	11376	11376
				11376	11376	11376	11376	11376	11376	11376	11376	11376	11376	11376	11376	11376	11376	11376	11376	11376	11376
				11376	11376	11376	11376	11376	11376	11376	11376	11376	11376	11376	11376	11376	11376	11376	11376	11376	11376
				11376	11376	11376	11376	11376	11376	11376	11376	11376	11376	11376	11376	11376	11376	11376	11376	11376	11376
				11376	11376	11376	11376	11376	11376	11376	11376	11376	11376	11376	11376	11376	11376	11376	11376	11376	11376
				11376	11376	11376	11376	11376	11376	11376	11376	11376	11376	11376	11376	11376	11376	11376	11376	11376	11376
				11376	11376	11376	11376	11376	11376	11376	11376	11376	11376	11376	11376	11376	11376	11376	11376	11376	11376
				11376	11376	11376	11376	11376	11376	11376	11376	11376	11376	11376	11376	11376	11376	11376	11376	11376	11376
				11376	11376	11376	11376	11376	11376	11376	11376	11376	11376	11376	11376	11376	11376	11376	11376	11376	11376
				11376	11376	11376	11376	11376	11376	11376	11376	11376	11376	11376	11376	11376	11376	11376	11376	11376	11376
				11376	11376	11376	11376	11376	11376	11376	11376	11376	11376	11376	11376	11376	11376	11376	11376	11376	11376
				11376	11376	11376	11376	11376	11376	11376	11376	11376	11376	11376	11376	11376	11376	11376	11376	11376	11376
				11376	11376	11376	11376	11376	11376	11376	11376	11376	11376	11376	11376	11376	11376	11376	11376	11376	11376
				11376	11376	11376	11376	11376	11376	11376	11376	11376	11376	11376	11376	11376	11376	11376	11376	11376	11376
				11376	11376	11376	11376	11376	11376	11376	11376	11376	11376	11376	11376	11376	11376	11376	11376	11376	11376
				11376	11376	11376	11376	11376	11376	11376	11376	11376	11376	11376	11376	11376	11376	11376	11376	11376	11376
				11376	11376	11376	11376	11376	11376	11376	11376	11376	11376	11376	11376	11376	11376	11376	11376	11376	11376
				11376	11376	11376	11376	11376	11376	11376	11376	11376	11376	11376	11376	11376	11376	11376	11376	11376	11376
				11376	11376	11376	11376	11376	11376	11376	11376	11376	11376	11376	11376	11376	11376	11376	11376	11376	11376
				11376	11376	11376	11376	11376	11376	11376	11376	11376	11376	11376	11376	11376	11376	11376	11376	11376	11376
				11376	11376	11376	11376	11376	11376	11376	11376	11376	11376	11376	11376	11376	11376	11376	11376	11376	11376
				11376	11376	11376	11376	11376	11376	11376	11376	11376	11376	11376	11376	11376	11376	11376	11376	11376	11376
				11376	11376	11376	11376	11376	11376	11376	11376	11376	11376	11376	11376	11376	11376	11376	11376	11376	11376
				11376	11376	11376	11376	11376	11376	11376	11376	11376	11376	11376	11376	11376	11376	11376	11376	11376	11376
				11376	11376	11376	11376	11376	11376	11376	11376	11376	11376	11376	11376	11376	11376	11376	11376	11376	11376
				11376	11376	11376	11376	11376	11376	11376	11376	11376	11376	11376	11376	11376	11376	11376	11376	11376	11376
				11376	11376	11376	11376	11376	11376	11376	11376	11376	11376	11376	11376	11376	11376	11376	11376	11376	11376
				11376	11376	11376	11376	11376	11376	11376	11376	11376	11376	11376	11376	11376	11376	11376	11376	11376	11376
				11376	11376	11376	11376	11376	11376	11376	11376	11376	11376	11376	11376	11376	11376	11376	11376	11376	11376
				11376	11376	11376	11376	11376	11376	11376	11376	11376	11376	11376	11376	11376	11376	11376	11376	11376	11376
				11376	11376	11376	11376	11376	11376	11376	11376	11376	11376	11376	11376	11376	11376	11376	11376	11376	11376
				11376	11376	11376	11376	11376	11376	11376	11376	11376	11376	11376	11376	11376	11376	11376	11376	11376	11376
				10000 10000 10000>;

			PS_Config_Lmt_Open_Rawdata_P = <
				3379	3375	3386	3425	3465	3442	3427	3452	65535	65535	3351	3320	3344	3368	3374	3385	3381	3323
				3179	3157	3185	3228	3269	3269	3263	3252	3228	3208	3246	3252	3264	3264	3266	3267	3241	3197
				3152	3127	3148	3193	3234	3234	3222	3214	3182	3126	3164	3178	3187	3189	3192	3197	3176	3151
				3210	3179	3207	3255	3302	3306	3297	3285	3252	3229	3276	3290	3301	3302	3302	3305	3283	3257
				3253	3225	3250	3298	3346	3347	3336	3325	3290	3201	3245	3259	3271	3274	3274	3278	3262	3238
				3217	3185	3210	3256	3306	3318	3308	3297	3262	3283	3329	3343	3357	3361	3360	3361	3350	3326
				3221	3200	3208	3218	3224	3221	3228	3217	3183	3253	3271	3287	3281	3273	3224	3164	3126	3092
				3326	3306	3319	3332	3334	3337	3340	3333	3298	3369	3390	3399	3399	3395	3344	3277	3235	3199
				3323	3302	3318	3334	3337	3341	3339	3336	3299	3369	3392	3400	3407	3400	3351	3287	3248	3208
				3351	3330	3351	3365	3371	3374	3374	3364	3330	3418	3441	3455	3459	3455	3403	3336	3298	3257
				3395	3369	3389	3402	3403	3406	3404	3393	3361	3416	3442	3452	3455	3452	3411	3350	3312	3274
				3325	3298	3313	3326	3326	3327	3319	3311	3280	3351	3376	3389	3400	3400	3368	3313	3281	3246
				3396	3371	3407	3418	3423	3420	3411	3402	3379	3439	3453	3463	3479	3477	3439	3383	3334	3301
				3438	3413	3448	3465	3463	3466	3453	3442	3427	3472	3484	3495	3512	3512	3484	3430	3382	3346
				3460	3434	3466	3479	3477	3479	3463	3455	3438	3451	3463	3473	3490	3495	3466	3421	3372	3339
				3403	3372	3396	3406	3402	3403	3389	3379	3361	3392	3404	3416	3428	3432	3414	3383	3344	3313
				3494	3467	3495	3498	3500	3501	3494	3484	3466	3491	3507	3521	3529	3530	3512	3481	3435	3396
				3521	3494	3518	3523	3522	3525	3516	3509	3490	3509	3525	3540	3549	3550	3535	3512	3472	3437
				3554	3522	3544	3547	3549	3550	3542	3529	3509	3502	3519	3532	3544	3547	3540	3512	3480	3452
				3469	3424	3441	3446	3444	3439	3432	3420	3403	3437	3455	3467	3479	3486	3483	3460	3431	3410
				3568	3523	3543	3553	3549	3549	3542	3530	3508	3530	3551	3563	3574	3578	3577	3549	3518	3495
				3605	3554	3574	3584	3579	3577	3570	3558	3537	3549	3570	3585	3595	3600	3603	3581	3550	3529
				3627	3578	3588	3605	3603	3600	3592	3581	3560	3518	3539	3551	3563	3567	3575	3564	3543	3529
				3514	3459	3459	3470	3467	3467	3459	3446	3425	3458	3477	3490	3501	3509	3519	3519	3501	3491
				3648	3595	3600	3614	3613	3612	3602	3589	3571	3533	3553	3565	3578	3586	3599	3598	3578	3571
				3627	3564	3567	3575	3574	3571	3563	3551	3533	3593	3613	3627	3637	3645	3656	3661	3644	3638
				3698	3637	3638	3647	3644	3640	3635	3626	3610	3567	3586	3603	3610	3616	3626	3630	3621	3619
				3550	3483	3479	3477	3473	3469	3465	3453	3438	3483	3501	3515	3523	3532	3543	3556	3551	3551
				3707	3638	3631	3630	3624	3621	3616	3605	3588	3543	3560	3575	3585	3593	3607	3623	3620	3624
				3178	3595	3588	3585	3582	3577	3571	3560	3546	3598	3616	3630	3641	3651	3665	3680	3677	3180
				3214	3642	3627	3619	3612	3606	3600	3591	3577	3557	3572	3584	3595	3605	3616	3633	3640	3148
				3442	3432	3455	3437	3425	3423	3421	3421	3417	3453	3460	3463	3467	3479	3495	3519	3494	3439
				5120 5120 5120>;

			PS_Config_Lmt_Open_Rawdata_N = <
				1448	1446	1451	1468	1485	1475	1468	1479	(-65535)	(-65535)	1436	1423	1433	1443	1446	1450	1449	1424
				1362	1353	1365	1383	1401	1401	1398	1393	1383	1375	1391	1393	1399	1399	1399	1400	1389	1370        
				1351	1340	1349	1368	1386	1386	1381	1377	1363	1339	1356	1362	1366	1366	1368	1370	1361	1350        
				1375	1362	1374	1395	1415	1417	1413	1408	1393	1384	1404	1410	1414	1415	1415	1416	1407	1396        
				1394	1382	1393	1413	1434	1434	1429	1425	1410	1372	1390	1396	1402	1403	1403	1405	1398	1387        
				1378	1365	1375	1395	1417	1422	1417	1413	1398	1407	1426	1432	1438	1440	1440	1440	1435	1425        
				1380	1371	1375	1379	1381	1380	1383	1378	1364	1394	1402	1408	1406	1402	1381	1356	1339	1325        
				1425	1417	1422	1428	1429	1430	1431	1428	1413	1444	1453	1456	1456	1455	1433	1404	1386	1371        
				1424	1415	1422	1429	1430	1432	1431	1429	1414	1444	1453	1457	1460	1457	1436	1408	1392	1375        
				1436	1427	1436	1442	1444	1446	1446	1441	1427	1465	1474	1480	1482	1480	1458	1429	1413	1396        
				1455	1444	1452	1458	1458	1459	1459	1454	1440	1464	1475	1479	1480	1479	1462	1435	1419	1403        
				1425	1413	1420	1425	1425	1426	1422	1419	1405	1436	1447	1452	1457	1457	1443	1420	1406	1391        
				1455	1444	1460	1465	1467	1465	1462	1458	1448	1474	1480	1484	1491	1490	1474	1450	1429	1414        
				1473	1462	1477	1485	1484	1485	1480	1475	1468	1488	1493	1498	1505	1505	1493	1470	1449	1434        
				1483	1471	1485	1491	1490	1491	1484	1480	1473	1479	1484	1488	1495	1498	1485	1466	1445	1431        
				1458	1445	1455	1459	1458	1458	1452	1448	1440	1453	1459	1464	1469	1471	1463	1450	1433	1420        
				1497	1486	1498	1499	1500	1500	1497	1493	1485	1496	1503	1509	1512	1513	1505	1492	1472	1455        
				1509	1497	1507	1510	1509	1510	1507	1504	1495	1504	1510	1517	1521	1521	1515	1505	1488	1473        
				1523	1509	1519	1520	1521	1521	1518	1512	1504	1501	1508	1513	1519	1520	1517	1505	1491	1479        
				1486	1467	1474	1477	1476	1474	1471	1465	1458	1473	1480	1486	1491	1494	1492	1483	1470	1461        
				1529	1510	1518	1522	1521	1521	1518	1513	1503	1513	1522	1527	1531	1533	1533	1521	1507	1498        
				1545	1523	1531	1536	1534	1533	1530	1525	1516	1521	1530	1536	1540	1543	1544	1534	1521	1512        
				1554	1533	1537	1545	1544	1543	1539	1534	1525	1507	1516	1522	1527	1528	1532	1527	1518	1512        
				1506	1482	1482	1487	1486	1486	1482	1477	1468	1482	1490	1495	1500	1504	1508	1508	1500	1496        
				1563	1540	1543	1549	1548	1548	1543	1538	1530	1514	1522	1528	1533	1537	1542	1542	1533	1530        
				1554	1527	1528	1532	1531	1530	1527	1522	1514	1540	1548	1554	1558	1562	1567	1569	1561	1559        
				1585	1558	1559	1563	1561	1560	1558	1554	1547	1528	1537	1544	1547	1549	1554	1555	1552	1551        
				1521	1492	1491	1490	1488	1486	1485	1480	1473	1492	1500	1506	1510	1513	1518	1524	1522	1522        
				1588	1559	1556	1555	1553	1552	1549	1545	1537	1518	1525	1532	1536	1540	1546	1552	1551	1553        
				1362	1540	1537	1536	1535	1533	1530	1525	1519	1542	1549	1555	1560	1564	1570	1577	1576	1363        
				1377	1561	1554	1551	1548	1545	1543	1539	1533	1524	1531	1536	1540	1545	1549	1557	1560	1349        
				1475	1471	1480	1473	1468	1467	1466	1466	1464	1480	1483	1484	1486	1491	1498	1508	1497	1474        
				(-511) (-511) (-511)>;

			PS_Config_Lmt_FW_Rawdata_P = <
				2207	2261	2206	2237	2226	2255	2247	2244	65535	65535	2223	2231	2227	2255	2254	2273	2269	2268
				2240	2223	2205	2233	2237	2227	2241	2227	2235	2261	2226	2237	2242	2219	2224	2238	2258	2259
				2265	2233	2219	2245	2263	2249	2259	2277	2255	2199	2240	2242	2245	2242	2244	2254	2272	2238
				2258	2233	2231	2247	2268	2258	2255	2238	2263	2223	2254	2268	2279	2221	2237	2268	2266	2203
				2277	2186	2235	2220	2265	2249	2255	2276	2273	2210	2196	2202	2212	2214	2219	2223	2262	2261
				2247	2196	2206	2193	2249	2245	2259	2262	2272	2234	2203	2216	2226	2213	2217	2203	2252	2234
				2231	2224	2226	2237	2237	2221	2224	2210	2223	2247	2210	2217	2203	2259	2242	2255	2228	2272
				2235	2282	2273	2304	2277	2259	2294	2256	2287	2240	2227	2226	2230	2248	2241	2244	2241	2235
				2214	2262	2244	2270	2241	2234	2261	2275	2252	2231	2237	2227	2228	2203	2272	2235	2245	2241
				2209	2262	2251	2252	2233	2234	2233	2241	2231	2221	2238	2240	2219	2224	2223	2255	2249	2234
				2217	2247	2200	2241	2189	2213	2200	2214	2206	2259	2259	2238	2249	2256	2262	2228	2242	2245
				2203	2256	2262	2259	2270	2252	2269	2272	2265	2265	2241	2238	2240	2255	2272	2251	2261	2254
				2261	2240	2228	2235	2214	2226	2231	2255	2235	2254	2212	2221	2206	2258	2249	2247	2251	2224
				2209	2255	2248	2228	2256	2252	2251	2249	2242	2228	2263	2247	2255	2245	2234	2220	2234	2245
				2290	2231	2226	2220	2213	2224	2202	2219	2202	2227	2219	2234	2227	2205	2256	2238	2261	2241
				2207	2238	2238	2224	2265	2270	2262	2255	2248	2223	2273	2279	2277	2233	2234	2241	2235	2247
				2252	2241	2219	2228	2230	2240	2231	2242	2245	2241	2240	2251	2247	2265	2238	2245	2251	2263
				2224	2248	2238	2251	2249	2242	2261	2259	2252	2265	2249	2245	2249	2240	2261	2269	2248	2221
				2251	2249	2248	2237	2254	2263	2261	2251	2252	2255	2248	2237	2235	2275	2268	2248	2268	2252
				2231	2249	2235	2259	2227	2258	2256	2235	2263	2269	2228	2224	2230	2237	2231	2240	2223	2216
				2219	2238	2252	2248	2226	2224	2220	2221	2219	2226	2238	2245	2241	2249	2261	2237	2248	2247
				2248	2240	2249	2251	2252	2231	2241	2263	2238	2276	2270	2238	2233	2276	2269	2289	2272	2207
				2230	2248	2248	2230	2238	2268	2252	2227	2256	2207	2223	2224	2224	2241	2213	2231	2237	2234
				2244	2233	2219	2249	2231	2238	2245	2227	2247	2213	2275	2228	2219	2270	2270	2273	2241	2223
				2227	2276	2259	2269	2265	2254	2255	2261	2242	2210	2247	2261	2265	2249	2268	2252	2275	2189
				2217	2259	2252	2235	2248	2259	2254	2231	2261	2247	2235	2230	2231	2223	2244	2242	2245	2265
				2252	2217	2227	2217	2205	2237	2209	2195	2221	2221	2224	2219	2212	2230	2251	2241	2240	2219
				2248	2240	2214	2210	2256	2249	2242	2224	2241	2283	2231	2244	2242	2227	2227	2235	2261	2249
				2242	2228	2240	2262	2255	2268	2273	2256	2275	2247	2238	2220	2220	2237	2220	2231	2241	2231
				2252	2224	2175	2185	2175	2233	2231	2175	2212	2235	2234	2221	2234	2217	2231	2241	2256	2259
				2258	2269	2205	2205	2212	2210	2191	2191	2230	2249	2240	2227	2228	2234	2255	2242	2227	2223
				2240	2216	2199	2203	2235	2242	2247	2233	2217	2248	2228	2235	2237	2248	2258	2221	2272	2216
				3840 3840 3840>;

			PS_Config_Lmt_FW_Rawdata_N = <
				946	969	945	958	954	966	963	961	(-65535)	(-65535)	952	956	954	966	966	974	972	972
				960	952	945	957	958	954	960	954	958	969	954	958	961	951	953	959	967	968            
				970	957	951	962	970	964	968	976	966	942	960	961	962	961	961	966	973	959            
				967	957	956	963	972	967	966	959	970	952	966	972	976	952	958	972	971	944            
				976	937	958	951	970	964	966	975	974	947	941	943	948	949	951	952	969	969            
				963	941	945	940	964	962	968	969	973	957	944	949	954	948	950	944	965	957            
				956	953	954	958	958	952	953	947	952	963	947	950	944	968	961	966	955	973            
				958	978	974	987	976	968	983	967	980	960	954	954	955	963	960	961	960	958            
				949	969	961	973	960	957	969	975	965	956	958	954	955	944	973	958	962	960            
				946	969	964	965	957	957	957	960	956	952	959	960	951	953	952	966	964	957            
				950	963	943	960	938	948	943	949	945	968	968	959	964	967	969	955	961	962            
				944	967	969	968	973	965	972	973	970	970	960	959	960	966	973	964	969	966            
				969	960	955	958	949	954	956	966	958	966	948	952	945	967	964	963	964	953            
				946	966	963	955	967	965	964	964	961	955	970	963	966	962	957	951	957	962            
				981	956	954	951	948	953	943	951	943	954	951	957	954	945	967	959	969	960            
				946	959	959	953	970	973	969	966	963	952	974	976	976	957	957	960	958	963            
				965	960	951	955	955	960	956	961	962	960	960	964	963	970	959	962	964	970            
				953	963	959	964	964	961	969	968	965	970	964	962	964	960	969	972	963	952            
				964	964	963	958	966	970	969	964	965	966	963	958	958	975	972	963	972	965            
				956	964	958	968	954	967	967	958	970	972	955	953	955	958	956	960	952	949            
				951	959	965	963	954	953	951	952	951	954	959	962	960	964	969	958	963	963            
				963	960	964	964	965	956	960	970	959	975	973	959	957	975	972	981	973	946            
				955	963	963	955	959	972	965	954	967	946	952	953	953	960	948	956	958	957            
				961	957	951	964	956	959	962	954	963	948	975	955	951	973	973	974	960	952            
				954	975	968	972	970	966	966	969	961	947	963	969	970	964	972	965	975	938            
				950	968	965	958	963	968	966	956	969	963	958	955	956	952	961	961	962	970            
				965	950	954	950	945	958	946	940	952	952	953	951	948	955	964	960	960	951            
				963	960	949	947	967	964	961	953	960	978	956	961	961	954	954	958	969	964            
				961	955	960	969	966	972	974	967	975	963	959	951	951	958	951	956	960	956            
				965	953	932	936	932	957	956	932	948	958	957	952	957	950	956	960	967	968            
				967	972	945	945	948	947	939	939	955	964	960	954	955	957	966	961	954	952            
				960	949	942	944	958	961	963	957	950	963	955	958	958	963	967	952	973	949            
				240 240 240>;

			PS_Config_Lmt_FW_CC_P = <
				92	91	92	92	92	92	92	92	65535	65535	97	97	97	96	96	96	95	95
				95	95	95	95	95	95	95	95	97	100	99	99	99	99	99	99	99	100   
				95	93	93	93	93	93	93	93	96	99	96	97	97	96	97	97	97	99    
				96	95	95	96	96	96	96	96	99	102	100	100	100	99	100	100	100	102   
				96	95	95	95	95	95	95	96	99	102	100	100	100	99	99	99	100	100   
				96	96	95	96	96	96	96	96	99	102	99	99	99	99	99	99	100	102   
				97	96	96	96	96	96	96	96	99	102	100	100	100	99	99	99	99	99    
				100	99	99	99	99	99	99	99	102	106	104	104	104	103	103	102	103	103   
				97	96	96	96	96	95	95	96	97	103	100	100	100	100	100	99	99	100   
				100	99	99	99	99	99	99	99	102	106	103	103	103	103	102	102	102	103   
				96	95	95	95	95	95	95	95	97	102	100	100	100	99	99	99	99	100   
				100	97	97	97	97	97	97	97	100	106	103	104	103	103	103	102	102	104   
				97	95	95	96	95	95	95	95	97	103	102	102	102	102	100	100	100	102   
				102	102	102	102	102	100	102	102	103	107	104	104	104	104	104	103	103	104   
				97	96	96	96	96	96	96	96	99	103	102	102	102	102	100	100	100	102   
				102	100	100	100	100	100	100	100	103	107	104	104	104	104	104	104	104	106   
				99	97	97	97	97	97	97	97	100	103	102	102	102	100	100	100	100	102   
				102	100	100	100	100	100	100	100	103	106	104	104	104	104	103	103	103	106   
				97	96	96	96	96	96	96	96	99	103	102	102	102	102	102	100	100	102   
				103	102	102	102	102	102	102	102	104	104	103	103	103	103	103	102	103	104   
				99	97	97	97	97	97	97	97	100	103	102	102	102	102	102	102	102	103   
				104	103	103	103	103	103	103	103	106	107	106	106	106	104	106	104	106	107   
				99	97	97	97	97	97	97	97	100	104	102	103	103	102	103	102	103	104   
				97	97	96	97	96	96	96	97	99	104	102	103	103	102	102	102	103	104   
				99	97	97	97	97	97	97	97	100	104	103	103	103	102	103	103	103	104   
				99	97	97	97	97	97	97	97	100	104	102	102	102	102	102	102	103	104   
				100	99	99	99	99	99	99	99	102	106	103	103	103	103	103	103	104	106   
				100	99	99	99	99	99	99	99	102	103	102	102	102	100	100	102	102	103   
				100	97	97	97	97	97	97	97	100	104	102	102	102	102	102	102	103	104   
				96	99	99	99	99	97	97	99	100	104	102	102	103	102	102	102	103	100   
				95	97	97	97	96	96	96	96	99	104	102	103	103	102	102	103	103	100   
				99	99	99	99	97	97	97	97	102	103	100	100	100	100	100	100	100	102   
				314 314 314>;

			PS_Config_Lmt_FW_CC_N = <
				41	40	41	41	41	41	41	41	(-65535)	(-65535)	44	44	44	43	43	43	42	42
				42	42	42	42	42	42	42	42	44	45	44	44	44	44	44	44	44	45            
				42	42	42	42	42	42	42	42	43	44	43	44	44	43	44	44	44	44            
				43	42	42	43	43	43	43	43	44	45	45	45	45	44	45	45	45	45            
				43	42	42	42	42	42	42	43	44	45	45	45	45	44	44	44	45	45            
				43	43	42	43	43	43	43	43	44	45	44	44	44	44	44	44	45	45            
				44	43	43	43	43	43	43	43	44	45	45	45	45	44	44	44	44	44            
				45	44	44	44	44	44	44	44	45	47	47	47	47	46	46	45	46	46            
				44	43	43	43	43	42	42	43	44	46	45	45	45	45	45	44	44	45            
				45	44	44	44	44	44	44	44	45	47	46	46	46	46	45	45	45	46            
				43	42	42	42	42	42	42	42	44	45	45	45	45	44	44	44	44	45            
				45	44	44	44	44	44	44	44	45	47	46	47	46	46	46	45	45	47            
				44	42	42	43	42	42	42	42	44	46	45	45	45	45	45	45	45	45            
				45	45	45	45	45	45	45	45	46	48	47	47	47	47	47	46	46	47            
				44	43	43	43	43	43	43	43	44	46	45	45	45	45	45	45	45	45            
				45	45	45	45	45	45	45	45	46	48	47	47	47	47	47	47	47	47            
				44	44	44	44	44	44	44	44	45	46	45	45	45	45	45	45	45	45            
				45	45	45	45	45	45	45	45	46	47	47	47	47	47	46	46	46	47            
				44	43	43	43	43	43	43	43	44	46	45	45	45	45	45	45	45	45            
				46	45	45	45	45	45	45	45	47	47	46	46	46	46	46	45	46	47            
				44	44	44	44	44	44	44	44	45	46	45	45	45	45	45	45	45	46            
				47	46	46	46	46	46	46	46	47	48	47	47	47	47	47	47	47	48            
				44	44	44	44	44	44	44	44	45	47	45	46	46	45	46	45	46	47            
				44	44	43	44	43	43	43	44	44	47	45	46	46	45	45	45	46	47            
				44	44	44	44	44	44	44	44	45	47	46	46	46	45	46	46	46	47            
				44	44	44	44	44	44	44	44	45	47	45	45	45	45	45	45	46	47            
				45	44	44	44	44	44	44	44	45	47	46	46	46	46	46	46	47	47            
				45	44	44	44	44	44	44	44	45	46	45	45	45	45	45	45	45	46            
				45	44	44	44	44	44	44	44	45	47	45	45	45	45	45	45	46	47            
				43	44	44	44	44	44	44	44	45	47	45	45	46	45	45	45	46	45            
				42	44	44	44	43	43	43	43	44	47	45	46	46	45	45	46	46	45            
				44	44	44	44	44	44	44	44	45	46	45	45	45	45	45	45	45	45            
				0 0 0>;

			PS_Config_Lmt_FW_Diff_P = <
				50	50	50	50	50	50	50	50	65535	65535	50	50	50	50	50	50	50	50
				50	50	50	50	50	50	50	50	50	50	50	50	50	50	50	50	50	50    
				50	50	50	50	50	50	50	50	50	50	50	50	50	50	50	50	50	50    
				50	50	50	50	50	50	50	50	50	50	50	50	50	50	50	50	50	50    
				50	50	50	50	50	50	50	50	50	50	50	50	50	50	50	50	50	50    
				50	50	50	50	50	50	50	50	50	50	50	50	50	50	50	50	50	50    
				50	50	50	50	50	50	50	50	50	50	50	50	50	50	50	50	50	50    
				50	50	50	50	50	50	50	50	50	50	50	50	50	50	50	50	50	50    
				50	50	50	50	50	50	50	50	50	50	50	50	50	50	50	50	50	50    
				50	50	50	50	50	50	50	50	50	50	50	50	50	50	50	50	50	50    
				50	50	50	50	50	50	50	50	50	50	50	50	50	50	50	50	50	50    
				50	50	50	50	50	50	50	50	50	50	50	50	50	50	50	50	50	50    
				50	50	50	50	50	50	50	50	50	50	50	50	50	50	50	50	50	50    
				50	50	50	50	50	50	50	50	50	50	50	50	50	50	50	50	50	50    
				50	50	50	50	50	50	50	50	50	50	50	50	50	50	50	50	50	50    
				50	50	50	50	50	50	50	50	50	50	50	50	50	50	50	50	50	50    
				50	50	50	50	50	50	50	50	50	50	50	50	50	50	50	50	50	50    
				50	50	50	50	50	50	50	50	50	50	50	50	50	50	50	50	50	50    
				50	50	50	50	50	50	50	50	50	50	50	50	50	50	50	50	50	50    
				50	50	50	50	50	50	50	50	50	50	50	50	50	50	50	50	50	50    
				50	50	50	50	50	50	50	50	50	50	50	50	50	50	50	50	50	50    
				50	50	50	50	50	50	50	50	50	50	50	50	50	50	50	50	50	50    
				50	50	50	50	50	50	50	50	50	50	50	50	50	50	50	50	50	50    
				50	50	50	50	50	50	50	50	50	50	50	50	50	50	50	50	50	50    
				50	50	50	50	50	50	50	50	50	50	50	50	50	50	50	50	50	50    
				50	50	50	50	50	50	50	50	50	50	50	50	50	50	50	50	50	50    
				50	50	50	50	50	50	50	50	50	50	50	50	50	50	50	50	50	50    
				50	50	50	50	50	50	50	50	50	50	50	50	50	50	50	50	50	50    
				50	50	50	50	50	50	50	50	50	50	50	50	50	50	50	50	50	50    
				50	50	50	50	50	50	50	50	50	50	50	50	50	50	50	50	50	50    
				50	50	50	50	50	50	50	50	50	50	50	50	50	50	50	50	50	50    
				50	50	50	50	50	50	50	50	50	50	50	50	50	50	50	50	50	50    
				75 75 75>;

			PS_Config_Lmt_FW_Diff_N = <
				(-50)	(-50)	(-50)	(-50)	(-50)	(-50)	(-50)	(-50)	(-65535)	(-65535)	(-50)	(-50)	(-50)	(-50)	(-50)	(-50)	(-50)	(-50)
				(-50)	(-50)	(-50)	(-50)	(-50)	(-50)	(-50)	(-50)	(-50)	(-50)	(-50)	(-50)	(-50)	(-50)	(-50)	(-50)	(-50)	(-50)        
				(-50)	(-50)	(-50)	(-50)	(-50)	(-50)	(-50)	(-50)	(-50)	(-50)	(-50)	(-50)	(-50)	(-50)	(-50)	(-50)	(-50)	(-50)        
				(-50)	(-50)	(-50)	(-50)	(-50)	(-50)	(-50)	(-50)	(-50)	(-50)	(-50)	(-50)	(-50)	(-50)	(-50)	(-50)	(-50)	(-50)        
				(-50)	(-50)	(-50)	(-50)	(-50)	(-50)	(-50)	(-50)	(-50)	(-50)	(-50)	(-50)	(-50)	(-50)	(-50)	(-50)	(-50)	(-50)        
				(-50)	(-50)	(-50)	(-50)	(-50)	(-50)	(-50)	(-50)	(-50)	(-50)	(-50)	(-50)	(-50)	(-50)	(-50)	(-50)	(-50)	(-50)        
				(-50)	(-50)	(-50)	(-50)	(-50)	(-50)	(-50)	(-50)	(-50)	(-50)	(-50)	(-50)	(-50)	(-50)	(-50)	(-50)	(-50)	(-50)        
				(-50)	(-50)	(-50)	(-50)	(-50)	(-50)	(-50)	(-50)	(-50)	(-50)	(-50)	(-50)	(-50)	(-50)	(-50)	(-50)	(-50)	(-50)        
				(-50)	(-50)	(-50)	(-50)	(-50)	(-50)	(-50)	(-50)	(-50)	(-50)	(-50)	(-50)	(-50)	(-50)	(-50)	(-50)	(-50)	(-50)        
				(-50)	(-50)	(-50)	(-50)	(-50)	(-50)	(-50)	(-50)	(-50)	(-50)	(-50)	(-50)	(-50)	(-50)	(-50)	(-50)	(-50)	(-50)        
				(-50)	(-50)	(-50)	(-50)	(-50)	(-50)	(-50)	(-50)	(-50)	(-50)	(-50)	(-50)	(-50)	(-50)	(-50)	(-50)	(-50)	(-50)        
				(-50)	(-50)	(-50)	(-50)	(-50)	(-50)	(-50)	(-50)	(-50)	(-50)	(-50)	(-50)	(-50)	(-50)	(-50)	(-50)	(-50)	(-50)        
				(-50)	(-50)	(-50)	(-50)	(-50)	(-50)	(-50)	(-50)	(-50)	(-50)	(-50)	(-50)	(-50)	(-50)	(-50)	(-50)	(-50)	(-50)        
				(-50)	(-50)	(-50)	(-50)	(-50)	(-50)	(-50)	(-50)	(-50)	(-50)	(-50)	(-50)	(-50)	(-50)	(-50)	(-50)	(-50)	(-50)        
				(-50)	(-50)	(-50)	(-50)	(-50)	(-50)	(-50)	(-50)	(-50)	(-50)	(-50)	(-50)	(-50)	(-50)	(-50)	(-50)	(-50)	(-50)        
				(-50)	(-50)	(-50)	(-50)	(-50)	(-50)	(-50)	(-50)	(-50)	(-50)	(-50)	(-50)	(-50)	(-50)	(-50)	(-50)	(-50)	(-50)        
				(-50)	(-50)	(-50)	(-50)	(-50)	(-50)	(-50)	(-50)	(-50)	(-50)	(-50)	(-50)	(-50)	(-50)	(-50)	(-50)	(-50)	(-50)        
				(-50)	(-50)	(-50)	(-50)	(-50)	(-50)	(-50)	(-50)	(-50)	(-50)	(-50)	(-50)	(-50)	(-50)	(-50)	(-50)	(-50)	(-50)        
				(-50)	(-50)	(-50)	(-50)	(-50)	(-50)	(-50)	(-50)	(-50)	(-50)	(-50)	(-50)	(-50)	(-50)	(-50)	(-50)	(-50)	(-50)        
				(-50)	(-50)	(-50)	(-50)	(-50)	(-50)	(-50)	(-50)	(-50)	(-50)	(-50)	(-50)	(-50)	(-50)	(-50)	(-50)	(-50)	(-50)        
				(-50)	(-50)	(-50)	(-50)	(-50)	(-50)	(-50)	(-50)	(-50)	(-50)	(-50)	(-50)	(-50)	(-50)	(-50)	(-50)	(-50)	(-50)        
				(-50)	(-50)	(-50)	(-50)	(-50)	(-50)	(-50)	(-50)	(-50)	(-50)	(-50)	(-50)	(-50)	(-50)	(-50)	(-50)	(-50)	(-50)        
				(-50)	(-50)	(-50)	(-50)	(-50)	(-50)	(-50)	(-50)	(-50)	(-50)	(-50)	(-50)	(-50)	(-50)	(-50)	(-50)	(-50)	(-50)        
				(-50)	(-50)	(-50)	(-50)	(-50)	(-50)	(-50)	(-50)	(-50)	(-50)	(-50)	(-50)	(-50)	(-50)	(-50)	(-50)	(-50)	(-50)        
				(-50)	(-50)	(-50)	(-50)	(-50)	(-50)	(-50)	(-50)	(-50)	(-50)	(-50)	(-50)	(-50)	(-50)	(-50)	(-50)	(-50)	(-50)        
				(-50)	(-50)	(-50)	(-50)	(-50)	(-50)	(-50)	(-50)	(-50)	(-50)	(-50)	(-50)	(-50)	(-50)	(-50)	(-50)	(-50)	(-50)        
				(-50)	(-50)	(-50)	(-50)	(-50)	(-50)	(-50)	(-50)	(-50)	(-50)	(-50)	(-50)	(-50)	(-50)	(-50)	(-50)	(-50)	(-50)        
				(-50)	(-50)	(-50)	(-50)	(-50)	(-50)	(-50)	(-50)	(-50)	(-50)	(-50)	(-50)	(-50)	(-50)	(-50)	(-50)	(-50)	(-50)        
				(-50)	(-50)	(-50)	(-50)	(-50)	(-50)	(-50)	(-50)	(-50)	(-50)	(-50)	(-50)	(-50)	(-50)	(-50)	(-50)	(-50)	(-50)        
				(-50)	(-50)	(-50)	(-50)	(-50)	(-50)	(-50)	(-50)	(-50)	(-50)	(-50)	(-50)	(-50)	(-50)	(-50)	(-50)	(-50)	(-50)        
				(-50)	(-50)	(-50)	(-50)	(-50)	(-50)	(-50)	(-50)	(-50)	(-50)	(-50)	(-50)	(-50)	(-50)	(-50)	(-50)	(-50)	(-50)        
				(-50)	(-50)	(-50)	(-50)	(-50)	(-50)	(-50)	(-50)	(-50)	(-50)	(-50)	(-50)	(-50)	(-50)	(-50)	(-50)	(-50)	(-50)        
				(-75) (-75) (-75)>;
			/*C3T code for HQ-223848 by chenzimo at 2022/9/16 end*/
			PS_Config_Diff_Test_Frame = <50>;
		};
	};
};
