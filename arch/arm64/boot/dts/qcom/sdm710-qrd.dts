/* Copyright (c) 2018, The Linux Foundation. All rights reserved.
 *
 * This program is free software; you can redistribute it and/or modify
 * it under the terms of the GNU General Public License version 2 and
 * only version 2 as published by the Free Software Foundation.
 *
 * This program is distributed in the hope that it will be useful,
 * but WITHOUT ANY WARRANTY; without even the implied warranty of
 * MERCHANTABILITY or FITNESS FOR A PARTICULAR PURPOSE.  See the
 * GNU General Public License for more details.
 */


/dts-v1/;

#include "sdm710.dtsi"
#include "sdm670-audio-overlay.dtsi"
#include "sdm670-qrd.dtsi"

/ {
	model = "Qualcomm Technologies, Inc. SDM710 PM660 + PM660L QRD";
	compatible = "qcom,sdm670-qrd", "qcom,sdm670", "qcom,qrd";
	qcom,board-id = <0x0002000b 0>;
	qcom,pmic-id = <0x0001001b 0x0101011a 0x0 0x0>,
		       <0x0001001b 0x0102001a 0x0 0x0>,
		       <0x0001001b 0x0201011a 0x0 0x0>;
};
