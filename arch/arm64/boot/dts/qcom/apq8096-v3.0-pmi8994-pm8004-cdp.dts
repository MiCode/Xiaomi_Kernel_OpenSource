/* Copyright (c) 2015, The Linux Foundation. All rights reserved.
 *
 * This program is free software; you can redistribute it and/or modify
 * it under the terms of the GNU General Public License version 2 and
 * only version 2 as published by the Free Software Foundation.
 *
 * This program is distributed in the hope that it will be useful,
 * but WITHOUT ANY WARRANTY; without even the implied warranty of
 * MERCHANTABILITY or FITNESS FOR A PARTICULAR PURPOSE.  See the
 * GNU General Public License for more details.
 */

/dts-v1/;

#include "apq8096-v3.0.dtsi"
#include "msm8996-pm8994-pmi8994-pm8004.dtsi"
#include "msm8996-cdp.dtsi"

/ {
	model = "Qualcomm Technologies, Inc. APQ 8096 v3.0 + PMI8994 + PM8004 CDP";
	compatible = "qcom,apq8096-cdp", "qcom,apq8096", "qcom,cdp";
	qcom,board-id = <1 0>, <0x01000001 0>;
};
