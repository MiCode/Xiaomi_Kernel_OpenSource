/* Copyright (c) 2017, The Linux Foundation. All rights reserved.
 * Copyright (C) 2020 XiaoMi, Inc.
 *
 * This program is free software; you can redistribute it and/or modify
 * it under the terms of the GNU General Public License version 2 and
 * only version 2 as published by the Free Software Foundation.
 *
 * This program is distributed in the hope that it will be useful,
 * but WITHOUT ANY WARRANTY; without even the implied warranty of
 * MERCHANTABILITY or FITNESS FOR A PARTICULAR PURPOSE.  See the
 * GNU General Public License for more details.
 */

&mdss_mdp {
	dsi_boe_hx83112_fhd_video: qcom,mdss_dsi_boe_hx83112_fhd_video {
		qcom,mdss-dsi-panel-name =
				"boe hx83112 fhd video mode dsi panel";
		qcom,mdss-dsi-panel-type = "dsi_video_mode";
		qcom,mdss-dsi-virtual-channel-id = <0>;
		qcom,mdss-dsi-stream = <0>;
		qcom,mdss-dsi-bpp = <24>;
		qcom,mdss-dsi-underflow-color = <0x0>;
		qcom,mdss-dsi-border-color = <0>;
		qcom,mdss-dsi-traffic-mode = "burst_mode";
		qcom,mdss-dsi-bllp-eof-power-mode;
		qcom,mdss-dsi-bllp-power-mode;
		qcom,mdss-dsi-lp11-init;
		qcom,mdss-dsi-lane-0-state;
		qcom,mdss-dsi-lane-1-state;
		qcom,mdss-dsi-lane-2-state;
		qcom,mdss-dsi-lane-3-state;
		qcom,mdss-brightness-max-level = <4095>;
		qcom,mdss-dsi-dma-trigger = "trigger_sw";
		qcom,mdss-dsi-mdp-trigger = "none";
		qcom,mdss-dsi-reset-sequence = <1 10>, <0 10>, <1 10>;
		qcom,mdss-pan-physical-width-dimension = <68>;
		qcom,mdss-pan-physical-height-dimension = <136>;
		qcom,mdss-dsi-tx-eot-append;
		qcom,mdss-dsi-post-init-delay = <1>;
		qcom,mdss-dsi-display-timings {
			timing@0{
				qcom,mdss-dsi-panel-width = <1080>;
				qcom,mdss-dsi-panel-height = <2160>;
				qcom,mdss-dsi-h-front-porch = <48>;
				qcom,mdss-dsi-h-back-porch = <16>;
				qcom,mdss-dsi-h-pulse-width = <12>;
				qcom,mdss-dsi-h-sync-skew = <0>;
				qcom,mdss-dsi-h-sync-pulse = <0>;
				qcom,mdss-dsi-v-back-porch = <7>;
				qcom,mdss-dsi-v-front-porch = <42>;
				qcom,mdss-dsi-v-pulse-width = <5>;
				qcom,mdss-dsi-panel-framerate = <60>;
				qcom,mdss-dsi-h-left-border = <0>;
				qcom,mdss-dsi-h-right-border = <0>;
				qcom,mdss-dsi-v-top-border = <0>;
				qcom,mdss-dsi-v-bottom-border = <0>;
				qcom,mdss-dsi-on-command = [
					39 01 00 00 00 00 04 B9 83 11 2A
					39 01 00 00 00 00 09 B1 08 24 24 80 80 4A 4F AA
					39 01 00 00 00 00 0F B2 00 02 00 80 70 00 0A 28 FC 11 00 01 15 A0
					39 01 00 00 00 00 03 D2 29 29
					39 01 00 00 00 00 1C B4 02 BA 02 BA 02 BA 04 C0 00 00 04 C0 00 FF 00 FF 00 00 0C 12 00 2B 06 06 0F 00 86
					39 01 00 00 00 00 04 B6 7B 7B E3
					39 01 00 00 00 00 02 CC 00
					39 01 00 00 00 00 30 D3 C0 00 00 00 00 01 00 14 14 03 01 11 08 03 03 03 03 32 10 00 00 00 32 10 0A 00 0A 32 10 08 00 00 00 00 00 00 00 00 00 00 00 00 00 00 00 EA 1C
					39 01 00 00 00 00 31 D5 18 18 18 18 18 18 18 18 18 18 18 18 18 18 18 18 C0 C0 18 18 40 40 18 18 18 18 31 31 30 30 2F 2F 01 00 03 02 20 20 C0 C0 C0 C0 19 19 40 40 25 24
					39 01 00 00 00 00 31 D6 18 18 18 18 18 18 18 18 18 18 18 18 18 18 18 18 40 40 18 18 40 40 18 18 18 18 31 31 30 30 2F 2F 02 03 00 01 20 20 40 40 40 40 40 40 19 19 24 25
					39 01 00 00 00 00 0D D8 AA AA AA AA AF EA AA AA AA AA AF EA
					39 01 00 00 00 00 02 BD 01
					39 01 00 00 00 00 0D D8 AA AA AF FF FF FF AA AA AF FF FF FF
					39 01 00 00 00 00 02 BD 02
					39 01 00 00 00 00 0D D8 AA AA AF FF FF FF AA AA AF FF FF FF
					39 01 00 00 00 00 02 BD 03
					39 01 00 00 00 00 19 D8 AA AA AE AA AA BE AA AA AE AA AA BE AA AA AF FF FF FF AA AA AF FF FF FF
					39 01 00 00 00 00 02 BD 00
					39 01 00 00 00 00 02 C1 01
					39 01 00 00 00 00 02 BD 01
					39 01 00 00 00 00 3A C1 FF FA F5 F0 EC E8 E3 D9 D5 D0 CB C6 C1 BC B7 B2 AD A8 A3 99 90 87 7E 76 6D 65 5D 55 4D 47 40 3A 32 2B 25 1F 19 12 0D 07 05 03 02 01 00 0B 87 24 64 11 18 8B DC B5 3A 95 00
					39 01 00 00 00 00 02 BD 02
					39 01 00 00 00 00 3A C1 FF FA F5 F0 EC E8 E3 D9 D5 D0 CB C6 C1 BC B7 B2 AD A8 A3 99 90 87 7E 76 6D 65 5D 55 4D 47 40 3A 32 2B 25 1F 19 12 0D 07 05 03 02 01 00 0B 87 24 64 11 18 8B DC B5 3A 95 00
					39 01 00 00 00 00 02 BD 03
					39 01 00 00 00 00 3A C1 FF FA F5 F0 EC E8 E3 D9 D5 D0 CB C6 C1 BC B7 B2 AD A8 A3 99 90 87 7E 76 6D 65 5D 55 4D 47 40 3A 32 2B 25 1F 19 12 0D 07 05 03 02 01 00 0B 87 24 64 11 18 8B DC B5 3A 95 00
					39 01 00 00 00 00 02 BD 00
					39 01 00 00 00 00 1A E7 0F 0F 1E 6B 1E 6B 00 50 01 14 00 00 02 02 02 05 14 14 32 B9 23 B9 08 13 69
					39 01 00 00 00 00 02 BD 01
					39 01 00 00 00 00 09 E7 02 00 88 01 9A 0E 20 0F
					39 01 00 00 00 00 02 BD 02
					39 01 00 00 00 00 1E E7 00 00 08 40 01 00 00 00 00 00 00 00 00 00 00 00 00 00 00 00 00 00 04 00 70 01 70 02 00
					39 01 00 00 00 00 02 BD 00
					39 01 00 00 00 00 03 C0 22 22
					39 01 00 00 00 00 02 BD 02
					39 01 00 00 00 00 0A B4 00 92 12 11 88 12 12 00 53
					39 01 00 00 00 00 02 BD 01
					39 01 00 00 00 00 04 B1 64 01 09
					39 01 00 00 00 00 02 BD 00
					39 01 00 00 00 00 07 C7 00 00 04 E0 33 00
					39 01 00 00 00 00 11 BA 73 03 64 33 33 33 33 11 10 00 00 10 08 3D 02 76
					39 01 00 00 00 00 03 BE 01 96
					39 01 00 00 00 00 04 D9 3F 01 02
					39 01 00 00 00 00 02 E9 C3
					39 01 00 00 00 00 05 CB 91 FF 00 02
					39 01 00 00 00 00 02 E9 3F
					15 01 00 00 00 00 02 51 00
					15 01 00 00 00 00 02 53 24
					15 01 00 00 00 00 02 55 00
					05 01 00 00 64 00 02 11 00
					05 01 00 00 14 00 02 29 00];
				qcom,mdss-dsi-off-command = [
					05 01 00 00 32 00 02 28 00
					05 01 00 00 64 00 02 10 00];
				qcom,mdss-dsi-on-command-state = "dsi_lp_mode";
				qcom,mdss-dsi-off-command-state = "dsi_lp_mode";
			};
		};
	};
};
