/* Copyright (c) 2018, The Linux Foundation. All rights reserved.
 *
 * This program is free software; you can redistribute it and/or modify
 * it under the terms of the GNU General Public License version 2 and
 * only version 2 as published by the Free Software Foundation.
 *
 * This program is distributed in the hope that it will be useful,
 * but WITHOUT ANY WARRANTY; without even the implied warranty of
 * MERCHANTABILITY or FITNESS FOR A PARTICULAR PURPOSE.  See the
 * GNU General Public License for more details.
 */

&soc {
	trusty {
		#size-cells = <0x2>;
		#address-cells = <0x2>;
		ranges;
		compatible = "android,trusty-smc-v1";
		log {
			compatible = "android,trusty-log-v1";
		};
		virtio {
			compatible = "android,trusty-virtio-v1";
		};
	};

};
