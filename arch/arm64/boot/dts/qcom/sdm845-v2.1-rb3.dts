/* Copyright (c) 2019, The Linux Foundation. All rights reserved.
 *
 * This program is free software; you can redistribute it and/or modify
 * it under the terms of the GNU General Public License version 2 and
 * only version 2 as published by the Free Software Foundation.
 *
 * This program is distributed in the hope that it will be useful,
 * but WITHOUT ANY WARRANTY; without even the implied warranty of
 * MERCHANTABILITY or FITNESS FOR A PARTICULAR PURPOSE.  See the
 * GNU General Public License for more details.
 */


/dts-v1/;
#include "sdm845-v2.1-rb3.dtsi"
#include "sdm845-camera-sensor-rb3.dtsi"

/ {
	model = "Qualcomm Technologies, Inc. sda845 v2.1 TurboX-SOM_V01";
	compatible = "qcom,sda845-mtp", "qcom,sda845", "qcom,mtp";
	qcom,msm-id = <341 0x20001>;
	qcom,board-id = <8 7>;
	aliases {
		spi0 = &qupv3_se5_spi;
	};
};
