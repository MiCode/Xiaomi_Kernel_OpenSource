/* Copyright (c) 2018, The Linux Foundation. All rights reserved.
 *
 * This program is free software; you can redistribute it and/or modify
 * it under the terms of the GNU General Public License version 2 and
 * only version 2 as published by the Free Software Foundation.
 *
 * This program is distributed in the hope that it will be useful,
 * but WITHOUT ANY WARRANTY; without even the implied warranty of
 * MERCHANTABILITY or FITNESS FOR A PARTICULAR PURPOSE.  See the
 * GNU General Public License for more details.
 */

/dts-v1/;

#include "sm6150p.dtsi"
#include "sm6150-idp.dtsi"

/ {
	model = "Qualcomm Technologies, Inc. SM6150P PM6150 IDP";
	compatible = "qcom,sm6150p-idp", "qcom,sm6150p", "qcom,idp";
	qcom,board-id = <34 0>;
};
