/* Copyright (c) 2013, The Linux Foundation. All rights reserved.
 * Copyright (C) 2021 XiaoMi, Inc.
 *
 * This program is free software; you can redistribute it and/or modify
 * it under the terms of the GNU General Public License version 2 and
 * only version 2 as published by the Free Software Foundation.
 *
 * This program is distributed in the hope that it will be useful,
 * but WITHOUT ANY WARRANTY; without even the implied warranty of
 * MERCHANTABILITY or FITNESS FOR A PARTICULAR PURPOSE.  See the
 * GNU General Public License for more details.
 */

/*---------------------------------------------------------------------------
 * This file is autogenerated file using gcdb parser. Please do not edit it.
 * Update input XML file to add a new entry or update variable in this file
 * VERSION = "1.0"
 *---------------------------------------------------------------------------*/
&mdss_mdp {
	dsi_ili9881d_hdplus_c3e_video: qcom,mdss_dsi_ili9881d_hdplus_video_c3e {
		qcom,mdss-dsi-panel-name = "ili9881d hdplus c3e video mode dsi panel";
		qcom,mdss-dsi-panel-controller = <&mdss_dsi0>;
		qcom,mdss-dsi-panel-type = "dsi_video_mode";
		qcom,mdss-dsi-panel-destination = "display_1";
		qcom,mdss-dsi-panel-framerate = <60>;
		qcom,mdss-dsi-virtual-channel-id = <0>;
		qcom,mdss-dsi-stream = <0>;
		qcom,mdss-dsi-panel-width = <720>;
		qcom,mdss-dsi-panel-height = <1440>;
		qcom,mdss-dsi-h-front-porch = <192>;
		qcom,mdss-dsi-h-back-porch = <192>;
		qcom,mdss-dsi-h-pulse-width = <16>;
		qcom,mdss-dsi-h-sync-skew = <0>;
		qcom,mdss-dsi-v-back-porch = <20>;
		qcom,mdss-dsi-v-front-porch = <20>;
		qcom,mdss-dsi-v-pulse-width = <8>;
		qcom,mdss-dsi-h-left-border = <0>;
		qcom,mdss-dsi-h-right-border = <0>;
		qcom,mdss-dsi-v-top-border = <0>;
		qcom,mdss-dsi-v-bottom-border = <0>;
		qcom,mdss-dsi-bpp = <24>;
		qcom,mdss-dsi-underflow-color = <0xff>;
		qcom,mdss-dsi-border-color = <0>;
		qcom,mdss-dsi-on-command = [
					29 01 00 00 00 00 04 ff 98 81 00
					29 01 00 00 78 00 02 11 00
					29 01 00 00 00 00 04 ff 98 81 02
					29 01 00 00 00 00 02 03 30
					29 01 00 00 00 00 02 04 00
					29 01 00 00 00 00 04 ff 98 81 02
					29 01 00 00 00 00 02 00 16
					29 01 00 00 00 00 02 01 16
					29 01 00 00 00 00 02 02 16
					29 01 00 00 00 00 02 05 25
					29 01 00 00 00 00 02 06 82
					29 01 00 00 00 00 02 07 A1
					29 01 00 00 00 00 02 11 F6
					29 01 00 00 00 00 02 14 0D
					29 01 00 00 00 00 02 15 0F
					29 01 00 00 00 00 02 16 10
					29 01 00 00 00 00 02 17 11
					29 01 00 00 00 00 02 18 12
					29 01 00 00 00 00 02 19 13
					29 01 00 00 00 00 02 1A 15
					29 01 00 00 00 00 02 1B 15
					29 01 00 00 00 00 02 1E 01
					29 01 00 00 00 00 02 1F 0A
					29 01 00 00 00 00 02 20 0B
					29 01 00 00 00 00 02 21 0C
					29 01 00 00 00 00 02 23 11
					29 01 00 00 00 00 02 24 14
					29 01 00 00 00 00 02 25 14
					29 01 00 00 00 00 02 27 96
					29 01 00 00 00 00 02 2D FF
					29 01 00 00 00 00 02 2E FF
					29 01 00 00 00 00 02 2F FF
					29 01 00 00 00 00 02 28 90
					29 01 00 00 00 00 04 ff 98 81 04
					29 01 00 00 00 00 02 3a 24
					29 01 00 00 00 00 04 ff 98 81 00
					29 01 00 00 00 00 03 51 0F FF
					29 01 00 00 00 00 02 53 2C
					29 01 00 00 00 00 02 55 00
					29 01 00 00 00 00 02 35 00
					29 01 00 00 14 00 02 29 00
					];
		qcom,mdss-dsi-off-command = [29 01 00 00 00 00 04 ff 98 81 00
					29 01 00 00 14 00 02 28 00
					29 01 00 00 78 00 02 10 00];
		qcom,mdss-dsi-CABC_UI_on-command = [
						29 01 00 00 00 00 04 FF 98 81 00
						29 01 00 00 00 00 02 55 01
						];
		qcom,mdss-dsi-CABC_STILL_on-command = [
						29 01 00 00 00 00 04 ff 98 81 00
						29 01 00 00 00 00 02 55 02
						];
		qcom,mdss-dsi-CABC_MOVIE_on-command = [
						29 01 00 00 00 00 04 FF 98 81 00
						29 01 00 00 00 00 02 55 03
						];
		qcom,mdss-dsi-CABC_off-command = [
						29 01 00 00 00 00 04 FF 98 81 00
						29 01 00 00 00 00 02 55 00
						];
		qcom,mdss-dsi-on-command-state = "dsi_lp_mode";
		qcom,mdss-dsi-off-command-state = "dsi_lp_mode";
		qcom,mdss-dsi-h-sync-pulse = <1>;
		qcom,mdss-dsi-traffic-mode = "burst_mode";
		qcom,mdss-dsi-lane-map = "lane_map_0123";
		qcom,mdss-dsi-bllp-eof-power-mode;
		qcom,mdss-dsi-bllp-power-mode;
		qcom,mdss-dsi-lane-0-state;
		qcom,mdss-dsi-lane-1-state;
		qcom,mdss-dsi-lane-2-state;
		qcom,mdss-dsi-lane-3-state;
		/delete-property/ qcom,mdss-dsi-panel-timings;
		qcom,mdss-dsi-panel-timings-phy-12nm = [
					0a 07 06 03 00 05 03 09];
		qcom,mdss-dsi-t-clk-post = <0x04>;
		qcom,mdss-dsi-t-clk-pre = <0x1c>;
		qcom,mdss-dsi-bl-min-level = <1>;
		qcom,mdss-dsi-bl-max-level = <2047>;
		qcom,mdss-brightness-max-level = <2047>;
		qcom,mdss-brightness-max-level-factory = <255>;
		qcom,mdss-dsi-bl-pmic-control-type = "bl_mount";
		qcom,panel-supply-entries = <&dsi_panel_pwr_supply>;
		qcom,mdss-dsi-reset-sequence = <1 20>, <0 2>, <1 20>;
		qcom,esd-check-enabled;
		qcom,mdss-dsi-panel-status-command = [06 01 00 01 05 00 01 0A];
		qcom,mdss-dsi-panel-status-command-mode = "dsi_lp_mode";
		qcom,mdss-dsi-panel-status-check-mode = "reg_read";
		qcom,mdss-dsi-panel-status-read-length = <1>;
		qcom,mdss-dsi-panel-status-valid-params = <1>;
		qcom,mdss-dsi-panel-status-value = <0x9C>;
		qcom,mdss-dsi-panel-max-error-count = <3>;
		qcom,mdss-dsi-post-init-delay = <1>;
		qcom,mdss-pan-physical-width-dimension = <62>;
		qcom,mdss-pan-physical-height-dimension = <124>;
	};
};
