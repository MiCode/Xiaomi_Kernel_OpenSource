// SPDX-License-Identifier: GPL-2.0-only
/*
 * Copyright (c) 2019, The Linux Foundation. All rights reserved.
 */

/dts-v1/;

#include "kona-v2.dtsi"
#include "kona-cdp.dtsi"

/ {
	model = "Qualcomm Technologies, Inc. kona CDP";
	compatible = "qcom,kona-cdp", "qcom,kona", "qcom,cdp";
	qcom,board-id = <1 0>;
};
