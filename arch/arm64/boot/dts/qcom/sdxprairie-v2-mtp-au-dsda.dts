/* Copyright (c) 2020, The Linux Foundation. All rights reserved.
 *
 * This program is free software; you can redistribute it and/or modify
 * it under the terms of the GNU General Public License version 2 and
 * only version 2 as published by the Free Software Foundation.
 *
 * This program is distributed in the hope that it will be useful,
 * but WITHOUT ANY WARRANTY; without even the implied warranty of
 * MERCHANTABILITY or FITNESS FOR A PARTICULAR PURPOSE.  See the
 * GNU General Public License for more details.
 */

/dts-v1/;

#include "sdxprairie-v2-mtp-cpe.dtsi"

/ {
	model = "Qualcomm Technologies, Inc. SDXPRAIRIE V2 AU DSDA";
	compatible = "qcom,sdxprairie-mtp",
		"qcom,sdxprairie", "qcom,mtp";
	qcom,board-id = <0x08010008 0x0>;
};

&usb {
	extcon = <&vbus_detect>;
};

&vbus_detect {
	status = "okay";
};
