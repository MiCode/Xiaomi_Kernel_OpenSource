// SPDX-License-Identifier: GPL-2.0-only
/*
 * Copyright (c) 2019, The Linux Foundation. All rights reserved.
 */

/dts-v1/;
/plugin/;

#include <dt-bindings/interrupt-controller/arm-gic.h>
#include "lito-atp.dtsi"

/ {
	model = "Qualcomm Technologies, Inc. Lito ATP";
	compatible = "qcom,lito-atp", "qcom,lito", "qcom,atp";
	qcom,msm-id = <400 0x10000>;
	qcom,board-id = <33 0>;
};
