// SPDX-License-Identifier: GPL-2.0-only
/*
 * Copyright (c) 2019, The Linux Foundation. All rights reserved.
 */

/dts-v1/;
/plugin/;

#include "lito-qrd.dtsi"

/ {
	model = "QRD";
	compatible = "qcom,lito-qrd", "qcom,lito", "qcom,qrd";
	qcom,msm-id = <400 0x10000>;
	qcom,board-id = <11 0>;
};
