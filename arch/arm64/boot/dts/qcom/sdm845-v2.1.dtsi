/* Copyright (c) 2017, The Linux Foundation. All rights reserved.
 *
 * This program is free software; you can redistribute it and/or modify
 * it under the terms of the GNU General Public License version 2 and
 * only version 2 as published by the Free Software Foundation.
 *
 * This program is distributed in the hope that it will be useful,
 * but WITHOUT ANY WARRANTY; without even the implied warranty of
 * MERCHANTABILITY or FITNESS FOR A PARTICULAR PURPOSE.  See the
 * GNU General Public License for more details.
 */

#include "sdm845-v2.dtsi"
#include "sdm845-v2-camera.dtsi"

/ {
	model = "Qualcomm Technologies, Inc. SDM845 V2.1";
	qcom,msm-id = <321 0x20001>;
};

&spmi_bus {
	/delete-property/ qcom,enable-ahb-bus-workaround;
};

&clock_gcc {
	compatible = "qcom,gcc-sdm845-v2.1", "syscon";
};

&apps_smmu {
	/delete-property/ qcom,no-asid-retention;
};
