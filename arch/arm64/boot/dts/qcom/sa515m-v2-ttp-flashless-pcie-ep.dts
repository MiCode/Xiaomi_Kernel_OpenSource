/* Copyright (c) 2019, The Linux Foundation. All rights reserved.
 *
 * This program is free software; you can redistribute it and/or modify
 * it under the terms of the GNU General Public License version 2 and
 * only version 2 as published by the Free Software Foundation.
 *
 * This program is distributed in the hope that it will be useful,
 * but WITHOUT ANY WARRANTY; without even the implied warranty of
 * MERCHANTABILITY or FITNESS FOR A PARTICULAR PURPOSE.  See the
 * GNU General Public License for more details.
 */

/dts-v1/;

#include "sa515m-v2-ttp.dtsi"
#include "sa515m-flashless.dtsi"

/ {
	model = "Qualcomm Technologies, Inc. SA515M TTP FLASHLESS PCIE EP";
	compatible = "qcom,sa515m-ttp",
		"qcom,sdxprairie","qcom,ttp";
	qcom,board-id = <30 3> , <30 0x103>;
};
