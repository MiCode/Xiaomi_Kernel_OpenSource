/*
 * Copyright (c) 2018, The Linux Foundation. All rights reserved.
 *
 * This program is free software; you can redistribute it and/or modify
 * it under the terms of the GNU General Public License version 2 and
 * only version 2 as published by the Free Software Foundation.
 *
 * This program is distributed in the hope that it will be useful,
 * but WITHOUT ANY WARRANTY; without even the implied warranty of
 * MERCHANTABILITY or FITNESS FOR A PARTICULAR PURPOSE.  See the
 * GNU General Public License for more details.
 */

/dts-v1/;

#include "msm8937-interposer-sdm439.dtsi"
#include "sdm439-cdp.dtsi"

/ {
	model = "Qualcomm Technologies, Inc. MSM8937 Interposer SDM439 CDP";
	compatible = "qcom,msm8937-cdp", "qcom,msm8937", "qcom,cdp";
	qcom,board-id = <1 2>;
	qcom,pmic-id = <0x010016 0x25 0x0 0x0>;
};
