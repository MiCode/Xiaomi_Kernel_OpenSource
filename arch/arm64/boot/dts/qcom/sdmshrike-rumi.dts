/* Copyright (c) 2018, The Linux Foundation. All rights reserved.
 *
 * This program is free software; you can redistribute it and/or modify
 * it under the terms of the GNU General Public License version 2 and
 * only version 2 as published by the Free Software Foundation.
 *
 * This program is distributed in the hope that it will be useful,
 * but WITHOUT ANY WARRANTY; without even the implied warranty of
 * MERCHANTABILITY or FITNESS FOR A PARTICULAR PURPOSE.  See the
 * GNU General Public License for more details.
 */

/dts-v1/;
/memreserve/ 0x90000000 0x00000100;

#include "sdmshrike.dtsi"
#include "sdmshrike-rumi.dtsi"

/ {
	model = "Qualcomm Technologies, Inc. SDMSHRIKE RUMI";
	compatible = "qcom,sdmshrike-rumi", "qcom,sdmshrike", "qcom,rumi";
	qcom,board-id = <15 0>;
};
