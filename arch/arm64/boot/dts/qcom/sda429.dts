/*
 * Copyright (c) 2020, The Linux Foundation. All rights reserved.
 *
 * This program is free software; you can redistribute it and/or modify
 * it under the terms of the GNU General Public License version 2 and
 * only version 2 as published by the Free Software Foundation.
 *
 * This program is distributed in the hope that it will be useful,
 * but WITHOUT ANY WARRANTY; without even the implied warranty of
 * MERCHANTABILITY or FITNESS FOR A PARTICULAR PURPOSE.  See the
 * GNU General Public License for more details.
 */

/dts-v1/;

#include "sda429.dtsi"
#include "sdm429w-bg-pm660.dtsi"

/ {
	model = "Qualcomm Technologies, Inc. SDA429 SoC";
	compatible = "qcom,sda429-cdp", "qcom,sda429", "qcom,cdp";
	qcom,pmic-id = <0x010016 0x25 0x0 0x0>;
	qcom.pmic-name = "PMI632";
};
