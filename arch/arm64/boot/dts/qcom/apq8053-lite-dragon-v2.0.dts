/*
 * Copyright (c) 2017-2018, The Linux Foundation. All rights reserved.
 *
 * This program is free software; you can redistribute it and/or modify
 * it under the terms of the GNU General Public License version 2 and
 * only version 2 as published by the Free Software Foundation.
 *
 * This program is distributed in the hope that it will be useful,
 * but WITHOUT ANY WARRANTY; without even the implied warranty of
 * MERCHANTABILITY or FITNESS FOR A PARTICULAR PURPOSE.  See the
 * GNU General Public License for more details.
 */

/dts-v1/;

#include "apq8053-lite-dragon-v2.0.dtsi"

/ {
	model = "Qualcomm Technologies, Inc. APQ8053 Lite DragonBoard V2.0";
	compatible = "qcom,apq8053-lite-dragonboard",
			"qcom,apq8053", "qcom,dragonboard";
	qcom,board-id = <0x0103000a 0>;
};

&blsp2_uart0 {
	status = "okay";
};

&blsp2_uart1 { /* UART6 */
	status = "okay";
};

