/* Copyright (c) 2019, The Linux Foundation. All rights reserved.
 *
 * This program is free software; you can redistribute it and/or modify
 * it under the terms of the GNU General Public License version 2 and
 * only version 2 as published by the Free Software Foundation.
 *
 * This program is distributed in the hope that it will be useful,
 * but WITHOUT ANY WARRANTY; without even the implied warranty of
 * MERCHANTABILITY or FITNESS FOR A PARTICULAR PURPOSE.  See the
 * GNU General Public License for more details.
 */

&mdss_mdp {
	dsi_nt36672_truly_video: qcom,mdss_dsi_nt36672_truly_video {
		qcom,mdss-dsi-panel-name =
				"nt36672 truly fhd video mode dsi panel";
		qcom,mdss-dsi-panel-type = "dsi_video_mode";
		qcom,mdss-dsi-virtual-channel-id = <0>;
		qcom,mdss-dsi-stream = <0>;
		qcom,mdss-dsi-bpp = <24>;
		qcom,mdss-dsi-underflow-color = <0xff>;
		qcom,mdss-dsi-border-color = <0>;
		qcom,mdss-dsi-traffic-mode = "burst_mode";
		qcom,mdss-dsi-te-pin-select = <1>;
		qcom,mdss-dsi-te-dcs-command = <1>;
		qcom,mdss-dsi-te-check-enable;
		qcom,mdss-dsi-te-using-te-pin;
		qcom,mdss-dsi-bllp-eof-power-mode;
		qcom,mdss-dsi-bllp-power-mode;
		qcom,mdss-dsi-lane-0-state;
		qcom,mdss-dsi-lane-1-state;
		qcom,mdss-dsi-lane-2-state;
		qcom,mdss-dsi-lane-3-state;
		qcom,mdss-dsi-reset-sequence = <1 10>, <0 10>, <1 10>;
		qcom,mdss-dsi-tx-eot-append;
		qcom,mdss-dsi-post-init-delay = <1>;
		qcom,mdss-dsi-dma-trigger = "trigger_sw";
		qcom,mdss-dsi-mdp-trigger = "none";

		qcom,mdss-dsi-display-timings {
			timing@0{
				qcom,mdss-dsi-panel-width = <1080>;
				qcom,mdss-dsi-panel-height = <2520>;
				qcom,mdss-dsi-h-front-porch = <28>;
				qcom,mdss-dsi-h-back-porch = <176>;
				qcom,mdss-dsi-h-pulse-width = <12>;
				qcom,mdss-dsi-h-sync-skew = <0>;
				qcom,mdss-dsi-v-back-porch = <10>;
				qcom,mdss-dsi-v-front-porch = <12>;
				qcom,mdss-dsi-v-pulse-width = <4>;
				qcom,mdss-dsi-h-sync-pulse = <0>;
				qcom,mdss-dsi-h-left-border = <0>;
				qcom,mdss-dsi-h-right-border = <0>;
				qcom,mdss-dsi-v-top-border = <0>;
				qcom,mdss-dsi-v-bottom-border = <0>;
				qcom,mdss-dsi-panel-framerate = <60>;
				qcom,mdss-dsi-on-command = [
					29 01 00 00 00 00 02 FF 10
					29 01 00 00 00 00 02 FB 01
					29 01 00 00 00 00 02 FF 20
					29 01 00 00 00 00 02 FB 01
					29 01 00 00 00 00 02 0E B0
					29 01 00 00 00 00 02 0F AE
					29 01 00 00 00 00 02 62 93
					29 01 00 00 00 00 02 6D 44
					29 01 00 00 00 00 02 78 01
					29 01 00 00 00 00 02 95 B9
					29 01 00 00 00 00 02 96 B9
					29 01 00 00 00 00 02 97 B9
					29 01 00 00 00 00 02 98 B9
					29 01 00 00 00 00 02 FF 24
					29 01 00 00 00 00 02 FB 01
					29 01 00 00 00 00 02 00 1C
					29 01 00 00 00 00 02 01 1C
					29 01 00 00 00 00 02 02 1C
					29 01 00 00 00 00 02 03 1C
					29 01 00 00 00 00 02 04 20
					29 01 00 00 00 00 02 05 00
					29 01 00 00 00 00 02 06 09
					29 01 00 00 00 00 02 07 0A
					29 01 00 00 00 00 02 08 1E
					29 01 00 00 00 00 02 09 0D
					29 01 00 00 00 00 02 0A 0D
					29 01 00 00 00 00 02 0B 25
					29 01 00 00 00 00 02 0C 24
					29 01 00 00 00 00 02 0D 01
					29 01 00 00 00 00 02 0E 04
					29 01 00 00 00 00 02 0F 04
					29 01 00 00 00 00 02 10 03
					29 01 00 00 00 00 02 11 03
					29 01 00 00 00 00 02 12 14
					29 01 00 00 00 00 02 13 14
					29 01 00 00 00 00 02 14 12
					29 01 00 00 00 00 02 15 12
					29 01 00 00 00 00 02 16 10
					29 01 00 00 00 00 02 17 1C
					29 01 00 00 00 00 02 18 1C
					29 01 00 00 00 00 02 19 1C
					29 01 00 00 00 00 02 1A 1C
					29 01 00 00 00 00 02 1B 20
					29 01 00 00 00 00 02 1C 0D
					29 01 00 00 00 00 02 1D 09
					29 01 00 00 00 00 02 1E 0A
					29 01 00 00 00 00 02 1F 1E
					29 01 00 00 00 00 02 20 0D
					29 01 00 00 00 00 02 21 0D
					29 01 00 00 00 00 02 22 25
					29 01 00 00 00 00 02 23 24
					29 01 00 00 00 00 02 24 01
					29 01 00 00 00 00 02 25 04
					29 01 00 00 00 00 02 26 04
					29 01 00 00 00 00 02 27 03
					29 01 00 00 00 00 02 28 03
					29 01 00 00 00 00 02 29 14
					29 01 00 00 00 00 02 2A 14
					29 01 00 00 00 00 02 2B 12
					29 01 00 00 00 00 02 2D 12
					29 01 00 00 00 00 02 2F 10
					29 01 00 00 00 00 02 31 02
					29 01 00 00 00 00 02 32 03
					29 01 00 00 00 00 02 33 04
					29 01 00 00 00 00 02 34 02
					29 01 00 00 00 00 02 37 09
					29 01 00 00 00 00 02 38 6A
					29 01 00 00 00 00 02 39 6A
					29 01 00 00 00 00 02 3F 6A
					29 01 00 00 00 00 02 41 02
					29 01 00 00 00 00 02 42 03
					29 01 00 00 00 00 02 4C 10
					29 01 00 00 00 00 02 4D 10
					29 01 00 00 00 00 02 60 90
					29 01 00 00 00 00 02 61 D8
					29 01 00 00 00 00 02 72 00
					29 01 00 00 00 00 02 73 00
					29 01 00 00 00 00 02 74 00
					29 01 00 00 00 00 02 75 00
					29 01 00 00 00 00 02 79 23
					29 01 00 00 00 00 02 7A 0D
					29 01 00 00 00 00 02 7B 98
					29 01 00 00 00 00 02 7C 80
					29 01 00 00 00 00 02 7D 09
					29 01 00 00 00 00 02 80 42
					29 01 00 00 00 00 02 82 11
					29 01 00 00 00 00 02 83 22
					29 01 00 00 00 00 02 84 33
					29 01 00 00 00 00 02 85 00
					29 01 00 00 00 00 02 86 00
					29 01 00 00 00 00 02 87 00
					29 01 00 00 00 00 02 88 11
					29 01 00 00 00 00 02 89 22
					29 01 00 00 00 00 02 8A 33
					29 01 00 00 00 00 02 8B 00
					29 01 00 00 00 00 02 8C 00
					29 01 00 00 00 00 02 8D 00
					29 01 00 00 00 00 02 92 6D
					29 01 00 00 00 00 02 9D B6
					29 01 00 00 00 00 02 B3 02
					29 01 00 00 00 00 02 B4 00
					29 01 00 00 00 00 02 DC 44
					29 01 00 00 00 00 02 DD 03
					29 01 00 00 00 00 02 DF 3E
					29 01 00 00 00 00 02 E0 3E
					29 01 00 00 00 00 02 E1 22
					29 01 00 00 00 00 02 E2 24
					29 01 00 00 00 00 02 E3 09
					29 01 00 00 00 00 02 E4 09
					29 01 00 00 00 00 02 EB 0F
					29 01 00 00 00 00 02 FF 25
					29 01 00 00 00 00 02 FB 01
					29 01 00 00 00 00 02 21 18
					29 01 00 00 00 00 02 22 18
					29 01 00 00 00 00 02 24 6D
					29 01 00 00 00 00 02 25 6D
					29 01 00 00 00 00 02 2F 10
					29 01 00 00 00 00 02 30 2D
					29 01 00 00 00 00 02 38 2D
					29 01 00 00 00 00 02 3F 21
					29 01 00 00 00 00 02 40 65
					29 01 00 00 00 00 02 4B 21
					29 01 00 00 00 00 02 4C 65
					29 01 00 00 00 00 02 58 22
					29 01 00 00 00 00 02 59 04
					29 01 00 00 00 00 02 5A 09
					29 01 00 00 00 00 02 5B 09
					29 01 00 00 00 00 02 5C 25
					29 01 00 00 00 00 02 5E FF
					29 01 00 00 00 00 02 5F 28
					29 01 00 00 00 00 02 66 D8
					29 01 00 00 00 00 02 67 2B
					29 01 00 00 00 00 02 68 58
					29 01 00 00 00 00 02 6B 00
					29 01 00 00 00 00 02 6C 6D
					29 01 00 00 00 00 02 77 72
					29 01 00 00 00 00 02 BF 00
					29 01 00 00 00 00 02 C3 01
					29 01 00 00 00 00 02 FF 26
					29 01 00 00 00 00 02 FB 01
					29 01 00 00 00 00 02 06 FF
					29 01 00 00 00 00 02 0C 11
					29 01 00 00 00 00 02 0F 09
					29 01 00 00 00 00 02 10 0A
					29 01 00 00 00 00 02 12 8C
					29 01 00 00 00 00 02 1A 28
					29 01 00 00 00 00 02 1C AF
					29 01 00 00 00 00 02 1E AB
					29 01 00 00 00 00 02 98 F1
					29 01 00 00 00 00 02 A9 12
					29 01 00 00 00 00 02 AA 10
					29 01 00 00 00 00 02 AE 6A
					29 01 00 00 00 00 02 FF 27
					29 01 00 00 00 00 02 FB 01
					29 01 00 00 00 00 02 13 00
					29 01 00 00 00 00 02 1E 24
					29 01 00 00 00 00 02 FF F0
					29 01 00 00 00 00 02 FB 01
					29 01 00 00 00 00 02 A2 00
					29 01 00 00 00 00 02 FF 20
					29 01 00 00 00 00 02 FB 01
					29 01 00 00 00 00 11 B0 00 00 00 3D 00
						74 00 9A 00 B9 00 D1 00 E6 00 F8
					29 01 00 00 00 00 11 B1 01 08 01 3B 01
						5E 01 95 01 BB 01 F8 02 23 02 25
					29 01 00 00 00 00 11 B2 02 51 02 84 02
						AB 02 E1 02 FB 03 30 03 3E 03 4D
					29 01 00 00 00 00 0D B3 03 5F 03 72 03
						8A 03 A9 03 C9 03 FF
					29 01 00 00 00 00 11 B4 00 00 00 3D 00
						74 00 9A 00 B9 00 D1 00 E6 00 F8
					29 01 00 00 00 00 11 B5 01 08 01 3B 01
						5E 01 95 01 BB 01 F8 02 23 02 25
					29 01 00 00 00 00 11 B6 02 51 02 84 02
						AB 02 E1 02 FB 03 30 03 3E 03 4D
					29 01 00 00 00 00 0D B7 03 5F 03 72 03
						8A 03 A9 03 C9 03 FF
					29 01 00 00 00 00 11 B8 00 00 00 3D 00
						74 00 9A 00 B9 00 D1 00 E6 00 F8
					29 01 00 00 00 00 11 B9 01 08 01 3B 01
						5E 01 95 01 BB 01 F8 02 23 02 25
					29 01 00 00 00 00 11 BA 02 51 02 84 02
						AB 02 E1 02 FB 03 30 03 3E 03 4D
					29 01 00 00 00 00 0D BB 03 5F 03 72 03
						8A 03 A9 03 C9 03 FF
					29 01 00 00 00 00 02 FF 21
					29 01 00 00 00 00 02 FB 01
					29 01 00 00 00 00 11 B0 00 00 00 3D 00
						74 00 9A 00 B9 00 D1 00 E6 00 F8
					29 01 00 00 00 00 11 B1 01 08 01 3B 01
						5E 01 95 01 BB 01 F8 02 23 02 25
					29 01 00 00 00 00 11 B2 02 51 02 84 02
						AB 02 E1 02 FB 03 30 03 3E 03 4D
					29 01 00 00 00 00 0D B3 03 5F 03 72 03
						8A 03 A9 03 C9 03 FF
					29 01 00 00 00 00 11 B4 00 00 00 3D 00
						74 00 9A 00 B9 00 D1 00 E6 00 F8
					29 01 00 00 00 00 11 B5 01 08 01 3B 01
						5E 01 95 01 BB 01 F8 02 23 02 25
					29 01 00 00 00 00 11 B6 02 51 02 84 02
						AB 02 E1 02 FB 03 30 03 3E 03 4D
					29 01 00 00 00 00 0D B7 03 5F 03 72 03
						8A 03 A9 03 C9 03 FF
					29 01 00 00 00 00 11 B8 00 00 00 3D 00
						74 00 9A 00 B9 00 D1 00 E6 00 F8
					29 01 00 00 00 00 11 B9 01 08 01 3B 01
						5E 01 95 01 BB 01 F8 02 23 02 25
					29 01 00 00 00 00 11 BA 02 51 02 84 02
						AB 02 E1 02 FB 03 30 03 3E 03 4D
					29 01 00 00 00 00 0D BB 03 5F 03 72 03
						8A 03 A9 03 C9 03 FF
					29 01 00 00 00 00 02 FF 10
					29 01 00 00 00 00 02 FB 01
					39 01 00 00 00 00 02 51 FF
					39 01 00 00 00 00 02 53 2C
					05 01 00 00 78 00 02 11 00
					05 01 00 00 32 00 02 29 00];
				qcom,mdss-dsi-off-command = [05 01 00 00 14
					00 02 28 00 05 01 00 00 78 00 02 10 00];
				qcom,mdss-dsi-on-command-state = "dsi_lp_mode";
				qcom,mdss-dsi-off-command-state = "dsi_lp_mode";
			};
		};
	};
};
