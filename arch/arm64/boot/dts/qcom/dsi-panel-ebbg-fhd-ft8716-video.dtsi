/* Copyright (c) 2015, The Linux Foundation. All rights reserved.
 * Copyright (C) 2019 XiaoMi, Inc.
 *
 * This program is free software; you can redistribute it and/or modify
 * it under the terms of the GNU General Public License version 2 and
 * only version 2 as published by the Free Software Foundation.
 *
 * This program is distributed in the hope that it will be useful,
 * but WITHOUT ANY WARRANTY; without even the implied warranty of
 * MERCHANTABILITY or FITNESS FOR A PARTICULAR PURPOSE.  See the
 * GNU General Public License for more details.
 */

/*---------------------------------------------------------------------------
 * This file is autogenerated file using gcdb parser. Please do not edit it.
 * Update input XML file to add a new entry or update variable in this file
 * VERSION = "1.0"
 *---------------------------------------------------------------------------*/
&soc {
	dsi_ebbg_fhd_ft8716_video: qcom,mdss_dsi_ebbg_fhd_ft8716_video {
		qcom,mdss-dsi-panel-name = "ebbg fhd video dsi panel";
		qcom,mdss-dsi-panel-id = <0>;
		qcom,mdss-dsi-panel-model = "EBBG FHD FT8716 VIDEO PANEL";
		qcom,mdss-dsi-panel-sleepwrmod = <0>;
		qcom,mdss-dsi-panel-type = "dsi_video_mode";
		qcom,mdss-dsi-virtual-channel-id = <0>;
		qcom,mdss-dsi-stream = <0>;
		qcom,mdss-dsi-bpp = <24>;
		qcom,mdss-dsi-color-order = "rgb_swap_rgb";
		qcom,mdss-dsi-underflow-color = <0x0>;
		qcom,mdss-dsi-border-color = <0>;
		qcom,mdss-dsi-traffic-mode = "burst_mode";
		qcom,mdss-dsi-bllp-eof-power-mode;
		qcom,mdss-dsi-bllp-power-mode;
		qcom,mdss-dsi-lp11-init;
		qcom,mdss-dsi-lane-0-state;
		qcom,mdss-dsi-lane-1-state;
		qcom,mdss-dsi-lane-2-state;
		qcom,mdss-dsi-lane-3-state;

		qcom,mdss-dsi-bl-min-level = <1>;
		qcom,mdss-dsi-bl-max-level = <4095>;
		qcom,mdss-brightness-max-level = <4095>;
		qcom,mdss-dsi-dma-trigger = "trigger_sw";
		qcom,mdss-dsi-mdp-trigger = "none";
		qcom,mdss-dsi-bl-pmic-control-type = "bl_ctrl_wled";
		qcom,mdss-dsi-reset-sequence = <1 5>, <0 2>, <1 6>;
		qcom,mdss-pan-physical-width-dimension = <68>;
		qcom,mdss-pan-physical-height-dimension = <136>;
		qcom,cont-splash-enabled;
		qcom,mdss-dsi-tx-eot-append;
		qcom,mdss-panel-on-dimming-delay = <120>;

		qcom,dispccbb-enabled;
		qcom,dispblnotify-enabled;
		qcom,dispparam-enabled;
		/*qcom,disp-paneloff-disablecabc-enabled;*/
		qcom,mdss-night-brightness = <7 25 43 61>;
		qcom,disp-panel-offon-mode-enabled;
		qcom,mdss-dsi-panel-hdr-enabled;
		qcom,mdss-dsi-panel-hdr-color-primaries = <14500 15500 32000
			17000 15500 30000 8000 3000>;
		qcom,mdss-dsi-panel-peak-brightness = <4200000>;
		qcom,mdss-dsi-panel-blackness-level = <3230>;
		qcom,mdss-dsi-panel-xy-coordinate = <0x04 0x3>;
		qcom,mdss-dsi-panel-max-luminance = <0x01 0x01>;
		qcom,mdss-dsi-panel-bl-info = <308 545 420 700>;

		qcom,esd-check-enabled;
		qcom,mdss-dsi-panel-status-check-mode = "reg_read";
		qcom,mdss-dsi-panel-status-command =
			[06 01 00 01 00 00 01 0A
			 06 01 00 01 00 00 01 0B
			 06 01 00 01 00 00 01 0C
			 06 01 00 01 00 00 01 0D
			 06 01 00 01 00 00 01 0F
			 06 01 00 01 00 00 01 1D
			 06 01 00 01 00 00 01 AC];
		qcom,mdss-dsi-panel-status-command-state = "dsi_hs_mode";
		qcom,mdss-dsi-panel-status-value = <0x9c 0x00 0x07 0x00 0xC0 0x02 0x00>;
		/*qcom,mdss-dsi-panel-on-check-value = <0x9c>;*/
		qcom,mdss-dsi-panel-status-read-length = <1 1 1 1 1 1 1>;
		qcom,mdss-panel-off-keep-reset;

		qcom,mdss-dsi-display-timings {
			timing@0{
				qcom,mdss-dsi-panel-framerate = <60>;
				qcom,mdss-dsi-panel-width = <1080>;
				qcom,mdss-dsi-panel-height = <2160>;
				qcom,mdss-dsi-h-front-porch = <28>;
				qcom,mdss-dsi-h-back-porch = <28>;
				qcom,mdss-dsi-h-pulse-width = <4>;
				qcom,mdss-dsi-h-sync-skew = <0>;
				qcom,mdss-dsi-v-back-porch = <16>;
				qcom,mdss-dsi-v-front-porch = <14>;
				qcom,mdss-dsi-v-pulse-width = <2>;
				qcom,mdss-dsi-h-left-border = <0>;
				qcom,mdss-dsi-h-right-border = <0>;
				qcom,mdss-dsi-v-top-border = <0>;
				qcom,mdss-dsi-v-bottom-border = <0>;

				qcom,mdss-dsi-on-command = [
					15 00 00 00 00 00 02 00 00
					29 00 00 00 00 00 04 FF 87 16 01
					15 00 00 00 00 00 02 00 80
					29 01 00 00 00 00 03 FF 87 16
					15 00 00 00 00 00 02 00 81
					29 01 00 00 00 00 0d F3 F8 E1 00 F8 E1 00 00 1C 00 00 1C 00
					15 00 00 00 00 00 02 00 B3
					15 00 00 00 00 00 02 CA 8C
					15 00 00 00 00 00 02 00 80
					15 00 00 00 00 00 02 A5 BF
					15 00 00 00 00 00 02 00 A1
					15 00 00 00 00 00 02 C0 0C
					15 00 00 00 00 00 02 00 D1
					15 00 00 00 00 00 02 C0 0C
					15 00 00 00 00 00 02 00 88
					29 01 00 00 00 00 05 C2 83 00 12 92
					15 00 00 00 00 00 02 00 CA
					15 00 00 00 00 00 02 CB 02
					15 00 00 00 00 00 02 00 8A
					15 00 00 00 00 00 02 CC 04
					15 00 00 00 00 00 02 00 9A
					15 00 00 00 00 00 02 CC 04
					15 00 00 00 00 00 02 00 A9
					15 00 00 00 00 00 02 CD 0B
					15 00 00 00 00 00 02 00 89
					15 01 00 00 00 00 02 CD 0B
					15 00 00 00 00 00 02 00 80
					29 00 00 00 00 00 0B CA 80 E5 FF 80 FF B2 FF 00 00 00
					15 00 00 00 00 00 02 00 00
					15 00 00 00 00 00 02 C6 10
					15 00 00 00 00 00 02 00 00
					29 00 00 00 00 00 13 C7 90 9A 8B 8B C9 9A 99 A9 A9 A9 BA 99 89 88 67 34 22 22
					15 00 00 00 00 00 02 00 00
					15 00 00 00 00 00 02 C6 11
					15 00 00 00 00 00 02 00 00
					29 00 00 00 00 00 13 C7 90 8A 9B 99 C8 9A 99 99 A9 99 BA 8A 89 88 67 45 33 22
					15 00 00 00 00 00 02 00 00
					15 00 00 00 00 00 02 C6 12
					15 00 00 00 00 00 02 00 00
					29 00 00 00 00 00 13 C7 90 99 9A 8A B9 A9 98 99 A9 99 B9 8A 88 88 78 45 33 33
					15 00 00 00 00 00 02 00 00
					15 00 00 00 00 00 02 C6 13
					15 00 00 00 00 00 02 00 00
					29 00 00 00 00 00 13 C7 80 9A 8A 8A B8 9A 98 99 99 99 A9 9A 88 88 78 56 34 33
					15 00 00 00 00 00 02 00 00
					15 00 00 00 00 00 02 C6 14
					15 00 00 00 00 00 02 00 00
					29 00 00 00 00 00 13 C7 80 8A 9A 89 B8 99 99 98 99 99 B8 8A 88 88 78 56 44 44
					15 00 00 00 00 00 02 00 00
					15 00 00 00 00 00 02 C6 15
					15 00 00 00 00 00 02 00 00
					29 00 00 00 00 00 13 C7 80 99 99 99 A8 99 89 89 99 89 A9 9A 88 88 88 57 44 44
					15 00 00 00 00 00 02 00 00
					15 00 00 00 00 00 02 C6 16
					15 00 00 00 00 00 02 00 00
					29 00 00 00 00 00 13 C7 80 99 99 98 98 8A 89 99 98 89 A9 99 88 88 88 67 55 44
					15 00 00 00 00 00 02 00 00
					15 00 00 00 00 00 02 C6 17
					15 00 00 00 00 00 02 00 00
					29 00 00 00 00 00 13 C7 80 89 99 89 A8 99 88 89 99 98 98 A9 88 88 88 67 55 55
					15 00 00 00 00 00 02 00 00
					15 00 00 00 00 00 02 C6 18
					15 00 00 00 00 00 02 00 00
					29 00 00 00 00 00 13 C7 80 98 99 98 98 89 89 98 98 89 98 99 89 88 88 78 55 55
					15 00 00 00 00 00 02 00 00
					15 00 00 00 00 00 02 C6 19
					15 00 00 00 00 00 02 00 00
					29 00 00 00 00 00 13 C7 80 98 89 89 98 89 89 88 99 88 A8 89 89 88 88 78 66 55
					15 00 00 00 00 00 02 00 00
					15 00 00 00 00 00 02 C6 1A
					15 00 00 00 00 00 02 00 00
					29 00 00 00 00 00 13 C7 80 88 99 88 98 89 89 88 89 98 98 98 89 88 88 78 66 66
					15 00 00 00 00 00 02 00 00
					15 00 00 00 00 00 02 C6 1B
					15 00 00 00 00 00 02 00 00
					29 00 00 00 00 00 13 C7 80 88 89 98 88 89 88 89 98 88 98 89 89 88 88 88 67 66
					15 00 00 00 00 00 02 00 00
					15 00 00 00 00 00 02 C6 1C
					15 00 00 00 00 00 02 00 00
					29 00 00 00 00 00 13 C7 80 88 98 88 98 98 88 88 98 88 98 98 88 88 88 88 77 67
					15 00 00 00 00 00 02 00 00
					15 00 00 00 00 00 02 C6 1D
					15 00 00 00 00 00 02 00 00
					29 00 00 00 00 00 13 C7 80 88 88 98 88 98 88 88 98 88 88 98 88 88 88 88 78 77
					15 00 00 00 00 00 02 00 00
					15 00 00 00 00 00 02 C6 1E
					15 00 00 00 00 00 02 00 00
					29 00 00 00 00 00 13 C7 80 88 88 88 88 89 88 88 88 98 97 88 88 88 88 88 88 78
					15 00 00 00 00 00 02 00 00
					15 00 00 00 00 00 02 C6 1F
					15 00 00 00 00 00 02 00 00
					29 00 00 00 00 00 13 C7 80 88 88 88 88 88 88 88 88 88 89 88 88 88 88 88 88 88
					15 00 00 00 00 00 02 00 00
					15 01 00 00 00 00 02 C6 00
					15 00 00 00 00 00 02 00 A0
					29 00 00 00 00 00 0D D6 0d 0a 07 04 08 10 11 0F 0E 15 13 0F
					15 00 00 00 00 00 02 00 B0
					29 00 00 00 00 00 0D D6 83 88 79 68 62 65 68 70 7F 8C 8D 92
					15 00 00 00 00 00 02 00 C0
					29 00 00 00 00 00 0D D6 6d 6b 6A 66 68 70 73 74 75 76 74 72
					15 00 00 00 00 00 02 00 D0
					29 01 00 00 00 00 0D D6 63 68 80 80 80 80 80 80 80 80 80 80
					15 00 00 00 00 00 02 00 00
					29 01 00 00 00 00 04 FF 00 00 00
					15 00 00 00 00 00 02 00 80
					29 01 00 00 00 00 03 FF 00 00
					15 00 00 00 00 00 02 00 00
					29 00 00 00 00 00 05 2A 00 00 04 37
					15 00 00 00 00 00 02 00 00
					29 01 00 00 00 00 05 2B 00 00 08 6F
					15 00 00 00 00 00 02 91 80
					15 00 00 00 00 00 02 00 00
					29 01 00 00 00 00 04 ff 87 16 01
					15 00 00 00 00 00 02 00 80
					29 01 00 00 00 00 03 ff 87 16
					15 00 00 00 00 00 02 00 81
					29 00 00 00 00 00 0d f3 f8 e1 00 f8 e1 00 00 1e 00 00 1e 00

					15 00 00 00 00 00 02 51 FF
					15 00 00 00 00 00 02 53 24
					15 00 00 00 00 00 02 55 00
					05 01 00 00 5A 00 02 11 00
					05 01 00 00 00 00 02 29 00
					];
				qcom,mdss-dsi-off-command = [
						05 01 00 00 0A 00 02 28 00
						05 01 00 00 5A 00 02 10 00
						15 01 00 00 00 00 02 00 00
						29 01 00 00 05 00 05 F7 5A A5 87 16
						];
				qcom,mdss-dsi-on-command-state = "dsi_lp_mode";
				qcom,mdss-dsi-off-command-state = "dsi_lp_mode";
				qcom,mdss-dsi-displayoff-command = [05 01 00 00 16 00 02 28 00];
				qcom,mdss-dsi-displayon-command = [05 01 00 00 14 00 02 29 00];
				qcom,mdss-dsi-displayoff-command-state = "dsi_hs_mode";
				qcom,mdss-dsi-displayon-command-state = "dsi_hs_mode";
				qcom,mdss-dsi-h-sync-pulse = <1>;

				qcom,mdss-dsi-dispparam-cabcuion-command = [
					15 01 00 00 00 00 02 55 01
					15 01 00 00 00 00 02 91 00
					];
				qcom,mdss-dsi-dispparam-cabcuion-command-state = "dsi_hs_mode";
				qcom,mdss-dsi-dispparam-cabcstillon-command = [
					15 01 00 00 00 00 02 55 02
					15 01 00 00 00 00 02 91 00
					];
				qcom,mdss-dsi-dispparam-cabcstillon-command-state = "dsi_hs_mode";
				qcom,mdss-dsi-dispparam-cabcmovieon-command = [
					15 01 00 00 00 00 02 55 03
					15 01 00 00 00 00 02 91 00
					];
				qcom,mdss-dsi-dispparam-cabcmovieon-command-state = "dsi_hs_mode";
				qcom,mdss-dsi-dispparam-cabcoff-command = [
					15 01 00 00 00 00 02 55 00
					15 01 00 00 00 00 02 91 00
					];
				qcom,mdss-dsi-dispparam-cabcoff-command-state = "dsi_hs_mode";

				qcom,mdss-dsi-dispparam-skince-cabcuion-command = [
					15 01 00 00 00 00 02 55 01
					15 01 00 00 00 00 02 91 80];
				qcom,mdss-dsi-dispparam-skince-cabcuion-command-state = "dsi_hs_mode";
				qcom,mdss-dsi-dispparam-skince-cabcstillon-command = [
					15 00 00 00 00 00 02 55 02
					15 01 00 00 00 00 02 91 80];
				qcom,mdss-dsi-dispparam-skince-cabcstillon-command-state = "dsi_hs_mode";
				qcom,mdss-dsi-dispparam-skince-cabcmovieon-command = [
					15 01 00 00 00 00 02 55 03
					15 01 00 00 00 00 02 91 80];
				qcom,mdss-dsi-dispparam-skince-cabcmovieon-command-state = "dsi_hs_mode";
				qcom,mdss-dsi-dispparam-skince-cabcoff-command = [
					15 01 00 00 01 00 02 55 00
					15 01 00 00 00 00 02 91 80];
				qcom,mdss-dsi-dispparam-skince-cabcoff-command-state = "dsi_hs_mode";

				qcom,mdss-dsi-dispparam-dimmingon-command = [
					39 01 00 00 01 00 02 53 2C
					];
				qcom,mdss-dsi-dispparam-dimmingon-command-state = "dsi_hs_mode";
				qcom,mdss-dsi-dispparam-idleon-command = [
					39 01 00 00 01 00 02 39 00
					];
				qcom,mdss-dsi-dispparam-idleoff-command = [
					39 01 00 00 01 00 02 38 00
					];
				qcom,mdss-dsi-dispparam-xy-coordinate-command = [
					06 01 00 01 05 00 02 A1 00];
				qcom,mdss-dsi-dispparam-xy-coordinate-command-state = "dsi_hs_mode";
				qcom,mdss-dsi-dispparam-max-luminance-command = [
					06 01 00 01 05 00 02 DC 00];
				qcom,mdss-dsi-dispparam-max-luminance-command-state = "dsi_hs_mode";
			};
		};
	};
};
