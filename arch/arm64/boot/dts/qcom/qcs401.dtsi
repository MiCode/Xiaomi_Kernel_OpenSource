/*
 * Copyright (c) 2018-2019, The Linux Foundation. All rights reserved.
 *
 * This program is free software; you can redistribute it and/or modify
 * it under the terms of the GNU General Public License version 2 and
 * only version 2 as published by the Free Software Foundation.
 *
 * This program is distributed in the hope that it will be useful,
 * but WITHOUT ANY WARRANTY; without even the implied warranty of
 * MERCHANTABILITY or FITNESS FOR A PARTICULAR PURPOSE.  See the
 * GNU General Public License for more details.
 */

#include "qcs403.dtsi"

/ {
	model = "Qualcomm Technologies, Inc. QCS401";
	qcom,msm-name = "QCS401";
	qcom,msm-id = <372 0x0>;
};

&soc {
	/delete-node/ qcom,turing@800000;
};
