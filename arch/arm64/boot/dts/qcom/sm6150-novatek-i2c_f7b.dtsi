/*
 * Copyright (C) 2010 - 2017 Novatek, Inc.
 * Copyright (C) 2021 XiaoMi, Inc.
 *
 * $Revision: 33334 $
 * $Date: 2018-09-04 19:17:10 +0800 (週二, 04 九月 2018) $
 *
 * This program is free software; you can redistribute it and/or modify
 * it under the terms of the GNU General Public License as published by
 * the Free Software Foundation; either version 2 of the License, or
 * (at your option) any later version.
 *
 * This program is distributed in the hope that it will be useful, but WITHOUT
 * ANY WARRANTY; without even the implied warranty of MERCHANTABILITY or
 * FITNESS FOR A PARTICULAR PURPOSE.  See the GNU General Public License for
 * more details.
 *
 */


&qupv3_se1_i2c {
	//status = "okay";
	/* Novatek device tree node */
	novatek@62 {
		status = "okay";
		compatible = "novatek,NVT-ts";
		reg = <0x62>;
		interrupt-parent = <&tlmm>;
		interrupts = <89 0x2008>;
		//vcc_i2c-supply=<&pm6150_l13>;

		novatek,reset-gpio = <&tlmm 88 0x00>;
		novatek,irq-gpio = <&tlmm 89 0x2001>;
		/* MP */
		novatek,mp-support-dt;

		// for Xiaomi F7B Tianma NVT36672A
		novatek-mp-criteria-5915@0 {
			#address-cells = <1>;
			#size-cells = <0>;
			compatible = "novatek-mp-criteria-5915";

			/* MP Config */
			IC_X_CFG_SIZE = <18>;
			IC_Y_CFG_SIZE = <36>;
			IC_KEY_CFG_SIZE = <0>;
			X_Channel = <18>;
			Y_Channel = <36>;
			AIN_X = <0 1 2 3 4 5 6 7 8 9 10 11 12 13 14 15 16 17>;
			AIN_Y = <0 1 2 3 4 5 6 7 8 9 10 11 12 13 14 15 16 17
					 18 19 20 21 22 23 24 25 26 27 28 29 30 31 32 33 34 35>;
			AIN_KEY = <0 1 2 0xFF>;

			/* MP Criteria */
			PS_Config_Lmt_Short_Rawdata_P = <
				14000 14000 14000 14000 14000 14000 14000 14000 14000 14000 14000 14000 14000 14000 14000 14000 14000 14000
				14000 14000 14000 14000 14000 14000 14000 14000 14000 14000 14000 14000 14000 14000 14000 14000 14000 14000
				14000 14000 14000 14000 14000 14000 14000 14000 14000 14000 14000 14000 14000 14000 14000 14000 14000 14000
				14000 14000 14000 14000 14000 14000 14000 14000 14000 14000 14000 14000 14000 14000 14000 14000 14000 14000
				14000 14000 14000 14000 14000 14000 14000 14000 14000 14000 14000 14000 14000 14000 14000 14000 14000 14000
				14000 14000 14000 14000 14000 14000 14000 14000 14000 14000 14000 14000 14000 14000 14000 14000 14000 14000
				14000 14000 14000 14000 14000 14000 14000 14000 14000 14000 14000 14000 14000 14000 14000 14000 14000 14000
				14000 14000 14000 14000 14000 14000 14000 14000 14000 14000 14000 14000 14000 14000 14000 14000 14000 14000
				14000 14000 14000 14000 14000 14000 14000 14000 14000 14000 14000 14000 14000 14000 14000 14000 14000 14000
				14000 14000 14000 14000 14000 14000 14000 14000 14000 14000 14000 14000 14000 14000 14000 14000 14000 14000
				14000 14000 14000 14000 14000 14000 14000 14000 14000 14000 14000 14000 14000 14000 14000 14000 14000 14000
				14000 14000 14000 14000 14000 14000 14000 14000 14000 14000 14000 14000 14000 14000 14000 14000 14000 14000
				14000 14000 14000 14000 14000 14000 14000 14000 14000 14000 14000 14000 14000 14000 14000 14000 14000 14000
				14000 14000 14000 14000 14000 14000 14000 14000 14000 14000 14000 14000 14000 14000 14000 14000 14000 14000
				14000 14000 14000 14000 14000 14000 14000 14000 14000 14000 14000 14000 14000 14000 14000 14000 14000 14000
				14000 14000 14000 14000 14000 14000 14000 14000 14000 14000 14000 14000 14000 14000 14000 14000 14000 14000
				14000 14000 14000 14000 14000 14000 14000 14000 14000 14000 14000 14000 14000 14000 14000 14000 14000 14000
				14000 14000 14000 14000 14000 14000 14000 14000 14000 14000 14000 14000 14000 14000 14000 14000 14000 14000
				14000 14000 14000 14000 14000 14000 14000 14000 14000 14000 14000 14000 14000 14000 14000 14000 14000 14000
				14000 14000 14000 14000 14000 14000 14000 14000 14000 14000 14000 14000 14000 14000 14000 14000 14000 14000
				14000 14000 14000 14000 14000 14000 14000 14000 14000 14000 14000 14000 14000 14000 14000 14000 14000 14000
				14000 14000 14000 14000 14000 14000 14000 14000 14000 14000 14000 14000 14000 14000 14000 14000 14000 14000
				14000 14000 14000 14000 14000 14000 14000 14000 14000 14000 14000 14000 14000 14000 14000 14000 14000 14000
				14000 14000 14000 14000 14000 14000 14000 14000 14000 14000 14000 14000 14000 14000 14000 14000 14000 14000
				14000 14000 14000 14000 14000 14000 14000 14000 14000 14000 14000 14000 14000 14000 14000 14000 14000 14000
				14000 14000 14000 14000 14000 14000 14000 14000 14000 14000 14000 14000 14000 14000 14000 14000 14000 14000
				14000 14000 14000 14000 14000 14000 14000 14000 14000 14000 14000 14000 14000 14000 14000 14000 14000 14000
				14000 14000 14000 14000 14000 14000 14000 14000 14000 14000 14000 14000 14000 14000 14000 14000 14000 14000
				14000 14000 14000 14000 14000 14000 14000 14000 14000 14000 14000 14000 14000 14000 14000 14000 14000 14000
				14000 14000 14000 14000 14000 14000 14000 14000 14000 14000 14000 14000 14000 14000 14000 14000 14000 14000
				14000 14000 14000 14000 14000 14000 14000 14000 14000 14000 14000 14000 14000 14000 14000 14000 14000 14000
				14000 14000 14000 14000 14000 14000 14000 14000 14000 14000 14000 14000 14000 14000 14000 14000 14000 14000
				14000 14000 14000 14000 14000 14000 14000 14000 14000 14000 14000 14000 14000 14000 14000 14000 14000 14000
				14000 14000 14000 14000 14000 14000 14000 14000 14000 14000 14000 14000 14000 14000 14000 14000 14000 14000
				14000 14000 14000 14000 14000 14000 14000 14000 14000 14000 14000 14000 14000 14000 14000 14000 14000 14000
				14000 14000 14000 14000 14000 14000 14000 14000 14000 14000 14000 14000 14000 14000 14000 14000 14000 14000
				20000 20000 20000>;

			PS_Config_Lmt_Short_Rawdata_N = <
				11000 11000 11000 11000 11000 11000 11000 11000 11000 11000 11000 11000 11000 11000 11000 11000 11000 11000
				11000 11000 11000 11000 11000 11000 11000 11000 11000 11000 11000 11000 11000 11000 11000 11000 11000 11000
				11000 11000 11000 11000 11000 11000 11000 11000 11000 11000 11000 11000 11000 11000 11000 11000 11000 11000
				11000 11000 11000 11000 11000 11000 11000 11000 11000 11000 11000 11000 11000 11000 11000 11000 11000 11000
				11000 11000 11000 11000 11000 11000 11000 11000 11000 11000 11000 11000 11000 11000 11000 11000 11000 11000
				11000 11000 11000 11000 11000 11000 11000 11000 11000 11000 11000 11000 11000 11000 11000 11000 11000 11000
				11000 11000 11000 11000 11000 11000 11000 11000 11000 11000 11000 11000 11000 11000 11000 11000 11000 11000
				11000 11000 11000 11000 11000 11000 11000 11000 11000 11000 11000 11000 11000 11000 11000 11000 11000 11000
				11000 11000 11000 11000 11000 11000 11000 11000 11000 11000 11000 11000 11000 11000 11000 11000 11000 11000
				11000 11000 11000 11000 11000 11000 11000 11000 11000 11000 11000 11000 11000 11000 11000 11000 11000 11000
				11000 11000 11000 11000 11000 11000 11000 11000 11000 11000 11000 11000 11000 11000 11000 11000 11000 11000
				11000 11000 11000 11000 11000 11000 11000 11000 11000 11000 11000 11000 11000 11000 11000 11000 11000 11000
				11000 11000 11000 11000 11000 11000 11000 11000 11000 11000 11000 11000 11000 11000 11000 11000 11000 11000
				11000 11000 11000 11000 11000 11000 11000 11000 11000 11000 11000 11000 11000 11000 11000 11000 11000 11000
				11000 11000 11000 11000 11000 11000 11000 11000 11000 11000 11000 11000 11000 11000 11000 11000 11000 11000
				11000 11000 11000 11000 11000 11000 11000 11000 11000 11000 11000 11000 11000 11000 11000 11000 11000 11000
				11000 11000 11000 11000 11000 11000 11000 11000 11000 11000 11000 11000 11000 11000 11000 11000 11000 11000
				11000 11000 11000 11000 11000 11000 11000 11000 11000 11000 11000 11000 11000 11000 11000 11000 11000 11000
				11000 11000 11000 11000 11000 11000 11000 11000 11000 11000 11000 11000 11000 11000 11000 11000 11000 11000
				11000 11000 11000 11000 11000 11000 11000 11000 11000 11000 11000 11000 11000 11000 11000 11000 11000 11000
				11000 11000 11000 11000 11000 11000 11000 11000 11000 11000 11000 11000 11000 11000 11000 11000 11000 11000
				11000 11000 11000 11000 11000 11000 11000 11000 11000 11000 11000 11000 11000 11000 11000 11000 11000 11000
				11000 11000 11000 11000 11000 11000 11000 11000 11000 11000 11000 11000 11000 11000 11000 11000 11000 11000
				11000 11000 11000 11000 11000 11000 11000 11000 11000 11000 11000 11000 11000 11000 11000 11000 11000 11000
				11000 11000 11000 11000 11000 11000 11000 11000 11000 11000 11000 11000 11000 11000 11000 11000 11000 11000
				11000 11000 11000 11000 11000 11000 11000 11000 11000 11000 11000 11000 11000 11000 11000 11000 11000 11000
				11000 11000 11000 11000 11000 11000 11000 11000 11000 11000 11000 11000 11000 11000 11000 11000 11000 11000
				11000 11000 11000 11000 11000 11000 11000 11000 11000 11000 11000 11000 11000 11000 11000 11000 11000 11000
				11000 11000 11000 11000 11000 11000 11000 11000 11000 11000 11000 11000 11000 11000 11000 11000 11000 11000
				11000 11000 11000 11000 11000 11000 11000 11000 11000 11000 11000 11000 11000 11000 11000 11000 11000 11000
				11000 11000 11000 11000 11000 11000 11000 11000 11000 11000 11000 11000 11000 11000 11000 11000 11000 11000
				11000 11000 11000 11000 11000 11000 11000 11000 11000 11000 11000 11000 11000 11000 11000 11000 11000 11000
				11000 11000 11000 11000 11000 11000 11000 11000 11000 11000 11000 11000 11000 11000 11000 11000 11000 11000
				11000 11000 11000 11000 11000 11000 11000 11000 11000 11000 11000 11000 11000 11000 11000 11000 11000 11000
				11000 11000 11000 11000 11000 11000 11000 11000 11000 11000 11000 11000 11000 11000 11000 11000 11000 11000
				11000 11000 11000 11000 11000 11000 11000 11000 11000 11000 11000 11000 11000 11000 11000 11000 11000 11000
				11550 11550 11550>;

			PS_Config_Lmt_Short_Diff_P = <
				6300 6300 6300 6300 6300 6300 6300 6300 6300 6300 6300 6300 6300 6300 6300 6300 6300 6300
				6300 6300 6300 6300 6300 6300 6300 6300 6300 6300 6300 6300 6300 6300 6300 6300 6300 6300
				6300 6300 6300 6300 6300 6300 6300 6300 6300 6300 6300 6300 6300 6300 6300 6300 6300 6300
				6300 6300 6300 6300 6300 6300 6300 6300 6300 6300 6300 6300 6300 6300 6300 6300 6300 6300
				6300 6300 6300 6300 6300 6300 6300 6300 6300 6300 6300 6300 6300 6300 6300 6300 6300 6300
				6300 6300 6300 6300 6300 6300 6300 6300 6300 6300 6300 6300 6300 6300 6300 6300 6300 6300
				6300 6300 6300 6300 6300 6300 6300 6300 6300 6300 6300 6300 6300 6300 6300 6300 6300 6300
				6300 6300 6300 6300 6300 6300 6300 6300 6300 6300 6300 6300 6300 6300 6300 6300 6300 6300
				6300 6300 6300 6300 6300 6300 6300 6300 6300 6300 6300 6300 6300 6300 6300 6300 6300 6300
				6300 6300 6300 6300 6300 6300 6300 6300 6300 6300 6300 6300 6300 6300 6300 6300 6300 6300
				6300 6300 6300 6300 6300 6300 6300 6300 6300 6300 6300 6300 6300 6300 6300 6300 6300 6300
				6300 6300 6300 6300 6300 6300 6300 6300 6300 6300 6300 6300 6300 6300 6300 6300 6300 6300
				6300 6300 6300 6300 6300 6300 6300 6300 6300 6300 6300 6300 6300 6300 6300 6300 6300 6300
				6300 6300 6300 6300 6300 6300 6300 6300 6300 6300 6300 6300 6300 6300 6300 6300 6300 6300
				6300 6300 6300 6300 6300 6300 6300 6300 6300 6300 6300 6300 6300 6300 6300 6300 6300 6300
				6300 6300 6300 6300 6300 6300 6300 6300 6300 6300 6300 6300 6300 6300 6300 6300 6300 6300
				6300 6300 6300 6300 6300 6300 6300 6300 6300 6300 6300 6300 6300 6300 6300 6300 6300 6300
				6300 6300 6300 6300 6300 6300 6300 6300 6300 6300 6300 6300 6300 6300 6300 6300 6300 6300
				6300 6300 6300 6300 6300 6300 6300 6300 6300 6300 6300 6300 6300 6300 6300 6300 6300 6300
				6300 6300 6300 6300 6300 6300 6300 6300 6300 6300 6300 6300 6300 6300 6300 6300 6300 6300
				6300 6300 6300 6300 6300 6300 6300 6300 6300 6300 6300 6300 6300 6300 6300 6300 6300 6300
				6300 6300 6300 6300 6300 6300 6300 6300 6300 6300 6300 6300 6300 6300 6300 6300 6300 6300
				6300 6300 6300 6300 6300 6300 6300 6300 6300 6300 6300 6300 6300 6300 6300 6300 6300 6300
				6300 6300 6300 6300 6300 6300 6300 6300 6300 6300 6300 6300 6300 6300 6300 6300 6300 6300
				6300 6300 6300 6300 6300 6300 6300 6300 6300 6300 6300 6300 6300 6300 6300 6300 6300 6300
				6300 6300 6300 6300 6300 6300 6300 6300 6300 6300 6300 6300 6300 6300 6300 6300 6300 6300
				6300 6300 6300 6300 6300 6300 6300 6300 6300 6300 6300 6300 6300 6300 6300 6300 6300 6300
				6300 6300 6300 6300 6300 6300 6300 6300 6300 6300 6300 6300 6300 6300 6300 6300 6300 6300
				6300 6300 6300 6300 6300 6300 6300 6300 6300 6300 6300 6300 6300 6300 6300 6300 6300 6300
				6300 6300 6300 6300 6300 6300 6300 6300 6300 6300 6300 6300 6300 6300 6300 6300 6300 6300
				6300 6300 6300 6300 6300 6300 6300 6300 6300 6300 6300 6300 6300 6300 6300 6300 6300 6300
				6300 6300 6300 6300 6300 6300 6300 6300 6300 6300 6300 6300 6300 6300 6300 6300 6300 6300
				6300 6300 6300>;

			PS_Config_Lmt_Short_Diff_N = <
				0 0 0 0 0 0 0 0 0 0 0 0 0 0 0 0 0 0
				0 0 0 0 0 0 0 0 0 0 0 0 0 0 0 0 0 0
				0 0 0 0 0 0 0 0 0 0 0 0 0 0 0 0 0 0
				0 0 0 0 0 0 0 0 0 0 0 0 0 0 0 0 0 0
				0 0 0 0 0 0 0 0 0 0 0 0 0 0 0 0 0 0
				0 0 0 0 0 0 0 0 0 0 0 0 0 0 0 0 0 0
				0 0 0 0 0 0 0 0 0 0 0 0 0 0 0 0 0 0
				0 0 0 0 0 0 0 0 0 0 0 0 0 0 0 0 0 0
				0 0 0 0 0 0 0 0 0 0 0 0 0 0 0 0 0 0
				0 0 0 0 0 0 0 0 0 0 0 0 0 0 0 0 0 0
				0 0 0 0 0 0 0 0 0 0 0 0 0 0 0 0 0 0
				0 0 0 0 0 0 0 0 0 0 0 0 0 0 0 0 0 0
				0 0 0 0 0 0 0 0 0 0 0 0 0 0 0 0 0 0
				0 0 0 0 0 0 0 0 0 0 0 0 0 0 0 0 0 0
				0 0 0 0 0 0 0 0 0 0 0 0 0 0 0 0 0 0
				0 0 0 0 0 0 0 0 0 0 0 0 0 0 0 0 0 0
				0 0 0 0 0 0 0 0 0 0 0 0 0 0 0 0 0 0
				0 0 0 0 0 0 0 0 0 0 0 0 0 0 0 0 0 0
				0 0 0 0 0 0 0 0 0 0 0 0 0 0 0 0 0 0
				0 0 0 0 0 0 0 0 0 0 0 0 0 0 0 0 0 0
				0 0 0 0 0 0 0 0 0 0 0 0 0 0 0 0 0 0
				0 0 0 0 0 0 0 0 0 0 0 0 0 0 0 0 0 0
				0 0 0 0 0 0 0 0 0 0 0 0 0 0 0 0 0 0
				0 0 0 0 0 0 0 0 0 0 0 0 0 0 0 0 0 0
				0 0 0 0 0 0 0 0 0 0 0 0 0 0 0 0 0 0
				0 0 0 0 0 0 0 0 0 0 0 0 0 0 0 0 0 0
				0 0 0 0 0 0 0 0 0 0 0 0 0 0 0 0 0 0
				0 0 0 0 0 0 0 0 0 0 0 0 0 0 0 0 0 0
				0 0 0 0 0 0 0 0 0 0 0 0 0 0 0 0 0 0
				0 0 0 0 0 0 0 0 0 0 0 0 0 0 0 0 0 0
				0 0 0 0 0 0 0 0 0 0 0 0 0 0 0 0 0 0
				0 0 0 0 0 0 0 0 0 0 0 0 0 0 0 0 0 0
				0 0 0>;

			PS_Config_Lmt_Short_Base_P = <
				2000 2000 2000 2000 2000 2000 2000 2000 2000 2000 2000 2000 2000 2000 2000 2000 2000 2000
				2000 2000 2000 2000 2000 2000 2000 2000 2000 2000 2000 2000 2000 2000 2000 2000 2000 2000
				2000 2000 2000 2000 2000 2000 2000 2000 2000 2000 2000 2000 2000 2000 2000 2000 2000 2000
				2000 2000 2000 2000 2000 2000 2000 2000 2000 2000 2000 2000 2000 2000 2000 2000 2000 2000
				2000 2000 2000 2000 2000 2000 2000 2000 2000 2000 2000 2000 2000 2000 2000 2000 2000 2000
				2000 2000 2000 2000 2000 2000 2000 2000 2000 2000 2000 2000 2000 2000 2000 2000 2000 2000
				2000 2000 2000 2000 2000 2000 2000 2000 2000 2000 2000 2000 2000 2000 2000 2000 2000 2000
				2000 2000 2000 2000 2000 2000 2000 2000 2000 2000 2000 2000 2000 2000 2000 2000 2000 2000
				2000 2000 2000 2000 2000 2000 2000 2000 2000 2000 2000 2000 2000 2000 2000 2000 2000 2000
				2000 2000 2000 2000 2000 2000 2000 2000 2000 2000 2000 2000 2000 2000 2000 2000 2000 2000
				2000 2000 2000 2000 2000 2000 2000 2000 2000 2000 2000 2000 2000 2000 2000 2000 2000 2000
				2000 2000 2000 2000 2000 2000 2000 2000 2000 2000 2000 2000 2000 2000 2000 2000 2000 2000
				2000 2000 2000 2000 2000 2000 2000 2000 2000 2000 2000 2000 2000 2000 2000 2000 2000 2000
				2000 2000 2000 2000 2000 2000 2000 2000 2000 2000 2000 2000 2000 2000 2000 2000 2000 2000
				2000 2000 2000 2000 2000 2000 2000 2000 2000 2000 2000 2000 2000 2000 2000 2000 2000 2000
				2000 2000 2000 2000 2000 2000 2000 2000 2000 2000 2000 2000 2000 2000 2000 2000 2000 2000
				2000 2000 2000 2000 2000 2000 2000 2000 2000 2000 2000 2000 2000 2000 2000 2000 2000 2000
				2000 2000 2000 2000 2000 2000 2000 2000 2000 2000 2000 2000 2000 2000 2000 2000 2000 2000
				2000 2000 2000 2000 2000 2000 2000 2000 2000 2000 2000 2000 2000 2000 2000 2000 2000 2000
				2000 2000 2000 2000 2000 2000 2000 2000 2000 2000 2000 2000 2000 2000 2000 2000 2000 2000
				2000 2000 2000 2000 2000 2000 2000 2000 2000 2000 2000 2000 2000 2000 2000 2000 2000 2000
				2000 2000 2000 2000 2000 2000 2000 2000 2000 2000 2000 2000 2000 2000 2000 2000 2000 2000
				2000 2000 2000 2000 2000 2000 2000 2000 2000 2000 2000 2000 2000 2000 2000 2000 2000 2000
				2000 2000 2000 2000 2000 2000 2000 2000 2000 2000 2000 2000 2000 2000 2000 2000 2000 2000
				2000 2000 2000 2000 2000 2000 2000 2000 2000 2000 2000 2000 2000 2000 2000 2000 2000 2000
				2000 2000 2000 2000 2000 2000 2000 2000 2000 2000 2000 2000 2000 2000 2000 2000 2000 2000
				2000 2000 2000 2000 2000 2000 2000 2000 2000 2000 2000 2000 2000 2000 2000 2000 2000 2000
				2000 2000 2000 2000 2000 2000 2000 2000 2000 2000 2000 2000 2000 2000 2000 2000 2000 2000
				2000 2000 2000 2000 2000 2000 2000 2000 2000 2000 2000 2000 2000 2000 2000 2000 2000 2000
				2000 2000 2000 2000 2000 2000 2000 2000 2000 2000 2000 2000 2000 2000 2000 2000 2000 2000
				2000 2000 2000 2000 2000 2000 2000 2000 2000 2000 2000 2000 2000 2000 2000 2000 2000 2000
				2000 2000 2000 2000 2000 2000 2000 2000 2000 2000 2000 2000 2000 2000 2000 2000 2000 2000
				2000 2000 2000>;

			PS_Config_Lmt_Short_Base_N = <
				(-2000) (-2000) (-2000) (-2000) (-2000) (-2000) (-2000) (-2000) (-2000) (-2000) (-2000) (-2000) (-2000) (-2000) (-2000) (-2000) (-2000) (-2000)
				(-2000) (-2000) (-2000) (-2000) (-2000) (-2000) (-2000) (-2000) (-2000) (-2000) (-2000) (-2000) (-2000) (-2000) (-2000) (-2000) (-2000) (-2000)
				(-2000) (-2000) (-2000) (-2000) (-2000) (-2000) (-2000) (-2000) (-2000) (-2000) (-2000) (-2000) (-2000) (-2000) (-2000) (-2000) (-2000) (-2000)
				(-2000) (-2000) (-2000) (-2000) (-2000) (-2000) (-2000) (-2000) (-2000) (-2000) (-2000) (-2000) (-2000) (-2000) (-2000) (-2000) (-2000) (-2000)
				(-2000) (-2000) (-2000) (-2000) (-2000) (-2000) (-2000) (-2000) (-2000) (-2000) (-2000) (-2000) (-2000) (-2000) (-2000) (-2000) (-2000) (-2000)
				(-2000) (-2000) (-2000) (-2000) (-2000) (-2000) (-2000) (-2000) (-2000) (-2000) (-2000) (-2000) (-2000) (-2000) (-2000) (-2000) (-2000) (-2000)
				(-2000) (-2000) (-2000) (-2000) (-2000) (-2000) (-2000) (-2000) (-2000) (-2000) (-2000) (-2000) (-2000) (-2000) (-2000) (-2000) (-2000) (-2000)
				(-2000) (-2000) (-2000) (-2000) (-2000) (-2000) (-2000) (-2000) (-2000) (-2000) (-2000) (-2000) (-2000) (-2000) (-2000) (-2000) (-2000) (-2000)
				(-2000) (-2000) (-2000) (-2000) (-2000) (-2000) (-2000) (-2000) (-2000) (-2000) (-2000) (-2000) (-2000) (-2000) (-2000) (-2000) (-2000) (-2000)
				(-2000) (-2000) (-2000) (-2000) (-2000) (-2000) (-2000) (-2000) (-2000) (-2000) (-2000) (-2000) (-2000) (-2000) (-2000) (-2000) (-2000) (-2000)
				(-2000) (-2000) (-2000) (-2000) (-2000) (-2000) (-2000) (-2000) (-2000) (-2000) (-2000) (-2000) (-2000) (-2000) (-2000) (-2000) (-2000) (-2000)
				(-2000) (-2000) (-2000) (-2000) (-2000) (-2000) (-2000) (-2000) (-2000) (-2000) (-2000) (-2000) (-2000) (-2000) (-2000) (-2000) (-2000) (-2000)
				(-2000) (-2000) (-2000) (-2000) (-2000) (-2000) (-2000) (-2000) (-2000) (-2000) (-2000) (-2000) (-2000) (-2000) (-2000) (-2000) (-2000) (-2000)
				(-2000) (-2000) (-2000) (-2000) (-2000) (-2000) (-2000) (-2000) (-2000) (-2000) (-2000) (-2000) (-2000) (-2000) (-2000) (-2000) (-2000) (-2000)
				(-2000) (-2000) (-2000) (-2000) (-2000) (-2000) (-2000) (-2000) (-2000) (-2000) (-2000) (-2000) (-2000) (-2000) (-2000) (-2000) (-2000) (-2000)
				(-2000) (-2000) (-2000) (-2000) (-2000) (-2000) (-2000) (-2000) (-2000) (-2000) (-2000) (-2000) (-2000) (-2000) (-2000) (-2000) (-2000) (-2000)
				(-2000) (-2000) (-2000) (-2000) (-2000) (-2000) (-2000) (-2000) (-2000) (-2000) (-2000) (-2000) (-2000) (-2000) (-2000) (-2000) (-2000) (-2000)
				(-2000) (-2000) (-2000) (-2000) (-2000) (-2000) (-2000) (-2000) (-2000) (-2000) (-2000) (-2000) (-2000) (-2000) (-2000) (-2000) (-2000) (-2000)
				(-2000) (-2000) (-2000) (-2000) (-2000) (-2000) (-2000) (-2000) (-2000) (-2000) (-2000) (-2000) (-2000) (-2000) (-2000) (-2000) (-2000) (-2000)
				(-2000) (-2000) (-2000) (-2000) (-2000) (-2000) (-2000) (-2000) (-2000) (-2000) (-2000) (-2000) (-2000) (-2000) (-2000) (-2000) (-2000) (-2000)
				(-2000) (-2000) (-2000) (-2000) (-2000) (-2000) (-2000) (-2000) (-2000) (-2000) (-2000) (-2000) (-2000) (-2000) (-2000) (-2000) (-2000) (-2000)
				(-2000) (-2000) (-2000) (-2000) (-2000) (-2000) (-2000) (-2000) (-2000) (-2000) (-2000) (-2000) (-2000) (-2000) (-2000) (-2000) (-2000) (-2000)
				(-2000) (-2000) (-2000) (-2000) (-2000) (-2000) (-2000) (-2000) (-2000) (-2000) (-2000) (-2000) (-2000) (-2000) (-2000) (-2000) (-2000) (-2000)
				(-2000) (-2000) (-2000) (-2000) (-2000) (-2000) (-2000) (-2000) (-2000) (-2000) (-2000) (-2000) (-2000) (-2000) (-2000) (-2000) (-2000) (-2000)
				(-2000) (-2000) (-2000) (-2000) (-2000) (-2000) (-2000) (-2000) (-2000) (-2000) (-2000) (-2000) (-2000) (-2000) (-2000) (-2000) (-2000) (-2000)
				(-2000) (-2000) (-2000) (-2000) (-2000) (-2000) (-2000) (-2000) (-2000) (-2000) (-2000) (-2000) (-2000) (-2000) (-2000) (-2000) (-2000) (-2000)
				(-2000) (-2000) (-2000) (-2000) (-2000) (-2000) (-2000) (-2000) (-2000) (-2000) (-2000) (-2000) (-2000) (-2000) (-2000) (-2000) (-2000) (-2000)
				(-2000) (-2000) (-2000) (-2000) (-2000) (-2000) (-2000) (-2000) (-2000) (-2000) (-2000) (-2000) (-2000) (-2000) (-2000) (-2000) (-2000) (-2000)
				(-2000) (-2000) (-2000) (-2000) (-2000) (-2000) (-2000) (-2000) (-2000) (-2000) (-2000) (-2000) (-2000) (-2000) (-2000) (-2000) (-2000) (-2000)
				(-2000) (-2000) (-2000) (-2000) (-2000) (-2000) (-2000) (-2000) (-2000) (-2000) (-2000) (-2000) (-2000) (-2000) (-2000) (-2000) (-2000) (-2000)
				(-2000) (-2000) (-2000) (-2000) (-2000) (-2000) (-2000) (-2000) (-2000) (-2000) (-2000) (-2000) (-2000) (-2000) (-2000) (-2000) (-2000) (-2000)
				(-2000) (-2000) (-2000) (-2000) (-2000) (-2000) (-2000) (-2000) (-2000) (-2000) (-2000) (-2000) (-2000) (-2000) (-2000) (-2000) (-2000) (-2000)
				(-2000) (-2000) (-2000)>;

			PS_Config_Lmt_Open_Rawdata_P = <
				2020 2970 3080 3090 3094 3091 3100 2945 65535 65535 2998 3172 3167 3168 3183 3202 3076 2023
				2943 3160 3156 3161 3168 3161 3177 3161 3067 3022 3115 3137 3129 3134 3149 3165 3173 2974
				3130 3106 3096 3103 3109 3107 3119 3102 3083 3117 3126 3149 3145 3146 3161 3181 3184 3198
				3210 3137 3127 3137 3140 3140 3142 3133 3109 3168 3183 3203 3202 3200 3219 3234 3241 3240
				3150 3125 3121 3126 3126 3126 3137 3118 3102 3136 3150 3167 3165 3172 3184 3199 3208 3208
				3173 3156 3156 3156 3160 3163 3164 3149 3134 3122 3141 3156 3156 3161 3173 3188 3200 3192
				3160 3148 3148 3148 3150 3154 3160 3141 3127 3191 3203 3219 3222 3226 3235 3250 3257 3253
				3196 3159 3156 3157 3163 3164 3167 3148 3141 3173 3190 3192 3187 3202 3217 3223 3235 3225
				3181 3152 3149 3157 3154 3157 3159 3142 3132 3198 3211 3219 3210 3223 3237 3249 3254 3242
				3188 3125 3126 3122 3133 3129 3129 3119 3105 3119 3137 3138 3136 3153 3164 3171 3179 3165
				3181 3088 3090 3088 3091 3088 3088 3079 3065 3121 3129 3137 3137 3146 3159 3167 3175 3157
				3154 3145 3142 3145 3144 3148 3148 3136 3119 3141 3148 3154 3159 3169 3177 3188 3195 3175
				3111 3194 3190 3190 3195 3195 3196 3186 3167 3138 3153 3161 3160 3171 3184 3190 3192 3171
				3163 3153 3149 3144 3149 3153 3149 3146 3125 3191 3204 3214 3214 3223 3227 3235 3240 3226
				3214 3100 3113 3106 3109 3109 3107 3107 3087 3167 3175 3184 3187 3195 3200 3213 3213 3192
				3164 3161 3163 3163 3167 3167 3171 3169 3148 3150 3161 3171 3171 3180 3190 3200 3195 3176
				3123 3111 3119 3113 3119 3114 3122 3127 3099 3150 3159 3169 3171 3179 3187 3196 3190 3173
				3180 3149 3160 3157 3157 3154 3160 3161 3141 3146 3161 3164 3169 3180 3184 3190 3188 3173
				3126 3084 3084 3082 3084 3080 3086 3084 3060 3117 3127 3137 3138 3148 3152 3157 3150 3129
				3160 3060 3064 3059 3057 3061 3064 3063 3052 3169 3179 3187 3195 3198 3203 3213 3204 3191
				3099 3145 3149 3140 3140 3140 3144 3148 3134 3168 3177 3187 3192 3195 3198 3207 3203 3184
				3079 3059 3063 3055 3057 3055 3061 3059 3048 3161 3165 3180 3179 3190 3191 3199 3195 3177
				3154 3075 3079 3073 3073 3072 3080 3083 3064 3149 3154 3169 3169 3177 3176 3181 3179 3160
				3071 3091 3096 3090 3086 3091 3099 3096 3082 3145 3154 3167 3165 3173 3172 3179 3177 3154
				2817 2802 2806 2803 2802 2802 2808 2805 2797 2841 2841 2860 2859 2866 2872 2874 2867 2855
				2841 2825 2832 2828 2828 2821 2829 2832 2821 2884 2889 2907 2907 2910 2917 2916 2913 2909
				2820 2806 2806 2805 2799 2799 2806 2809 2802 2824 2830 2843 2848 2852 2855 2856 2857 2847
				2848 2810 2813 2806 2809 2808 2813 2812 2806 2783 2785 2805 2802 2808 2812 2814 2813 2798
				2821 2798 2802 2799 2799 2798 2806 2801 2793 2798 2803 2817 2814 2824 2829 2824 2828 2817
				2826 2809 2812 2808 2806 2810 2814 2813 2802 2868 2870 2880 2883 2890 2887 2894 2897 2887
				2813 2793 2787 2786 2787 2783 2797 2794 2783 2793 2794 2809 2808 2816 2817 2818 2824 2809
				2825 2782 2781 2778 2782 2778 2789 2782 2776 2828 2828 2835 2835 2845 2844 2852 2852 2841
				2803 2739 2737 2737 2741 2739 2752 2743 2736 2763 2767 2775 2776 2781 2783 2786 2789 2779
				2794 2756 2756 2751 2762 2760 2768 2762 2751 2801 2802 2813 2812 2822 2821 2826 2829 2828
				2497 2743 2736 2732 2740 2741 2749 2740 2735 2727 2737 2756 2744 2754 2749 2763 2770 2533
				1655 2598 2721 2725 2731 2733 2745 2729 2722 2709 2725 2745 2736 2739 2740 2745 2628 1641
				13000 13000 13000>;

			PS_Config_Lmt_Open_Rawdata_N = <
				973 1430 1483 1487 1489 1488 1493 1418 (-65535) (-65535) 1443 1527 1524 1525 1532 1541 1481 974
				1417 1521 1519 1522 1525 1522 1530 1522 1476 1455 1500 1510 1506 1509 1516 1524 1528 1431
				1507 1495 1491 1494 1496 1496 1502 1493 1484 1500 1505 1516 1514 1515 1522 1532 1533 1539
				1545 1510 1506 1510 1511 1511 1513 1508 1496 1525 1532 1542 1541 1541 1550 1557 1560 1560
				1517 1504 1502 1505 1505 1505 1510 1501 1493 1509 1517 1524 1524 1527 1533 1540 1545 1545
				1528 1519 1519 1519 1521 1522 1523 1516 1509 1503 1512 1519 1519 1522 1528 1535 1541 1537
				1521 1515 1515 1515 1517 1519 1521 1512 1506 1536 1542 1550 1551 1553 1558 1565 1568 1566
				1539 1521 1519 1520 1522 1523 1524 1515 1512 1528 1535 1537 1534 1541 1548 1552 1558 1552
				1532 1517 1516 1520 1519 1520 1521 1513 1508 1539 1546 1550 1545 1552 1558 1564 1567 1561
				1535 1504 1505 1503 1508 1506 1506 1502 1495 1502 1510 1511 1509 1518 1523 1526 1530 1524
				1532 1487 1487 1487 1488 1487 1487 1482 1476 1502 1506 1510 1510 1515 1521 1524 1528 1520
				1519 1514 1513 1514 1513 1515 1515 1509 1502 1512 1515 1519 1521 1526 1530 1535 1538 1528
				1498 1537 1535 1535 1538 1538 1539 1534 1524 1511 1518 1522 1521 1526 1533 1535 1537 1526
				1522 1518 1516 1513 1516 1518 1516 1515 1504 1536 1543 1547 1547 1552 1554 1558 1560 1553
				1547 1493 1498 1495 1496 1496 1496 1496 1486 1524 1528 1533 1534 1538 1541 1547 1547 1537
				1523 1522 1522 1522 1524 1524 1526 1526 1515 1517 1522 1526 1526 1531 1535 1541 1538 1529
				1504 1498 1502 1498 1502 1499 1503 1506 1492 1517 1521 1526 1526 1530 1534 1539 1535 1528
				1531 1516 1521 1520 1520 1519 1521 1522 1512 1515 1522 1523 1526 1531 1533 1535 1535 1528
				1505 1485 1485 1483 1485 1483 1485 1485 1473 1500 1506 1510 1511 1515 1517 1520 1517 1506
				1521 1473 1475 1472 1472 1474 1475 1474 1469 1526 1530 1534 1538 1539 1542 1547 1543 1536
				1492 1514 1516 1511 1511 1511 1513 1515 1509 1525 1530 1534 1537 1538 1539 1544 1542 1533
				1482 1472 1474 1470 1472 1470 1474 1472 1467 1522 1524 1531 1530 1535 1536 1540 1538 1530
				1519 1480 1482 1480 1480 1479 1483 1484 1475 1516 1519 1526 1526 1530 1529 1532 1530 1521
				1478 1488 1491 1487 1485 1488 1492 1491 1483 1514 1519 1524 1524 1528 1527 1530 1530 1519
				1356 1349 1351 1350 1349 1349 1352 1350 1346 1368 1368 1377 1376 1379 1383 1383 1380 1374
				1368 1360 1363 1361 1361 1358 1362 1363 1358 1389 1391 1400 1400 1401 1404 1404 1402 1400
				1357 1351 1351 1350 1348 1348 1351 1352 1349 1359 1363 1368 1371 1373 1374 1375 1376 1370
				1371 1353 1354 1351 1352 1352 1354 1353 1351 1340 1340 1350 1349 1352 1353 1355 1354 1347
				1358 1347 1349 1348 1348 1347 1351 1348 1344 1347 1350 1356 1355 1359 1362 1359 1361 1356
				1361 1352 1353 1352 1351 1353 1355 1354 1349 1381 1381 1387 1388 1391 1390 1393 1394 1390
				1354 1344 1342 1341 1342 1340 1346 1345 1340 1344 1345 1352 1352 1355 1356 1357 1359 1352
				1360 1339 1339 1337 1339 1337 1342 1339 1337 1361 1361 1365 1365 1370 1369 1373 1373 1368
				1350 1318 1318 1318 1320 1318 1325 1320 1317 1330 1332 1336 1337 1339 1340 1341 1342 1338
				1345 1327 1327 1324 1329 1329 1333 1329 1324 1348 1349 1354 1353 1359 1358 1361 1362 1361
				1202 1320 1317 1315 1319 1320 1324 1319 1316 1313 1318 1327 1321 1326 1324 1330 1333 1220
				796 1251 1310 1312 1314 1316 1322 1314 1311 1304 1312 1322 1317 1318 1319 1322 1265 790
				6500 6500 6500>;

			PS_Config_Lmt_FW_Rawdata_P = <
				1750 1750 1750 1750 1750 1750 1750 1750 65535 65535 1750 1750 1750 1750 1750 1750 1750 1750
				1750 1750 1750 1750 1750 1750 1750 1750 1750 1750 1750 1750 1750 1750 1750 1750 1750 1750
				1750 1750 1750 1750 1750 1750 1750 1750 1750 1750 1750 1750 1750 1750 1750 1750 1750 1750
				1750 1750 1750 1750 1750 1750 1750 1750 1750 1750 1750 1750 1750 1750 1750 1750 1750 1750
				1750 1750 1750 1750 1750 1750 1750 1750 1750 1750 1750 1750 1750 1750 1750 1750 1750 1750
				1750 1750 1750 1750 1750 1750 1750 1750 1750 1750 1750 1750 1750 1750 1750 1750 1750 1750
				1750 1750 1750 1750 1750 1750 1750 1750 1750 1750 1750 1750 1750 1750 1750 1750 1750 1750
				1750 1750 1750 1750 1750 1750 1750 1750 1750 1750 1750 1750 1750 1750 1750 1750 1750 1750
				1750 1750 1750 1750 1750 1750 1750 1750 1750 1750 1750 1750 1750 1750 1750 1750 1750 1750
				1750 1750 1750 1750 1750 1750 1750 1750 1750 1750 1750 1750 1750 1750 1750 1750 1750 1750
				1750 1750 1750 1750 1750 1750 1750 1750 1750 1750 1750 1750 1750 1750 1750 1750 1750 1750
				1750 1750 1750 1750 1750 1750 1750 1750 1750 1750 1750 1750 1750 1750 1750 1750 1750 1750
				1750 1750 1750 1750 1750 1750 1750 1750 1750 1750 1750 1750 1750 1750 1750 1750 1750 1750
				1750 1750 1750 1750 1750 1750 1750 1750 1750 1750 1750 1750 1750 1750 1750 1750 1750 1750
				1750 1750 1750 1750 1750 1750 1750 1750 1750 1750 1750 1750 1750 1750 1750 1750 1750 1750
				1750 1750 1750 1750 1750 1750 1750 1750 1750 1750 1750 1750 1750 1750 1750 1750 1750 1750
				1750 1750 1750 1750 1750 1750 1750 1750 1750 1750 1750 1750 1750 1750 1750 1750 1750 1750
				1750 1750 1750 1750 1750 1750 1750 1750 1750 1750 1750 1750 1750 1750 1750 1750 1750 1750
				1750 1750 1750 1750 1750 1750 1750 1750 1750 1750 1750 1750 1750 1750 1750 1750 1750 1750
				1750 1750 1750 1750 1750 1750 1750 1750 1750 1750 1750 1750 1750 1750 1750 1750 1750 1750
				1750 1750 1750 1750 1750 1750 1750 1750 1750 1750 1750 1750 1750 1750 1750 1750 1750 1750
				1750 1750 1750 1750 1750 1750 1750 1750 1750 1750 1750 1750 1750 1750 1750 1750 1750 1750
				1750 1750 1750 1750 1750 1750 1750 1750 1750 1750 1750 1750 1750 1750 1750 1750 1750 1750
				1750 1750 1750 1750 1750 1750 1750 1750 1750 1750 1750 1750 1750 1750 1750 1750 1750 1750
				1750 1750 1750 1750 1750 1750 1750 1750 1750 1750 1750 1750 1750 1750 1750 1750 1750 1750
				1750 1750 1750 1750 1750 1750 1750 1750 1750 1750 1750 1750 1750 1750 1750 1750 1750 1750
				1750 1750 1750 1750 1750 1750 1750 1750 1750 1750 1750 1750 1750 1750 1750 1750 1750 1750
				1750 1750 1750 1750 1750 1750 1750 1750 1750 1750 1750 1750 1750 1750 1750 1750 1750 1750
				1750 1750 1750 1750 1750 1750 1750 1750 1750 1750 1750 1750 1750 1750 1750 1750 1750 1750
				1750 1750 1750 1750 1750 1750 1750 1750 1750 1750 1750 1750 1750 1750 1750 1750 1750 1750
				1750 1750 1750 1750 1750 1750 1750 1750 1750 1750 1750 1750 1750 1750 1750 1750 1750 1750
				1750 1750 1750 1750 1750 1750 1750 1750 1750 1750 1750 1750 1750 1750 1750 1750 1750 1750
				1750 1750 1750 1750 1750 1750 1750 1750 1750 1750 1750 1750 1750 1750 1750 1750 1750 1750
				1750 1750 1750 1750 1750 1750 1750 1750 1750 1750 1750 1750 1750 1750 1750 1750 1750 1750
				1750 1750 1750 1750 1750 1750 1750 1750 1750 1750 1750 1750 1750 1750 1750 1750 1750 1750
				1750 1750 1750 1750 1750 1750 1750 1750 1750 1750 1750 1750 1750 1750 1750 1750 1750 1750
				2000 2000 2000>;

			PS_Config_Lmt_FW_Rawdata_N = <
				650 650 650 650 650 650 650 650 (-65535) (-65535) 650 650 650 650 650 650 650 650
				650 650 650 650 650 650 650 650 650 650 650 650 650 650 650 650 650 650
				650 650 650 650 650 650 650 650 650 650 650 650 650 650 650 650 650 650
				650 650 650 650 650 650 650 650 650 650 650 650 650 650 650 650 650 650
				650 650 650 650 650 650 650 650 650 650 650 650 650 650 650 650 650 650
				650 650 650 650 650 650 650 650 650 650 650 650 650 650 650 650 650 650
				650 650 650 650 650 650 650 650 650 650 650 650 650 650 650 650 650 650
				650 650 650 650 650 650 650 650 650 650 650 650 650 650 650 650 650 650
				650 650 650 650 650 650 650 650 650 650 650 650 650 650 650 650 650 650
				650 650 650 650 650 650 650 650 650 650 650 650 650 650 650 650 650 650
				650 650 650 650 650 650 650 650 650 650 650 650 650 650 650 650 650 650
				650 650 650 650 650 650 650 650 650 650 650 650 650 650 650 650 650 650
				650 650 650 650 650 650 650 650 650 650 650 650 650 650 650 650 650 650
				650 650 650 650 650 650 650 650 650 650 650 650 650 650 650 650 650 650
				650 650 650 650 650 650 650 650 650 650 650 650 650 650 650 650 650 650
				650 650 650 650 650 650 650 650 650 650 650 650 650 650 650 650 650 650
				650 650 650 650 650 650 650 650 650 650 650 650 650 650 650 650 650 650
				650 650 650 650 650 650 650 650 650 650 650 650 650 650 650 650 650 650
				650 650 650 650 650 650 650 650 650 650 650 650 650 650 650 650 650 650
				650 650 650 650 650 650 650 650 650 650 650 650 650 650 650 650 650 650
				650 650 650 650 650 650 650 650 650 650 650 650 650 650 650 650 650 650
				650 650 650 650 650 650 650 650 650 650 650 650 650 650 650 650 650 650
				650 650 650 650 650 650 650 650 650 650 650 650 650 650 650 650 650 650
				650 650 650 650 650 650 650 650 650 650 650 650 650 650 650 650 650 650
				650 650 650 650 650 650 650 650 650 650 650 650 650 650 650 650 650 650
				650 650 650 650 650 650 650 650 650 650 650 650 650 650 650 650 650 650
				650 650 650 650 650 650 650 650 650 650 650 650 650 650 650 650 650 650
				650 650 650 650 650 650 650 650 650 650 650 650 650 650 650 650 650 650
				650 650 650 650 650 650 650 650 650 650 650 650 650 650 650 650 650 650
				650 650 650 650 650 650 650 650 650 650 650 650 650 650 650 650 650 650
				650 650 650 650 650 650 650 650 650 650 650 650 650 650 650 650 650 650
				650 650 650 650 650 650 650 650 650 650 650 650 650 650 650 650 650 650
				650 650 650 650 650 650 650 650 650 650 650 650 650 650 650 650 650 650
				650 650 650 650 650 650 650 650 650 650 650 650 650 650 650 650 650 650
				650 650 650 650 650 650 650 650 650 650 650 650 650 650 650 650 650 650
				650 650 650 650 650 650 650 650 650 650 650 650 650 650 650 650 650 650
				400 400 400>;

			PS_Config_Lmt_FW_CC_P = <
				129 126 126 125 124 124 122 124 65535 65535 128 129 126 125 126 126 125 122
				129 131 128 128 128 126 125 126 125 124 126 125 124 124 124 124 125 128
				131 124 124 121 121 120 118 120 118 124 126 126 125 124 126 126 126 129
				135 126 125 124 124 124 122 122 122 126 129 129 128 126 128 128 129 132
				129 126 124 124 124 121 121 121 121 118 121 121 121 118 121 121 121 124
				132 128 126 126 124 124 124 124 124 124 126 125 124 124 124 124 125 128
				129 125 124 122 121 121 121 121 121 125 129 126 126 126 126 126 126 129
				133 129 128 128 126 126 126 126 126 126 128 126 125 124 125 126 126 129
				129 129 126 126 126 124 126 124 124 129 126 126 125 124 126 126 126 129
				135 126 126 126 126 124 124 124 124 129 124 124 124 124 124 124 126 129
				135 126 125 125 124 124 124 124 122 129 124 124 124 122 124 124 125 128
				135 126 125 125 124 124 124 124 122 136 128 129 128 128 129 129 129 135
				132 126 126 126 124 124 124 124 124 129 124 124 124 124 124 124 125 129
				132 129 128 126 126 125 126 126 125 129 124 124 122 122 124 124 125 128
				132 124 122 122 121 121 121 124 120 129 124 124 122 122 124 124 125 129
				135 126 126 126 126 124 126 126 124 138 129 129 129 129 129 131 132 138
				128 126 125 124 124 124 124 125 122 128 122 122 121 121 122 124 124 128
				132 128 126 126 126 125 126 126 124 129 125 124 122 124 124 124 125 129
				131 126 124 124 124 124 124 124 121 128 124 122 121 121 124 124 124 129
				132 124 124 122 121 121 122 122 122 132 126 126 126 126 126 128 128 135
				129 128 126 126 125 125 126 125 125 132 129 126 126 126 128 128 129 135
				129 126 126 126 124 124 125 124 124 132 126 126 126 126 128 129 129 135
				131 124 124 124 122 122 124 124 121 132 128 128 126 128 129 129 129 136
				129 126 125 124 124 124 124 126 124 132 128 129 128 129 129 129 132 138
				128 129 128 128 126 126 128 128 125 126 125 126 125 126 126 126 128 133
				129 129 129 126 126 126 128 129 126 129 126 128 126 129 129 129 129 138
				132 126 126 125 124 124 126 126 124 124 124 124 124 124 125 126 126 132
				133 128 128 126 126 126 128 129 125 126 126 126 126 128 128 129 131 136
				129 124 124 124 124 124 124 125 121 126 126 126 126 126 128 128 129 135
				129 129 129 126 126 126 129 129 126 126 126 126 126 126 126 128 129 135
				126 126 126 126 125 126 126 126 124 125 124 124 125 125 126 126 129 133
				132 129 129 129 126 128 129 129 126 126 126 126 126 126 128 129 131 136
				129 124 124 124 122 124 125 125 122 121 121 121 122 122 124 124 126 132
				135 132 132 129 129 129 135 132 129 124 124 124 124 124 126 126 129 138
				126 129 128 126 126 126 132 129 126 126 129 129 126 126 126 126 128 129
				129 128 126 125 125 126 131 129 125 118 124 124 118 118 118 118 120 118
				38 38 38>;

			PS_Config_Lmt_FW_CC_N = <
				58 57 57 56 55 55 55 55 (-65535) (-65535) 57 58 57 56 57 57 56 55
				58 58 57 57 57 57 56 57 56 55 57 56 55 55 55 55 56 57
				58 55 55 54 54 53 53 53 53 55 57 57 56 55 57 57 57 58
				60 57 56 55 55 55 55 55 55 57 58 58 57 57 57 57 58 59
				58 57 55 55 55 54 54 54 54 53 54 54 54 53 54 54 54 55
				59 57 57 57 55 55 55 55 55 55 57 56 55 55 55 55 56 57
				58 56 55 55 54 54 54 54 54 56 58 57 57 57 57 57 57 58
				60 58 57 57 57 57 57 57 57 57 57 57 56 55 56 57 57 58
				58 58 57 57 57 55 57 55 55 58 57 57 56 55 57 57 57 58
				60 57 57 57 57 55 55 55 55 58 55 55 55 55 55 55 57 58
				60 57 56 56 55 55 55 55 55 58 55 55 55 55 55 55 56 57
				60 57 56 56 55 55 55 55 55 61 57 58 57 57 58 58 58 60
				59 57 57 57 55 55 55 55 55 58 55 55 55 55 55 55 56 58
				59 58 57 57 57 56 57 57 56 58 55 55 55 55 55 55 56 57
				59 55 55 55 54 54 54 55 53 58 55 55 55 55 55 55 56 58
				60 57 57 57 57 55 57 57 55 62 58 58 58 58 58 58 59 62
				57 57 56 55 55 55 55 56 55 57 55 55 54 54 55 55 55 57
				59 57 57 57 57 56 57 57 55 58 56 55 55 55 55 55 56 58
				58 57 55 55 55 55 55 55 54 57 55 55 54 54 55 55 55 58
				59 55 55 55 54 54 55 55 55 59 57 57 57 57 57 57 57 60
				58 57 57 57 56 56 57 56 56 59 58 57 57 57 57 57 58 60
				58 57 57 57 55 55 56 55 55 59 57 57 57 57 57 58 58 60
				58 55 55 55 55 55 55 55 54 59 57 57 57 57 58 58 58 61
				58 57 56 55 55 55 55 57 55 59 57 58 57 58 58 58 59 62
				57 58 57 57 57 57 57 57 56 57 56 57 56 57 57 57 57 60
				58 58 58 57 57 57 57 58 57 58 57 57 57 58 58 58 58 62
				59 57 57 56 55 55 57 57 55 55 55 55 55 55 56 57 57 59
				60 57 57 57 57 57 57 58 56 57 57 57 57 57 57 58 58 61
				58 55 55 55 55 55 55 56 54 57 57 57 57 57 57 57 58 60
				58 58 58 57 57 57 58 58 57 57 57 57 57 57 57 57 58 60
				57 57 57 57 56 57 57 57 55 56 55 55 56 56 57 57 58 60
				59 58 58 58 57 57 58 58 57 57 57 57 57 57 57 58 58 61
				58 55 55 55 55 55 56 56 55 54 54 54 55 55 55 55 57 59
				60 59 59 58 58 58 60 59 58 55 55 55 55 55 57 57 58 62
				57 58 57 57 57 57 59 58 57 57 58 58 57 57 57 57 57 58
				58 57 57 56 56 57 58 58 56 53 55 55 53 53 53 53 53 53
				9 9 9>;

			PS_Config_Lmt_FW_CC_I_P = <
				25 25 25 25 25 25 25 25 25 25 25 25 25 25 25 25 25 25
				25 25 25 25 25 25 25 25 25 25 25 25 25 25 25 25 25 25
				25 25 25 25 25 25 25 25 25 25 25 25 25 25 25 25 25 25
				25 25 25 25 25 25 25 25 25 25 25 25 25 25 25 25 25 25
				25 25 25 25 25 25 25 25 25 25 25 25 25 25 25 25 25 25
				25 25 25 25 25 25 25 25 25 25 25 25 25 25 25 25 25 25
				25 25 25 25 25 25 25 25 25 25 25 25 25 25 25 25 25 25
				25 25 25 25 25 25 25 25 25 25 25 25 25 25 25 25 25 25
				25 25 25 25 25 25 25 25 25 25 25 25 25 25 25 25 25 25
				25 25 25 25 25 25 25 25 25 25 25 25 25 25 25 25 25 25
				25 25 25 25 25 25 25 25 25 25 25 25 25 25 25 25 25 25
				25 25 25 25 25 25 25 25 25 25 25 25 25 25 25 25 25 25
				25 25 25 25 25 25 25 25 25 25 25 25 25 25 25 25 25 25
				25 25 25 25 25 25 25 25 25 25 25 25 25 25 25 25 25 25
				25 25 25 25 25 25 25 25 25 25 25 25 25 25 25 25 25 25
				25 25 25 25 25 25 25 25 25 25 25 25 25 25 25 25 25 25
				25 25 25 25 25 25 25 25 25 25 25 25 25 25 25 25 25 25
				25 25 25 25 25 25 25 25 25 25 25 25 25 25 25 25 25 25
				25 25 25 25 25 25 25 25 25 25 25 25 25 25 25 25 25 25
				25 25 25 25 25 25 25 25 25 25 25 25 25 25 25 25 25 25
				25 25 25 25 25 25 25 25 25 25 25 25 25 25 25 25 25 25
				25 25 25 25 25 25 25 25 25 25 25 25 25 25 25 25 25 25
				25 25 25 25 25 25 25 25 25 25 25 25 25 25 25 25 25 25
				25 25 25 25 25 25 25 25 25 25 25 25 25 25 25 25 25 25
				25 25 25 25 25 25 25 25 25 25 25 25 25 25 25 25 25 25
				25 25 25 25 25 25 25 25 25 25 25 25 25 25 25 25 25 25
				25 25 25 25 25 25 25 25 25 25 25 25 25 25 25 25 25 25
				25 25 25 25 25 25 25 25 25 25 25 25 25 25 25 25 25 25
				25 25 25 25 25 25 25 25 25 25 25 25 25 25 25 25 25 25
				25 25 25 25 25 25 25 25 25 25 25 25 25 25 25 25 25 25
				25 25 25 25 25 25 25 25 25 25 25 25 25 25 25 25 25 25
				25 25 25 25 25 25 25 25 25 25 25 25 25 25 25 25 25 25
				25 25 25>;

			PS_Config_Lmt_FW_CC_I_N = <
				0 0 0 0 0 0 0 0 0 0 0 0 0 0 0 0 0 0
				0 0 0 0 0 0 0 0 0 0 0 0 0 0 0 0 0 0
				0 0 0 0 0 0 0 0 0 0 0 0 0 0 0 0 0 0
				0 0 0 0 0 0 0 0 0 0 0 0 0 0 0 0 0 0
				0 0 0 0 0 0 0 0 0 0 0 0 0 0 0 0 0 0
				0 0 0 0 0 0 0 0 0 0 0 0 0 0 0 0 0 0
				0 0 0 0 0 0 0 0 0 0 0 0 0 0 0 0 0 0
				0 0 0 0 0 0 0 0 0 0 0 0 0 0 0 0 0 0
				0 0 0 0 0 0 0 0 0 0 0 0 0 0 0 0 0 0
				0 0 0 0 0 0 0 0 0 0 0 0 0 0 0 0 0 0
				0 0 0 0 0 0 0 0 0 0 0 0 0 0 0 0 0 0
				0 0 0 0 0 0 0 0 0 0 0 0 0 0 0 0 0 0
				0 0 0 0 0 0 0 0 0 0 0 0 0 0 0 0 0 0
				0 0 0 0 0 0 0 0 0 0 0 0 0 0 0 0 0 0
				0 0 0 0 0 0 0 0 0 0 0 0 0 0 0 0 0 0
				0 0 0 0 0 0 0 0 0 0 0 0 0 0 0 0 0 0
				0 0 0 0 0 0 0 0 0 0 0 0 0 0 0 0 0 0
				0 0 0 0 0 0 0 0 0 0 0 0 0 0 0 0 0 0
				0 0 0 0 0 0 0 0 0 0 0 0 0 0 0 0 0 0
				0 0 0 0 0 0 0 0 0 0 0 0 0 0 0 0 0 0
				0 0 0 0 0 0 0 0 0 0 0 0 0 0 0 0 0 0
				0 0 0 0 0 0 0 0 0 0 0 0 0 0 0 0 0 0
				0 0 0 0 0 0 0 0 0 0 0 0 0 0 0 0 0 0
				0 0 0 0 0 0 0 0 0 0 0 0 0 0 0 0 0 0
				0 0 0 0 0 0 0 0 0 0 0 0 0 0 0 0 0 0
				0 0 0 0 0 0 0 0 0 0 0 0 0 0 0 0 0 0
				0 0 0 0 0 0 0 0 0 0 0 0 0 0 0 0 0 0
				0 0 0 0 0 0 0 0 0 0 0 0 0 0 0 0 0 0
				0 0 0 0 0 0 0 0 0 0 0 0 0 0 0 0 0 0
				0 0 0 0 0 0 0 0 0 0 0 0 0 0 0 0 0 0
				0 0 0 0 0 0 0 0 0 0 0 0 0 0 0 0 0 0
				0 0 0 0 0 0 0 0 0 0 0 0 0 0 0 0 0 0
				0 0 0>;

			PS_Config_Lmt_FW_CC_Q_P = <
				25 25 25 25 25 25 25 25 25 25 25 25 25 25 25 25 25 25
				25 25 25 25 25 25 25 25 25 25 25 25 25 25 25 25 25 25
				25 25 25 25 25 25 25 25 25 25 25 25 25 25 25 25 25 25
				25 25 25 25 25 25 25 25 25 25 25 25 25 25 25 25 25 25
				25 25 25 25 25 25 25 25 25 25 25 25 25 25 25 25 25 25
				25 25 25 25 25 25 25 25 25 25 25 25 25 25 25 25 25 25
				25 25 25 25 25 25 25 25 25 25 25 25 25 25 25 25 25 25
				25 25 25 25 25 25 25 25 25 25 25 25 25 25 25 25 25 25
				25 25 25 25 25 25 25 25 25 25 25 25 25 25 25 25 25 25
				25 25 25 25 25 25 25 25 25 25 25 25 25 25 25 25 25 25
				25 25 25 25 25 25 25 25 25 25 25 25 25 25 25 25 25 25
				25 25 25 25 25 25 25 25 25 25 25 25 25 25 25 25 25 25
				25 25 25 25 25 25 25 25 25 25 25 25 25 25 25 25 25 25
				25 25 25 25 25 25 25 25 25 25 25 25 25 25 25 25 25 25
				25 25 25 25 25 25 25 25 25 25 25 25 25 25 25 25 25 25
				25 25 25 25 25 25 25 25 25 25 25 25 25 25 25 25 25 25
				25 25 25 25 25 25 25 25 25 25 25 25 25 25 25 25 25 25
				25 25 25 25 25 25 25 25 25 25 25 25 25 25 25 25 25 25
				25 25 25 25 25 25 25 25 25 25 25 25 25 25 25 25 25 25
				25 25 25 25 25 25 25 25 25 25 25 25 25 25 25 25 25 25
				25 25 25 25 25 25 25 25 25 25 25 25 25 25 25 25 25 25
				25 25 25 25 25 25 25 25 25 25 25 25 25 25 25 25 25 25
				25 25 25 25 25 25 25 25 25 25 25 25 25 25 25 25 25 25
				25 25 25 25 25 25 25 25 25 25 25 25 25 25 25 25 25 25
				25 25 25 25 25 25 25 25 25 25 25 25 25 25 25 25 25 25
				25 25 25 25 25 25 25 25 25 25 25 25 25 25 25 25 25 25
				25 25 25 25 25 25 25 25 25 25 25 25 25 25 25 25 25 25
				25 25 25 25 25 25 25 25 25 25 25 25 25 25 25 25 25 25
				25 25 25 25 25 25 25 25 25 25 25 25 25 25 25 25 25 25
				25 25 25 25 25 25 25 25 25 25 25 25 25 25 25 25 25 25
				25 25 25 25 25 25 25 25 25 25 25 25 25 25 25 25 25 25
				25 25 25 25 25 25 25 25 25 25 25 25 25 25 25 25 25 25
				25 25 25>;

			PS_Config_Lmt_FW_CC_Q_N = <
				0 0 0 0 0 0 0 0 0 0 0 0 0 0 0 0 0 0
				0 0 0 0 0 0 0 0 0 0 0 0 0 0 0 0 0 0
				0 0 0 0 0 0 0 0 0 0 0 0 0 0 0 0 0 0
				0 0 0 0 0 0 0 0 0 0 0 0 0 0 0 0 0 0
				0 0 0 0 0 0 0 0 0 0 0 0 0 0 0 0 0 0
				0 0 0 0 0 0 0 0 0 0 0 0 0 0 0 0 0 0
				0 0 0 0 0 0 0 0 0 0 0 0 0 0 0 0 0 0
				0 0 0 0 0 0 0 0 0 0 0 0 0 0 0 0 0 0
				0 0 0 0 0 0 0 0 0 0 0 0 0 0 0 0 0 0
				0 0 0 0 0 0 0 0 0 0 0 0 0 0 0 0 0 0
				0 0 0 0 0 0 0 0 0 0 0 0 0 0 0 0 0 0
				0 0 0 0 0 0 0 0 0 0 0 0 0 0 0 0 0 0
				0 0 0 0 0 0 0 0 0 0 0 0 0 0 0 0 0 0
				0 0 0 0 0 0 0 0 0 0 0 0 0 0 0 0 0 0
				0 0 0 0 0 0 0 0 0 0 0 0 0 0 0 0 0 0
				0 0 0 0 0 0 0 0 0 0 0 0 0 0 0 0 0 0
				0 0 0 0 0 0 0 0 0 0 0 0 0 0 0 0 0 0
				0 0 0 0 0 0 0 0 0 0 0 0 0 0 0 0 0 0
				0 0 0 0 0 0 0 0 0 0 0 0 0 0 0 0 0 0
				0 0 0 0 0 0 0 0 0 0 0 0 0 0 0 0 0 0
				0 0 0 0 0 0 0 0 0 0 0 0 0 0 0 0 0 0
				0 0 0 0 0 0 0 0 0 0 0 0 0 0 0 0 0 0
				0 0 0 0 0 0 0 0 0 0 0 0 0 0 0 0 0 0
				0 0 0 0 0 0 0 0 0 0 0 0 0 0 0 0 0 0
				0 0 0 0 0 0 0 0 0 0 0 0 0 0 0 0 0 0
				0 0 0 0 0 0 0 0 0 0 0 0 0 0 0 0 0 0
				0 0 0 0 0 0 0 0 0 0 0 0 0 0 0 0 0 0
				0 0 0 0 0 0 0 0 0 0 0 0 0 0 0 0 0 0
				0 0 0 0 0 0 0 0 0 0 0 0 0 0 0 0 0 0
				0 0 0 0 0 0 0 0 0 0 0 0 0 0 0 0 0 0
				0 0 0 0 0 0 0 0 0 0 0 0 0 0 0 0 0 0
				0 0 0 0 0 0 0 0 0 0 0 0 0 0 0 0 0 0
				0 0 0>;

			PS_Config_Lmt_FW_Diff_P = <
				50 50 50 50 50 50 50 50 65535 65535 50 50 50 50 50 50 50 50
				50 50 50 50 50 50 50 50 50 50 50 50 50 50 50 50 50 50
				50 50 50 50 50 50 50 50 50 50 50 50 50 50 50 50 50 50
				50 50 50 50 50 50 50 50 50 50 50 50 50 50 50 50 50 50
				50 50 50 50 50 50 50 50 50 50 50 50 50 50 50 50 50 50
				50 50 50 50 50 50 50 50 50 50 50 50 50 50 50 50 50 50
				50 50 50 50 50 50 50 50 50 50 50 50 50 50 50 50 50 50
				50 50 50 50 50 50 50 50 50 50 50 50 50 50 50 50 50 50
				50 50 50 50 50 50 50 50 50 50 50 50 50 50 50 50 50 50
				50 50 50 50 50 50 50 50 50 50 50 50 50 50 50 50 50 50
				50 50 50 50 50 50 50 50 50 50 50 50 50 50 50 50 50 50
				50 50 50 50 50 50 50 50 50 50 50 50 50 50 50 50 50 50
				50 50 50 50 50 50 50 50 50 50 50 50 50 50 50 50 50 50
				50 50 50 50 50 50 50 50 50 50 50 50 50 50 50 50 50 50
				50 50 50 50 50 50 50 50 50 50 50 50 50 50 50 50 50 50
				50 50 50 50 50 50 50 50 50 50 50 50 50 50 50 50 50 50
				50 50 50 50 50 50 50 50 50 50 50 50 50 50 50 50 50 50
				50 50 50 50 50 50 50 50 50 50 50 50 50 50 50 50 50 50
				50 50 50 50 50 50 50 50 50 50 50 50 50 50 50 50 50 50
				50 50 50 50 50 50 50 50 50 50 50 50 50 50 50 50 50 50
				50 50 50 50 50 50 50 50 50 50 50 50 50 50 50 50 50 50
				50 50 50 50 50 50 50 50 50 50 50 50 50 50 50 50 50 50
				50 50 50 50 50 50 50 50 50 50 50 50 50 50 50 50 50 50
				50 50 50 50 50 50 50 50 50 50 50 50 50 50 50 50 50 50
				50 50 50 50 50 50 50 50 50 50 50 50 50 50 50 50 50 50
				50 50 50 50 50 50 50 50 50 50 50 50 50 50 50 50 50 50
				50 50 50 50 50 50 50 50 50 50 50 50 50 50 50 50 50 50
				50 50 50 50 50 50 50 50 50 50 50 50 50 50 50 50 50 50
				50 50 50 50 50 50 50 50 50 50 50 50 50 50 50 50 50 50
				50 50 50 50 50 50 50 50 50 50 50 50 50 50 50 50 50 50
				50 50 50 50 50 50 50 50 50 50 50 50 50 50 50 50 50 50
				50 50 50 50 50 50 50 50 50 50 50 50 50 50 50 50 50 50
				50 50 50 50 50 50 50 50 50 50 50 50 50 50 50 50 50 50
				50 50 50 50 50 50 50 50 50 50 50 50 50 50 50 50 50 50
				50 50 50 50 50 50 50 50 50 50 50 50 50 50 50 50 50 50
				50 50 50 50 50 50 50 50 50 50 50 50 50 50 50 50 50 50
				50 50 50>;

			PS_Config_Lmt_FW_Diff_N = <
				(-50) (-50) (-50) (-50) (-50) (-50) (-50) (-50) (-65535) (-65535) (-50) (-50) (-50) (-50) (-50) (-50) (-50) (-50)
				(-50) (-50) (-50) (-50) (-50) (-50) (-50) (-50) (-50) (-50) (-50) (-50) (-50) (-50) (-50) (-50) (-50) (-50)
				(-50) (-50) (-50) (-50) (-50) (-50) (-50) (-50) (-50) (-50) (-50) (-50) (-50) (-50) (-50) (-50) (-50) (-50)
				(-50) (-50) (-50) (-50) (-50) (-50) (-50) (-50) (-50) (-50) (-50) (-50) (-50) (-50) (-50) (-50) (-50) (-50)
				(-50) (-50) (-50) (-50) (-50) (-50) (-50) (-50) (-50) (-50) (-50) (-50) (-50) (-50) (-50) (-50) (-50) (-50)
				(-50) (-50) (-50) (-50) (-50) (-50) (-50) (-50) (-50) (-50) (-50) (-50) (-50) (-50) (-50) (-50) (-50) (-50)
				(-50) (-50) (-50) (-50) (-50) (-50) (-50) (-50) (-50) (-50) (-50) (-50) (-50) (-50) (-50) (-50) (-50) (-50)
				(-50) (-50) (-50) (-50) (-50) (-50) (-50) (-50) (-50) (-50) (-50) (-50) (-50) (-50) (-50) (-50) (-50) (-50)
				(-50) (-50) (-50) (-50) (-50) (-50) (-50) (-50) (-50) (-50) (-50) (-50) (-50) (-50) (-50) (-50) (-50) (-50)
				(-50) (-50) (-50) (-50) (-50) (-50) (-50) (-50) (-50) (-50) (-50) (-50) (-50) (-50) (-50) (-50) (-50) (-50)
				(-50) (-50) (-50) (-50) (-50) (-50) (-50) (-50) (-50) (-50) (-50) (-50) (-50) (-50) (-50) (-50) (-50) (-50)
				(-50) (-50) (-50) (-50) (-50) (-50) (-50) (-50) (-50) (-50) (-50) (-50) (-50) (-50) (-50) (-50) (-50) (-50)
				(-50) (-50) (-50) (-50) (-50) (-50) (-50) (-50) (-50) (-50) (-50) (-50) (-50) (-50) (-50) (-50) (-50) (-50)
				(-50) (-50) (-50) (-50) (-50) (-50) (-50) (-50) (-50) (-50) (-50) (-50) (-50) (-50) (-50) (-50) (-50) (-50)
				(-50) (-50) (-50) (-50) (-50) (-50) (-50) (-50) (-50) (-50) (-50) (-50) (-50) (-50) (-50) (-50) (-50) (-50)
				(-50) (-50) (-50) (-50) (-50) (-50) (-50) (-50) (-50) (-50) (-50) (-50) (-50) (-50) (-50) (-50) (-50) (-50)
				(-50) (-50) (-50) (-50) (-50) (-50) (-50) (-50) (-50) (-50) (-50) (-50) (-50) (-50) (-50) (-50) (-50) (-50)
				(-50) (-50) (-50) (-50) (-50) (-50) (-50) (-50) (-50) (-50) (-50) (-50) (-50) (-50) (-50) (-50) (-50) (-50)
				(-50) (-50) (-50) (-50) (-50) (-50) (-50) (-50) (-50) (-50) (-50) (-50) (-50) (-50) (-50) (-50) (-50) (-50)
				(-50) (-50) (-50) (-50) (-50) (-50) (-50) (-50) (-50) (-50) (-50) (-50) (-50) (-50) (-50) (-50) (-50) (-50)
				(-50) (-50) (-50) (-50) (-50) (-50) (-50) (-50) (-50) (-50) (-50) (-50) (-50) (-50) (-50) (-50) (-50) (-50)
				(-50) (-50) (-50) (-50) (-50) (-50) (-50) (-50) (-50) (-50) (-50) (-50) (-50) (-50) (-50) (-50) (-50) (-50)
				(-50) (-50) (-50) (-50) (-50) (-50) (-50) (-50) (-50) (-50) (-50) (-50) (-50) (-50) (-50) (-50) (-50) (-50)
				(-50) (-50) (-50) (-50) (-50) (-50) (-50) (-50) (-50) (-50) (-50) (-50) (-50) (-50) (-50) (-50) (-50) (-50)
				(-50) (-50) (-50) (-50) (-50) (-50) (-50) (-50) (-50) (-50) (-50) (-50) (-50) (-50) (-50) (-50) (-50) (-50)
				(-50) (-50) (-50) (-50) (-50) (-50) (-50) (-50) (-50) (-50) (-50) (-50) (-50) (-50) (-50) (-50) (-50) (-50)
				(-50) (-50) (-50) (-50) (-50) (-50) (-50) (-50) (-50) (-50) (-50) (-50) (-50) (-50) (-50) (-50) (-50) (-50)
				(-50) (-50) (-50) (-50) (-50) (-50) (-50) (-50) (-50) (-50) (-50) (-50) (-50) (-50) (-50) (-50) (-50) (-50)
				(-50) (-50) (-50) (-50) (-50) (-50) (-50) (-50) (-50) (-50) (-50) (-50) (-50) (-50) (-50) (-50) (-50) (-50)
				(-50) (-50) (-50) (-50) (-50) (-50) (-50) (-50) (-50) (-50) (-50) (-50) (-50) (-50) (-50) (-50) (-50) (-50)
				(-50) (-50) (-50) (-50) (-50) (-50) (-50) (-50) (-50) (-50) (-50) (-50) (-50) (-50) (-50) (-50) (-50) (-50)
				(-50) (-50) (-50) (-50) (-50) (-50) (-50) (-50) (-50) (-50) (-50) (-50) (-50) (-50) (-50) (-50) (-50) (-50)
				(-50) (-50) (-50) (-50) (-50) (-50) (-50) (-50) (-50) (-50) (-50) (-50) (-50) (-50) (-50) (-50) (-50) (-50)
				(-50) (-50) (-50) (-50) (-50) (-50) (-50) (-50) (-50) (-50) (-50) (-50) (-50) (-50) (-50) (-50) (-50) (-50)
				(-50) (-50) (-50) (-50) (-50) (-50) (-50) (-50) (-50) (-50) (-50) (-50) (-50) (-50) (-50) (-50) (-50) (-50)
				(-50) (-50) (-50) (-50) (-50) (-50) (-50) (-50) (-50) (-50) (-50) (-50) (-50) (-50) (-50) (-50) (-50) (-50)
				(-50) (-50) (-50)>;

			PS_Config_Diff_Test_Frame = <50>;
		};

		// for Xiaomi F7B Shenchao NVT36672A
		novatek-mp-criteria-5916@0 {
			#address-cells = <1>;
			#size-cells = <0>;
			compatible = "novatek-mp-criteria-5916";

			/* MP Config */
			IC_X_CFG_SIZE = <18>;
			IC_Y_CFG_SIZE = <36>;
			IC_KEY_CFG_SIZE = <0>;
			X_Channel = <18>;
			Y_Channel = <36>;
			AIN_X = <0 1 2 3 4 5 6 7 8 9 10 11 12 13 14 15 16 17>;
			AIN_Y = <0 1 2 3 4 5 6 7 8 9 10 11 12 13 14 15 16 17
					 18 19 20 21 22 23 24 25 26 27 28 29 30 31 32 33 34 35>;
			AIN_KEY = <0 1 2 0xFF>;

			/* MP Criteria */
			PS_Config_Lmt_Short_Rawdata_P = <
                14000 14000 14000 14000 14000 14000 14000 14000 14000 14000 14000 14000 14000 14000 14000 14000 14000 14000
                14000 14000 14000 14000 14000 14000 14000 14000 14000 14000 14000 14000 14000 14000 14000 14000 14000 14000
                14000 14000 14000 14000 14000 14000 14000 14000 14000 14000 14000 14000 14000 14000 14000 14000 14000 14000
                14000 14000 14000 14000 14000 14000 14000 14000 14000 14000 14000 14000 14000 14000 14000 14000 14000 14000
                14000 14000 14000 14000 14000 14000 14000 14000 14000 14000 14000 14000 14000 14000 14000 14000 14000 14000
                14000 14000 14000 14000 14000 14000 14000 14000 14000 14000 14000 14000 14000 14000 14000 14000 14000 14000
                14000 14000 14000 14000 14000 14000 14000 14000 14000 14000 14000 14000 14000 14000 14000 14000 14000 14000
                14000 14000 14000 14000 14000 14000 14000 14000 14000 14000 14000 14000 14000 14000 14000 14000 14000 14000
                14000 14000 14000 14000 14000 14000 14000 14000 14000 14000 14000 14000 14000 14000 14000 14000 14000 14000
                14000 14000 14000 14000 14000 14000 14000 14000 14000 14000 14000 14000 14000 14000 14000 14000 14000 14000
                14000 14000 14000 14000 14000 14000 14000 14000 14000 14000 14000 14000 14000 14000 14000 14000 14000 14000
                14000 14000 14000 14000 14000 14000 14000 14000 14000 14000 14000 14000 14000 14000 14000 14000 14000 14000
                14000 14000 14000 14000 14000 14000 14000 14000 14000 14000 14000 14000 14000 14000 14000 14000 14000 14000
                14000 14000 14000 14000 14000 14000 14000 14000 14000 14000 14000 14000 14000 14000 14000 14000 14000 14000
                14000 14000 14000 14000 14000 14000 14000 14000 14000 14000 14000 14000 14000 14000 14000 14000 14000 14000
                14000 14000 14000 14000 14000 14000 14000 14000 14000 14000 14000 14000 14000 14000 14000 14000 14000 14000
                14000 14000 14000 14000 14000 14000 14000 14000 14000 14000 14000 14000 14000 14000 14000 14000 14000 14000
                14000 14000 14000 14000 14000 14000 14000 14000 14000 14000 14000 14000 14000 14000 14000 14000 14000 14000
                14000 14000 14000 14000 14000 14000 14000 14000 14000 14000 14000 14000 14000 14000 14000 14000 14000 14000
                14000 14000 14000 14000 14000 14000 14000 14000 14000 14000 14000 14000 14000 14000 14000 14000 14000 14000
                14000 14000 14000 14000 14000 14000 14000 14000 14000 14000 14000 14000 14000 14000 14000 14000 14000 14000
                14000 14000 14000 14000 14000 14000 14000 14000 14000 14000 14000 14000 14000 14000 14000 14000 14000 14000
                14000 14000 14000 14000 14000 14000 14000 14000 14000 14000 14000 14000 14000 14000 14000 14000 14000 14000
                14000 14000 14000 14000 14000 14000 14000 14000 14000 14000 14000 14000 14000 14000 14000 14000 14000 14000
                14000 14000 14000 14000 14000 14000 14000 14000 14000 14000 14000 14000 14000 14000 14000 14000 14000 14000
                14000 14000 14000 14000 14000 14000 14000 14000 14000 14000 14000 14000 14000 14000 14000 14000 14000 14000
                14000 14000 14000 14000 14000 14000 14000 14000 14000 14000 14000 14000 14000 14000 14000 14000 14000 14000
                14000 14000 14000 14000 14000 14000 14000 14000 14000 14000 14000 14000 14000 14000 14000 14000 14000 14000
                14000 14000 14000 14000 14000 14000 14000 14000 14000 14000 14000 14000 14000 14000 14000 14000 14000 14000
                14000 14000 14000 14000 14000 14000 14000 14000 14000 14000 14000 14000 14000 14000 14000 14000 14000 14000
                14000 14000 14000 14000 14000 14000 14000 14000 14000 14000 14000 14000 14000 14000 14000 14000 14000 14000
                14000 14000 14000 14000 14000 14000 14000 14000 14000 14000 14000 14000 14000 14000 14000 14000 14000 14000
                14000 14000 14000 14000 14000 14000 14000 14000 14000 14000 14000 14000 14000 14000 14000 14000 14000 14000
                14000 14000 14000 14000 14000 14000 14000 14000 14000 14000 14000 14000 14000 14000 14000 14000 14000 14000
                14000 14000 14000 14000 14000 14000 14000 14000 14000 14000 14000 14000 14000 14000 14000 14000 14000 14000
                14000 14000 14000 14000 14000 14000 14000 14000 14000 14000 14000 14000 14000 14000 14000 14000 14000 14000
				20000 20000 20000>;

			PS_Config_Lmt_Short_Rawdata_N = <
                11000 11000 11000 11000 11000 11000 11000 11000 11000 11000 11000 11000 11000 11000 11000 11000 11000 11000
                11000 11000 11000 11000 11000 11000 11000 11000 11000 11000 11000 11000 11000 11000 11000 11000 11000 11000
                11000 11000 11000 11000 11000 11000 11000 11000 11000 11000 11000 11000 11000 11000 11000 11000 11000 11000
                11000 11000 11000 11000 11000 11000 11000 11000 11000 11000 11000 11000 11000 11000 11000 11000 11000 11000
                11000 11000 11000 11000 11000 11000 11000 11000 11000 11000 11000 11000 11000 11000 11000 11000 11000 11000
                11000 11000 11000 11000 11000 11000 11000 11000 11000 11000 11000 11000 11000 11000 11000 11000 11000 11000
                11000 11000 11000 11000 11000 11000 11000 11000 11000 11000 11000 11000 11000 11000 11000 11000 11000 11000
                11000 11000 11000 11000 11000 11000 11000 11000 11000 11000 11000 11000 11000 11000 11000 11000 11000 11000
                11000 11000 11000 11000 11000 11000 11000 11000 11000 11000 11000 11000 11000 11000 11000 11000 11000 11000
                11000 11000 11000 11000 11000 11000 11000 11000 11000 11000 11000 11000 11000 11000 11000 11000 11000 11000
                11000 11000 11000 11000 11000 11000 11000 11000 11000 11000 11000 11000 11000 11000 11000 11000 11000 11000
                11000 11000 11000 11000 11000 11000 11000 11000 11000 11000 11000 11000 11000 11000 11000 11000 11000 11000
                11000 11000 11000 11000 11000 11000 11000 11000 11000 11000 11000 11000 11000 11000 11000 11000 11000 11000
                11000 11000 11000 11000 11000 11000 11000 11000 11000 11000 11000 11000 11000 11000 11000 11000 11000 11000
                11000 11000 11000 11000 11000 11000 11000 11000 11000 11000 11000 11000 11000 11000 11000 11000 11000 11000
                11000 11000 11000 11000 11000 11000 11000 11000 11000 11000 11000 11000 11000 11000 11000 11000 11000 11000
                11000 11000 11000 11000 11000 11000 11000 11000 11000 11000 11000 11000 11000 11000 11000 11000 11000 11000
                11000 11000 11000 11000 11000 11000 11000 11000 11000 11000 11000 11000 11000 11000 11000 11000 11000 11000
                11000 11000 11000 11000 11000 11000 11000 11000 11000 11000 11000 11000 11000 11000 11000 11000 11000 11000
                11000 11000 11000 11000 11000 11000 11000 11000 11000 11000 11000 11000 11000 11000 11000 11000 11000 11000
                11000 11000 11000 11000 11000 11000 11000 11000 11000 11000 11000 11000 11000 11000 11000 11000 11000 11000
                11000 11000 11000 11000 11000 11000 11000 11000 11000 11000 11000 11000 11000 11000 11000 11000 11000 11000
                11000 11000 11000 11000 11000 11000 11000 11000 11000 11000 11000 11000 11000 11000 11000 11000 11000 11000
                11000 11000 11000 11000 11000 11000 11000 11000 11000 11000 11000 11000 11000 11000 11000 11000 11000 11000
                11000 11000 11000 11000 11000 11000 11000 11000 11000 11000 11000 11000 11000 11000 11000 11000 11000 11000
                11000 11000 11000 11000 11000 11000 11000 11000 11000 11000 11000 11000 11000 11000 11000 11000 11000 11000
                11000 11000 11000 11000 11000 11000 11000 11000 11000 11000 11000 11000 11000 11000 11000 11000 11000 11000
                11000 11000 11000 11000 11000 11000 11000 11000 11000 11000 11000 11000 11000 11000 11000 11000 11000 11000
                11000 11000 11000 11000 11000 11000 11000 11000 11000 11000 11000 11000 11000 11000 11000 11000 11000 11000
                11000 11000 11000 11000 11000 11000 11000 11000 11000 11000 11000 11000 11000 11000 11000 11000 11000 11000
                11000 11000 11000 11000 11000 11000 11000 11000 11000 11000 11000 11000 11000 11000 11000 11000 11000 11000
                11000 11000 11000 11000 11000 11000 11000 11000 11000 11000 11000 11000 11000 11000 11000 11000 11000 11000
                11000 11000 11000 11000 11000 11000 11000 11000 11000 11000 11000 11000 11000 11000 11000 11000 11000 11000
                11000 11000 11000 11000 11000 11000 11000 11000 11000 11000 11000 11000 11000 11000 11000 11000 11000 11000
                11000 11000 11000 11000 11000 11000 11000 11000 11000 11000 11000 11000 11000 11000 11000 11000 11000 11000
                11000 11000 11000 11000 11000 11000 11000 11000 11000 11000 11000 11000 11000 11000 11000 11000 11000 11000
				11550 11550 11550>;

			PS_Config_Lmt_Short_Diff_P = <
				6300 6300 6300 6300 6300 6300 6300 6300 6300 6300 6300 6300 6300 6300 6300 6300 6300 6300
				6300 6300 6300 6300 6300 6300 6300 6300 6300 6300 6300 6300 6300 6300 6300 6300 6300 6300
				6300 6300 6300 6300 6300 6300 6300 6300 6300 6300 6300 6300 6300 6300 6300 6300 6300 6300
				6300 6300 6300 6300 6300 6300 6300 6300 6300 6300 6300 6300 6300 6300 6300 6300 6300 6300
				6300 6300 6300 6300 6300 6300 6300 6300 6300 6300 6300 6300 6300 6300 6300 6300 6300 6300
				6300 6300 6300 6300 6300 6300 6300 6300 6300 6300 6300 6300 6300 6300 6300 6300 6300 6300
				6300 6300 6300 6300 6300 6300 6300 6300 6300 6300 6300 6300 6300 6300 6300 6300 6300 6300
				6300 6300 6300 6300 6300 6300 6300 6300 6300 6300 6300 6300 6300 6300 6300 6300 6300 6300
				6300 6300 6300 6300 6300 6300 6300 6300 6300 6300 6300 6300 6300 6300 6300 6300 6300 6300
				6300 6300 6300 6300 6300 6300 6300 6300 6300 6300 6300 6300 6300 6300 6300 6300 6300 6300
				6300 6300 6300 6300 6300 6300 6300 6300 6300 6300 6300 6300 6300 6300 6300 6300 6300 6300
				6300 6300 6300 6300 6300 6300 6300 6300 6300 6300 6300 6300 6300 6300 6300 6300 6300 6300
				6300 6300 6300 6300 6300 6300 6300 6300 6300 6300 6300 6300 6300 6300 6300 6300 6300 6300
				6300 6300 6300 6300 6300 6300 6300 6300 6300 6300 6300 6300 6300 6300 6300 6300 6300 6300
				6300 6300 6300 6300 6300 6300 6300 6300 6300 6300 6300 6300 6300 6300 6300 6300 6300 6300
				6300 6300 6300 6300 6300 6300 6300 6300 6300 6300 6300 6300 6300 6300 6300 6300 6300 6300
				6300 6300 6300 6300 6300 6300 6300 6300 6300 6300 6300 6300 6300 6300 6300 6300 6300 6300
				6300 6300 6300 6300 6300 6300 6300 6300 6300 6300 6300 6300 6300 6300 6300 6300 6300 6300
				6300 6300 6300 6300 6300 6300 6300 6300 6300 6300 6300 6300 6300 6300 6300 6300 6300 6300
				6300 6300 6300 6300 6300 6300 6300 6300 6300 6300 6300 6300 6300 6300 6300 6300 6300 6300
				6300 6300 6300 6300 6300 6300 6300 6300 6300 6300 6300 6300 6300 6300 6300 6300 6300 6300
				6300 6300 6300 6300 6300 6300 6300 6300 6300 6300 6300 6300 6300 6300 6300 6300 6300 6300
				6300 6300 6300 6300 6300 6300 6300 6300 6300 6300 6300 6300 6300 6300 6300 6300 6300 6300
				6300 6300 6300 6300 6300 6300 6300 6300 6300 6300 6300 6300 6300 6300 6300 6300 6300 6300
				6300 6300 6300 6300 6300 6300 6300 6300 6300 6300 6300 6300 6300 6300 6300 6300 6300 6300
				6300 6300 6300 6300 6300 6300 6300 6300 6300 6300 6300 6300 6300 6300 6300 6300 6300 6300
				6300 6300 6300 6300 6300 6300 6300 6300 6300 6300 6300 6300 6300 6300 6300 6300 6300 6300
				6300 6300 6300 6300 6300 6300 6300 6300 6300 6300 6300 6300 6300 6300 6300 6300 6300 6300
				6300 6300 6300 6300 6300 6300 6300 6300 6300 6300 6300 6300 6300 6300 6300 6300 6300 6300
				6300 6300 6300 6300 6300 6300 6300 6300 6300 6300 6300 6300 6300 6300 6300 6300 6300 6300
				6300 6300 6300 6300 6300 6300 6300 6300 6300 6300 6300 6300 6300 6300 6300 6300 6300 6300
				6300 6300 6300 6300 6300 6300 6300 6300 6300 6300 6300 6300 6300 6300 6300 6300 6300 6300
				6300 6300 6300>;

			PS_Config_Lmt_Short_Diff_N = <
				0 0 0 0 0 0 0 0 0 0 0 0 0 0 0 0 0 0
				0 0 0 0 0 0 0 0 0 0 0 0 0 0 0 0 0 0
				0 0 0 0 0 0 0 0 0 0 0 0 0 0 0 0 0 0
				0 0 0 0 0 0 0 0 0 0 0 0 0 0 0 0 0 0
				0 0 0 0 0 0 0 0 0 0 0 0 0 0 0 0 0 0
				0 0 0 0 0 0 0 0 0 0 0 0 0 0 0 0 0 0
				0 0 0 0 0 0 0 0 0 0 0 0 0 0 0 0 0 0
				0 0 0 0 0 0 0 0 0 0 0 0 0 0 0 0 0 0
				0 0 0 0 0 0 0 0 0 0 0 0 0 0 0 0 0 0
				0 0 0 0 0 0 0 0 0 0 0 0 0 0 0 0 0 0
				0 0 0 0 0 0 0 0 0 0 0 0 0 0 0 0 0 0
				0 0 0 0 0 0 0 0 0 0 0 0 0 0 0 0 0 0
				0 0 0 0 0 0 0 0 0 0 0 0 0 0 0 0 0 0
				0 0 0 0 0 0 0 0 0 0 0 0 0 0 0 0 0 0
				0 0 0 0 0 0 0 0 0 0 0 0 0 0 0 0 0 0
				0 0 0 0 0 0 0 0 0 0 0 0 0 0 0 0 0 0
				0 0 0 0 0 0 0 0 0 0 0 0 0 0 0 0 0 0
				0 0 0 0 0 0 0 0 0 0 0 0 0 0 0 0 0 0
				0 0 0 0 0 0 0 0 0 0 0 0 0 0 0 0 0 0
				0 0 0 0 0 0 0 0 0 0 0 0 0 0 0 0 0 0
				0 0 0 0 0 0 0 0 0 0 0 0 0 0 0 0 0 0
				0 0 0 0 0 0 0 0 0 0 0 0 0 0 0 0 0 0
				0 0 0 0 0 0 0 0 0 0 0 0 0 0 0 0 0 0
				0 0 0 0 0 0 0 0 0 0 0 0 0 0 0 0 0 0
				0 0 0 0 0 0 0 0 0 0 0 0 0 0 0 0 0 0
				0 0 0 0 0 0 0 0 0 0 0 0 0 0 0 0 0 0
				0 0 0 0 0 0 0 0 0 0 0 0 0 0 0 0 0 0
				0 0 0 0 0 0 0 0 0 0 0 0 0 0 0 0 0 0
				0 0 0 0 0 0 0 0 0 0 0 0 0 0 0 0 0 0
				0 0 0 0 0 0 0 0 0 0 0 0 0 0 0 0 0 0
				0 0 0 0 0 0 0 0 0 0 0 0 0 0 0 0 0 0
				0 0 0 0 0 0 0 0 0 0 0 0 0 0 0 0 0 0
				0 0 0>;

			PS_Config_Lmt_Short_Base_P = <
				2000 2000 2000 2000 2000 2000 2000 2000 2000 2000 2000 2000 2000 2000 2000 2000 2000 2000
				2000 2000 2000 2000 2000 2000 2000 2000 2000 2000 2000 2000 2000 2000 2000 2000 2000 2000
				2000 2000 2000 2000 2000 2000 2000 2000 2000 2000 2000 2000 2000 2000 2000 2000 2000 2000
				2000 2000 2000 2000 2000 2000 2000 2000 2000 2000 2000 2000 2000 2000 2000 2000 2000 2000
				2000 2000 2000 2000 2000 2000 2000 2000 2000 2000 2000 2000 2000 2000 2000 2000 2000 2000
				2000 2000 2000 2000 2000 2000 2000 2000 2000 2000 2000 2000 2000 2000 2000 2000 2000 2000
				2000 2000 2000 2000 2000 2000 2000 2000 2000 2000 2000 2000 2000 2000 2000 2000 2000 2000
				2000 2000 2000 2000 2000 2000 2000 2000 2000 2000 2000 2000 2000 2000 2000 2000 2000 2000
				2000 2000 2000 2000 2000 2000 2000 2000 2000 2000 2000 2000 2000 2000 2000 2000 2000 2000
				2000 2000 2000 2000 2000 2000 2000 2000 2000 2000 2000 2000 2000 2000 2000 2000 2000 2000
				2000 2000 2000 2000 2000 2000 2000 2000 2000 2000 2000 2000 2000 2000 2000 2000 2000 2000
				2000 2000 2000 2000 2000 2000 2000 2000 2000 2000 2000 2000 2000 2000 2000 2000 2000 2000
				2000 2000 2000 2000 2000 2000 2000 2000 2000 2000 2000 2000 2000 2000 2000 2000 2000 2000
				2000 2000 2000 2000 2000 2000 2000 2000 2000 2000 2000 2000 2000 2000 2000 2000 2000 2000
				2000 2000 2000 2000 2000 2000 2000 2000 2000 2000 2000 2000 2000 2000 2000 2000 2000 2000
				2000 2000 2000 2000 2000 2000 2000 2000 2000 2000 2000 2000 2000 2000 2000 2000 2000 2000
				2000 2000 2000 2000 2000 2000 2000 2000 2000 2000 2000 2000 2000 2000 2000 2000 2000 2000
				2000 2000 2000 2000 2000 2000 2000 2000 2000 2000 2000 2000 2000 2000 2000 2000 2000 2000
				2000 2000 2000 2000 2000 2000 2000 2000 2000 2000 2000 2000 2000 2000 2000 2000 2000 2000
				2000 2000 2000 2000 2000 2000 2000 2000 2000 2000 2000 2000 2000 2000 2000 2000 2000 2000
				2000 2000 2000 2000 2000 2000 2000 2000 2000 2000 2000 2000 2000 2000 2000 2000 2000 2000
				2000 2000 2000 2000 2000 2000 2000 2000 2000 2000 2000 2000 2000 2000 2000 2000 2000 2000
				2000 2000 2000 2000 2000 2000 2000 2000 2000 2000 2000 2000 2000 2000 2000 2000 2000 2000
				2000 2000 2000 2000 2000 2000 2000 2000 2000 2000 2000 2000 2000 2000 2000 2000 2000 2000
				2000 2000 2000 2000 2000 2000 2000 2000 2000 2000 2000 2000 2000 2000 2000 2000 2000 2000
				2000 2000 2000 2000 2000 2000 2000 2000 2000 2000 2000 2000 2000 2000 2000 2000 2000 2000
				2000 2000 2000 2000 2000 2000 2000 2000 2000 2000 2000 2000 2000 2000 2000 2000 2000 2000
				2000 2000 2000 2000 2000 2000 2000 2000 2000 2000 2000 2000 2000 2000 2000 2000 2000 2000
				2000 2000 2000 2000 2000 2000 2000 2000 2000 2000 2000 2000 2000 2000 2000 2000 2000 2000
				2000 2000 2000 2000 2000 2000 2000 2000 2000 2000 2000 2000 2000 2000 2000 2000 2000 2000
				2000 2000 2000 2000 2000 2000 2000 2000 2000 2000 2000 2000 2000 2000 2000 2000 2000 2000
				2000 2000 2000 2000 2000 2000 2000 2000 2000 2000 2000 2000 2000 2000 2000 2000 2000 2000
				2000 2000 2000>;

			PS_Config_Lmt_Short_Base_N = <
				(-2000) (-2000) (-2000) (-2000) (-2000) (-2000) (-2000) (-2000) (-2000) (-2000) (-2000) (-2000) (-2000) (-2000) (-2000) (-2000) (-2000) (-2000)
				(-2000) (-2000) (-2000) (-2000) (-2000) (-2000) (-2000) (-2000) (-2000) (-2000) (-2000) (-2000) (-2000) (-2000) (-2000) (-2000) (-2000) (-2000)
				(-2000) (-2000) (-2000) (-2000) (-2000) (-2000) (-2000) (-2000) (-2000) (-2000) (-2000) (-2000) (-2000) (-2000) (-2000) (-2000) (-2000) (-2000)
				(-2000) (-2000) (-2000) (-2000) (-2000) (-2000) (-2000) (-2000) (-2000) (-2000) (-2000) (-2000) (-2000) (-2000) (-2000) (-2000) (-2000) (-2000)
				(-2000) (-2000) (-2000) (-2000) (-2000) (-2000) (-2000) (-2000) (-2000) (-2000) (-2000) (-2000) (-2000) (-2000) (-2000) (-2000) (-2000) (-2000)
				(-2000) (-2000) (-2000) (-2000) (-2000) (-2000) (-2000) (-2000) (-2000) (-2000) (-2000) (-2000) (-2000) (-2000) (-2000) (-2000) (-2000) (-2000)
				(-2000) (-2000) (-2000) (-2000) (-2000) (-2000) (-2000) (-2000) (-2000) (-2000) (-2000) (-2000) (-2000) (-2000) (-2000) (-2000) (-2000) (-2000)
				(-2000) (-2000) (-2000) (-2000) (-2000) (-2000) (-2000) (-2000) (-2000) (-2000) (-2000) (-2000) (-2000) (-2000) (-2000) (-2000) (-2000) (-2000)
				(-2000) (-2000) (-2000) (-2000) (-2000) (-2000) (-2000) (-2000) (-2000) (-2000) (-2000) (-2000) (-2000) (-2000) (-2000) (-2000) (-2000) (-2000)
				(-2000) (-2000) (-2000) (-2000) (-2000) (-2000) (-2000) (-2000) (-2000) (-2000) (-2000) (-2000) (-2000) (-2000) (-2000) (-2000) (-2000) (-2000)
				(-2000) (-2000) (-2000) (-2000) (-2000) (-2000) (-2000) (-2000) (-2000) (-2000) (-2000) (-2000) (-2000) (-2000) (-2000) (-2000) (-2000) (-2000)
				(-2000) (-2000) (-2000) (-2000) (-2000) (-2000) (-2000) (-2000) (-2000) (-2000) (-2000) (-2000) (-2000) (-2000) (-2000) (-2000) (-2000) (-2000)
				(-2000) (-2000) (-2000) (-2000) (-2000) (-2000) (-2000) (-2000) (-2000) (-2000) (-2000) (-2000) (-2000) (-2000) (-2000) (-2000) (-2000) (-2000)
				(-2000) (-2000) (-2000) (-2000) (-2000) (-2000) (-2000) (-2000) (-2000) (-2000) (-2000) (-2000) (-2000) (-2000) (-2000) (-2000) (-2000) (-2000)
				(-2000) (-2000) (-2000) (-2000) (-2000) (-2000) (-2000) (-2000) (-2000) (-2000) (-2000) (-2000) (-2000) (-2000) (-2000) (-2000) (-2000) (-2000)
				(-2000) (-2000) (-2000) (-2000) (-2000) (-2000) (-2000) (-2000) (-2000) (-2000) (-2000) (-2000) (-2000) (-2000) (-2000) (-2000) (-2000) (-2000)
				(-2000) (-2000) (-2000) (-2000) (-2000) (-2000) (-2000) (-2000) (-2000) (-2000) (-2000) (-2000) (-2000) (-2000) (-2000) (-2000) (-2000) (-2000)
				(-2000) (-2000) (-2000) (-2000) (-2000) (-2000) (-2000) (-2000) (-2000) (-2000) (-2000) (-2000) (-2000) (-2000) (-2000) (-2000) (-2000) (-2000)
				(-2000) (-2000) (-2000) (-2000) (-2000) (-2000) (-2000) (-2000) (-2000) (-2000) (-2000) (-2000) (-2000) (-2000) (-2000) (-2000) (-2000) (-2000)
				(-2000) (-2000) (-2000) (-2000) (-2000) (-2000) (-2000) (-2000) (-2000) (-2000) (-2000) (-2000) (-2000) (-2000) (-2000) (-2000) (-2000) (-2000)
				(-2000) (-2000) (-2000) (-2000) (-2000) (-2000) (-2000) (-2000) (-2000) (-2000) (-2000) (-2000) (-2000) (-2000) (-2000) (-2000) (-2000) (-2000)
				(-2000) (-2000) (-2000) (-2000) (-2000) (-2000) (-2000) (-2000) (-2000) (-2000) (-2000) (-2000) (-2000) (-2000) (-2000) (-2000) (-2000) (-2000)
				(-2000) (-2000) (-2000) (-2000) (-2000) (-2000) (-2000) (-2000) (-2000) (-2000) (-2000) (-2000) (-2000) (-2000) (-2000) (-2000) (-2000) (-2000)
				(-2000) (-2000) (-2000) (-2000) (-2000) (-2000) (-2000) (-2000) (-2000) (-2000) (-2000) (-2000) (-2000) (-2000) (-2000) (-2000) (-2000) (-2000)
				(-2000) (-2000) (-2000) (-2000) (-2000) (-2000) (-2000) (-2000) (-2000) (-2000) (-2000) (-2000) (-2000) (-2000) (-2000) (-2000) (-2000) (-2000)
				(-2000) (-2000) (-2000) (-2000) (-2000) (-2000) (-2000) (-2000) (-2000) (-2000) (-2000) (-2000) (-2000) (-2000) (-2000) (-2000) (-2000) (-2000)
				(-2000) (-2000) (-2000) (-2000) (-2000) (-2000) (-2000) (-2000) (-2000) (-2000) (-2000) (-2000) (-2000) (-2000) (-2000) (-2000) (-2000) (-2000)
				(-2000) (-2000) (-2000) (-2000) (-2000) (-2000) (-2000) (-2000) (-2000) (-2000) (-2000) (-2000) (-2000) (-2000) (-2000) (-2000) (-2000) (-2000)
				(-2000) (-2000) (-2000) (-2000) (-2000) (-2000) (-2000) (-2000) (-2000) (-2000) (-2000) (-2000) (-2000) (-2000) (-2000) (-2000) (-2000) (-2000)
				(-2000) (-2000) (-2000) (-2000) (-2000) (-2000) (-2000) (-2000) (-2000) (-2000) (-2000) (-2000) (-2000) (-2000) (-2000) (-2000) (-2000) (-2000)
				(-2000) (-2000) (-2000) (-2000) (-2000) (-2000) (-2000) (-2000) (-2000) (-2000) (-2000) (-2000) (-2000) (-2000) (-2000) (-2000) (-2000) (-2000)
				(-2000) (-2000) (-2000) (-2000) (-2000) (-2000) (-2000) (-2000) (-2000) (-2000) (-2000) (-2000) (-2000) (-2000) (-2000) (-2000) (-2000) (-2000)
				(-2000) (-2000) (-2000)>;

            PS_Config_Lmt_Open_Rawdata_P = <
                65535	3409	3402	3402	3407	3393	3396	3342	65535	65535	3403	3465	3467	3478	3478	3467	3471	65535
                3098	3136	3137	3134	3137	3127	3130	3121	2950	2993	3168	3179	3180	3189	3190	3188	3185	3138
                3247	3216	3216	3214	3216	3205	3208	3197	3197	3251	3247	3259	3260	3270	3272	3267	3267	3284
                3173	3142	3143	3140	3141	3130	3133	3121	3123	3177	3173	3185	3186	3194	3198	3195	3195	3212
                3254	3221	3223	3219	3219	3208	3212	3199	3201	3257	3251	3264	3264	3273	3276	3273	3275	3293
                3179	3146	3147	3142	3142	3132	3136	3123	3125	3172	3167	3180	3181	3189	3193	3193	3194	3215
                3253	3219	3220	3216	3216	3206	3208	3195	3199	3249	3241	3257	3257	3266	3270	3270	3267	3288
                3180	3145	3147	3142	3143	3133	3136	3123	3128	3169	3163	3177	3176	3184	3188	3190	3188	3211
                3255	3220	3223	3218	3219	3207	3212	3197	3202	3245	3237	3253	3251	3260	3263	3267	3264	3290
                3169	3136	3138	3132	3133	3123	3128	3115	3117	3163	3156	3171	3168	3176	3179	3185	3182	3208
                3246	3211	3215	3208	3208	3199	3203	3190	3193	3244	3236	3247	3247	3255	3258	3264	3262	3288
                3167	3130	3136	3129	3129	3119	3124	3112	3115	3156	3146	3156	3155	3163	3166	3172	3171	3197
                3233	3199	3203	3197	3198	3188	3192	3180	3182	3228	3216	3225	3224	3233	3236	3244	3244	3271
                3155	3121	3125	3119	3120	3110	3114	3106	3104	3145	3136	3143	3142	3151	3154	3162	3163	3190
                3220	3185	3192	3185	3186	3176	3180	3175	3171	3219	3208	3216	3215	3224	3225	3234	3233	3262
                3136	3103	3108	3102	3103	3094	3101	3093	3089	3130	3124	3129	3127	3136	3140	3147	3147	3175
                3207	3173	3179	3172	3175	3164	3171	3169	3160	3207	3201	3203	3202	3211	3212	3221	3221	3251
                3121	3089	3094	3088	3088	3078	3086	3080	3075	3115	3104	3112	3108	3116	3119	3128	3128	3156
                3182	3149	3154	3146	3149	3140	3146	3140	3134	3189	3179	3186	3181	3190	3193	3202	3203	3231
                3099	3064	3071	3064	3065	3056	3064	3058	3055	3101	3090	3098	3093	3101	3104	3111	3112	3141
                3163	3129	3134	3128	3130	3121	3129	3121	3123	3168	3158	3164	3160	3168	3171	3179	3180	3210
                3078	3043	3049	3043	3045	3037	3047	3037	3037	3075	3064	3073	3068	3075	3078	3085	3086	3116
                3140	3107	3111	3106	3107	3099	3107	3099	3098	3149	3137	3146	3141	3149	3151	3156	3159	3189
                3054	3020	3024	3017	3020	3012	3021	3013	3012	3051	3041	3051	3045	3052	3054	3060	3062	3091
                2920	2887	2893	2889	2887	2880	2889	2881	2885	2929	2915	2924	2917	2925	2928	2933	2935	2964
                2842	2809	2813	2808	2809	2802	2811	2803	2807	2834	2824	2833	2826	2833	2835	2842	2844	2873
                2900	2865	2870	2864	2865	2859	2868	2861	2863	2899	2894	2900	2893	2900	2903	2908	2912	2943
                2817	2782	2787	2781	2782	2776	2785	2779	2779	2795	2794	2802	2796	2803	2804	2812	2813	2844
                2872	2841	2844	2839	2839	2833	2843	2834	2837	2856	2854	2864	2856	2863	2865	2872	2874	2903
                2783	2752	2756	2751	2751	2746	2755	2746	2748	2765	2763	2774	2766	2772	2774	2782	2783	2809
                2839	2807	2811	2804	2804	2799	2808	2798	2803	2826	2824	2835	2828	2833	2837	2843	2844	2872
                2753	2720	2724	2718	2718	2712	2722	2712	2716	2734	2731	2744	2735	2742	2744	2751	2752	2778
                2805	2774	2777	2772	2772	2765	2778	2765	2770	2791	2789	2802	2792	2800	2802	2808	2809	2837
                2356	2682	2685	2681	2681	2675	2690	2675	2679	2696	2692	2709	2696	2703	2705	2712	2712	2375
                2331	2733	2737	2731	2733	2726	2742	2725	2730	2757	2753	2772	2756	2764	2765	2772	2774	2362
                2161	2562	2666	2672	2673	2659	2675	2660	2665	2685	2682	2699	2685	2699	2700	2696	2595	2187
                13000 13000 13000>;

            PS_Config_Lmt_Open_Rawdata_N = <
                (-65535)	1835	1832	1832	1835	1827	1828	1800	(-65535)	(-65535)	1833	1866	1867	1873	1873	1867	1869	(-65535)
                1668	1688	1689	1688	1689	1684	1686	1681	1588	1611	1706	1712	1712	1717	1718	1716	1715	1690
                1749	1732	1732	1730	1732	1726	1728	1721	1721	1751	1749	1755	1756	1761	1762	1759	1759	1768
                1709	1692	1693	1691	1691	1686	1687	1681	1681	1711	1709	1715	1716	1720	1722	1721	1721	1730
                1752	1735	1735	1733	1733	1728	1730	1723	1723	1754	1751	1758	1758	1763	1764	1763	1763	1773
                1712	1694	1695	1692	1692	1686	1688	1681	1683	1708	1705	1712	1713	1717	1719	1719	1720	1731
                1751	1733	1734	1732	1732	1726	1728	1721	1723	1749	1745	1754	1754	1758	1761	1761	1759	1770
                1712	1693	1695	1692	1693	1687	1688	1681	1684	1707	1703	1711	1710	1714	1716	1718	1716	1729
                1753	1734	1735	1733	1733	1727	1730	1721	1724	1747	1743	1751	1751	1756	1757	1759	1758	1772
                1707	1688	1690	1686	1687	1681	1684	1677	1679	1703	1700	1707	1706	1710	1712	1715	1714	1728
                1748	1729	1731	1728	1728	1723	1725	1718	1719	1747	1742	1749	1749	1753	1754	1758	1756	1770
                1705	1686	1688	1685	1685	1679	1682	1676	1677	1700	1694	1700	1699	1703	1705	1708	1707	1721
                1741	1723	1725	1721	1722	1716	1719	1712	1714	1738	1732	1737	1736	1741	1742	1747	1747	1761
                1699	1681	1683	1679	1680	1674	1677	1672	1672	1693	1688	1693	1692	1697	1698	1702	1703	1718
                1734	1715	1719	1715	1716	1710	1712	1709	1707	1733	1728	1732	1731	1736	1737	1742	1741	1756
                1688	1671	1674	1670	1671	1666	1670	1665	1663	1686	1682	1685	1684	1688	1691	1695	1695	1709
                1727	1709	1712	1708	1709	1704	1707	1707	1702	1727	1723	1725	1724	1729	1730	1735	1735	1751
                1681	1663	1666	1663	1663	1658	1662	1658	1656	1677	1672	1676	1674	1678	1679	1684	1684	1700
                1714	1695	1698	1694	1695	1691	1694	1691	1688	1717	1712	1716	1713	1718	1719	1724	1725	1740
                1669	1650	1653	1650	1651	1646	1650	1646	1645	1670	1664	1668	1665	1670	1672	1675	1676	1691
                1703	1685	1688	1684	1686	1681	1685	1681	1681	1706	1700	1704	1702	1706	1707	1712	1712	1728
                1658	1639	1642	1639	1639	1635	1641	1635	1635	1656	1650	1655	1652	1656	1658	1661	1662	1678
                1691	1673	1675	1672	1673	1669	1673	1669	1668	1695	1689	1694	1691	1695	1697	1700	1701	1717
                1644	1626	1628	1625	1626	1622	1627	1623	1622	1643	1637	1643	1639	1644	1644	1648	1649	1665
                1572	1555	1558	1555	1555	1551	1555	1551	1553	1577	1569	1574	1571	1575	1576	1579	1581	1596
                1530	1513	1515	1512	1513	1509	1513	1509	1511	1526	1520	1525	1522	1525	1527	1530	1532	1547
                1562	1543	1546	1542	1543	1539	1544	1541	1541	1561	1558	1562	1558	1562	1563	1566	1568	1585
                1517	1498	1501	1497	1498	1495	1499	1497	1497	1505	1504	1509	1506	1509	1510	1514	1515	1532
                1546	1530	1532	1529	1529	1525	1531	1526	1527	1538	1537	1542	1538	1541	1543	1546	1548	1563
                1499	1482	1484	1481	1481	1478	1483	1478	1480	1489	1488	1494	1490	1492	1494	1498	1499	1513
                1529	1511	1513	1510	1510	1507	1512	1506	1509	1522	1520	1527	1523	1525	1527	1531	1532	1546
                1483	1464	1467	1464	1464	1460	1466	1460	1462	1472	1471	1478	1473	1476	1478	1481	1482	1496
                1511	1494	1495	1492	1492	1489	1496	1489	1492	1503	1502	1509	1504	1508	1509	1512	1513	1527
                1268	1444	1446	1443	1443	1441	1448	1441	1443	1452	1450	1459	1452	1455	1457	1460	1460	1279
                1255	1471	1474	1471	1471	1468	1476	1467	1470	1485	1483	1492	1484	1488	1489	1492	1494	1272
                1163	1380	1436	1439	1439	1432	1441	1432	1435	1446	1444	1453	1446	1453	1454	1452	1397	1177
                6500 6500 6500>;

            PS_Config_Lmt_FW_Rawdata_P = <
                65535	1750	1750	1750	1750	1750	1750	1750	65535	65535	1750	1750	1750	1750	1750	1750	1750	65535
                1750	1750	1750	1750	1750	1750	1750	1750	1750	1750	1750	1750	1750	1750	1750	1750	1750	1750
                1750	1750	1750	1750	1750	1750	1750	1750	1750	1750	1750	1750	1750	1750	1750	1750	1750	1750
                1750	1750	1750	1750	1750	1750	1750	1750	1750	1750	1750	1750	1750	1750	1750	1750	1750	1750
                1750	1750	1750	1750	1750	1750	1750	1750	1750	1750	1750	1750	1750	1750	1750	1750	1750	1750
                1750	1750	1750	1750	1750	1750	1750	1750	1750	1750	1750	1750	1750	1750	1750	1750	1750	1750
                1750	1750	1750	1750	1750	1750	1750	1750	1750	1750	1750	1750	1750	1750	1750	1750	1750	1750
                1750	1750	1750	1750	1750	1750	1750	1750	1750	1750	1750	1750	1750	1750	1750	1750	1750	1750
                1750	1750	1750	1750	1750	1750	1750	1750	1750	1750	1750	1750	1750	1750	1750	1750	1750	1750
                1750	1750	1750	1750	1750	1750	1750	1750	1750	1750	1750	1750	1750	1750	1750	1750	1750	1750
                1750	1750	1750	1750	1750	1750	1750	1750	1750	1750	1750	1750	1750	1750	1750	1750	1750	1750
                1750	1750	1750	1750	1750	1750	1750	1750	1750	1750	1750	1750	1750	1750	1750	1750	1750	1750
                1750	1750	1750	1750	1750	1750	1750	1750	1750	1750	1750	1750	1750	1750	1750	1750	1750	1750
                1750	1750	1750	1750	1750	1750	1750	1750	1750	1750	1750	1750	1750	1750	1750	1750	1750	1750
                1750	1750	1750	1750	1750	1750	1750	1750	1750	1750	1750	1750	1750	1750	1750	1750	1750	1750
                1750	1750	1750	1750	1750	1750	1750	1750	1750	1750	1750	1750	1750	1750	1750	1750	1750	1750
                1750	1750	1750	1750	1750	1750	1750	1750	1750	1750	1750	1750	1750	1750	1750	1750	1750	1750
                1750	1750	1750	1750	1750	1750	1750	1750	1750	1750	1750	1750	1750	1750	1750	1750	1750	1750
                1750	1750	1750	1750	1750	1750	1750	1750	1750	1750	1750	1750	1750	1750	1750	1750	1750	1750
                1750	1750	1750	1750	1750	1750	1750	1750	1750	1750	1750	1750	1750	1750	1750	1750	1750	1750
                1750	1750	1750	1750	1750	1750	1750	1750	1750	1750	1750	1750	1750	1750	1750	1750	1750	1750
                1750	1750	1750	1750	1750	1750	1750	1750	1750	1750	1750	1750	1750	1750	1750	1750	1750	1750
                1750	1750	1750	1750	1750	1750	1750	1750	1750	1750	1750	1750	1750	1750	1750	1750	1750	1750
                1750	1750	1750	1750	1750	1750	1750	1750	1750	1750	1750	1750	1750	1750	1750	1750	1750	1750
                1750	1750	1750	1750	1750	1750	1750	1750	1750	1750	1750	1750	1750	1750	1750	1750	1750	1750
                1750	1750	1750	1750	1750	1750	1750	1750	1750	1750	1750	1750	1750	1750	1750	1750	1750	1750
                1750	1750	1750	1750	1750	1750	1750	1750	1750	1750	1750	1750	1750	1750	1750	1750	1750	1750
                1750	1750	1750	1750	1750	1750	1750	1750	1750	1750	1750	1750	1750	1750	1750	1750	1750	1750
                1750	1750	1750	1750	1750	1750	1750	1750	1750	1750	1750	1750	1750	1750	1750	1750	1750	1750
                1750	1750	1750	1750	1750	1750	1750	1750	1750	1750	1750	1750	1750	1750	1750	1750	1750	1750
                1750	1750	1750	1750	1750	1750	1750	1750	1750	1750	1750	1750	1750	1750	1750	1750	1750	1750
                1750	1750	1750	1750	1750	1750	1750	1750	1750	1750	1750	1750	1750	1750	1750	1750	1750	1750
                1750	1750	1750	1750	1750	1750	1750	1750	1750	1750	1750	1750	1750	1750	1750	1750	1750	1750
                1750	1750	1750	1750	1750	1750	1750	1750	1750	1750	1750	1750	1750	1750	1750	1750	1750	1750
                1750	1750	1750	1750	1750	1750	1750	1750	1750	1750	1750	1750	1750	1750	1750	1750	1750	1750
                1750	1750	1750	1750	1750	1750	1750	1750	1750	1750	1750	1750	1750	1750	1750	1750	1750	1750
                2000 2000 2000>;

            PS_Config_Lmt_FW_Rawdata_N = <
                (-65535)	650	650	650	650	650	650	650	(-65535)	(-65535)	650	650	650	650	650	650	650	(-65535)
                650	650	650	650	650	650	650	650	650	650	650	650	650	650	650	650	650	650
                650	650	650	650	650	650	650	650	650	650	650	650	650	650	650	650	650	650
                650	650	650	650	650	650	650	650	650	650	650	650	650	650	650	650	650	650
                650	650	650	650	650	650	650	650	650	650	650	650	650	650	650	650	650	650
                650	650	650	650	650	650	650	650	650	650	650	650	650	650	650	650	650	650
                650	650	650	650	650	650	650	650	650	650	650	650	650	650	650	650	650	650
                650	650	650	650	650	650	650	650	650	650	650	650	650	650	650	650	650	650
                650	650	650	650	650	650	650	650	650	650	650	650	650	650	650	650	650	650
                650	650	650	650	650	650	650	650	650	650	650	650	650	650	650	650	650	650
                650	650	650	650	650	650	650	650	650	650	650	650	650	650	650	650	650	650
                650	650	650	650	650	650	650	650	650	650	650	650	650	650	650	650	650	650
                650	650	650	650	650	650	650	650	650	650	650	650	650	650	650	650	650	650
                650	650	650	650	650	650	650	650	650	650	650	650	650	650	650	650	650	650
                650	650	650	650	650	650	650	650	650	650	650	650	650	650	650	650	650	650
                650	650	650	650	650	650	650	650	650	650	650	650	650	650	650	650	650	650
                650	650	650	650	650	650	650	650	650	650	650	650	650	650	650	650	650	650
                650	650	650	650	650	650	650	650	650	650	650	650	650	650	650	650	650	650
                650	650	650	650	650	650	650	650	650	650	650	650	650	650	650	650	650	650
                650	650	650	650	650	650	650	650	650	650	650	650	650	650	650	650	650	650
                650	650	650	650	650	650	650	650	650	650	650	650	650	650	650	650	650	650
                650	650	650	650	650	650	650	650	650	650	650	650	650	650	650	650	650	650
                650	650	650	650	650	650	650	650	650	650	650	650	650	650	650	650	650	650
                650	650	650	650	650	650	650	650	650	650	650	650	650	650	650	650	650	650
                650	650	650	650	650	650	650	650	650	650	650	650	650	650	650	650	650	650
                650	650	650	650	650	650	650	650	650	650	650	650	650	650	650	650	650	650
                650	650	650	650	650	650	650	650	650	650	650	650	650	650	650	650	650	650
                650	650	650	650	650	650	650	650	650	650	650	650	650	650	650	650	650	650
                650	650	650	650	650	650	650	650	650	650	650	650	650	650	650	650	650	650
                650	650	650	650	650	650	650	650	650	650	650	650	650	650	650	650	650	650
                650	650	650	650	650	650	650	650	650	650	650	650	650	650	650	650	650	650
                650	650	650	650	650	650	650	650	650	650	650	650	650	650	650	650	650	650
                650	650	650	650	650	650	650	650	650	650	650	650	650	650	650	650	650	650
                650	650	650	650	650	650	650	650	650	650	650	650	650	650	650	650	650	650
                650	650	650	650	650	650	650	650	650	650	650	650	650	650	650	650	650	650
                650	650	650	650	650	650	650	650	650	650	650	650	650	650	650	650	650	650
                400 400 400>;

            PS_Config_Lmt_FW_CC_P = <
                65535	125	122	122	122	122	121	126	65535	65535	131	127	129	127	127	127	130	65535
                129	124	121	121	121	122	121	122	122	125	125	122	124	122	122	124	125	129
                126	121	121	121	121	121	120	121	121	129	127	126	126	126	126	126	127	131
                126	122	121	121	121	121	121	122	121	126	126	124	125	124	124	125	125	129
                126	122	121	121	121	121	121	122	121	127	126	125	126	126	125	125	126	130
                127	124	122	122	122	124	122	124	124	126	125	122	124	122	122	122	124	127
                125	121	120	120	120	121	120	121	121	129	127	126	126	126	126	126	126	130
                126	121	121	121	121	121	121	122	122	126	125	124	124	124	124	124	124	129
                126	121	121	121	121	121	121	122	121	127	126	125	125	125	124	124	125	129
                127	122	122	122	122	122	122	124	124	126	124	124	124	122	122	122	124	127
                125	121	121	120	120	121	121	121	121	130	127	126	126	125	125	125	126	129
                125	121	121	121	121	121	121	122	121	130	125	124	124	122	122	122	122	126
                125	121	121	121	121	121	121	124	122	131	126	124	124	124	122	124	124	127
                126	122	122	122	122	124	124	126	124	130	126	122	122	121	121	121	121	125
                124	121	121	120	121	121	121	125	121	133	129	126	126	125	125	125	125	129
                125	121	121	121	121	122	121	126	122	131	126	122	124	122	122	122	122	126
                125	121	121	121	121	122	122	124	122	131	126	124	124	122	122	122	122	126
                126	122	122	122	122	124	124	125	124	130	124	121	121	121	121	121	121	124
                124	121	121	121	121	121	121	122	121	133	127	125	125	124	124	124	124	127
                125	121	121	121	121	122	121	124	124	131	125	122	122	121	121	121	121	125
                124	121	121	121	121	122	122	122	122	133	125	124	124	122	122	122	122	126
                126	122	124	124	122	125	125	125	124	130	122	121	121	120	120	121	120	122
                124	121	121	121	121	122	121	122	121	134	126	125	126	124	124	122	122	126
                124	121	121	121	121	124	122	125	122	131	124	122	122	121	121	121	121	124
                122	120	120	121	121	121	121	124	121	130	124	121	121	121	120	120	120	124
                125	121	122	121	122	124	124	126	122	126	122	121	121	118	118	118	118	121
                122	120	120	120	120	121	121	124	121	126	126	124	124	121	121	121	121	125
                124	121	121	121	121	122	122	126	121	121	124	121	121	120	120	120	118	121
                124	121	121	121	121	122	122	125	121	121	125	121	121	120	120	120	120	122
                125	121	122	121	122	124	124	126	122	120	122	121	121	118	118	118	118	121
                121	120	120	120	120	121	121	124	121	122	126	124	122	121	121	121	121	124
                124	121	121	121	121	122	122	125	121	120	124	121	121	118	118	118	118	121
                124	121	121	121	121	122	122	126	121	121	125	121	121	120	120	120	120	122
                122	121	121	122	122	124	125	126	122	118	122	121	120	118	118	118	118	118
                120	120	120	120	120	121	124	124	120	121	126	124	121	121	121	121	121	121
                117	118	118	120	120	121	124	125	121	120	125	122	121	118	118	118	118	117
                119 120 120>;

            PS_Config_Lmt_FW_CC_N = <
                (-65535)	67	66	66	66	66	65	68	(-65535)	(-65535)	71	69	69	69	69	69	70	(-65535)
                69	67	65	65	65	66	65	66	66	67	67	66	67	66	66	67	67	69
                68	65	65	65	65	65	64	65	65	69	69	68	68	68	68	68	69	71
                68	66	65	65	65	65	65	66	65	68	68	67	67	67	67	67	67	69
                68	66	65	65	65	65	65	66	65	69	68	67	68	68	67	67	68	70
                69	67	66	66	66	67	66	67	67	68	67	66	67	66	66	66	67	69
                67	65	64	64	64	65	64	65	65	69	69	68	68	68	68	68	68	70
                68	65	65	65	65	65	65	66	66	68	67	67	67	67	67	67	67	69
                68	65	65	65	65	65	65	66	65	69	68	67	67	67	67	67	67	69
                69	66	66	66	66	66	66	67	67	68	67	67	67	66	66	66	67	69
                67	65	65	64	64	65	65	65	65	70	69	68	68	67	67	67	68	69
                67	65	65	65	65	65	65	66	65	70	67	67	67	66	66	66	66	68
                67	65	65	65	65	65	65	67	66	71	68	67	67	67	66	67	67	69
                68	66	66	66	66	67	67	68	67	70	68	66	66	65	65	65	65	67
                67	65	65	64	65	65	65	67	65	71	69	68	68	67	67	67	67	69
                67	65	65	65	65	66	65	68	66	71	68	66	67	66	66	66	66	68
                67	65	65	65	65	66	66	67	66	71	68	67	67	66	66	66	66	68
                68	66	66	66	66	67	67	67	67	70	67	65	65	65	65	65	65	67
                67	65	65	65	65	65	65	66	65	71	69	67	67	67	67	67	67	69
                67	65	65	65	65	66	65	67	67	71	67	66	66	65	65	65	65	67
                67	65	65	65	65	66	66	66	66	71	67	67	67	66	66	66	66	68
                68	66	67	67	66	67	67	67	67	70	66	65	65	64	64	65	64	66
                67	65	65	65	65	66	65	66	65	72	68	67	68	67	67	66	66	68
                67	65	65	65	65	67	66	67	66	71	67	66	66	65	65	65	65	67
                66	64	64	65	65	65	65	67	65	70	67	65	65	65	64	64	64	67
                67	65	66	65	66	67	67	68	66	68	66	65	65	64	64	64	64	65
                66	64	64	64	64	65	65	67	65	68	68	67	67	65	65	65	65	67
                67	65	65	65	65	66	66	68	65	65	67	65	65	64	64	64	64	65
                67	65	65	65	65	66	66	67	65	65	67	65	65	64	64	64	64	66
                67	65	66	65	66	67	67	68	66	64	66	65	65	64	64	64	64	65
                65	64	64	64	64	65	65	67	65	66	68	67	66	65	65	65	65	67
                67	65	65	65	65	66	66	67	65	64	67	65	65	64	64	64	64	65
                67	65	65	65	65	66	66	68	65	65	67	65	65	64	64	64	64	66
                66	65	65	66	66	67	67	68	66	64	66	65	64	64	64	64	64	64
                64	64	64	64	64	65	67	67	64	65	68	67	65	65	65	65	65	65
                63	64	64	64	64	65	67	67	65	64	67	66	65	64	64	64	64	63
                53 54 54>;

            PS_Config_Lmt_FW_CC_I_P = <
                25 25 25 25 25 25 25 25 25 25 25 25 25 25 25 25 25 25
                25 25 25 25 25 25 25 25 25 25 25 25 25 25 25 25 25 25
                25 25 25 25 25 25 25 25 25 25 25 25 25 25 25 25 25 25
                25 25 25 25 25 25 25 25 25 25 25 25 25 25 25 25 25 25
                25 25 25 25 25 25 25 25 25 25 25 25 25 25 25 25 25 25
                25 25 25 25 25 25 25 25 25 25 25 25 25 25 25 25 25 25
                25 25 25 25 25 25 25 25 25 25 25 25 25 25 25 25 25 25
                25 25 25 25 25 25 25 25 25 25 25 25 25 25 25 25 25 25
                25 25 25 25 25 25 25 25 25 25 25 25 25 25 25 25 25 25
                25 25 25 25 25 25 25 25 25 25 25 25 25 25 25 25 25 25
                25 25 25 25 25 25 25 25 25 25 25 25 25 25 25 25 25 25
                25 25 25 25 25 25 25 25 25 25 25 25 25 25 25 25 25 25
                25 25 25 25 25 25 25 25 25 25 25 25 25 25 25 25 25 25
                25 25 25 25 25 25 25 25 25 25 25 25 25 25 25 25 25 25
                25 25 25 25 25 25 25 25 25 25 25 25 25 25 25 25 25 25
                25 25 25 25 25 25 25 25 25 25 25 25 25 25 25 25 25 25
                25 25 25 25 25 25 25 25 25 25 25 25 25 25 25 25 25 25
                25 25 25 25 25 25 25 25 25 25 25 25 25 25 25 25 25 25
                25 25 25 25 25 25 25 25 25 25 25 25 25 25 25 25 25 25
                25 25 25 25 25 25 25 25 25 25 25 25 25 25 25 25 25 25
                25 25 25 25 25 25 25 25 25 25 25 25 25 25 25 25 25 25
                25 25 25 25 25 25 25 25 25 25 25 25 25 25 25 25 25 25
                25 25 25 25 25 25 25 25 25 25 25 25 25 25 25 25 25 25
                25 25 25 25 25 25 25 25 25 25 25 25 25 25 25 25 25 25
                25 25 25 25 25 25 25 25 25 25 25 25 25 25 25 25 25 25
                25 25 25 25 25 25 25 25 25 25 25 25 25 25 25 25 25 25
                25 25 25 25 25 25 25 25 25 25 25 25 25 25 25 25 25 25
                25 25 25 25 25 25 25 25 25 25 25 25 25 25 25 25 25 25
                25 25 25 25 25 25 25 25 25 25 25 25 25 25 25 25 25 25
                25 25 25 25 25 25 25 25 25 25 25 25 25 25 25 25 25 25
                25 25 25 25 25 25 25 25 25 25 25 25 25 25 25 25 25 25
                25 25 25 25 25 25 25 25 25 25 25 25 25 25 25 25 25 25
                25 25 25 25 25 25 25 25 25 25 25 25 25 25 25 25 25 25
                25 25 25 25 25 25 25 25 25 25 25 25 25 25 25 25 25 25
                25 25 25 25 25 25 25 25 25 25 25 25 25 25 25 25 25 25
                25 25 25 25 25 25 25 25 25 25 25 25 25 25 25 25 25 25
                25 25 25>;

            PS_Config_Lmt_FW_CC_I_N = <
                0 0 0 0 0 0 0 0 0 0 0 0 0 0 0 0 0 0
                0 0 0 0 0 0 0 0 0 0 0 0 0 0 0 0 0 0
                0 0 0 0 0 0 0 0 0 0 0 0 0 0 0 0 0 0
                0 0 0 0 0 0 0 0 0 0 0 0 0 0 0 0 0 0
                0 0 0 0 0 0 0 0 0 0 0 0 0 0 0 0 0 0
                0 0 0 0 0 0 0 0 0 0 0 0 0 0 0 0 0 0
                0 0 0 0 0 0 0 0 0 0 0 0 0 0 0 0 0 0
                0 0 0 0 0 0 0 0 0 0 0 0 0 0 0 0 0 0
                0 0 0 0 0 0 0 0 0 0 0 0 0 0 0 0 0 0
                0 0 0 0 0 0 0 0 0 0 0 0 0 0 0 0 0 0
                0 0 0 0 0 0 0 0 0 0 0 0 0 0 0 0 0 0
                0 0 0 0 0 0 0 0 0 0 0 0 0 0 0 0 0 0
                0 0 0 0 0 0 0 0 0 0 0 0 0 0 0 0 0 0
                0 0 0 0 0 0 0 0 0 0 0 0 0 0 0 0 0 0
                0 0 0 0 0 0 0 0 0 0 0 0 0 0 0 0 0 0
                0 0 0 0 0 0 0 0 0 0 0 0 0 0 0 0 0 0
                0 0 0 0 0 0 0 0 0 0 0 0 0 0 0 0 0 0
                0 0 0 0 0 0 0 0 0 0 0 0 0 0 0 0 0 0
                0 0 0 0 0 0 0 0 0 0 0 0 0 0 0 0 0 0
                0 0 0 0 0 0 0 0 0 0 0 0 0 0 0 0 0 0
                0 0 0 0 0 0 0 0 0 0 0 0 0 0 0 0 0 0
                0 0 0 0 0 0 0 0 0 0 0 0 0 0 0 0 0 0
                0 0 0 0 0 0 0 0 0 0 0 0 0 0 0 0 0 0
                0 0 0 0 0 0 0 0 0 0 0 0 0 0 0 0 0 0
                0 0 0 0 0 0 0 0 0 0 0 0 0 0 0 0 0 0
                0 0 0 0 0 0 0 0 0 0 0 0 0 0 0 0 0 0
                0 0 0 0 0 0 0 0 0 0 0 0 0 0 0 0 0 0
                0 0 0 0 0 0 0 0 0 0 0 0 0 0 0 0 0 0
                0 0 0 0 0 0 0 0 0 0 0 0 0 0 0 0 0 0
                0 0 0 0 0 0 0 0 0 0 0 0 0 0 0 0 0 0
                0 0 0 0 0 0 0 0 0 0 0 0 0 0 0 0 0 0
                0 0 0 0 0 0 0 0 0 0 0 0 0 0 0 0 0 0
                0 0 0 0 0 0 0 0 0 0 0 0 0 0 0 0 0 0
                0 0 0 0 0 0 0 0 0 0 0 0 0 0 0 0 0 0
                0 0 0 0 0 0 0 0 0 0 0 0 0 0 0 0 0 0
                0 0 0 0 0 0 0 0 0 0 0 0 0 0 0 0 0 0
                0 0 0>;

            PS_Config_Lmt_FW_CC_Q_P = <
                25 25 25 25 25 25 25 25 25 25 25 25 25 25 25 25 25 25
                25 25 25 25 25 25 25 25 25 25 25 25 25 25 25 25 25 25
                25 25 25 25 25 25 25 25 25 25 25 25 25 25 25 25 25 25
                25 25 25 25 25 25 25 25 25 25 25 25 25 25 25 25 25 25
                25 25 25 25 25 25 25 25 25 25 25 25 25 25 25 25 25 25
                25 25 25 25 25 25 25 25 25 25 25 25 25 25 25 25 25 25
                25 25 25 25 25 25 25 25 25 25 25 25 25 25 25 25 25 25
                25 25 25 25 25 25 25 25 25 25 25 25 25 25 25 25 25 25
                25 25 25 25 25 25 25 25 25 25 25 25 25 25 25 25 25 25
                25 25 25 25 25 25 25 25 25 25 25 25 25 25 25 25 25 25
                25 25 25 25 25 25 25 25 25 25 25 25 25 25 25 25 25 25
                25 25 25 25 25 25 25 25 25 25 25 25 25 25 25 25 25 25
                25 25 25 25 25 25 25 25 25 25 25 25 25 25 25 25 25 25
                25 25 25 25 25 25 25 25 25 25 25 25 25 25 25 25 25 25
                25 25 25 25 25 25 25 25 25 25 25 25 25 25 25 25 25 25
                25 25 25 25 25 25 25 25 25 25 25 25 25 25 25 25 25 25
                25 25 25 25 25 25 25 25 25 25 25 25 25 25 25 25 25 25
                25 25 25 25 25 25 25 25 25 25 25 25 25 25 25 25 25 25
                25 25 25 25 25 25 25 25 25 25 25 25 25 25 25 25 25 25
                25 25 25 25 25 25 25 25 25 25 25 25 25 25 25 25 25 25
                25 25 25 25 25 25 25 25 25 25 25 25 25 25 25 25 25 25
                25 25 25 25 25 25 25 25 25 25 25 25 25 25 25 25 25 25
                25 25 25 25 25 25 25 25 25 25 25 25 25 25 25 25 25 25
                25 25 25 25 25 25 25 25 25 25 25 25 25 25 25 25 25 25
                25 25 25 25 25 25 25 25 25 25 25 25 25 25 25 25 25 25
                25 25 25 25 25 25 25 25 25 25 25 25 25 25 25 25 25 25
                25 25 25 25 25 25 25 25 25 25 25 25 25 25 25 25 25 25
                25 25 25 25 25 25 25 25 25 25 25 25 25 25 25 25 25 25
                25 25 25 25 25 25 25 25 25 25 25 25 25 25 25 25 25 25
                25 25 25 25 25 25 25 25 25 25 25 25 25 25 25 25 25 25
                25 25 25 25 25 25 25 25 25 25 25 25 25 25 25 25 25 25
                25 25 25 25 25 25 25 25 25 25 25 25 25 25 25 25 25 25
                25 25 25 25 25 25 25 25 25 25 25 25 25 25 25 25 25 25
                25 25 25 25 25 25 25 25 25 25 25 25 25 25 25 25 25 25
                25 25 25 25 25 25 25 25 25 25 25 25 25 25 25 25 25 25
                25 25 25 25 25 25 25 25 25 25 25 25 25 25 25 25 25 25
                25 25 25>;

            PS_Config_Lmt_FW_CC_Q_N = <
                0 0 0 0 0 0 0 0 0 0 0 0 0 0 0 0 0 0
                0 0 0 0 0 0 0 0 0 0 0 0 0 0 0 0 0 0
                0 0 0 0 0 0 0 0 0 0 0 0 0 0 0 0 0 0
                0 0 0 0 0 0 0 0 0 0 0 0 0 0 0 0 0 0
                0 0 0 0 0 0 0 0 0 0 0 0 0 0 0 0 0 0
                0 0 0 0 0 0 0 0 0 0 0 0 0 0 0 0 0 0
                0 0 0 0 0 0 0 0 0 0 0 0 0 0 0 0 0 0
                0 0 0 0 0 0 0 0 0 0 0 0 0 0 0 0 0 0
                0 0 0 0 0 0 0 0 0 0 0 0 0 0 0 0 0 0
                0 0 0 0 0 0 0 0 0 0 0 0 0 0 0 0 0 0
                0 0 0 0 0 0 0 0 0 0 0 0 0 0 0 0 0 0
                0 0 0 0 0 0 0 0 0 0 0 0 0 0 0 0 0 0
                0 0 0 0 0 0 0 0 0 0 0 0 0 0 0 0 0 0
                0 0 0 0 0 0 0 0 0 0 0 0 0 0 0 0 0 0
                0 0 0 0 0 0 0 0 0 0 0 0 0 0 0 0 0 0
                0 0 0 0 0 0 0 0 0 0 0 0 0 0 0 0 0 0
                0 0 0 0 0 0 0 0 0 0 0 0 0 0 0 0 0 0
                0 0 0 0 0 0 0 0 0 0 0 0 0 0 0 0 0 0
                0 0 0 0 0 0 0 0 0 0 0 0 0 0 0 0 0 0
                0 0 0 0 0 0 0 0 0 0 0 0 0 0 0 0 0 0
                0 0 0 0 0 0 0 0 0 0 0 0 0 0 0 0 0 0
                0 0 0 0 0 0 0 0 0 0 0 0 0 0 0 0 0 0
                0 0 0 0 0 0 0 0 0 0 0 0 0 0 0 0 0 0
                0 0 0 0 0 0 0 0 0 0 0 0 0 0 0 0 0 0
                0 0 0 0 0 0 0 0 0 0 0 0 0 0 0 0 0 0
                0 0 0 0 0 0 0 0 0 0 0 0 0 0 0 0 0 0
                0 0 0 0 0 0 0 0 0 0 0 0 0 0 0 0 0 0
                0 0 0 0 0 0 0 0 0 0 0 0 0 0 0 0 0 0
                0 0 0 0 0 0 0 0 0 0 0 0 0 0 0 0 0 0
                0 0 0 0 0 0 0 0 0 0 0 0 0 0 0 0 0 0
                0 0 0 0 0 0 0 0 0 0 0 0 0 0 0 0 0 0
                0 0 0 0 0 0 0 0 0 0 0 0 0 0 0 0 0 0
                0 0 0 0 0 0 0 0 0 0 0 0 0 0 0 0 0 0
                0 0 0 0 0 0 0 0 0 0 0 0 0 0 0 0 0 0
                0 0 0 0 0 0 0 0 0 0 0 0 0 0 0 0 0 0
                0 0 0 0 0 0 0 0 0 0 0 0 0 0 0 0 0 0
                0 0 0>;

            PS_Config_Lmt_FW_Diff_P = <
                65535 50 50 50 50 50 50 50 65535 65535 50 50 50 50 50 50 50 65535
                50 50 50 50 50 50 50 50 50 50 50 50 50 50 50 50 50 50
                50 50 50 50 50 50 50 50 50 50 50 50 50 50 50 50 50 50
                50 50 50 50 50 50 50 50 50 50 50 50 50 50 50 50 50 50
                50 50 50 50 50 50 50 50 50 50 50 50 50 50 50 50 50 50
                50 50 50 50 50 50 50 50 50 50 50 50 50 50 50 50 50 50
                50 50 50 50 50 50 50 50 50 50 50 50 50 50 50 50 50 50
                50 50 50 50 50 50 50 50 50 50 50 50 50 50 50 50 50 50
                50 50 50 50 50 50 50 50 50 50 50 50 50 50 50 50 50 50
                50 50 50 50 50 50 50 50 50 50 50 50 50 50 50 50 50 50
                50 50 50 50 50 50 50 50 50 50 50 50 50 50 50 50 50 50
                50 50 50 50 50 50 50 50 50 50 50 50 50 50 50 50 50 50
                50 50 50 50 50 50 50 50 50 50 50 50 50 50 50 50 50 50
                50 50 50 50 50 50 50 50 50 50 50 50 50 50 50 50 50 50
                50 50 50 50 50 50 50 50 50 50 50 50 50 50 50 50 50 50
                50 50 50 50 50 50 50 50 50 50 50 50 50 50 50 50 50 50
                50 50 50 50 50 50 50 50 50 50 50 50 50 50 50 50 50 50
                50 50 50 50 50 50 50 50 50 50 50 50 50 50 50 50 50 50
                50 50 50 50 50 50 50 50 50 50 50 50 50 50 50 50 50 50
                50 50 50 50 50 50 50 50 50 50 50 50 50 50 50 50 50 50
                50 50 50 50 50 50 50 50 50 50 50 50 50 50 50 50 50 50
                50 50 50 50 50 50 50 50 50 50 50 50 50 50 50 50 50 50
                50 50 50 50 50 50 50 50 50 50 50 50 50 50 50 50 50 50
                50 50 50 50 50 50 50 50 50 50 50 50 50 50 50 50 50 50
                50 50 50 50 50 50 50 50 50 50 50 50 50 50 50 50 50 50
                50 50 50 50 50 50 50 50 50 50 50 50 50 50 50 50 50 50
                50 50 50 50 50 50 50 50 50 50 50 50 50 50 50 50 50 50
                50 50 50 50 50 50 50 50 50 50 50 50 50 50 50 50 50 50
                50 50 50 50 50 50 50 50 50 50 50 50 50 50 50 50 50 50
                50 50 50 50 50 50 50 50 50 50 50 50 50 50 50 50 50 50
                50 50 50 50 50 50 50 50 50 50 50 50 50 50 50 50 50 50
                50 50 50 50 50 50 50 50 50 50 50 50 50 50 50 50 50 50
                50 50 50 50 50 50 50 50 50 50 50 50 50 50 50 50 50 50
                50 50 50 50 50 50 50 50 50 50 50 50 50 50 50 50 50 50
                50 50 50 50 50 50 50 50 50 50 50 50 50 50 50 50 50 50
                50 50 50 50 50 50 50 50 50 50 50 50 50 50 50 50 50 50
                50 50 50>;

            PS_Config_Lmt_FW_Diff_N = <
                (-65535) (-50) (-50) (-50) (-50) (-50) (-50) (-50) (-65535) (-65535) (-50) (-50) (-50) (-50) (-50) (-50) (-50) (-65535)
                (-50) (-50) (-50) (-50) (-50) (-50) (-50) (-50) (-50) (-50) (-50) (-50) (-50) (-50) (-50) (-50) (-50) (-50)
                (-50) (-50) (-50) (-50) (-50) (-50) (-50) (-50) (-50) (-50) (-50) (-50) (-50) (-50) (-50) (-50) (-50) (-50)
                (-50) (-50) (-50) (-50) (-50) (-50) (-50) (-50) (-50) (-50) (-50) (-50) (-50) (-50) (-50) (-50) (-50) (-50)
                (-50) (-50) (-50) (-50) (-50) (-50) (-50) (-50) (-50) (-50) (-50) (-50) (-50) (-50) (-50) (-50) (-50) (-50)
                (-50) (-50) (-50) (-50) (-50) (-50) (-50) (-50) (-50) (-50) (-50) (-50) (-50) (-50) (-50) (-50) (-50) (-50)
                (-50) (-50) (-50) (-50) (-50) (-50) (-50) (-50) (-50) (-50) (-50) (-50) (-50) (-50) (-50) (-50) (-50) (-50)
                (-50) (-50) (-50) (-50) (-50) (-50) (-50) (-50) (-50) (-50) (-50) (-50) (-50) (-50) (-50) (-50) (-50) (-50)
                (-50) (-50) (-50) (-50) (-50) (-50) (-50) (-50) (-50) (-50) (-50) (-50) (-50) (-50) (-50) (-50) (-50) (-50)
                (-50) (-50) (-50) (-50) (-50) (-50) (-50) (-50) (-50) (-50) (-50) (-50) (-50) (-50) (-50) (-50) (-50) (-50)
                (-50) (-50) (-50) (-50) (-50) (-50) (-50) (-50) (-50) (-50) (-50) (-50) (-50) (-50) (-50) (-50) (-50) (-50)
                (-50) (-50) (-50) (-50) (-50) (-50) (-50) (-50) (-50) (-50) (-50) (-50) (-50) (-50) (-50) (-50) (-50) (-50)
                (-50) (-50) (-50) (-50) (-50) (-50) (-50) (-50) (-50) (-50) (-50) (-50) (-50) (-50) (-50) (-50) (-50) (-50)
                (-50) (-50) (-50) (-50) (-50) (-50) (-50) (-50) (-50) (-50) (-50) (-50) (-50) (-50) (-50) (-50) (-50) (-50)
                (-50) (-50) (-50) (-50) (-50) (-50) (-50) (-50) (-50) (-50) (-50) (-50) (-50) (-50) (-50) (-50) (-50) (-50)
                (-50) (-50) (-50) (-50) (-50) (-50) (-50) (-50) (-50) (-50) (-50) (-50) (-50) (-50) (-50) (-50) (-50) (-50)
                (-50) (-50) (-50) (-50) (-50) (-50) (-50) (-50) (-50) (-50) (-50) (-50) (-50) (-50) (-50) (-50) (-50) (-50)
                (-50) (-50) (-50) (-50) (-50) (-50) (-50) (-50) (-50) (-50) (-50) (-50) (-50) (-50) (-50) (-50) (-50) (-50)
                (-50) (-50) (-50) (-50) (-50) (-50) (-50) (-50) (-50) (-50) (-50) (-50) (-50) (-50) (-50) (-50) (-50) (-50)
                (-50) (-50) (-50) (-50) (-50) (-50) (-50) (-50) (-50) (-50) (-50) (-50) (-50) (-50) (-50) (-50) (-50) (-50)
                (-50) (-50) (-50) (-50) (-50) (-50) (-50) (-50) (-50) (-50) (-50) (-50) (-50) (-50) (-50) (-50) (-50) (-50)
                (-50) (-50) (-50) (-50) (-50) (-50) (-50) (-50) (-50) (-50) (-50) (-50) (-50) (-50) (-50) (-50) (-50) (-50)
                (-50) (-50) (-50) (-50) (-50) (-50) (-50) (-50) (-50) (-50) (-50) (-50) (-50) (-50) (-50) (-50) (-50) (-50)
                (-50) (-50) (-50) (-50) (-50) (-50) (-50) (-50) (-50) (-50) (-50) (-50) (-50) (-50) (-50) (-50) (-50) (-50)
                (-50) (-50) (-50) (-50) (-50) (-50) (-50) (-50) (-50) (-50) (-50) (-50) (-50) (-50) (-50) (-50) (-50) (-50)
                (-50) (-50) (-50) (-50) (-50) (-50) (-50) (-50) (-50) (-50) (-50) (-50) (-50) (-50) (-50) (-50) (-50) (-50)
                (-50) (-50) (-50) (-50) (-50) (-50) (-50) (-50) (-50) (-50) (-50) (-50) (-50) (-50) (-50) (-50) (-50) (-50)
                (-50) (-50) (-50) (-50) (-50) (-50) (-50) (-50) (-50) (-50) (-50) (-50) (-50) (-50) (-50) (-50) (-50) (-50)
                (-50) (-50) (-50) (-50) (-50) (-50) (-50) (-50) (-50) (-50) (-50) (-50) (-50) (-50) (-50) (-50) (-50) (-50)
                (-50) (-50) (-50) (-50) (-50) (-50) (-50) (-50) (-50) (-50) (-50) (-50) (-50) (-50) (-50) (-50) (-50) (-50)
                (-50) (-50) (-50) (-50) (-50) (-50) (-50) (-50) (-50) (-50) (-50) (-50) (-50) (-50) (-50) (-50) (-50) (-50)
                (-50) (-50) (-50) (-50) (-50) (-50) (-50) (-50) (-50) (-50) (-50) (-50) (-50) (-50) (-50) (-50) (-50) (-50)
                (-50) (-50) (-50) (-50) (-50) (-50) (-50) (-50) (-50) (-50) (-50) (-50) (-50) (-50) (-50) (-50) (-50) (-50)
                (-50) (-50) (-50) (-50) (-50) (-50) (-50) (-50) (-50) (-50) (-50) (-50) (-50) (-50) (-50) (-50) (-50) (-50)
                (-50) (-50) (-50) (-50) (-50) (-50) (-50) (-50) (-50) (-50) (-50) (-50) (-50) (-50) (-50) (-50) (-50) (-50)
                (-50) (-50) (-50) (-50) (-50) (-50) (-50) (-50) (-50) (-50) (-50) (-50) (-50) (-50) (-50) (-50) (-50) (-50)
                (-50) (-50) (-50)>;

            PS_Config_Diff_Test_Frame = <50>;
        };
    };
};
