/* Copyright (c) 2018-2019, The Linux Foundation. All rights reserved.
 * Copyright (C) 2020 XiaoMi, Inc.
 *
 * This program is free software; you can redistribute it and/or modify
 * it under the terms of the GNU General Public License version 2 and
 * only version 2 as published by the Free Software Foundation.
 *
 * This program is distributed in the hope that it will be useful,
 * but WITHOUT ANY WARRANTY; without even the implied warranty of
 * MERCHANTABILITY or FITNESS FOR A PARTICULAR PURPOSE.  See the
 * GNU General Public License for more details.
 */

&mdss_mdp {
	dsi_ft8756_huaxing_video: qcom,mdss_dsi_ft8756_huaxing_video {
		qcom,mdss-dsi-panel-name =
			"ft8756 video mode dsi huaxing panel";
		qcom,mdss-dsi-panel-type = "dsi_video_mode";

		qcom,mdss-dsi-virtual-channel-id = <0>;
		qcom,mdss-dsi-stream = <0>;
		qcom,mdss-dsi-h-left-border = <0>;
		qcom,mdss-dsi-h-right-border = <0>;
		qcom,mdss-dsi-v-top-border = <0>;
		qcom,mdss-dsi-v-bottom-border = <0>;
		qcom,mdss-dsi-bpp = <24>;
		qcom,mdss-dsi-color-order = "rgb_swap_rgb";
		qcom,mdss-dsi-underflow-color = <0xff>;
		qcom,mdss-dsi-border-color = <0>;
		qcom,mdss-dsi-h-sync-pulse = <0>;
		qcom,mdss-dsi-traffic-mode = "non_burst_sync_event";
		qcom,mdss-dsi-lane-map = "lane_map_0123";
		qcom,mdss-dsi-bllp-eof-power-mode;
		qcom,mdss-dsi-bllp-power-mode;
		qcom,mdss-dsi-tx-eot-append;
		qcom,mdss-dsi-lane-0-state;
		qcom,mdss-dsi-lane-1-state;
		qcom,mdss-dsi-lane-2-state;
		qcom,mdss-dsi-lane-3-state;
		qcom,mdss-dsi-dma-trigger = "trigger_sw";
		qcom,mdss-dsi-mdp-trigger = "none";
		qcom,mdss-dsi-force-clock-lane-hs;
		qcom,mdss-dsi-lp11-init;
		qcom,mdss-dsi-bl-pmic-control-type = "bl_ctrl_wled";
		qcom,mdss-dsi-bl-min-level = <1>;
		qcom,mdss-dsi-bl-max-level = <4095>;
		qcom,mdss-dsi-reset-sequence = <1 4>, <0 1>, <1 10>;
		qcom,mdss-pan-physical-width-dimension = <69>;
		qcom,mdss-pan-physical-height-dimension = <154>;

		qcom,mdss-dsi-display-timings {
			timing@0 {
				qcom,mdss-dsi-panel-width = <1080>;
				qcom,mdss-dsi-panel-height = <2400>;
				qcom,mdss-dsi-h-front-porch = <20>;
				qcom,mdss-dsi-h-back-porch = <20>;
				qcom,mdss-dsi-h-pulse-width = <4>;
				qcom,mdss-dsi-h-sync-skew = <0>;
				qcom,mdss-dsi-v-back-porch = <32>;
				qcom,mdss-dsi-v-front-porch = <8>;
				qcom,mdss-dsi-v-pulse-width = <4>;
				qcom,mdss-dsi-panel-framerate = <60>;
				qcom,mdss-dsi-on-command = [
						39 01 00 00 00 00 02 00 00 
						39 01 00 00 00 00 04 FF 87 56 01 
						39 01 00 00 00 00 02 00 80 
						39 01 00 00 00 00 03 FF 87 56 
						//cabc start
						15 01 00 00 00 00 02 00 80 
						39 01 00 00 00 00 0D CA 80 80 80 80 80 80 80 80 80 80 80 80 
						15 01 00 00 00 00 02 00 90 
						39 01 00 00 00 00 0A CA FE FF 66 F6 FF 66 FB FF 32
						//cabc end
						15 01 00 00 00 00 02 51 B8
						15 01 00 00 00 00 02 53 24
						15 01 00 00 00 00 02 55 00
						39 01 00 00 00 00 02 00 B5 
						39 01 00 00 00 00 02 CA 04
						05 01 00 00 5A 00 02 11 00
						05 01 00 00 05 00 02 29 00
				];
				qcom,mdss-dsi-off-command = [
				05 01 00 00 0A 00 02 28 00
				05 01 00 00 5A 00 02 10 00
						//low power mode start
				39 01 00 00 00 00 02 00 00
				39 01 00 00 00 00 05 f7 5a a5 95 27
						//low power mode end
				]; 
				qcom,mdss-dsi-hbm1-on-command = [
						15 01 00 00 00 00 02 53 2C
						15 01 00 00 00 00 02 51 CC
				];
				qcom,mdss-dsi-hbm2-on-command = [
						15 01 00 00 00 00 02 53 2C
						15 01 00 00 00 00 02 51 E6
				];
				qcom,mdss-dsi-hbm3-on-command = [
						15 01 00 00 00 00 02 53 2C
						15 01 00 00 00 00 02 51 FF
				];
				qcom,mdss-dsi-hbm-off-command = [
						15 01 00 00 00 00 02 53 2C
						15 01 00 00 00 00 02 51 B8
				];
				qcom,mdss-dsi-cabc-on-command = [
						15 01 00 00 00 00 02 55 01
				];
				qcom,mdss-dsi-cabc_movie-on-command = [
						15 01 00 00 00 00 02 55 03
				];
				qcom,mdss-dsi-cabc_still-on-command  = [
						15 01 00 00 00 00 02 55 02
				];
				qcom,mdss-dsi-cabc-off-command = [
						15 01 00 00 00 00 02 55 00
				];
			qcom,mdss-dsi-on-command-state = "dsi_lp_mode";
			qcom,mdss-dsi-off-command-state = "dsi_hs_mode";
			qcom,mdss-dsi-hbm1-on-command-state = "dsi_hs_mode";
			qcom,mdss-dsi-hbm2-on-command-state = "dsi_hs_mode";
			qcom,mdss-dsi-hbm3-on-command-state = "dsi_hs_mode";
			qcom,mdss-dsi-hbm-off-command-state = "dsi_hs_mode";
			qcom,mdss-dsi-cabc-on-command-state = "dsi_hs_mode";
			qcom,mdss-dsi-cabc-off-command-state = "dsi_hs_mode";
			qcom,mdss-dsi-cabc_movie-on-command-state = "dsi_hs_mode";
			qcom,mdss-dsi-cabc_still-on-command-state = "dsi_hs_mode";

			};
		};
	};
};
