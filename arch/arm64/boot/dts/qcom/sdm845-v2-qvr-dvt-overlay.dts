/* Copyright (c) 2017-2018, The Linux Foundation. All rights reserved.
 *
 * This program is free software; you can redistribute it and/or modify
 * it under the terms of the GNU General Public License version 2 and
 * only version 2 as published by the Free Software Foundation.
 *
 * This program is distributed in the hope that it will be useful,
 * but WITHOUT ANY WARRANTY; without even the implied warranty of
 * MERCHANTABILITY or FITNESS FOR A PARTICULAR PURPOSE.  See the
 * GNU General Public License for more details.
 */

/dts-v1/;
/plugin/;

#include "sdm845-v2-qvr-dvt.dtsi"
#include "sdm845-qvr-audio-overlay.dtsi"

/ {
	model = "Qualcomm Technologies, Inc. SDM845 V2 DVT QVR";
	compatible = "qcom,sdm845-qvr", "qcom,sdm845", "qcom,qvr";
	qcom,msm-id = <321 0x20000>;
	qcom,board-id = <0x02000B 0x20>;
};
