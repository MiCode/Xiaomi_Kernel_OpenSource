/*
 * Copyright (c) 2018 The Linux Foundation. All rights reserved.
 *
 * This program is free software; you can redistribute it and/or modify
 * it under the terms of the GNU General Public License version 2 and
 * only version 2 as published by the Free Software Foundation.
 *
 * This program is distributed in the hope that it will be useful,
 * but WITHOUT ANY WARRANTY; without even the implied warranty of
 * MERCHANTABILITY or FITNESS FOR A PARTICULAR PURPOSE.  See the
 * GNU General Public License for more details.
 */

#include "pmi8940.dtsi"

&qpnp_smbcharger {
	qcom,chg-led-sw-controls;
	qcom,chg-led-support;
	dpdm-supply = <&usb_otg>;
};

&usb_otg {
	extcon = <&qpnp_smbcharger>;
};

&soc {
	led_flash0: qcom,camera-flash {
		cell-index = <0>;
		compatible = "qcom,camera-flash";
		qcom,flash-type = <1>;
		qcom,flash-source = <&pmi8940_flash0 &pmi8940_flash1>;
		qcom,torch-source = <&pmi8940_torch0 &pmi8940_torch1>;
		qcom,switch-source = <&pmi8940_switch>;
	};
};
