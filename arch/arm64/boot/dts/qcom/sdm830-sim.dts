/* Copyright (c) 2016, The Linux Foundation. All rights reserved.
 *
 * This program is free software; you can redistribute it and/or modify
 * it under the terms of the GNU General Public License version 2 and
 * only version 2 as published by the Free Software Foundation.
 *
 * This program is distributed in the hope that it will be useful,
 * but WITHOUT ANY WARRANTY; without even the implied warranty of
 * MERCHANTABILITY or FITNESS FOR A PARTICULAR PURPOSE.  See the
 * GNU General Public License for more details.
 */


/dts-v1/;
/memreserve/ 0x90000000 0x00000100;

#include "sdm830.dtsi"
#include "sdm830-sim.dtsi"

/ {
	model = "Qualcomm Technologies, Inc. SDM830 SIM";
	compatible = "qcom,sdm830-sim", "qcom,sdm830", "qcom,sim";
	qcom,board-id = <16 0>;
};

