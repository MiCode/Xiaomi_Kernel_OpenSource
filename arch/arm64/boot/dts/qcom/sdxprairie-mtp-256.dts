/* Copyright (c) 2019, The Linux Foundation. All rights reserved.
 *
 * This program is free software; you can redistribute it and/or modify
 * it under the terms of the GNU General Public License version 2 and
 * only version 2 as published by the Free Software Foundation.
 *
 * This program is distributed in the hope that it will be useful,
 * but WITHOUT ANY WARRANTY; without even the implied warranty of
 * MERCHANTABILITY or FITNESS FOR A PARTICULAR PURPOSE.  See the
 * GNU General Public License for more details.
 */

/dts-v1/;

#include "sdxprairie.dtsi"
#include "sdxprairie-mtp-256.dtsi"

/ {
	model = "Qualcomm Technologies, Inc. SDXPRAIRIE MTP(256MB)";
	compatible = "qcom,sdxprairie-mtp",
		"qcom,sdxprairie", "qcom,mtp";
	qcom,board-id = <0x10008 0x0>;
};

&qnand_1 {
	status = "ok";
};

&blsp1_uart2b_hs {
	status = "okay";
};
