/*
 * Copyright (c) 2018, The Linux Foundation. All rights reserved.
 *
 * This program is free software; you can redistribute it and/or modify
 * it under the terms of the GNU General Public License version 2 and
 * only version 2 as published by the Free Software Foundation.
 *
 * This program is distributed in the hope that it will be useful,
 * but WITHOUT ANY WARRANTY; without even the implied warranty of
 * MERCHANTABILITY or FITNESS FOR A PARTICULAR PURPOSE.  See the
 * GNU General Public License for more details.
 */

/dts-v1/;

#include "sda450.dtsi"
#include "sdm450-pmi632-cdp-s2.dtsi"
#include "sdm450-pmi632.dtsi"

/ {
	model = "Qualcomm Technologies, Inc. SDA450 + PMI632 CDP S2";
	compatible = "qcom,sda450-cdp", "qcom,sda450", "qcom,cdp";
	qcom,board-id = <1 2>;
	qcom,pmic-id = <0x010016 0x25 0x0 0x0>;
};

