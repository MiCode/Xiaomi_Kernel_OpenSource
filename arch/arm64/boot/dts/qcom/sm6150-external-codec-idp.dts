/* Copyright (c) 2018, The Linux Foundation. All rights reserved.
 *
 * This program is free software; you can redistribute it and/or modify
 * it under the terms of the GNU General Public License version 2 and
 * only version 2 as published by the Free Software Foundation.
 *
 * This program is distributed in the hope that it will be useful,
 * but WITHOUT ANY WARRANTY; without even the implied warranty of
 * MERCHANTABILITY or FITNESS FOR A PARTICULAR PURPOSE.  See the
 * GNU General Public License for more details.
 */

/dts-v1/;

#include "sm6150.dtsi"
#include "sm6150-idp.dtsi"
#include "sm6150-ext-codec-audio-overlay.dtsi"
#include "sm6150-external-codec.dtsi"

/ {
	model = "Qualcomm Technologies, Inc. SM6150 PM6150 External Audio Codec IDP";
	compatible = "qcom,sm6150-idp", "qcom,sm6150", "qcom,idp";
	qcom,board-id = <34 1>;
};
