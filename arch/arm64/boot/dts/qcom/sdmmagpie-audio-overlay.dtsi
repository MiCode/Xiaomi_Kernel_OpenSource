/*
 * Copyright (c) 2018, The Linux Foundation. All rights reserved.
 *
 * This program is free software; you can redistribute it and/or modify
 * it under the terms of the GNU General Public License version 2 and
 * only version 2 as published by the Free Software Foundation.
 *
 * This program is distributed in the hope that it will be useful,
 * but WITHOUT ANY WARRANTY; without even the implied warranty of
 * MERCHANTABILITY or FITNESS FOR A PARTICULAR PURPOSE.  See the
 * GNU General Public License for more details.
 */

#include "sm6150-audio-overlay.dtsi"

&swr0 {
	interrupts = <0 295 0>;
};

&swr1 {
	interrupts = <0 297 0>;
};

&swr2 {
	qcom,swr-wakeup-required = <0>;
	interrupts = <0 296 0>, <0 500 0>;
	interrupt-names = "swr_master_irq", "swr_wake_irq";
};

&sm6150_snd {
	qcom,model = "sm6150-wcd9375-snd-card";
};
