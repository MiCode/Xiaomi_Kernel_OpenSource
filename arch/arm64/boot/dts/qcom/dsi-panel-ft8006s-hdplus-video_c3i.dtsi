/* Copyright (c) 2013, The Linux Foundation. All rights reserved.
 * Copyright (C) 2021 XiaoMi, Inc.
 *
 * This program is free software; you can redistribute it and/or modify
 * it under the terms of the GNU General Public License version 2 and
 * only version 2 as published by the Free Software Foundation.
 *
 * This program is distributed in the hope that it will be useful,
 * but WITHOUT ANY WARRANTY; without even the implied warranty of
 * MERCHANTABILITY or FITNESS FOR A PARTICULAR PURPOSE.  See the
 * GNU General Public License for more details.
 */

/*---------------------------------------------------------------------------
 * This file is autogenerated file using gcdb parser. Please do not edit it.
 * Update input XML file to add a new entry or update variable in this file
 * VERSION = "1.0"
 *---------------------------------------------------------------------------*/
&mdss_mdp {
	dsi_ft8006s_hdplus_c3i_video: qcom,mdss_dsi_ft8006s_hdplus_video_c3i {
		qcom,mdss-dsi-panel-name = "ft8006s hdplus c3i video mode dsi panel";
		qcom,mdss-dsi-panel-controller = <&mdss_dsi0>;
		qcom,mdss-dsi-panel-type = "dsi_video_mode";
		qcom,mdss-dsi-panel-destination = "display_1";
		qcom,mdss-dsi-panel-framerate = <60>;
		qcom,mdss-dsi-virtual-channel-id = <0>;
		qcom,mdss-dsi-stream = <0>;
		qcom,mdss-dsi-panel-width = <720>;
		qcom,mdss-dsi-panel-height = <1520>;
		qcom,mdss-dsi-h-front-porch = <80>;
		qcom,mdss-dsi-h-back-porch = <60>;
		qcom,mdss-dsi-h-pulse-width = <16>;
		qcom,mdss-dsi-h-sync-skew = <0>;
		qcom,mdss-dsi-v-front-porch = <70>;
		qcom,mdss-dsi-v-back-porch = <37>;
		qcom,mdss-dsi-v-pulse-width = <8>;
		qcom,mdss-dsi-h-left-border = <0>;
		qcom,mdss-dsi-h-right-border = <0>;
		qcom,mdss-dsi-v-top-border = <0>;
		qcom,mdss-dsi-v-bottom-border = <0>;
		qcom,mdss-dsi-bpp = <24>;
		qcom,mdss-dsi-underflow-color = <0xff>;
		qcom,mdss-dsi-border-color = <0>;
		qcom,mdss-dsi-on-command = [
					39 01 00 00 00 00 03 41 5A 24
					39 01 00 00 00 00 02 8D 5A	//CRC check
					39 01 00 00 00 00 03 41 5A 09
					39 01 00 00 00 00 02 91 00
					39 01 00 00 00 00 03 41 5A 15
					39 01 00 00 00 00 02 FF 02
					39 01 00 00 00 00 03 41 5A 16
					39 01 00 00 00 00 05 80 05 85 82 02
					39 01 00 00 00 00 03 41 5A 2F
					39 01 00 00 00 00 02 19 00
					39 01 00 00 00 00 02 4C 03	//clean reload initial code singnal
					39 01 00 00 00 00 03 41 5A 19
					39 01 00 00 00 00 03 A1 00 46	//11 bit 16frame 17K
					39 01 00 00 00 00 03 41 5A 19
					39 01 00 00 00 00 11 80 E7 CE BC B5 A7 A1 98 93 8C 89 84 82 00 60 F6 6F
					39 01 00 00 00 00 08 90 F6 2F F3 EF 6F BF 0F //cabc code
					39 01 00 00 00 00 03 41 5A 18
					39 01 00 00 00 00 11 80 30 4A F9 DC 7B 0B AD 37 B8 68 19 6A BA 9A BA 7A
					39 01 00 00 00 00 11 90 EA 19 49 68 49 E9 19 1A 0A FA 69 9A 2A 9A 79 09
					39 01 00 00 00 00 0D A0 3A BA 19 2A CA 09 CA A9 88 48 48 09 //CE code
					05 01 00 00 78 00 01 11
					05 01 00 00 0A 00 01 29
					39 01 00 00 00 00 03 51 FF 0E	//max-level
					15 01 00 00 00 00 02 53 2C
					15 01 00 00 00 00 02 55 00
					15 01 00 00 00 00 02 35 00
					];
		qcom,mdss-dsi-off-command = [
					05 01 00 00 14 00 01 28
					05 01 00 00 0A 00 01 10
					15 01 00 00 00 00 02 17 5A
					15 01 00 00 96 00 02 18 5A	//deep sleep
					];
		qcom,mdss-dsi-CABC_UI_on-command = [
					15 01 00 00 00 00 02 55 01
					];
		qcom,mdss-dsi-CABC_MOVIE_on-command = [
					15 01 00 00 00 00 02 55 03
					];
		qcom,mdss-dsi-CABC_STILL_on-command = [
					15 01 00 00 00 00 02 55 02
					];
		qcom,mdss-dsi-CABC_off-command = [
					15 01 00 00 00 00 02 55 00
					];
		qcom,mdss-dsi-CE_on-command = [
					15 01 00 00 00 00 02 90 01
					];
		qcom,mdss-dsi-CE_off-command = [
					15 01 00 00 00 00 02 90 00
					];
		qcom,mdss-dsi-on-command-state = "dsi_lp_mode";
		qcom,mdss-dsi-off-command-state = "dsi_lp_mode";
		qcom,mdss-dsi-h-sync-pulse = <1>;
		qcom,mdss-dsi-traffic-mode = "burst_mode";
		qcom,mdss-dsi-lp11-init;
		qcom,mdss-dsi-lane-map = "lane_map_0123";
		qcom,mdss-dsi-bllp-eof-power-mode;
		qcom,mdss-dsi-bllp-power-mode;
		qcom,mdss-dsi-lane-0-state;
		qcom,mdss-dsi-lane-1-state;
		qcom,mdss-dsi-lane-2-state;
		qcom,mdss-dsi-lane-3-state;
		/delete-property/ qcom,mdss-dsi-panel-timings;
		qcom,mdss-dsi-panel-timings-phy-12nm = [
					0b 07 06 03 00 05 03 09];
		qcom,mdss-dsi-t-clk-post = <0x60>;
		qcom,mdss-dsi-t-clk-pre = <0x06>;
		qcom,mdss-dsi-bl-min-level = <1>;
		qcom,mdss-dsi-bl-max-level = <2047>;
		qcom,mdss-brightness-max-level = <2047>;
		qcom,mdss-brightness-max-level-factory = <255>;
		qcom,mdss-dsi-bl-pmic-control-type = "bl_mount";
		qcom,panel-supply-entries = <&dsi_panel_pwr_supply>;
		qcom,mdss-dsi-reset-sequence = <1 5>, <0 10>, <1 45>;
		qcom,esd-check-enabled;
		qcom,mdss-dsi-panel-status-command = [06 01 00 01 05 00 01 0A];
		qcom,mdss-dsi-panel-status-command-mode = "dsi_lp_mode";
		qcom,mdss-dsi-panel-status-check-mode = "reg_read";
		qcom,mdss-dsi-panel-status-read-length = <1>;
		qcom,mdss-dsi-panel-status-valid-params = <1>;
		qcom,mdss-dsi-panel-status-value = <0x9C>;
		qcom,mdss-dsi-panel-max-error-count = <3>;
		qcom,mdss-pan-physical-width-dimension = <68>;
		qcom,mdss-pan-physical-height-dimension = <143>;
	};
};
