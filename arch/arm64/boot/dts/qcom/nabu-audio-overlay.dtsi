/*
 * Copyright (c) 2018, The Linux Foundation. All rights reserved.
 * Copyright (C) 2021 XiaoMi, Inc.
 *
 * This program is free software; you can redistribute it and/or modify
 * it under the terms of the GNU General Public License version 2 and
 * only version 2 as published by the Free Software Foundation.
 *
 * This program is distributed in the hope that it will be useful,
 * but WITHOUT ANY WARRANTY; without even the implied warranty of
 * MERCHANTABILITY or FITNESS FOR A PARTICULAR PURPOSE.  See the
 * GNU General Public License for more details.
 */

#include "sm8150-audio-overlay.dtsi"

&snd_934x {
	qcom,audio-routing =
		"AIF4 VI", "MCLK",
		"RX_BIAS", "MCLK",
		"MADINPUT", "MCLK",
		"hifi amp", "LINEOUT1",
		"hifi amp", "LINEOUT2",
		"AMIC2", "MIC BIAS2",
		"MIC BIAS2", "Headset Mic",
		"AMIC1", "MIC BIAS3",
		"MIC BIAS3", "ANCRight Headset Mic",
		"AMIC3", "MIC BIAS4",
		"MIC BIAS4", "Analog Mic5";

	qcom,wsa-max-devs = <0>;
	qcom,msm-mbhc-hphl-swh = <1>;
	qcom,msm-mbhc-gnd-swh = <1>;
	qcom,msm-mbhc-usbc-audio-supported = <1>;
	qcom,msm-mbhc-hs-mic-max-threshold-mv = <2600>;
	qcom,msm-mbhc-hs-mic-min-threshold-mv = <50>;
	fsa4480-i2c-handle = <&fsa4480>;
	pinctrl-names = "quat_mi2s_enable", "quat_mi2s_disable",
					"quat_tdm_enable", "quat_tdm_disable";
	pinctrl-0 = <&quat_mi2s_active &quat_mi2s_sd0_active &quat_mi2s_sd1_active>;
	pinctrl-1 = <&quat_mi2s_sleep &quat_mi2s_sd0_sleep &quat_mi2s_sd1_sleep>;
	pinctrl-2 = <&quat_tdm_active &quat_tdm_dout_active &quat_tdm_din_active>;
	pinctrl-3 = <&quat_tdm_sleep &quat_tdm_dout_sleep &quat_tdm_din_sleep>;
};

&wcd934x_cdc {
	qcom,cdc-micbias1-mv = <1800>;
	qcom,cdc-micbias2-mv = <2750>;
	qcom,cdc-micbias3-mv = <1800>;
	qcom,cdc-micbias4-mv = <1800>;
};
