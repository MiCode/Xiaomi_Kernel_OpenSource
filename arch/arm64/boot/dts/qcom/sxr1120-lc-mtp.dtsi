/*
 * Copyright (c) 2018, The Linux Foundation. All rights reserved.
 *
 * This program is free software; you can redistribute it and/or modify
 * it under the terms of the GNU General Public License version 2 and
 * only version 2 as published by the Free Software Foundation.
 *
 * This program is distributed in the hope that it will be useful,
 * but WITHOUT ANY WARRANTY; without even the implied warranty of
 * MERCHANTABILITY or FITNESS FOR A PARTICULAR PURPOSE.  See the
 * GNU General Public License for more details.
 */

#include "qcs605-lc-mtp.dtsi"
#include <dt-bindings/gpio/gpio.h>

&sde_dsi_active {
	pins = "gpio93", "gpio121", "gpio76";
};

&sde_dsi_suspend {
	pins = "gpio93", "gpio121", "gpio76";
};

&sde_te_active {
	pins = "gpio10";
};

&sde_te_suspend {
	pins = "gpio10";
};
