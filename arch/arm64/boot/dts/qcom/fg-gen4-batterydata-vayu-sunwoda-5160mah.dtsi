qcom,xiaomi_j20s_sunwoda_5160mah_averaged_masterslave_aug26th2019 {
	qcom,profile-revision = <24>;
	/* #4174016_Xiaomi_J20S_5160mAh_averaged_MasterSlave_Aug26th2019*/
	qcom,max-voltage-uv = <4475000>;
        qcom,fastchg-current-ma = <5900>;
	qcom,jeita-fcc-ranges = <(-100)  0   500000
                                1  50   1000000
				51  100  2500000
				101 150  4000000
				151 450  5900000
				451 580  2500000>;
	qcom,jeita-fv-ranges = <(-100)   0   4450000
                                1   50   4450000
				51  100  4450000
				101 150  4450000
				151 450  4475000
				451 600  4100000>;
	qcom,step-chg-ranges = <3001000  4150000  5900000
				4150001  4230000  5900000
				4230001  4350000  5400000
				4350001  4400000  5400000
				4400001  4430000  5400000
				4430001  4475000  4000000>;
	qcom,taper-fcc;
	qcom,jeita-too-hot = <590>;
	qcom,jeita-too-cold = <(-100)>;
	qcom,jeita-warm-th= <450>;
	qcom,jeita-cool-th= <150>;
	qcom,use-bq-pump;
	mi,six-pin-battery;
	qcom,ffc-low-temp-term-current-ma = <(-723)>;
	qcom,ffc-high-temp-term-current-ma = <(-774)>;
	qcom,fg-cc-cv-threshold-mv = <4440>;
	qcom,fg-ffc-cc-cv-threshold-mv = <4490>;
	qcom,nom-batt-capacity-mah = <5160>;
	qcom,batt-id-kohm = <100>;
	qcom,battery-beta = <4250>;
	qcom,therm-room-temp = <100000>;
	qcom,battery-type = "J20S_sunwoda_5160mah";
	qcom,therm-coefficients = <0x2318 0xd0c 0xdaf7 0xc556 0x848d>;
	qcom,therm-center-offset = <0x70>;
	qcom,therm-pull-up = <100>;
	qcom,rslow-normal-coeffs = <0x71 0x04 0x9c 0x12>;
	qcom,rslow-low-coeffs = <0x9d 0x15 0x4c 0x02>;
	qcom,checksum = <0x7304>;
	qcom,gui-version = "PM855GUI - 1.0.0.14";
	qcom,fg-profile-data = [
		 09 00 8B E2
		 99 D4 2B DB
		 9D D4 00 00
		 95 B4 2D 83
		 FD 87 E3 9D
		 61 86 4B 80
		 24 00 71 04
		 9C 12 05 FC
		 EE F3 CE 07
		 32 00 B1 EA
		 FC ED 33 DA
		 2E 12 37 DB
		 8B BC 31 12
		 E8 01 63 C5
		 60 00 49 00
		 4B 00 48 00
		 31 00 2F 00
		 37 00 40 00
		 3E 00 43 00
		 38 00 60 00
		 35 00 3B 00
		 4D 00 44 00
		 3A 00 71 00
		 57 64 49 00
		 44 08 40 10
		 60 08 47 00
		 43 08 58 10
		 55 10 45 00
		 8B 28 62 48
		 4E 60 44 0C
		 41 00 D8 08
		 16 21 97 15
		 60 0A F9 FD
		 1A 1C 20 02
		 DF 04 70 23
		 0E 17 A9 42
		 9D 54 FF 02
		 69 15 B0 23
		 63 0C 28 13
		 48 05 F3 1C
		 15 03 66 05
		 5F 03 EA 16
		 8C 23 5D 45
		 AD 52 93 14
		 22 21 C4 E5
		 35 C2 3A B4
		 D6 1C A9 C9
		 27 05 A1 B3
		 49 17 70 8B
		 53 85 D9 9A
		 86 A0 09 80
		 77 FA 99 FC
		 29 FC 27 F2
		 00 F8 42 DC
		 29 E2 FA F7
		 B1 E2 77 BD
		 44 18 1A 00
		 6D D4 D9 03
		 11 05 C3 02
		 CE 07 32 00
		 01 03 C7 02
		 68 04 86 02
		 87 02 E1 05
		 38 02 43 01
		 69 04 46 00
		 38 00 44 00
		 44 64 48 00
		 4F 08 46 10
		 46 00 47 00
		 46 00 41 08
		 41 10 3D 00
		 53 20 52 40
		 5D 58 69 0F
		 48 00 52 08
		 5E 10 62 00
		 4E 00 44 00
		 42 10 54 10
		 4B 00 5E 20
		 75 40 46 50
		 56 10 5E 00
		 5A 08 3B 10
		 D8 08 3E 22
		 5A FD 5D 02
		 1E 0C C9 1C
		 26 23 02 44
		 08 52 66 18
		 98 03 77 04
		 6B 02 7C 13
		 3F 0A CD 20
		 F7 05 19 02
		 5E 04 A6 1C
		 74 03 8E 05
		 C0 02 65 18
		 4F 03 F7 04
		 E4 03 6A 00
		 EF 22 CB 04
		 F1 02 67 05
		 EB 1C E7 03
		 3E 04 34 02
		 89 18 E4 02
		 A8 05 A0 02
		 8A 00 BF 00
		 C0 00 FA 00
		 22 14 00 00
	];
};
