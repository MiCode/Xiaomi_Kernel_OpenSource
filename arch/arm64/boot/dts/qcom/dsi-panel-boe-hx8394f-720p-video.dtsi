/*
 * Copyright (c) 2015-2016, The Linux Foundation. All rights reserved.
 * Copyright (C) 2019 XiaoMi, Inc.
 *
 * This program is free software; you can redistribute it and/or modify
 * it under the terms of the GNU General Public License version 2 and
 * only version 2 as published by the Free Software Foundation.
 *
 * This program is distributed in the hope that it will be useful,
 * but WITHOUT ANY WARRANTY; without even the implied warranty of
 * MERCHANTABILITY or FITNESS FOR A PARTICULAR PURPOSE.  See the
 * GNU General Public License for more details.
 */

/*---------------------------------------------------------------------------
 * This file is autogenerated file using gcdb parser. Please do not edit it.
 * Update input XML file to add a new entry or update variable in this file
 * VERSION = "1.0"
 *---------------------------------------------------------------------------*/
&mdss_mdp {
	dsi_boe_hx8394f_720p_video: qcom,mdss_dsi_boe_hx8394f_720p_video {
		qcom,mdss-dsi-panel-name = "boe hx8394f video mode dsi panel";
		qcom,mdss-dsi-panel-controller = <&mdss_dsi0>;
		qcom,mdss-dsi-panel-type = "dsi_video_mode";
		qcom,mdss-dsi-panel-framerate = <58>;
		qcom,mdss-dsi-virtual-channel-id = <0>;
		qcom,mdss-dsi-stream = <0>;
		qcom,mdss-dsi-panel-width = <720>;
		qcom,mdss-dsi-panel-height = <1520>;
		qcom,mdss-dsi-h-front-porch = <16>;
		qcom,mdss-dsi-h-back-porch = <20>;
		qcom,mdss-dsi-h-pulse-width = <12>;
		qcom,mdss-dsi-h-sync-skew = <0>;
		qcom,mdss-dsi-v-back-porch = <12>;
		qcom,mdss-dsi-v-front-porch = <10>;
		qcom,mdss-dsi-v-pulse-width = <4>;
		qcom,mdss-dsi-h-left-border = <0>;
		qcom,mdss-dsi-h-right-border = <0>;
		qcom,mdss-dsi-v-top-border = <0>;
		qcom,mdss-dsi-v-bottom-border = <0>;
		qcom,mdss-dsi-bpp = <24>;
		qcom,mdss-dsi-underflow-color = <0xff>;
		qcom,mdss-dsi-border-color = <0>;
		qcom,mdss-pan-physical-width-dimension = <65>;
		qcom,mdss-pan-physical-height-dimension = <138>;
		qcom,mdss-dsi-on-command = [
				39 01 00 00 00 00 04 B9 FF 83 94
				39 01 00 00 00 00 02 35 00
				05 01 00 00 78 00 02 11 00
				39 01 00 00 00 00 02 51 00
				39 01 00 00 05 00 0a c9 13 00 0a 10 b2 20 00 91 00
				39 01 00 00 05 00 02 55 11
				39 01 00 00 05 00 0a ca 24 24 22 20 20 20 20 20 20
				39 01 00 00 00 00 02 53 24
				39 01 00 00 00 00 02 CC 0B
				39 01 00 00 00 00 02 BA 72
				05 01 00 00 14 00 02 29 00];
		qcom,mdss-dsi-off-command = [
				05 01 00 00 24 00 02 28 00
				05 01 00 00 3C 00 02 10 00];
		qcom,mdss-dsi-cabc-on-command = [
			39 01 00 00 05 00 0A CA 24 24 23 22 21 21 21 20 20
		];
		qcom,mdss-dsi-cabc-off-command = [
			39 01 00 00 05 00 0A CA 20 20 20 20 20 20 20 20 20
		];
		qcom,mdss-dsi-cabc-movie-on-command = [
			39 01 00 00 05 00 0A CA 2D 2C 2A 28 26 24 23 21 20
		];
		qcom,mdss-dsi-cabc-movie-off-command = [
			39 01 00 00 05 00 0A CA 20 20 20 20 20 20 20 20 20
		];
		qcom,mdss-dsi-cabc-still-on-command = [
			39 01 00 00 05 00 0A CA 4D 39 35 31 2D 29 25 22 20
		];
		qcom,mdss-dsi-cabc-still-off-command = [
			39 01 00 00 05 00 0A CA 20 20 20 20 20 20 20 20 20
		];
		qcom,mdss-dsi-ce-on-command = [
			15 01 00 00 00 00 02 E4 00
			39 01 00 00 00 00 20 E5 00 00 02 08 01 00 00 00 00 00 00 05 1D 19 1F 05 ED 09 20 00 00 04 0B 02 01 08 08 07 02 04 02
			39 01 00 00 00 00 16 E6 00 08 00 05 05 10 10 10 20 20 20 10 10 10 10 10 10 A0 01 0F 11
			39 01 00 00 00 00 03 E4 00 41
		];
		qcom,mdss-dsi-ce-off-command = [
			39 01 00 00 00 00 03 E4 00 00
		];
		qcom,mdss-dsi-srgb-on-command = [
		];
		qcom,mdss-dsi-srgb-off-command = [
		];
		qcom,mdss-dsi-on-command-state = "dsi_lp_mode";
		qcom,mdss-dsi-off-command-state = "dsi_hs_mode";
		qcom,mdss-dsi-ce-on-command-state = "dsi_hs_mode";
		qcom,mdss-dsi-ce-off-command-state = "dsi_hs_mode";
		qcom,mdss-dsi-cabc-on-command-state = "dsi_hs_mode";
		qcom,mdss-dsi-cabc-off-command-state = "dsi_hs_mode";
		qcom,mdss-dsi-cabc-movie-on-command-state = "dsi_hs_mode";
		qcom,mdss-dsi-cabc-movie-off-command-state = "dsi_hs_mode";
		qcom,mdss-dsi-cabc-still-on-command-state = "dsi_hs_mode";
		qcom,mdss-dsi-cabc-still-off-command-state = "dsi_hs_mode";
		qcom,mdss-dsi-srgb-on-command-state = "dsi_hs_mode";
		qcom,mdss-dsi-srgb-off-command-state = "dsi_hs_mode";
		qcom,mdss-dsi-h-sync-pulse = <1>;
		qcom,mdss-dsi-traffic-mode = "burst_mode";
		qcom,mdss-dsi-lane-map = "lane_map_0123";
		qcom,mdss-dsi-bllp-eof-power-mode;
		qcom,mdss-dsi-bllp-power-mode;
		qcom,mdss-dsi-lane-0-state;
		qcom,mdss-dsi-lane-1-state;
		qcom,mdss-dsi-lane-2-state;
		//qcom,mdss-dsi-lane-3-state;
		qcom,mdss-dsi-panel-timings
			= [8B 1E 14 00 42 46 18 20 19 03 04 00];
		qcom,mdss-dsi-t-clk-post = <0x0a>;
		qcom,mdss-dsi-t-clk-pre = <0x1f>;
		qcom,mdss-dsi-bl-min-level = <1>;
		qcom,mdss-dsi-bl-max-level = <255>;
		qcom,mdss-dsi-dma-trigger = "trigger_sw";
		qcom,mdss-dsi-mdp-trigger = "none";
		qcom,mdss-dsi-bl-pmic-control-type = "bl_ctrl_dcs";
		qcom,mdss-dsi-bl-dcs-command-state = "dsi_hs_mode";
		qcom,mdss-dsi-reset-sequence = <1 10>, <0 10>, <1 30>;
		qcom,mdss-dsi-lp11-init;
		qcom,mdss-dsi-tx-eot-append;
		qcom,mdss-dsi-panel-status-command-state = "dsi_hs_mode";
		qcom,mdss-dsi-panel-status-check-mode = "reg_read";
		qcom,mdss-dsi-panel-status-command = [14 01 00 01 05 00 01 0a];
		qcom,mdss-dsi-panel-status-read-length = <1>;
		qcom,mdss-dsi-panel-status-value = <0x1c>;
		qcom,esd-check-enabled;
	};
};
