/* Copyright (c) 2015, The Linux Foundation. All rights reserved.
 * Copyright (C) 2021 XiaoMi, Inc.
 *
 * This program is free software; you can redistribute it and/or modify
 * it under the terms of the GNU General Public License version 2 and
 * only version 2 as published by the Free Software Foundation.
 *
 * This program is distributed in the hope that it will be useful,
 * but WITHOUT ANY WARRANTY; without even the implied warranty of
 * MERCHANTABILITY or FITNESS FOR A PARTICULAR PURPOSE.  See the
 * GNU General Public License for more details.
 */

/*---------------------------------------------------------------------------
 * This file is autogenerated file using gcdb parser. Please do not edit it.
 * Update input XML file to add a new entry or update variable in this file
 * VERSION = "1.0"
 *---------------------------------------------------------------------------*/
&soc {
	dsi_g7b_37_02_0a_video: qcom,mdss_dsi_g7b_37_02_0a_dsc_video {
		qcom,mdss-dsi-panel-name = "xiaomi 37 02 0a video mode dsc dsi panel";
		qcom,mdss-dsi-panel-id = <0>;
		qcom,mdss-dsi-panel-model = "xiaomi 37 02 0a VIDEO PANEL";
		qcom,mdss-dsi-panel-type = "dsi_video_mode";
		qcom,mdss-dsi-virtual-channel-id = <0>;
		qcom,mdss-dsi-stream = <0>;
		qcom,mdss-dsi-bpp = <24>;
		qcom,mdss-dsi-color-order = "rgb_swap_rgb";
		qcom,mdss-dsi-underflow-color = <0x0>;
		qcom,mdss-dsi-border-color = <0>;
		qcom,mdss-dsi-traffic-mode = "burst_mode";
		qcom,mdss-dsi-bllp-eof-power-mode;
		qcom,mdss-dsi-bllp-power-mode;
		qcom,mdss-dsi-lp11-init;
		qcom,mdss-dsi-lane-0-state;
		qcom,mdss-dsi-lane-1-state;
		qcom,mdss-dsi-lane-2-state;
		qcom,mdss-dsi-lane-3-state;
		qcom,mdss-brightness-max-level = <4095>;
		qcom,mdss-dsi-dma-trigger = "trigger_sw";
		qcom,mdss-dsi-mdp-trigger = "none";
		qcom,mdss-dsi-reset-sequence = <1 5>, <0 1>, <1 10>;
		qcom,mdss-pan-physical-width-dimension = <700>;
		qcom,mdss-pan-physical-height-dimension = <1540>;
		qcom,cont-splash-enabled;
		qcom,mdss-dsi-tx-eot-append;
		qcom,dispparam-enabled;
		qcom,mdss-panel-on-dimming-delay = <200>;
		qcom,bl-update-flag = "delay_until_first_frame";
		qcom,disp-panel-offon-mode-enabled;
		qcom,mdss-dsi-panel-hdr-enabled;
		qcom,mdss-dsi-panel-hdr-color-primaries = <14500 15500 32000
			17000 15500 30000 8000 3000>;
		qcom,mdss-dsi-panel-peak-brightness = <4200000>;
		qcom,mdss-dsi-panel-blackness-level = <3230>;
		qcom,mdss-dsi-panel-xy-coordinate = <0x0F 0x18>;
		qcom,mdss-dsi-panel-max-luminance = <0x0F 0x20>;
		qcom,mdss-dsi-panel-max-luminance-valid = <0x01 0x01>;
		qcom,esd-err-irq-gpio = <&tlmm 32 0x2002>; /* trig-flags: falling-0x0002 rasing-0x0001*/
		qcom,mdss-dsi-qsync-min-refresh-rate = <60>;
#if 1
		qcom,mdss-dsi-pan-enable-dynamic-fps;
		qcom,mdss-dsi-pan-enable-smart-fps;
		qcom,mdss-dsi-pan-fps-update =
			"dfps_immediate_porch_mode_vfp";
		qcom,dsi-supported-dfps-list = <120 90 60 50 30>;
#endif
		qcom,is-tddi-flag;
		qcom,mdss-dsi-display-timings {
			timing@0{
				qcom,mdss-dsi-panel-framerate = <120>;
				qcom,mdss-dsi-panel-width = <1080>;
				qcom,mdss-dsi-panel-height = <2400>;
				qcom,mdss-dsi-h-pulse-width = <12>;
				qcom,mdss-dsi-h-back-porch = <40>;
				qcom,mdss-dsi-h-front-porch = <40>;
				qcom,mdss-dsi-h-sync-skew = <0>;
				qcom,mdss-dsi-v-pulse-width = <2>;
				qcom,mdss-dsi-v-back-porch = <30>;
				qcom,mdss-dsi-v-front-porch = <32>;
				qcom,mdss-dsi-h-left-border = <0>;
				qcom,mdss-dsi-h-right-border = <0>;
				qcom,mdss-dsi-v-top-border = <0>;
				qcom,mdss-dsi-v-bottom-border = <0>;

				qcom,mdss-dsi-on-command = [
						15 01 00 00 00 00 02 FF 23
						15 00 00 00 00 00 02 FB 01
						15 00 00 00 00 00 02 00 80
						15 00 00 00 00 00 02 07 00
						15 00 00 00 00 00 02 08 01
						15 00 00 00 00 00 02 09 45
						15 01 00 00 00 00 02 FF 20
						15 00 00 00 00 00 02 FB 01
						15 00 00 00 00 00 02 01 66
						15 00 00 00 00 00 02 32 4D
						15 00 00 00 00 00 02 69 D1
						15 00 00 00 00 00 02 F2 64
						15 00 00 00 00 00 02 F4 64
						15 00 00 00 00 00 02 F6 64
						15 00 00 00 00 00 02 F9 64
						15 01 00 00 00 00 02 FF 26
						15 00 00 00 00 00 02 FB 01
						15 00 00 00 00 00 02 81 0E
						15 00 00 00 00 00 02 84 03
						15 00 00 00 00 00 02 86 03
						15 00 00 00 00 00 02 88 07
						15 01 00 00 00 00 02 FF 27
						15 00 00 00 00 00 02 FB 01
						15 00 00 00 00 00 02 E3 01
						15 00 00 00 00 00 02 E4 EC
						15 00 00 00 00 00 02 E5 02
						15 00 00 00 00 00 02 E6 E3
						15 00 00 00 00 00 02 E7 01
						15 00 00 00 00 00 02 E8 EC
						15 00 00 00 00 00 02 E9 02
						15 00 00 00 00 00 02 EA 22
						15 00 00 00 00 00 02 EB 03
						15 00 00 00 00 00 02 EC 32
						15 00 00 00 00 00 02 ED 02
						15 00 00 00 00 00 02 EE 22
						15 01 00 00 00 00 02 FF 2A
						15 00 00 00 00 00 02 FB 01
						15 00 00 00 00 00 02 0C 04
						15 00 00 00 00 00 02 0F 01
						15 00 00 00 00 00 02 11 E0
						15 00 00 00 00 00 02 15 0E
						15 00 00 00 00 00 02 16 78
						15 00 00 00 00 00 02 19 0D
						15 00 00 00 00 00 02 1A F4
						15 00 00 00 00 00 02 37 6E
						15 00 00 00 00 00 02 88 76
						15 01 00 00 00 00 02 FF 2C
						15 00 00 00 00 00 02 FB 01
						15 00 00 00 00 00 02 4D 1E
						15 00 00 00 00 00 02 4E 04
						15 00 00 00 00 00 02 4F 00
						15 00 00 00 00 00 02 9D 1E
						15 00 00 00 00 00 02 9E 04
						15 00 00 00 00 00 02 9F 17
						15 01 00 00 00 00 02 FF F0
						15 00 00 00 00 00 02 FB 01
						15 00 00 00 00 00 02 5A 00
						15 01 00 00 00 00 02 FF E0
						15 00 00 00 00 00 02 FB 01
						15 00 00 00 00 00 02 25 00
						15 00 00 00 00 00 02 4E 02
						15 00 00 00 00 00 02 85 02
						15 01 00 00 00 00 02 FF D0
						15 00 00 00 00 00 02 FB 01
						15 00 00 00 00 00 02 09 AD
						15 01 00 00 00 00 02 FF 20
						15 00 00 00 00 00 02 FB 01
						15 00 00 00 00 00 02 F8 64
						15 01 00 00 00 00 02 FF 2A
						15 00 00 00 00 00 02 FB 01
						15 00 00 00 00 00 02 1A F0
						15 00 00 00 00 00 02 30 5E
						15 00 00 00 00 00 02 31 CA
						15 00 00 00 00 00 02 34 FE
						15 00 00 00 00 00 02 35 35
						15 00 00 00 00 00 02 36 A2
						15 00 00 00 00 00 02 37 F8
						15 00 00 00 00 00 02 38 37
						15 00 00 00 00 00 02 39 A0
						15 00 00 00 00 00 02 3A 5E
						15 00 00 00 00 00 02 53 D7
						15 00 00 00 00 00 02 88 72
						15 01 00 00 00 00 02 FF 24
						15 00 00 00 00 00 02 FB 01
						15 00 00 00 00 00 02 C6 C0
						15 01 00 00 00 00 02 FF 23
						15 00 00 00 00 00 02 FB 01
						15 00 00 00 00 00 02 00 80
						15 00 00 00 00 00 02 01 84
						15 00 00 00 00 00 02 05 2D
						15 00 00 00 00 00 02 06 00
						15 00 00 00 00 00 02 07 00
						15 00 00 00 00 00 02 08 01
						15 00 00 00 00 00 02 09 45
						15 00 00 00 00 00 02 11 01
						15 00 00 00 00 00 02 12 95
						15 00 00 00 00 00 02 15 68
						15 00 00 00 00 00 02 16 0B
						15 00 00 00 00 00 02 29 0A
						15 00 00 00 00 00 02 30 FF
						15 00 00 00 00 00 02 31 FE
						15 00 00 00 00 00 02 32 FD
						15 00 00 00 00 00 02 33 FB
						15 00 00 00 00 00 02 34 F8
						15 00 00 00 00 00 02 35 F5
						15 00 00 00 00 00 02 36 F3
						15 00 00 00 00 00 02 37 F2
						15 00 00 00 00 00 02 38 F2
						15 00 00 00 00 00 02 39 F2
						15 00 00 00 00 00 02 3A EF
						15 00 00 00 00 00 02 3B EC
						15 00 00 00 00 00 02 3D E9
						15 00 00 00 00 00 02 3F E5
						15 00 00 00 00 00 02 40 E5
						15 00 00 00 00 00 02 41 E5
						15 00 00 00 00 00 02 2A 13
						15 00 00 00 00 00 02 45 FF
						15 00 00 00 00 00 02 46 F4
						15 00 00 00 00 00 02 47 E7
						15 00 00 00 00 00 02 48 DA
						15 00 00 00 00 00 02 49 CD
						15 00 00 00 00 00 02 4A C0
						15 00 00 00 00 00 02 4B B3
						15 00 00 00 00 00 02 4C B2
						15 00 00 00 00 00 02 4D B2
						15 00 00 00 00 00 02 4E B2
						15 00 00 00 00 00 02 4F 99
						15 00 00 00 00 00 02 50 80
						15 00 00 00 00 00 02 51 68
						15 00 00 00 00 00 02 52 66
						15 00 00 00 00 00 02 53 66
						15 00 00 00 00 00 02 54 66
						15 00 00 00 00 00 02 2B 0E
						15 00 00 00 00 00 02 58 FF
						15 00 00 00 00 00 02 59 FB
						15 00 00 00 00 00 02 5A F7
						15 00 00 00 00 00 02 5B F3
						15 00 00 00 00 00 02 5C EF
						15 00 00 00 00 00 02 5D E3
						15 00 00 00 00 00 02 5E DA
						15 00 00 00 00 00 02 5F D8
						15 00 00 00 00 00 02 60 D8
						15 00 00 00 00 00 02 61 D8
						15 00 00 00 00 00 02 62 CB
						15 00 00 00 00 00 02 63 BF
						15 00 00 00 00 00 02 64 B3
						15 00 00 00 00 00 02 65 B2
						15 00 00 00 00 00 02 66 B2
						15 00 00 00 00 00 02 67 B2
						15 01 00 00 00 00 02 FF C0
						15 00 00 00 00 00 02 FB 01
						15 00 00 00 00 00 02 9C 11
						15 00 00 00 00 00 02 9D 11
						15 01 00 00 00 00 02 FF F0
						15 00 00 00 00 00 02 FB 01
						15 00 00 00 00 00 02 9C 00
						15 01 00 00 00 00 02 FF 10
						15 00 00 00 00 00 02 FB 01
						39 00 00 00 00 00 03 51 0B 6C
						15 00 00 00 00 00 02 53 24
						15 01 00 00 46 00 02 11 00
						15 01 00 00 00 00 02 29 00
						15 01 00 00 00 00 02 FF 27
						15 00 00 00 00 00 02 FB 01
						15 00 00 00 00 00 02 3F 01
						15 00 00 00 00 00 02 43 08
						15 00 00 00 00 00 02 40 25
						15 01 00 00 00 00 02 FF E0
						15 00 00 00 00 00 02 35 82
						15 01 00 00 00 00 02 FF 10
				];
				qcom,mdss-dsi-off-command = [
						15 01 00 00 00 00 02 FF 27
						15 00 00 00 00 00 02 FB 01
						15 00 00 00 00 00 02 3F 00
						15 01 00 00 00 00 02 FF 10
						15 01 00 00 00 00 02 28 00
						15 01 00 00 46 00 02 10 00];
				qcom,mdss-dsi-displayoff-command = [15 01 00 00 20 00 02 28 00];
				qcom,mdss-dsi-displayon-command = [15 01 00 00 14 00 02 29 00];
				qcom,mdss-dsi-read-lockdown-info-command = [
						15 01 00 00 00 00 02 FF 21
						06 01 00 00 00 00 01 F1
				];
				qcom,mdss-dsi-on-command-state = "dsi_lp_mode";
				qcom,mdss-dsi-off-command-state = "dsi_hs_mode";
				qcom,mdss-dsi-displayoff-command-state = "dsi_hs_mode";
				qcom,mdss-dsi-displayon-command-state = "dsi_hs_mode";
				qcom,mdss-dsi-read-lockdown-info-command-state = "dsi_lp_mode";
				qcom,mdss-dsi-h-sync-pulse = <1>;

				qcom,mdss-dsi-dispparam-cabcuion-command = [
						15 01 00 00 00 00 02 FF 10
						15 01 00 00 00 00 02 55 01
				];
				qcom,mdss-dsi-dispparam-cabcstillon-command = [
						15 01 00 00 00 00 02 FF 10
						15 01 00 00 00 00 02 55 02
				];
				qcom,mdss-dsi-dispparam-cabcmovieon-command = [
						15 01 00 00 00 00 02 FF 10
						15 01 00 00 00 00 02 55 03
				];
				qcom,mdss-dsi-dispparam-cabcoff-command = [
						15 01 00 00 00 00 02 FF 10
						15 01 00 00 00 00 02 55 00
				];
				qcom,mdss-dsi-dispparam-cabcuion-command-state = "dsi_hs_mode";
				qcom,mdss-dsi-dispparam-cabcstillon-command-state = "dsi_hs_mode";
				qcom,mdss-dsi-dispparam-cabcmovieon-command-state = "dsi_hs_mode";
				qcom,mdss-dsi-dispparam-cabcoff-command-state = "dsi_hs_mode";

				qcom,mdss-dsi-dispparam-lcd-hbm-l1-on-command = [39 01 00 00 00 00 03 51 0D B5];
				qcom,mdss-dsi-dispparam-lcd-hbm-l1-on-command-state = "dsi_lp_mode";
				qcom,mdss-dsi-dispparam-lcd-hbm-l2-on-command = [39 01 00 00 00 00 03 51 0E 8C];
				qcom,mdss-dsi-dispparam-lcd-hbm-l2-on-command-state = "dsi_lp_mode";
				qcom,mdss-dsi-dispparam-lcd-hbm-off-command = [39 01 00 00 00 00 03 51 0B 6C];
				qcom,mdss-dsi-dispparam-lcd-hbm-off-command-state = "dsi_lp_mode";

				qcom,mdss-dsi-panel-xy-coordinate = <0x0F 0x18>;
				qcom,mdss-dsi-dispparam-xy-coordinate-command = [
						15 01 00 00 00 00 02 FF 10
						06 01 00 01 05 00 02 A1 00];
				qcom,mdss-dsi-dispparam-xy-coordinate-command-state = "dsi_hs_mode";

				//delay dimming on
				qcom,mdss-dsi-dispparam-dimmingon-command = [39 01 00 00 01 00 02 53 2C];
				qcom,mdss-dsi-dispparam-dimmingon-command-state = "dsi_lp_mode";
				qcom,mdss-dsi-dispparam-dimmingoff-command = [39 01 00 00 01 00 02 53 24];
				qcom,mdss-dsi-dispparam-dimmingoff-command-state = "dsi_lp_mode";

				qcom,compression-mode = "dsc";
				qcom,mdss-dsc-version = <0x11>;
				qcom,mdss-dsc-scr-version = <0x0>;
				qcom,mdss-dsc-slice-height = <20>;
				qcom,mdss-dsc-slice-width = <540>;
				qcom,mdss-dsc-slice-per-pkt = <2>;
				qcom,mdss-dsc-bit-per-component = <8>;
				qcom,mdss-dsc-bit-per-pixel = <8>;
				qcom,mdss-dsc-block-prediction-enable;
			};
		};
	};
};

