/* Copyright (c) 2015, The Linux Foundation. All rights reserved.
 *
 * This program is free software; you can redistribute it and/or modify
 * it under the terms of the GNU General Public License version 2 and
 * only version 2 as published by the Free Software Foundation.
 *
 * This program is distributed in the hope that it will be useful,
 * but WITHOUT ANY WARRANTY; without even the implied warranty of
 * MERCHANTABILITY or FITNESS FOR A PARTICULAR PURPOSE.  See the
 * GNU General Public License for more details.
 */

qcom,qrd_msm8952_skum_2920mah {
	qcom,max-voltage-uv = <4400000>;
	qcom,nom-batt-capacity-mah = <2920>;
	qcom,batt-id-kohm = <50 90>;
	qcom,battery-beta = <0>;
	qcom,battery-type = "qrd_msm8952_skum_2920mah";
	qcom,fastchg-current-ma = <3000>;
	qcom,fg-cc-cv-threshold-mv = <4390>;
	qcom,chg-rslow-comp-c1 = <4847657>;
	qcom,chg-rslow-comp-c2 = <11109950>;
	qcom,chg-rs-to-rslow = <819081>;
	qcom,chg-rslow-comp-thr = <0xC7>;
	qcom,checksum = <0x13EE>;
	qcom,gui-version = "PMI8950GUI - 0.0.0.32";
	qcom,fg-profile-data = [
		C7 83 0E 77
		EE 7A 0A 6E
		3A 83 D3 70
		5B 71 3F 86
		B0 81 82 A0
		3E C4 77 D1
		54 0D D4 83
		8A 76 4C 7A
		D0 6C 4F 83
		77 6B 2E 79
		05 8C 20 82
		70 9A 79 BD
		3C CA 54 0D
		D3 0B A0 62
		14 70 71 FD
		35 2F CD 35
		FE 1A 00 00
		9C 4D 14 3B
		FE 3A 00 00
		00 00 00 00
		00 00 00 00
		0D 6B A9 69
		A2 76 CE 81
		8B 7D A0 72
		95 6F 64 78
		46 7C 34 70
		9B 49 85 93
		50 4B 61 22
		5E A0 71 0C
		28 00 FF 36
		F0 11 30 03
		00 00 00 00
	];
};
