/* Copyright (c) 2018, The Linux Foundation. All rights reserved.
 *
 * This program is free software; you can redistribute it and/or modify
 * it under the terms of the GNU General Public License version 2 and
 * only version 2 as published by the Free Software Foundation.
 *
 * This program is distributed in the hope that it will be useful,
 * but WITHOUT ANY WARRANTY; without even the implied warranty of
 * MERCHANTABILITY or FITNESS FOR A PARTICULAR PURPOSE.  See the
 * GNU General Public License for more details.
 */

/dts-v1/;
/plugin/;

#include <dt-bindings/interrupt-controller/arm-gic.h>

#include "sm6150-rumi.dtsi"

/ {
	model = "Qualcomm Technologies, Inc. SM6150 RUMI";
	compatible = "qcom,sm6150-rumi", "qcom,sm6150", "qcom,rumi";
	qcom,msm-id = <355 0x0>;
	qcom,board-id = <15 0>;
};
