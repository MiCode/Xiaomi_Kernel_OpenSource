/* Copyright (c) 2018-2019, The Linux Foundation. All rights reserved.
 *
 * This program is free software; you can redistribute it and/or modify
 * it under the terms of the GNU General Public License version 2 and
 * only version 2 as published by the Free Software Foundation.
 *
 * This program is distributed in the hope that it will be useful,
 * but WITHOUT ANY WARRANTY; without even the implied warranty of
 * MERCHANTABILITY or FITNESS FOR A PARTICULAR PURPOSE.  See the
 * GNU General Public License for more details.
 */

/dts-v1/;

#include "sdmmagpie.dtsi"
#include "sdmmagpie-idp.dtsi"

/ {
	model = "Qualcomm Technologies, Inc. SDMMAGPIE PM6150 Dual Display IDP";
	compatible = "qcom,sdmmagpie-idp", "qcom,sdmmagpie", "qcom,idp";
	qcom,board-id = <34 3>;
};

&dsi_sw43404_amoled_fhd_plus_cmd_display {
	qcom,dsi-display-active;
};

&dsi_nt35695b_truly_fhd_cmd_sec_display {
	qcom,dsi-display-active;
};

&mdss_mdp {
	qcom,sde-mixer-display-pref = "primary", "none", "none",
			"none", "none", "none";
};
