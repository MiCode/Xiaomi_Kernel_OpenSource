/* Copyright (c) 2018, The Linux Foundation. All rights reserved.
 *
 * This program is free software; you can redistribute it and/or modify
 * it under the terms of the GNU General Public License version 2 and
 * only version 2 as published by the Free Software Foundation.
 *
 * This program is distributed in the hope that it will be useful,
 * but WITHOUT ANY WARRANTY; without even the implied warranty of
 * MERCHANTABILITY or FITNESS FOR A PARTICULAR PURPOSE.  See the
 * GNU General Public License for more details.
 */

/dts-v1/;
/plugin/;

#include <dt-bindings/clock/qcom,gcc-sdm855.h>
#include <dt-bindings/clock/qcom,camcc-sdm855.h>
#include <dt-bindings/clock/qcom,rpmh.h>
#include <dt-bindings/interrupt-controller/arm-gic.h>

#include "sdm855-cdp.dtsi"

#include "sdx50m-external-soc.dtsi"
#include "sdm855-sdx50m.dtsi"

/ {
	model = "SDX50M CDP";
	compatible = "qcom,sdm855-cdp", "qcom,sdm855", "qcom,cdp";
	qcom,board-id = <1 1>;
};
