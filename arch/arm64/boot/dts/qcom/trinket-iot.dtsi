/*
 * Copyright (c) 2020, The Linux Foundation. All rights reserved.
 *
 * This program is free software; you can redistribute it and/or modify
 * it under the terms of the GNU General Public License version 2 and
 * only version 2 as published by the Free Software Foundation.
 *
 * This program is distributed in the hope that it will be useful,
 * but WITHOUT ANY WARRANTY; without even the implied warranty of
 * MERCHANTABILITY or FITNESS FOR A PARTICULAR PURPOSE.  See the
 * GNU General Public License for more details.
 */

#include "trinket.dtsi"

/ {
	model = "Qualcomm Technologies, Inc. TRINKET IOT";
	compatible = "qcom,trinket-iot";
	qcom,msm-id = <467 0x0>;
	qcom,msm-name = "trinket";
};
