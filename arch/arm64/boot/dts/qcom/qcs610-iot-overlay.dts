/* Copyright (c) 2019-2020, The Linux Foundation. All rights reserved.
 *
 * This program is free software; you can redistribute it and/or modify
 * it under the terms of the GNU General Public License version 2 and
 * only version 2 as published by the Free Software Foundation.
 *
 * This program is distributed in the hope that it will be useful,
 * but WITHOUT ANY WARRANTY; without even the implied warranty of
 * MERCHANTABILITY or FITNESS FOR A PARTICULAR PURPOSE.  See the
 * GNU General Public License for more details.
 */

/dts-v1/;
/plugin/;

#include <dt-bindings/clock/qcom,camcc-sm6150.h>

#include "qcs610-iot.dtsi"

/ {
	model = "Qualcomm Technologies, Inc. QCS610 IOT Overlay";
	compatible = "qcom,qcs610-iot", "qcom,qcs610", "qcom,iot";
	qcom,msm-id = <401 0x0>;
	qcom,board-id = <32 0>;
};
