/* Copyright (c) 2018-2020, The Linux Foundation. All rights reserved.
 *
 * This program is free software; you can redistribute it and/or modify
 * it under the terms of the GNU General Public License version 2 and
 * only version 2 as published by the Free Software Foundation.
 *
 * This program is distributed in the hope that it will be useful,
 * but WITHOUT ANY WARRANTY; without even the implied warranty of
 * MERCHANTABILITY or FITNESS FOR A PARTICULAR PURPOSE.  See the
 * GNU General Public License for more details.
 */

/dts-v1/;

#include "sa8155p-v2.dtsi"
#include "sa8155-adp-common.dtsi"
#include "sa8155-adp-star-display.dtsi"

/ {
	model = "Qualcomm Technologies, Inc. SA8155P V2 ADP Air + LPASS Audio
			 PLL sourced from eMAC PPO ";
	compatible = "qcom,sa8155p-v2-adp-air", "qcom,sa8155p", "qcom,adp-air";
	qcom,board-id = <0x04010019 0>;
};

&qupv3_se0_spi {
	status = "disabled";
};
