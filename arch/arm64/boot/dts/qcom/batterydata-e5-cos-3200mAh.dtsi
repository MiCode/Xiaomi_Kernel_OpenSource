qcom,e5_cos_3200mAh {
	qcom, = <24>;
	qcom,max-voltage-uv = <4400000>;
	qcom,fg-cc-cv-threshold-mv = <4390>;
	qcom,nom-batt-capacity-mah = <3200>;
	qcom,batt-id-kohm = <100>;
	qcom,battery-beta = <3380>;

	qcom,battery-type = "e5_cos_3200mAh";
	qcom,fastchg-current-ma = <3100>;
	qcom,jeita-fcc-ranges = <0   50   310000
							51  100  930000
							101 150  2170000
							151 450  3100000
							451 600  1550000>;
	qcom,jeita-fv-ranges =  <0   50   4400000
							51  100  4400000
							101 150  4400000
							151 450  4400000
							451 600  4100000>;
	qcom,checksum = <0x6F2A>;
	qcom,gui-version = "PMI8998GUI - 2.0.0.58";
	qcom,fg-profile-data = [
		CB 1E 45 FD
		15 03 66 F5
		E4 1C E2 01
		D9 0D 7B 0A
		8F 17 FF 23
		3A 44 6F 5A
		70 00 00 00
		10 00 00 00
		00 00 3D B5
		4D CD 89 BB
		1D 00 08 00
		A6 DA C7 07
		13 FC 58 01
		E7 F5 65 12
		7D 06 D0 2A
		2E 06 09 20
		27 00 14 00
		5F 1F 43 FC
		D8 03 ED FD
		B4 1C 2C 03
		C8 15 6A 12
		75 18 D7 23
		E8 4D 2D 5B
		65 00 00 00
		0E 00 00 00
		00 00 40 CC
		5F CA 78 BC
		17 00 00 00
		5D 00 C7 07
		7D FD C9 00
		9A EC BD 02
		17 02 76 23
		CB 33 CC FF
		07 10 00 00
		76 0C 66 46
		17 00 40 00
		71 01 0A FA
		FF 00 00 00
		00 00 00 00
		00 00 00 00
		00 00 00 00
		00 00 00 00
		00 00 00 00
		00 00 00 00
		00 00 00 00
		00 00 00 00
		00 00 00 00
		00 00 00 00
		00 00 00 00
		00 00 00 00
		00 00 00 00
		00 00 00 00
		00 00 00 00
		00 00 00 00
		00 00 00 00
		00 00 00 00
	];
};
