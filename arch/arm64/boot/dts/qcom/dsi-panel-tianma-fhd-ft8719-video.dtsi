/* Copyright (c) 2015, The Linux Foundation. All rights reserved.
 * Copyright (C) 2019 XiaoMi, Inc.
 *
 * This program is free software; you can redistribute it and/or modify
 * it under the terms of the GNU General Public License version 2 and
 * only version 2 as published by the Free Software Foundation.
 *
 * This program is distributed in the hope that it will be useful,
 * but WITHOUT ANY WARRANTY; without even the implied warranty of
 * MERCHANTABILITY or FITNESS FOR A PARTICULAR PURPOSE.  See the
 * GNU General Public License for more details.
 */

/*---------------------------------------------------------------------------
 * This file is autogenerated file using gcdb parser. Please do not edit it.
 * Update input XML file to add a new entry or update variable in this file
 * VERSION = "1.0"
 *---------------------------------------------------------------------------*/
&mdss_mdp {
	dsi_tianma_fhd_ft8719_video: qcom,mdss_dsi_tianma_fhd_ft8719_video {
		qcom,mdss-dsi-panel-name = "tianma fhd video dsi panel";
		qcom,mdss-dsi-panel-id = <0>;
		qcom,mdss-dsi-panel-model = "TIANMA FHD FT8719 VIDE PANEL";
		qcom,mdss-dsi-panel-sleepwrmod = <0>;

		qcom,mdss-dsi-panel-type = "dsi_video_mode";
		qcom,mdss-dsi-virtual-channel-id = <0>;
		qcom,mdss-dsi-stream = <0>;
		qcom,mdss-dsi-bpp = <24>;
		qcom,mdss-dsi-color-order = "rgb_swap_rgb";
		qcom,mdss-dsi-underflow-color = <0x0>;
		qcom,mdss-dsi-border-color = <0>;
		qcom,mdss-dsi-traffic-mode = "burst_mode";
		qcom,mdss-dsi-lane-map = "lane_map_0123";
		qcom,mdss-dsi-bllp-eof-power-mode;
		qcom,mdss-dsi-bllp-power-mode;
		qcom,mdss-dsi-lp11-init;
		qcom,mdss-dsi-lane-0-state;
		qcom,mdss-dsi-lane-1-state;
		qcom,mdss-dsi-lane-2-state;
		qcom,mdss-dsi-lane-3-state;
		qcom,mdss-dsi-tx-eot-append;
		qcom,mdss-dsi-bl-pmic-control-type = "bl_ctrl_wled";
		qcom,mdss-dsi-bl-min-level = <1>;
		qcom,mdss-dsi-bl-max-level = <4095>;
		//qcom,mdss-brightness-max-level = <255>;
		qcom,mdss-dsi-dma-trigger = "trigger_sw";
		qcom,mdss-dsi-mdp-trigger = "none";
		qcom,mdss-dsi-reset-sequence = <1 1>, <0 5>, <1 15>;
		qcom,mdss-pan-physical-width-dimension = <68>;
		qcom,mdss-pan-physical-height-dimension = <136>;

		//qcom,mdss-dsi-panel-hdr-enabled;
		//qcom,mdss-dsi-panel-hdr-color-primaries = <14500 15500 32000
		//	17000 15500 30000 8000 3000>;
		//qcom,dispparam-enabled;
		//qcom,mdss-panel-on-dimming-delay = <120>;

		qcom,mdss-dsi-display-timings {
			timing@0{
				qcom,mdss-dsi-panel-framerate = <60>;
				qcom,mdss-dsi-panel-width = <1080>;
				qcom,mdss-dsi-panel-height = <2340>;
				qcom,mdss-dsi-h-front-porch = <16>;
				qcom,mdss-dsi-h-back-porch = <16>;
				qcom,mdss-dsi-h-pulse-width = <4>;
				qcom,mdss-dsi-h-sync-skew = <0>;
				qcom,mdss-dsi-v-back-porch = <12>;
				qcom,mdss-dsi-v-front-porch = <120>;
				qcom,mdss-dsi-v-pulse-width = <4>;
				qcom,mdss-dsi-h-right-border = <0>;
				qcom,mdss-dsi-v-top-border = <0>;
				qcom,mdss-dsi-v-bottom-border = <0>;
				qcom,mdss-dsi-h-sync-pulse = <0>;

				qcom,mdss-dsi-on-command = [
					/*
					15 01 00 00 00 00 02 00 00
					39 01 00 00 00 00 04 ff 87 19 01
					15 01 00 00 00 00 02 00 80
					39 01 00 00 00 00 03 ff 87 19

					39 01 00 00 00 00 02 00 80
					39 01 00 00 00 00 0D C0 00 7B 00 6B 00 10 01 00 00 00 1B 09
					39 01 00 00 00 00 02 00 D7
					39 01 00 00 00 00 07 C0 00 77 00 6E 00 10
					39 01 00 00 00 00 02 00 90
					39 01 00 00 00 00 07 C0 00 7B 00 6B 00 10
					39 01 00 00 00 00 02 00 A0
					39 01 00 00 00 00 07 C0 01 0A 00 3A 00 10
					39 01 00 00 00 00 02 00 B0
					39 01 00 00 00 00 06 C0 00 7B 01 FB 10
					39 01 00 00 00 00 02 00 C1
					39 01 00 00 00 00 09 C0 00 B2 00 8B 00 77 00 D1
					39 01 00 00 00 00 02 00 A5
					39 01 00 00 00 00 05 C1 00 28 00 02

					39 01 00 00 00 00 02 00 90
					39 01 00 00 00 00 0A CE 00 82 0D 5C 00 82 80 09 04

					39 01 00 00 00 00 02 00 D0
					39 01 00 00 00 00 09 CE 91 00 0A 01 01 00 5C 01
					39 01 00 00 00 00 02 00 E0
					39 01 00 00 00 00 0D CE 88 08 02 15 02 15 02 15 00 2B 00 5F
					39 01 00 00 00 00 02 00 F0
					39 01 00 00 00 00 0B CE 80 16 0B 0F 01 09 01 0A 01 0A
					*/
					15 01 00 00 00 00 02 35 00
					15 01 00 00 78 00 02 11 00
					15 01 00 00 14 00 02 29 00
					15 01 00 00 00 00 02 51 ff
					15 01 00 00 00 00 02 53 24
					15 01 00 00 00 00 02 55 00
				];

				qcom,mdss-dsi-off-command = [
				  15 01 00 00 14 00 02 28 00
				  15 01 00 00 78 00 02 10 00
				];

				qcom,mdss-dsi-on-command-state = "dsi_lp_mode";
				qcom,mdss-dsi-off-command-state = "dsi_hs_mode";
			};
		};
	};
};
