/*
 * Copyright (c) 2018, The Linux Foundation. All rights reserved.
 *
 * This program is free software; you can redistribute it and/or modify
 * it under the terms of the GNU General Public License version 2 and
 * only version 2 as published by the Free Software Foundation.
 *
 * This program is distributed in the hope that it will be useful,
 * but WITHOUT ANY WARRANTY; without even the implied warranty of
 * MERCHANTABILITY or FITNESS FOR A PARTICULAR PURPOSE.  See the
 * GNU General Public License for more details.
 */

/dts-v1/;

#include "sdm632.dtsi"
#include "sdm450-pmi632.dtsi"
#include "sdm632-pm8004.dtsi"
#include "sdm632-ext-codec-cdp-s3.dtsi"

/ {
	model = "Qualcomm Technologies, Inc. SDM632 + PMI632 + PMI8004 Ext Codec CDP S3";
	compatible = "qcom,sdm632-cdp", "qcom,sdm632", "qcom,cdp";
	qcom,board-id = <1 3>;
	qcom,pmic-id = <0x010016 0x25 0xC 0x0>;
};

