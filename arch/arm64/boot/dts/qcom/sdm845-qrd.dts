/* Copyright (c) 2017, The Linux Foundation. All rights reserved.
 *
 * This program is free software; you can redistribute it and/or modify
 * it under the terms of the GNU General Public License version 2 and
 * only version 2 as published by the Free Software Foundation.
 *
 * This program is distributed in the hope that it will be useful,
 * but WITHOUT ANY WARRANTY; without even the implied warranty of
 * MERCHANTABILITY or FITNESS FOR A PARTICULAR PURPOSE.  See the
 * GNU General Public License for more details.
 */


/dts-v1/;

#include "sdm845.dtsi"
#include "sdm845-sde-display.dtsi"
#include "sdm845-qrd.dtsi"

/ {
	model = "Qualcomm Technologies, Inc. SDM845 QRD";
	compatible = "qcom,sdm845-qrd", "qcom,sdm845", "qcom,qrd";
	qcom,board-id = <11 0>;
};
