/*
 * Copyright (c) 2017-2018, 2020 The Linux Foundation. All rights reserved.
 *
 * This program is free software; you can redistribute it and/or modify
 * it under the terms of the GNU General Public License version 2 and
 * only version 2 as published by the Free Software Foundation.
 *
 * This program is distributed in the hope that it will be useful,
 * but WITHOUT ANY WARRANTY; without even the implied warranty of
 * MERCHANTABILITY or FITNESS FOR A PARTICULAR PURPOSE.  See the
 * GNU General Public License for more details.
 */

#include "sdxprairie-audio-overlay.dtsi"

&soc {
	sound-tavil {
		qcom,wsa-max-devs = <1>;
		qcom,wsa-devs = <&wsa881x_0214>;
		qcom,wsa-aux-dev-prefix = "SpkrRight";
	};
};

&wsa_spkr_wcd_sd2 {
	pinctrl-0 = <&spkr_1_wcd_en_active>;
	pinctrl-1 = <&spkr_1_wcd_en_sleep>;
};
