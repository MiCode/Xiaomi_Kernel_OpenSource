/* Copyright (c) 2015, The Linux Foundation. All rights reserved.
 * Copyright (C) 2021 XiaoMi, Inc.
 *
 * This program is free software; you can redistribute it and/or modify
 * it under the terms of the GNU General Public License version 2 and
 * only version 2 as published by the Free Software Foundation.
 *
 * This program is distributed in the hope that it will be useful,
 * but WITHOUT ANY WARRANTY; without even the implied warranty of
 * MERCHANTABILITY or FITNESS FOR A PARTICULAR PURPOSE.  See the
 * GNU General Public License for more details.
 */

/*---------------------------------------------------------------------------
 * This file is autogenerated file using gcdb parser. Please do not edit it.
 * Update input XML file to add a new entry or update variable in this file
 * VERSION = "1.0"
 *---------------------------------------------------------------------------*/
&soc {
	dsi_samsung_fhd_ea8076_f1p2_2_cmd: qcom,mdss_dsi_samsung_fhd_ea8076_f1p2_2_cmd {
		qcom,mdss-dsi-panel-name = "samsung ea8076 fhd cmd dsi panel";
		qcom,mdss-dsi-panel-id = <0>;
		qcom,mdss-dsi-panel-model = "SAMSUNG FHD EA8076 CMD PANEL";
		qcom,mdss-dsi-panel-sleepwrmod = <0>;
		qcom,mdss-dsi-panel-type = "dsi_cmd_mode";
		qcom,mdss-dsi-virtual-channel-id = <0>;
		qcom,mdss-dsi-stream = <0>;
		qcom,mdss-dsi-bpp = <24>;
		qcom,mdss-dsi-underflow-color = <0xff>;
		qcom,mdss-dsi-border-color = <0>;
		qcom,mdss-dsi-traffic-mode = "burst_mode";
		qcom,mdss-dsi-bllp-eof-power-mode;
		qcom,mdss-dsi-bllp-power-mode;
		qcom,ulps-enabled;
		qcom,mdss-dsi-lp11-init;
		qcom,mdss-dsi-lane-0-state;
		qcom,mdss-dsi-lane-1-state;
		qcom,mdss-dsi-lane-2-state;
		qcom,mdss-dsi-lane-3-state;
		qcom,mdss-brightness-max-level = <2047>;
		qcom,bl-update-flag = "delay_until_first_frame";
		qcom,mdss-dsi-dma-trigger = "trigger_sw";
		qcom,mdss-dsi-mdp-trigger = "none";
		qcom,mdss-dsi-bl-dcs-type-ss;
		qcom,mdss-dsi-reset-sequence = <0 1>, <1 10>;
		qcom,mdss-pan-physical-width-dimension = <68>;
		qcom,mdss-pan-physical-height-dimension = <147>;
		qcom,mdss-dsi-te-pin-select = <1>;
		qcom,mdss-dsi-wr-mem-start = <0x2c>;
		qcom,mdss-dsi-wr-mem-continue = <0x3c>;
		qcom,mdss-dsi-te-dcs-command = <1>;
		qcom,mdss-dsi-te-check-enable;
		qcom,mdss-dsi-te-using-te-pin;
		qcom,mdss-dsi-tx-eot-append;
		qcom,mdss-dsi-panel-hdr-enabled;
		qcom,mdss-dsi-panel-hdr-color-primaries = <14500 15500 32000
			17000 15500 30000 8000 3000>;
		qcom,mdss-dsi-panel-peak-brightness = <4300000>;
		qcom,mdss-dsi-panel-blackness-level = <3230>;

		qcom,mdss-dsi-panel-fod-dimlayer-enabled;

		qcom,dispparam-enabled;
		qcom,mdss-panel-on-dimming-delay = <200>;
		qcom,mdss-dsi-panel-dc-threshold = <610>;
		/* IRQF_ONESHOT | IRQF_TRIGGER_FALLING */
		qcom,esd-err-irq-gpio = <&tlmm 5 0x2002>;

		qcom,disp-doze-backlight-threshold = <8>;
		qcom,disp-fod-off-dimming-delay = <85>;

		qcom,elvss_dimming_check_enable;
		qcom,mdss-dsi-panel-elvss-dimming-read-length = <1>;
		qcom,mdss-dsi-dispparam-elvss-dimming-offset-command = [39 01 00 00 00 00 02 B0 07];
		qcom,mdss-dsi-dispparam-elvss-dimming-offset-command-state = "dsi_hs_mode";
		qcom,mdss-dsi-dispparam-elvss-dimming-read-command = [06 01 00 01 00 00 01 B7];
		qcom,mdss-dsi-dispparam-elvss-dimming-read-command-state = "dsi_hs_mode";
		qcom,mdss-dsi-dispparam-hbm-fod-off-doze-hbm-on-command = [
					39 01 00 00 00 00 02 53 22
					39 00 00 00 00 00 03 F0 5A 5A
					39 00 00 00 00 00 03 B7 01 4B
					39 00 00 00 00 00 02 B0 03
					39 00 00 00 00 00 02 B7 49
					39 00 00 00 00 00 02 B0 07
					39 00 00 00 00 00 02 B7 91
					39 01 00 00 01 00 03 F0 A5 A5];
		qcom,mdss-dsi-dispparam-hbm-fod-off-doze-hbm-on-command-state = "dsi_lp_mode";
		qcom,mdss-dsi-dispparam-hbm-fod-off-doze-lbm-on-command = [
					39 01 00 00 00 00 02 53 23
					39 00 00 00 00 00 03 F0 5A 5A
					39 00 00 00 00 00 03 B7 01 4B
					39 00 00 00 00 00 02 B0 03
					39 00 00 00 00 00 02 B7 49
					39 00 00 00 00 00 02 B0 07
					39 00 00 00 00 00 02 B7 91
					39 01 00 00 01 00 03 F0 A5 A5];
		qcom,mdss-dsi-dispparam-hbm-fod-off-doze-lbm-on-command-state = "dsi_lp_mode";
		qcom,mdss-dsi-dispparam-hbm-fod-off-command = [
					39 01 00 00 00 00 02 53 20
					39 00 00 00 00 00 03 F0 5A 5A
					39 00 00 00 00 00 03 B7 01 4B
					39 00 00 00 00 00 02 B0 03
					39 00 00 00 00 00 02 B7 49
					39 00 00 00 00 00 02 B0 07
					39 00 00 00 00 00 02 B7 91
					39 01 00 00 01 00 03 F0 A5 A5];
		qcom,mdss-dsi-dispparam-hbm-fod-off-command-state = "dsi_lp_mode";
		qcom,mdss-dsi-dispparam-hbm-fod-on-command = [
					39 00 00 00 00 00 03 F0 5A 5A
					39 00 00 00 00 00 02 B0 03
					39 00 00 00 00 00 02 B7 C9
					39 00 00 00 00 00 02 B0 07
					39 00 00 00 00 00 02 B7 91
					39 00 00 00 00 00 03 B7 01 43
					39 00 00 00 00 00 03 F0 A5 A5
					39 01 00 00 01 00 02 53 E0];
		qcom,mdss-dsi-dispparam-hbm-fod-on-command-state = "dsi_lp_mode";

		qcom,mdss-dsi-display-timings {
			timing@0{
				qcom,mdss-dsi-panel-width = <1080>;
				qcom,mdss-dsi-panel-height = <2340>;
				qcom,mdss-dsi-h-front-porch = <64>;
				qcom,mdss-dsi-h-back-porch = <64>;
				qcom,mdss-dsi-h-pulse-width = <20>;
				qcom,mdss-dsi-h-sync-skew = <0>;
				qcom,mdss-dsi-v-back-porch = <64>;
				qcom,mdss-dsi-v-front-porch = <64>;
				qcom,mdss-dsi-v-pulse-width = <20>;
				qcom,mdss-dsi-h-left-border = <0>;
				qcom,mdss-dsi-h-right-border = <0>;
				qcom,mdss-dsi-v-top-border = <0>;
				qcom,mdss-dsi-v-bottom-border = <0>;
				qcom,mdss-dsi-panel-framerate = <60>;
				qcom,mdss-dsi-panel-clockrate = <1100000000>;
				qcom,mdss-dsi-panel-jitter = <0x5 0x1>;
				qcom,mdss-dsi-on-command = [
					39 00 00 00 00 00 03 F0 5A 5A
					39 00 00 00 00 00 03 FC 5A 5A
					39 00 00 00 00 00 02 B0 0C
					39 00 00 00 00 00 02 FF 10
					39 00 00 00 00 00 02 B0 2F
					39 01 00 00 00 00 02 D1 01
					39 00 00 00 00 00 03 F0 A5 A5
					39 01 00 00 00 00 03 FC A5 A5
					05 01 00 00 0A 00 02 11 00
					39 00 00 00 00 00 03 F0 5A 5A
					39 00 00 00 00 00 02 35 00
					39 00 00 00 00 00 03 B7 01 4B
					39 00 00 00 00 00 02 B0 06
					39 00 00 00 00 00 02 B7 10
					39 01 00 00 00 00 03 F0 A5 A5
					39 01 00 00 00 00 05 2B 00 00 09 23
					39 00 00 00 00 00 03 F0 5A 5A
					39 00 00 00 00 00 03 FC 5A 5A
					39 00 00 00 00 00 02 B0 24
					39 00 00 00 00 00 02 D1 33
					39 00 00 00 00 00 0C E9 11 55 A6 75 A3 A6 37 BE 00 1A B8
					39 00 00 00 00 00 0C D9 14 00 00 8F 6E 00 00 8F 2E 6E 34
					39 00 00 00 00 00 6D C0 31 01 03 00 06 00 00 00 00 00 00 00 00 00 00 00 00 50 00 00 40 3D 00 5E 00 00 00 20 07 20 30 58 00 00 00 00 00 00 E0 0B 75 D8 00 00 00 00 FC 00 00 00 F6 97 0F 6D E6 CD 05 21 8B EC ED ED ED 0D 3F 60 00 67 FD 6D 51 BC DD DD 00 00 07 00 00 20 00 00 00 00 00 00 00 00 00 00 00 00 70 2F 00 00 03 2E 3C 20 E0 00 00 00 00 00 06 8C
					39 01 00 00 00 00 02 C0 31
					39 00 00 00 00 00 07 E1 00 00 02 02 42 02
					39 00 00 00 00 00 07 E2 00 00 00 00 00 00
					39 00 00 00 00 00 02 B0 0C
					39 00 00 00 00 00 02 E1 19
					39 00 00 00 00 00 03 F0 A5 A5
					39 01 00 00 00 00 03 FC A5 A5
					39 00 00 00 00 00 02 53 20
					39 00 00 00 00 00 03 51 00 00
					39 01 00 00 43 00 02 55 00
					05 01 00 00 00 00 02 29 00];
				qcom,mdss-dsi-off-command = [
					05 01 00 00 00 00 02 28 00
					05 01 00 00 78 00 02 10 00];
				qcom,mdss-dsi-on-command-state = "dsi_lp_mode";
				qcom,mdss-dsi-off-command-state = "dsi_lp_mode";

				qcom,mdss-dsi-doze-hbm-command = [
					39 00 00 00 00 00 03 F0 5A 5A
					39 00 00 00 00 00 02 D4 8B
					39 00 00 00 00 00 02 B0 A5
					39 00 00 00 00 00 02 C7 00
					39 00 00 00 00 00 02 B0 69
					39 00 00 00 00 00 03 B9 08 8F
					39 01 00 00 01 00 02 53 22
					39 01 00 00 00 00 03 F0 A5 A5];
				qcom,mdss-dsi-doze-lbm-command = [
					39 00 00 00 00 00 03 F0 5A 5A
					39 00 00 00 00 00 02 D4 8B
					39 00 00 00 00 00 02 B0 A5
					39 00 00 00 00 00 02 C7 00
					39 00 00 00 00 00 02 B0 69
					39 00 00 00 00 00 03 B9 08 8F
					39 01 00 00 00 00 02 53 23
					39 01 00 00 00 00 03 F0 A5 A5];
				qcom,mdss-dsi-nolp-command = [
					05 01 00 00 22 00 02 28 00
					39 01 00 00 00 00 02 53 20
					05 01 00 00 00 00 02 29 00];
				qcom,mdss-dsi-doze-hbm-command-state = "dsi_lp_mode";
				qcom,mdss-dsi-doze-lbm-command-state = "dsi_lp_mode";
				qcom,mdss-dsi-nolp-command-state = "dsi_lp_mode";

				qcom,mdss-dsi-dispparam-acl-off-command = [39 01 00 00 00 00 02 55 00];
				qcom,mdss-dsi-dispparam-acl-off-command-state = "dsi_lp_mode";
				qcom,mdss-dsi-dispparam-acl-l1-command = [39 01 00 00 00 00 02 55 01];/* 50% */
				qcom,mdss-dsi-dispparam-acl-l1-command-state = "dsi_lp_mode";
				qcom,mdss-dsi-dispparam-acl-l2-command = [39 01 00 00 00 00 02 55 02];/* 40% */
				qcom,mdss-dsi-dispparam-acl-l2-command-state = "dsi_lp_mode";
				qcom,mdss-dsi-dispparam-acl-l3-command = [39 01 00 00 00 00 02 55 03];/* 30% */
				qcom,mdss-dsi-dispparam-acl-l3-command-state = "dsi_lp_mode";

				qcom,mdss-dsi-dispparam-hbm-off-command = [39 01 00 00 00 00 02 53 28];
				qcom,mdss-dsi-dispparam-hbm-off-command-state = "dsi_lp_mode";
				qcom,mdss-dsi-dispparam-hbm-on-command = [39 01 00 00 00 00 02 53 E8];
				qcom,mdss-dsi-dispparam-hbm-on-command-state = "dsi_lp_mode";

				qcom,mdss-dsi-dispparam-dimmingon-command = [39 01 00 00 01 00 02 53 28];
				qcom,mdss-dsi-dispparam-dimmingon-command-state = "dsi_lp_mode";
				qcom,mdss-dsi-dispparam-dimmingoff-command = [39 01 00 00 01 00 02 53 20];
				qcom,mdss-dsi-dispparam-dimmingoff-command-state = "dsi_lp_mode";
				qcom,mdss-dsi-dispparam-crc-srgb-on-command = [
					/* CRC Enable + sRGB mode */
					39 01 00 00 00 00 02 81 90
					39 01 00 00 00 00 03 F0 5A 5A
					/* CRC Enable */
					39 01 00 00 00 00 02 B1 00
					/* Set Offset P2*/
					39 01 00 00 00 00 02 B0 01
					/* CRC LUT(sRGB mode) */
					39 01 00 00 00 00 16 B1 AE 0C 05 3F C6 14 05 07 AA 4A DD C8 C3 14 C0 E8 DC 19 FF F4 D9
					/* Set Offset P23*/
					39 01 00 00 00 00 02 B0 16
					/* CRC LUT(DCI-P3 mode) */
					39 01 00 00 00 00 16 B1 BD 02 00 14 D1 00 04 07 AA 0C EC CB C8 0F DD D9 E4 05 FF FF FF
					39 01 00 00 00 00 03 F0 A5 A5
					];
				qcom,mdss-dsi-dispparam-crc-srgb-on-command-state = "dsi_lp_mode";
				qcom,mdss-dsi-dispparam-crc-dcip3-on-command = [
					/* CRC Enable + DCI-P3 mode */
					39 01 00 00 00 00 02 81 91
					39 01 00 00 00 00 03 F0 5A 5A
					/* CRC Enable */
					39 01 00 00 00 00 02 B1 00
					/* Set Offset P2*/
					39 01 00 00 00 00 02 B0 01
					/* CRC LUT(sRGB mode) */
					39 01 00 00 00 00 16 B1 AE 0C 05 3F C6 14 05 07 AA 4A DD C8 C3 14 C0 E8 DC 19 FF F4 D9
					/* Set Offset P23*/
					39 01 00 00 00 00 02 B0 16
					/* CRC LUT(DCI-P3 mode) */
					39 01 00 00 00 00 16 B1 CB 0B 01 0B EC 03 05 08 CF 14 FA FA E7 05 EE EE F2 00 FF FF FF
					39 01 00 00 00 00 03 F0 A5 A5
					];
				qcom,mdss-dsi-dispparam-crc-dcip3-on-command-state = "dsi_lp_mode";
				qcom,mdss-dsi-dispparam-crc-off-command = [
					/* CRC Disable (Normal mode) */
					39 01 00 00 00 00 02 81 00
					39 01 00 00 00 00 03 F0 5A 5A
					/* CRC Bypass */
					39 01 00 00 00 00 02 B1 01
					39 01 00 00 00 00 03 F0 A5 A5
					];
				qcom,mdss-dsi-dispparam-crc-off-command-state = "dsi_lp_mode";
				qcom,mdss-dsi-dispparam-elvss-dimming-off-command = [
					39 00 00 00 00 00 03 F0 5A 5A
					39 00 00 00 00 00 02 B0 07
					39 00 00 00 00 00 02 B7 91
					39 01 00 00 01 00 03 F0 A5 A5];
				qcom,mdss-dsi-dispparam-elvss-dimming-off-command-state = "dsi_lp_mode";
				qcom,mdss-dsi-h-sync-pulse = <0>;
			};
		};
	};
};
