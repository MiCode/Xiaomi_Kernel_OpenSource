/* Copyright (c) 2019, The Linux Foundation. All rights reserved.
 *
 * This program is free software; you can redistribute it and/or modify
 * it under the terms of the GNU General Public License version 2 and
 * only version 2 as published by the Free Software Foundation.
 *
 * This program is distributed in the hope that it will be useful,
 * but WITHOUT ANY WARRANTY; without even the implied warranty of
 * MERCHANTABILITY or FITNESS FOR A PARTICULAR PURPOSE.  See the
 * GNU General Public License for more details.
 */

/dts-v1/;
#include "sa8195p.dtsi"
#include "sa8195p-adp-star.dtsi"

/ {
	model = "Qualcomm Technologies, Inc. SA8195P ADP-STAR";
	compatible = "qcom,sa8195p-adp-star", "qcom,sa8195p",
		"qcom,adp-star";
	qcom,board-id = <25 0>;
};
