/* Copyright (c) 2015, The Linux Foundation. All rights reserved.
 * Copyright (C) 2021 XiaoMi, Inc.
 *
 * This program is free software; you can redistribute it and/or modify
 * it under the terms of the GNU General Public License version 2 and
 * only version 2 as published by the Free Software Foundation.
 *
 * This program is distributed in the hope that it will be useful,
 * but WITHOUT ANY WARRANTY; without even the implied warranty of
 * MERCHANTABILITY or FITNESS FOR A PARTICULAR PURPOSE.  See the
 * GNU General Public License for more details.
 */

/*---------------------------------------------------------------------------
 * This file is autogenerated file using gcdb parser. Please do not edit it.
 * Update input XML file to add a new entry or update variable in this file
 * VERSION = "1.0"
 *---------------------------------------------------------------------------*/
&mdss_mdp {
	dsi_k82_36_02_0b_dual_cphy_video: qcom,mdss_dsi_k82_36_02_0b_dual_cphy_video {
		qcom,mdss-dsi-panel-name = "xiaomi 36 02 0b video mode dual dsi cphy panel";
		qcom,mdss-dsi-panel-id = <0>;
		qcom,mdss-dsi-panel-model = "xiaomi 36 02 0b VIDEO PANEL";
		qcom,mdss-dsi-panel-type = "dsi_video_mode";
		qcom,mdss-dsi-stream = <0>;
		qcom,mdss-dsi-bpp = <24>;
		qcom,mdss-dsi-underflow-color = <0xff>;
		qcom,mdss-dsi-border-color = <0>;
		qcom,mdss-dsi-traffic-mode = "non_burst_sync_event";
		qcom,mdss-dsi-bllp-eof-power-mode;
		qcom,mdss-dsi-bllp-power-mode;

		qcom,mdss-dsi-lp11-init;
		qcom,mdss-dsi-virtual-channel-id = <0>;
		qcom,mdss-dsi-color-order = "rgb_swap_rgb";
		qcom,mdss-dsi-lane-0-state;
		qcom,mdss-dsi-lane-1-state;
		qcom,mdss-dsi-lane-2-state;

		qcom,mdss-dsi-dma-trigger = "trigger_sw";
		qcom,mdss-dsi-mdp-trigger = "none";
		qcom,mdss-dsi-reset-sequence = <0 12>, <1 12>, <0 12>, <1 12>;
		qcom,mdss-pan-physical-width-dimension = <1474>;
		qcom,mdss-pan-physical-height-dimension = <2359>;
		qcom,mdss-dsi-tx-eot-append;
		qcom,mdss-dsi-rx-eot-ignore;
		qcom,bl-update-flag = "delay_until_first_frame";
		qcom,cmd-sync-wait-broadcast;
		qcom,panel-cphy-mode;
		qcom,mdss-dsi-cphy-strength;
		mi,cphy-esd-check;
		mi,is-tddi-flag;
		qcom,mdss-dsi-pan-enable-dynamic-fps;
		qcom,mdss-dsi-pan-fps-update =
				"dfps_immediate_porch_mode_vfp";
		qcom,dsi-supported-dfps-list = <120 60>;
		qcom,mdss-dsi-panel-hdr-enabled;
		qcom,mdss-dsi-panel-hdr-color-primaries = <14500 15500 32000 17000 15500 30000 8000 3000>;
		qcom,mdss-dsi-panel-peak-brightness = <4200000>;
		qcom,mdss-dsi-panel-blackness-level = <3230>;

		qcom,mdss-dsi-display-timings {
			timing@0{
				qcom,mdss-dsi-panel-framerate = <120>;
				qcom,mdss-dsi-panel-width = <800>; // 1600/2
				qcom,mdss-dsi-panel-height = <2560>;
				qcom,mdss-dsi-h-pulse-width = <20>;
				qcom,mdss-dsi-h-back-porch = <20>;
				qcom,mdss-dsi-h-front-porch = <44>;
				qcom,mdss-dsi-h-sync-skew = <0>;
				qcom,mdss-dsi-v-pulse-width = <4>;
				qcom,mdss-dsi-v-back-porch = <168>;
				qcom,mdss-dsi-v-front-porch = <26>;
				qcom,mdss-dsi-h-left-border = <0>;
				qcom,mdss-dsi-h-right-border = <0>;
				qcom,mdss-dsi-v-top-border = <0>;
				qcom,mdss-dsi-v-bottom-border = <0>;

				qcom,mdss-dsi-on-command= [
						15 00 00 00 00 00 02 FF 10
						15 00 00 00 00 00 02 FB 01
						15 00 00 00 00 00 02 B9 05
						15 00 00 00 00 00 02 FF 20
						15 00 00 00 00 00 02 FB 01
						15 00 00 00 00 00 02 18 40
						15 00 00 00 00 00 02 FF 10
						15 00 00 00 00 00 02 FB 01
						15 01 00 00 00 00 02 B9 02
						/*CABC start*/
						15 00 00 00 00 00 02 FF 23
						15 00 00 00 00 00 02 FB 01
						15 00 00 00 00 00 02 00 80
						15 00 00 00 00 00 02 01 84
						15 00 00 00 00 00 02 05 2D
						15 00 00 00 00 00 02 06 00
						15 00 00 00 00 00 02 07 00
						15 00 00 00 00 00 02 08 01
						15 00 00 00 00 00 02 09 45
						15 00 00 00 00 00 02 11 02
						15 00 00 00 00 00 02 12 80
						15 00 00 00 00 00 02 15 83
						15 01 00 00 00 00 02 16 0C
						15 00 00 00 00 00 02 29 0A
						15 00 00 00 00 00 02 30 FF
						15 00 00 00 00 00 02 31 FE
						15 00 00 00 00 00 02 32 FD
						15 00 00 00 00 00 02 33 FB
						15 00 00 00 00 00 02 34 F8
						15 00 00 00 00 00 02 35 F5
						15 00 00 00 00 00 02 36 F3
						15 00 00 00 00 00 02 37 F2
						15 00 00 00 00 00 02 38 F2
						15 00 00 00 00 00 02 39 F2
						15 00 00 00 00 00 02 3A EF
						15 00 00 00 00 00 02 3B EC
						15 00 00 00 00 00 02 3D E9
						15 00 00 00 00 00 02 3F E5
						15 00 00 00 00 00 02 40 E5
						15 00 00 00 00 00 02 41 E5
						15 00 00 00 00 00 02 2A 13
						15 01 00 00 00 00 02 45 FF
						15 00 00 00 00 00 02 46 F4
						15 00 00 00 00 00 02 47 E7
						15 00 00 00 00 00 02 48 DA
						15 00 00 00 00 00 02 49 CD
						15 00 00 00 00 00 02 4A C0
						15 00 00 00 00 00 02 4B B3
						15 00 00 00 00 00 02 4C B2
						15 00 00 00 00 00 02 4D B2
						15 00 00 00 00 00 02 4E B2
						15 00 00 00 00 00 02 4F 99
						15 00 00 00 00 00 02 50 80
						15 00 00 00 00 00 02 51 68
						15 00 00 00 00 00 02 52 66
						15 00 00 00 00 00 02 53 66
						15 00 00 00 00 00 02 54 66
						15 01 00 00 00 00 02 2B 0E
						15 00 00 00 00 00 02 58 FF
						15 00 00 00 00 00 02 59 FB
						15 00 00 00 00 00 02 5A F7
						15 00 00 00 00 00 02 5B F3
						15 00 00 00 00 00 02 5C EF
						15 00 00 00 00 00 02 5D E3
						15 00 00 00 00 00 02 5E DA
						15 00 00 00 00 00 02 5F D8
						15 00 00 00 00 00 02 60 D8
						15 00 00 00 00 00 02 61 D8
						15 00 00 00 00 00 02 62 CB
						15 00 00 00 00 00 02 63 BF
						15 00 00 00 00 00 02 64 B3
						15 00 00 00 00 00 02 65 B2
						15 00 00 00 00 00 02 66 B2
						15 01 00 00 00 00 02 67 B2
						/*CABC end*/
						/*ESD start*/
						15 00 00 00 00 00 02 FF F0
						15 00 00 00 00 00 02 FB 01
						15 00 00 00 00 00 02 84 08
						15 00 00 00 00 00 02 85 0C
						15 00 00 00 00 00 02 FF 20
						15 00 00 00 00 00 02 FB 01
						15 00 00 00 00 00 02 51 00
						15 00 00 00 00 00 02 FF 25
						15 00 00 00 00 00 02 FB 01
						15 00 00 00 00 00 02 91 1F
						15 00 00 00 00 00 02 92 0F
						15 00 00 00 00 00 02 93 01
						15 00 00 00 00 00 02 94 18
						15 01 00 00 00 00 02 95 03
						15 00 00 00 00 00 02 96 01
						15 00 00 00 00 00 02 FF 10
						15 00 00 00 00 00 02 B0 01
						15 00 00 00 00 00 02 FF 25
						15 00 00 00 00 00 02 FB 01
						15 00 00 00 00 00 02 19 1F
						15 00 00 00 00 00 02 1B 1B
						15 00 00 00 00 00 02 FF 24
						15 00 00 00 00 00 02 FB 01
						15 00 00 00 00 00 02 B8 28
						15 00 00 00 00 00 02 FF 27
						15 00 00 00 00 00 02 FB 01
						15 00 00 00 00 00 02 D0 31
						15 00 00 00 00 00 02 DE 80
						15 00 00 00 00 00 02 DF 02
						15 00 00 00 00 00 02 D1 20
						15 00 00 00 00 00 02 D2 30
						15 01 00 00 00 00 02 D4 08
						/*ESD end*/
						/*OSC start*/
						15 00 00 00 00 00 02 FF 26
						15 00 00 00 00 00 02 FB 01
						15 00 00 00 00 00 02 00 81
						15 00 00 00 00 00 02 01 B0
						15 00 00 00 00 00 02 FF 22
						15 00 00 00 00 00 02 FB 01
						15 00 00 00 00 00 02 6F 01
						15 00 00 00 00 00 02 70 11
						15 00 00 00 00 00 02 73 01
						15 00 00 00 00 00 02 74 46
						15 00 00 00 00 00 02 A0 3F
						15 00 00 00 00 00 02 A9 50
						15 00 00 00 00 00 02 AA 28
						15 00 00 00 00 00 02 AB 28
						15 01 00 00 00 00 02 AD 10
						15 00 00 00 00 00 02 B8 00
						15 00 00 00 00 00 02 B9 46
						15 00 00 00 00 00 02 BA 8C
						15 00 00 00 00 00 02 BB 46
						15 00 00 00 00 00 02 BE 0A
						15 00 00 00 00 00 02 BF 46
						15 00 00 00 00 00 02 C0 0A
						15 00 00 00 00 00 02 C1 56
						15 00 00 00 00 00 02 C2 00
						15 00 00 00 00 00 02 C5 00
						15 00 00 00 00 00 02 C6 00
						15 01 00 00 00 00 02 C7 30
						15 00 00 00 00 00 02 CA 00
						15 00 00 00 00 00 02 CB 3C
						15 00 00 00 00 00 02 CE 00
						15 00 00 00 00 00 02 CF 00
						15 00 00 00 00 00 02 D0 38
						15 00 00 00 00 00 02 D3 08
						15 00 00 00 00 00 02 D4 3D
						15 00 00 00 00 00 02 FF 25
						15 00 00 00 00 00 02 FB 01
						15 00 00 00 00 00 02 BC 01
						15 00 00 00 00 00 02 BD 1C
						15 00 00 00 00 00 02 FF 2A
						15 00 00 00 00 00 02 FB 01
						15 01 00 00 00 00 02 9A 03
						 /*OSC end*/
						15 00 00 00 00 00 02 FF D0
						15 00 00 00 00 00 02 FB 01
						15 00 00 00 00 00 02 00 32
						15 00 00 00 00 00 02 02 FF
						15 00 00 00 00 00 02 09 FF
						15 00 00 00 00 00 02 53 22
						15 00 00 00 00 00 02 54 02
						15 00 00 00 00 00 02 1C 99
						15 00 00 00 00 00 02 1D 09
						15 00 00 00 00 00 02 FF E0
						15 00 00 00 00 00 02 FB 01
						15 00 00 00 00 00 02 14 60
						15 00 00 00 00 00 02 16 C0
						15 00 00 00 00 00 02 4F 02
						15 01 00 00 00 00 02 FF F0
						15 00 00 00 00 00 02 FB 01
						15 00 00 00 00 00 02 3A 08
						15 00 00 00 00 00 02 FF 10
						15 00 00 00 00 00 02 FB 01
						15 00 00 00 00 00 02 BB 13
						39 00 00 00 00 00 06 3B 03 AC 1A 04 04
						15 00 00 00 00 00 02 35 00
						39 00 00 00 00 00 03 51 0F FF
						15 01 00 00 00 00 02 53 2C
						05 01 00 00 46 00 02 11 00
						15 01 00 00 00 00 02 29 00];
				qcom,mdss-dsi-off-command = [
						05 01 00 00 00 00 02 28 00
						05 01 00 00 46 00 02 10 00];
				qcom,mdss-dsi-displayoff-command = [05 01 00 00 20 00 02 28 00];
				qcom,mdss-dsi-displayon-command = [05 01 00 00 14 00 02 29 00];
				qcom,mdss-dsi-on-command-state = "dsi_lp_mode";
				qcom,mdss-dsi-off-command-state = "dsi_lp_mode";
				qcom,mdss-dsi-displayoff-command-state = "dsi_hs_mode";
				qcom,mdss-dsi-displayon-command-state = "dsi_hs_mode";
				qcom,mdss-dsi-dispparam-pen-120hz-command = [
						15 00 00 00 00 00 02 FF 2A
						15 00 00 00 00 00 02 23 0D
						15 01 00 00 00 00 02 FF 10];
				qcom,mdss-dsi-dispparam-pen-60hz-command = [
						15 00 00 00 00 00 02 FF 2A
						15 00 00 00 00 00 02 23 0C
						15 01 00 00 00 00 02 FF 10];
				qcom,mdss-dsi-dispparam-pen-120hz-command-state = "dsi_lp_mode";
				qcom,mdss-dsi-dispparam-pen-60hz-command-state = "dsi_lp_mode";

						/* max brightness 85% */
				qcom,mdss-dsi-dispparam-lcd-hbm-l1-on-command = [
						15 01 00 00 00 00 02 FF 10
						39 01 00 00 00 00 03 51 0F FF];
				qcom,mdss-dsi-dispparam-lcd-hbm-l1-on-command-state = "dsi_lp_mode";
						/* max brightness 91% */
				qcom,mdss-dsi-dispparam-lcd-hbm-l2-on-command = [
						15 01 00 00 00 00 02 FF 10
						39 01 00 00 00 00 03 51 0F FF];
				qcom,mdss-dsi-dispparam-lcd-hbm-l2-on-command-state = "dsi_lp_mode";
				qcom,mdss-dsi-dispparam-lcd-hbm-off-command = [
						15 01 00 00 00 00 02 FF 10
						39 01 00 00 00 00 03 51 0F FF];
				qcom,mdss-dsi-dispparam-lcd-hbm-off-command-state = "dsi_lp_mode";
			};
		};
	};
};

&dsi_k82_36_02_0b_dual_cphy_video {
	qcom,dispparam-enabled;
	qcom,mdss-panel-on-dimming-delay = <120>;
	qcom,esd-err-irq-gpio = <&tlmm 37 0x2002>;  /* trig-flags: falling-0x0002 rasing-0x0001*/
	mi,mdss-dsi-panel-xy-coordinate = <0x3 0x3>;
	mi,mdss-dsi-panel-max-luminance = <0x3 0x4>;
	qcom,mdss-dsi-display-timings {
		timing@0{
				mi,mdss-dsi-read-lockdown-info-command = [
						15 01 00 00 00 00 02 FF 22
						06 01 00 00 00 00 01 01
						06 01 00 00 00 00 01 02
						06 01 00 00 00 00 01 03
						06 01 00 00 00 00 01 04
						06 01 00 00 00 00 01 05
						06 01 00 00 00 00 01 06
						06 01 00 00 00 00 01 07
						06 01 00 00 00 00 01 08];
				mi,mdss-dsi-read-lockdown-info-command-state = "dsi_lp_mode";
				qcom,mdss-dsi-dispparam-cabcuion-command = [
						15 01 00 00 00 00 02 55 01
				];
				qcom,mdss-dsi-dispparam-cabcstillon-command = [
						15 01 00 00 00 00 02 55 02
				];
				qcom,mdss-dsi-dispparam-cabcmovieon-command = [
						15 01 00 00 00 00 02 55 03
				];
				qcom,mdss-dsi-dispparam-cabcoff-command = [
						15 01 00 00 00 00 02 55 00
				];
				qcom,mdss-dsi-dispparam-dimmingon-command = [
						/* CABC DIMMING ON */
						15 01 00 00 00 00 02 53 2C
				];
				qcom,mdss-dsi-dispparam-dimmingoff-command = [
						15 01 00 00 00 00 02 53 24
				];

				qcom,mdss-dsi-dispparam-cabcuion-command-state = "dsi_lp_mode";
				qcom,mdss-dsi-dispparam-cabcstillon-command-state = "dsi_lp_mode";
				qcom,mdss-dsi-dispparam-cabcmovieon-command-state = "dsi_lp_mode";
				qcom,mdss-dsi-dispparam-cabcoff-command-state = "dsi_lp_mode";
				qcom,mdss-dsi-dispparam-dimmingon-command-state = "dsi_lp_mode";
				qcom,mdss-dsi-dispparam-dimmingoff-command-state = "dsi_lp_mode";
				mi,mdss-dsi-esd-check-read-command = [
						/* esd detect */
						15 01 00 00 00 00 02 FF 27
						15 01 00 00 00 00 02 D1 28
						15 01 00 00 00 00 02 FF 10
						15 01 00 00 00 00 02 53 2C
				];
				mi,mdss-dsi-esd-check-read-command-state = "dsi_lp_mode";

				qcom,mdss-dsi-dispparam-xy-coordinate-command = [
						15 01 00 00 00 00 02 FF 10
						06 01 00 00 00 00 01 A1
				];
				qcom,mdss-dsi-dispparam-xy-coordinate-command-state = "dsi_lp_mode";

				mi,mdss-dsi-max-luminance-write-command = [
						15 01 00 00 00 00 02 FF 10];
				mi,mdss-dsi-max-luminance-write-command-state = "dsi_lp_mode";
				mi,mdss-dsi-max-luminance-read-command = [
						06 01 00 00 00 00 01 A1];
				mi,mdss-dsi-max-luminance-read-command-state = "dsi_lp_mode";
		};
	};
};


