
qcom,e2_coslight_3120mAh {
	qcom, = <24>;
	/* #3298034_Xiaomi_E2cos_3120mAh_averaged_MasterSlave_Jan29th2018*/
	qcom,max-voltage-uv = <4400000>;
	qcom,fastchg-current-ma = <3000>;
	qcom,nom-batt-capacity-mah = <3120>;
	qcom,batt-id-kohm = <100>;
	qcom,battery-beta = <3435>;
	qcom,fg-cc-cv-threshold-mv = <4390>;
	qcom,battery-type = "e2_coslight";
	qcom,jeita-fcc-ranges = <0   50   300000
				51  150  900000
				151 450  3000000
				451 600  1500000>;
	qcom,jeita-fv-ranges = <0   50   4400000
				51  150  4400000
				151 450  4400000
				451 600  4100000>;
	qcom,checksum = <0xE401>;
	qcom,gui-version = "PM660GUI - 0.0.0.45";
	qcom,fg-profile-data = [
		 24 1F 47 FC
		 02 0A A5 FD
		 E5 1C E7 01
		 CD 0D 8C 0A
		 E9 17 BF 23
		 78 44 47 5A
		 72 00 00 00
		 10 00 00 00
		 00 00 71 B5
		 A2 CD 83 BA
		 24 00 08 00
		 28 00 DB ED
		 AF FC 1D FA
		 AF 0D FE 02
		 FA D3 AE 2B
		 28 06 09 20
		 27 00 14 00
		 E8 1F 60 05
		 9B 0A 37 06
		 C1 1C 0F 03
		 E3 15 4B 12
		 84 18 F6 23
		 C1 4D 89 5B
		 6A 00 00 00
		 0D 00 00 00
		 00 00 C8 D5
		 0A CA 06 BB
		 1C 00 00 00
		 0C EB DB ED
		 2A F4 1E F2
		 DE ED CE 02
		 23 01 5B 1B
		 B4 33 CC FF
		 07 10 00 00
		 26 0C 66 46
		 1C 00 40 00
		 8E 01 0A FA
		 FF 00 00 00
		 00 00 00 00
		 00 00 00 00
		 00 00 00 00
		 00 00 00 00
		 00 00 00 00
		 00 00 00 00
		 00 00 00 00
		 00 00 00 00
		 00 00 00 00
		 00 00 00 00
		 00 00 00 00
		 00 00 00 00
		 00 00 00 00
		 00 00 00 00
		 00 00 00 00
		 00 00 00 00
		 00 00 00 00
		 00 00 00 00
	];
};
