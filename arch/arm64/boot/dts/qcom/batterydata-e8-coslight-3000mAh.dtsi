
qcom,e1_coslight_3070mAh {
	qcom,max-voltage-uv = <4400000>;
	qcom,nom-batt-capacity-mah = <3000>;
	qcom,batt-id-kohm = <100>;
	qcom,battery-beta = <3380>;
	qcom,fg-cc-cv-threshold-mv = <4390>;
	qcom,battery-type = "e8_coslight_3000mAh";
	qcom,fastchg-current-ma = <2900>;
	qcom,jeita-fcc-ranges = <0   50   290000
			51  100  870000
			101 150  1450000
			151 450  2900000
			451 600  1450000>;
	qcom,jeita-fv-ranges =  <0   50   4400000
			51  100  4400000
			101 150  4400000
			151 450  4400000
			451 600  4100000>;
	qcom,dynamic-fv-ranges = <0    100  4400000
			101  200  4380000
			201  300  4360000
			301  400  4340000
			401  500  4340000>;
	qcom,checksum = <0x572F>;
	qcom,gui-version = "PMI8998GUI - 2.0.0.58";
	qcom,fg-profile-data = [
			7F 1F D5 05
			34 0A A9 06
			F5 1C A8 01
			B9 04 CD 03
			D6 17 B9 23
			96 44 24 5A
			7F 00 00 00
			11 00 00 00
			00 00 EE C5
			64 C4 6F BB
			25 00 08 00
			EA E2 A5 07
			63 FD A9 00
			84 0D C6 0B
			10 05 68 32
			1C 06 09 20
			27 00 14 00
			61 1F 0B 06
			1D 0A 57 FD
			B6 1C 31 03
			BF 15 82 12
			76 18 D8 23
			E7 4D 2E 5B
			63 00 00 00
			0E 00 00 00
			00 00 F9 07
			5B C3 47 8B
			1F 00 00 00
			1F F2 A5 07
			9F F4 A1 EA
			13 F4 31 FA
			03 00 A6 1A
			AA 33 CC FF
			07 10 00 00
			B7 0B 66 46
			1F 00 40 00
			4E 01 0A FA
			FF 00 00 00
			00 00 00 00
			00 00 00 00
			00 00 00 00
			00 00 00 00
			00 00 00 00
			00 00 00 00
			00 00 00 00
			00 00 00 00
			00 00 00 00
			00 00 00 00
			00 00 00 00
			00 00 00 00
			00 00 00 00
			00 00 00 00
			00 00 00 00
			00 00 00 00
			00 00 00 00
			00 00 00 00
	];
};
