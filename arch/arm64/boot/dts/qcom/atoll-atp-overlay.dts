/* Copyright (c) 2019, The Linux Foundation. All rights reserved.
 *
 * This program is free software; you can redistribute it and/or modify
 * it under the terms of the GNU General Public License version 2 and
 * only version 2 as published by the Free Software Foundation.
 *
 * This program is distributed in the hope that it will be useful,
 * but WITHOUT ANY WARRANTY; without even the implied warranty of
 * MERCHANTABILITY or FITNESS FOR A PARTICULAR PURPOSE.  See the
 * GNU General Public License for more details.
 */

/dts-v1/;
/plugin/;

#include <dt-bindings/interrupt-controller/arm-gic.h>

#include "atoll-atp.dtsi"
#include "atoll-audio-overlay.dtsi"

/ {
	model = "ATP";
	compatible = "qcom,atoll-idp", "qcom,atoll", "qcom,idp", "qcom,atp";
	qcom,msm-id = <407 0x0>;
	qcom,board-id = <33 0>;
};
