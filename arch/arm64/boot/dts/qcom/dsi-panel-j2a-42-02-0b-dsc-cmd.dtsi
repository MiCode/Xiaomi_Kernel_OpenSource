&soc {
	dsi_j2a_42_02_0b_dsc_cmd: qcom,mdss_dsi_j2a_42_02_0b_dsc_cmd {
		qcom,mdss-dsi-panel-name = "xiaomi 42 02 0b cmd mode dsc dsi panel";
		qcom,mdss-dsi-panel-type = "dsi_cmd_mode";
		qcom,mdss-dsi-virtual-channel-id = <0>;
		qcom,mdss-dsi-stream = <0>;
		qcom,mdss-dsi-bpp = <24>;
		qcom,mdss-dsi-underflow-color = <0xff>;
		qcom,mdss-dsi-border-color = <0>;
		qcom,dsi-ctrl-num = <0>;
		qcom,dsi-phy-num = <0>;
		qcom,mdss-dsi-traffic-mode = "burst_mode";
		qcom,mdss-dsi-bllp-eof-power-mode;
		qcom,mdss-dsi-bllp-power-mode;
		qcom,mdss-dsi-lane-0-state;
		qcom,mdss-dsi-lane-1-state;
		qcom,mdss-dsi-lane-2-state;
		qcom,mdss-dsi-lane-3-state;
		qcom,mdss-dsi-dma-trigger = "trigger_sw";
		qcom,mdss-dsi-mdp-trigger = "none";
		qcom,mdss-dsi-reset-sequence = <1 10>, <0 30>, <1 10>;
		qcom,mdss-pan-physical-width-dimension = <68>;
		qcom,mdss-pan-physical-height-dimension = <147>;
		qcom,mdss-dsi-te-pin-select = <1>;
		qcom,mdss-dsi-wr-mem-start = <0x2c>;
		qcom,mdss-dsi-wr-mem-continue = <0x3c>;
		qcom,mdss-dsi-te-dcs-command = <1>;
		qcom,mdss-dsi-te-check-enable;
		qcom,mdss-dsi-te-using-te-pin;
		qcom,mdss-dsi-tx-eot-append;
		qcom,mdss-dsi-lp11-init;
		qcom,mdss-dsi-bl-dcs-type-ss;
		qcom,mdss-dsi-panel-hdr-enabled;
		qcom,mdss-dsi-panel-hdr-color-primaries = <14500 15500 32000
			17000 15500 30000 8000 3000>;
		qcom,mdss-dsi-panel-peak-brightness = <4200000>;
		qcom,mdss-dsi-panel-blackness-level = <3230>;
		qcom,bl-update-flag = "delay_until_first_frame";

		qcom,mdss-dsi-display-timings {
			timing@0{
				qcom,mdss-dsi-panel-width = <1080>;
				qcom,mdss-dsi-panel-height = <2340>;
				qcom,mdss-dsi-h-front-porch = <64>;
				qcom,mdss-dsi-h-back-porch = <64>;
				qcom,mdss-dsi-h-pulse-width = <20>;
				qcom,mdss-dsi-h-sync-skew = <0>;
				qcom,mdss-dsi-v-back-porch = <64>;
				qcom,mdss-dsi-v-front-porch = <64>;
				qcom,mdss-dsi-v-pulse-width = <20>;
				qcom,mdss-dsi-h-sync-pulse = <0>;
				qcom,mdss-dsi-h-left-border = <0>;
				qcom,mdss-dsi-h-right-border = <0>;
				qcom,mdss-dsi-v-top-border = <0>;
				qcom,mdss-dsi-v-bottom-border = <0>;
				qcom,mdss-dsi-panel-framerate = <60>;
				qcom,mdss-dsi-panel-clockrate = <455000000>;
				qcom,mdss-dsi-panel-jitter = <0x5 0x1>;
				qcom,mdss-dsi-on-command = [
					/* Round OFF */
					39 01 00 00 00 00 06 F0 55 AA 52 08 07 /* Set page 7 */
					39 01 00 00 00 00 02 C0 10
					/* Demura Setting */
					39 01 00 00 00 00 06 F0 55 AA 52 08 04 /* Set page 4 */
					39 01 00 00 00 00 02 C2 54
					39 01 00 00 00 00 03 B1 01 C1
					39 01 00 00 00 00 06 D0 00 80 00 00 80 /* Demura ON */
					39 01 00 00 00 00 02 6F 09
					39 01 00 00 00 00 04 B1 F0 47 13
					/* Dcode & 101.6M OSC Setting */
					39 01 00 00 00 00 05 FF AA 55 A5 81    /* CMD4 Dcode */
					39 01 00 00 00 00 02 6F 0D
					39 01 00 00 00 00 02 F3 AB
					39 01 00 00 00 00 05 FF AA 55 A5 81    /* CMD4 OSC SET */
					39 01 00 00 00 00 02 6F 05
					39 01 00 00 00 00 03 FD 00 DA
					/* CMD3 lpm_dec_all_on */
					39 01 00 00 00 00 05 FF AA 55 A5 80
					39 01 00 00 00 00 02 6F 0A
					39 01 00 00 00 00 02 FC 02
					/* VIDEO TRIM */
					39 01 00 00 00 00 05 FF AA 55 A5 81
					39 01 00 00 00 00 02 6F 09
					39 01 00 00 00 00 02 FD AC
					39 01 00 00 00 00 06 F0 55 AA 52 08 01
					39 01 00 00 00 00 08 C3 9A 00 F7 0F E1 81 00
					39 01 00 00 00 00 05 FF AA 55 A5 80
					/* Page Disable */
					39 01 00 00 00 00 06 F0 55 AA 52 00 00
					/* VBP/VFP Video Mode */
					39 01 00 00 00 00 05 3B 00 0C 00 04
					/* COMPRESSION_METHOD = 1 VESA, Slice 12 */
					39 01 00 00 00 00 02 90 01
					39 01 00 00 00 00 13 93 89 28 00 0C 02 00 02 0E 01 1F 00 07 08 BB 08 7A 10 F0 /* DSC Setting */
					39 01 00 00 00 00 02 03 11
					39 01 00 00 00 00 02 2C 00
					39 01 00 00 00 00 02 35 00             /* TE ON*/
					39 01 00 00 00 00 02 53 20
					39 01 00 00 00 00 03 51 00 00          /* Normal Mode */
					39 01 00 00 00 00 05 2A 00 00 04 37
					39 01 00 00 00 00 05 2B 00 00 09 23
					/* Enter 60Hz 1 Pluse */
					39 00 00 00 00 00 02 2F 01
					39 01 00 00 00 00 02 26 01
					/* Sleep Out */
					05 01 00 00 78 00 02 11 00
					/* Display On */
					05 01 00 00 14 00 02 29 00];

				qcom,mdss-dsi-off-command = [
					05 01 00 00 0A 00 02 28 00
					05 01 00 00 78 00 02 10 00];
				qcom,mdss-dsi-on-command-state = "dsi_lp_mode";
				qcom,mdss-dsi-off-command-state = "dsi_lp_mode";

				qcom,compression-mode = "dsc";
				qcom,mdss-dsc-version = <0x11>;
				qcom,mdss-dsc-scr-version = <0x0>;
				qcom,mdss-dsc-slice-height = <12>;
				qcom,mdss-dsc-slice-width = <540>;
				qcom,mdss-dsc-slice-per-pkt = <2>;
				qcom,mdss-dsc-bit-per-component = <8>;
				qcom,mdss-dsc-bit-per-pixel = <8>;
				qcom,mdss-dsc-block-prediction-enable;
			};
		};
	};
};
