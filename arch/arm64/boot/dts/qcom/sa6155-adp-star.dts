/* Copyright (c) 2018-2019, The Linux Foundation. All rights reserved.
 *
 * This program is free software; you can redistribute it and/or modify
 * it under the terms of the GNU General Public License version 2 and
 * only version 2 as published by the Free Software Foundation.
 *
 * This program is distributed in the hope that it will be useful,
 * but WITHOUT ANY WARRANTY; without even the implied warranty of
 * MERCHANTABILITY or FITNESS FOR A PARTICULAR PURPOSE.  See the
 * GNU General Public License for more details.
 */

/dts-v1/;
#include "sa6155.dtsi"
#include "sa6155-adp-star.dtsi"

/ {
	model = "Qualcomm Technologies, Inc. SA6155 ADP-STAR";
	compatible = "qcom,sa6155-adp-star", "qcom,sa6155", "qcom,adp-star";
	qcom,board-id = <0x10019 0>;
};
