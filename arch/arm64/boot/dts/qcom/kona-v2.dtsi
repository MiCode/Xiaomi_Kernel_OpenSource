// SPDX-License-Identifier: GPL-2.0-only
/*
 * Copyright (c) 2019, The Linux Foundation. All rights reserved.
 */

#include "kona.dtsi"

/ {
	model = "Qualcomm Technologies, Inc. kona v2";
	compatible = "qcom,kona";
	qcom,msm-id = <356 0x20000>;
};

