/*
 * Copyright (c) 2018, The Linux Foundation. All rights reserved.
 *
 * This program is free software; you can redistribute it and/or modify
 * it under the terms of the GNU General Public License version 2 and
 * only version 2 as published by the Free Software Foundation.
 *
 * This program is distributed in the hope that it will be useful,
 * but WITHOUT ANY WARRANTY; without even the implied warranty of
 * MERCHANTABILITY or FITNESS FOR A PARTICULAR PURPOSE.  See the
 * GNU General Public License for more details.
 */

#include "sm6150-ext-codec-audio-overlay.dtsi"

&wcd9xxx_intc {
	qcom,gpio-connect = <&tlmm 58 0>;
};

&qupv3_se4_spi {
	status = "disabled";
};

&qupv3_se0_spi {
	status = "okay";
};
