/*
 * Copyright (c) 2018, The Linux Foundation. All rights reserved.
 *
 * This program is free software; you can redistribute it and/or modify
 * it under the terms of the GNU General Public License version 2 and
 * only version 2 as published by the Free Software Foundation.
 *
 * This program is distributed in the hope that it will be useful,
 * but WITHOUT ANY WARRANTY; without even the implied warranty of
 * MERCHANTABILITY or FITNESS FOR A PARTICULAR PURPOSE.  See the
 * GNU General Public License for more details.
 */

#include "sdm450-qrd-sku4.dtsi"

&ssphy {
	fpc-redrive-supply = <&pm8953_l6>;
	qcom,redrive-voltage-level = <0 1800000 1900000>;
	qcom,redrive-load = <105000>;
};

&pmi632_charger {
	qcom,thermal-mitigation = <4200000 3500000 3000000 2500000
				2000000 1500000 1000000 500000>;
};
