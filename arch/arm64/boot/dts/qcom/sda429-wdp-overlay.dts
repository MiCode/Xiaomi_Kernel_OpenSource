/*
 * Copyright (c) 2020 The Linux Foundation. All rights reserved.
 *
 * This program is free software; you can redistribute it and/or modify
 * it under the terms of the GNU General Public License version 2 and
 * only version 2 as published by the Free Software Foundation.
 *
 * This program is distributed in the hope that it will be useful,
 * but WITHOUT ANY WARRANTY; without even the implied warranty of
 * MERCHANTABILITY or FITNESS FOR A PARTICULAR PURPOSE.  See the
 * GNU General Public License for more details.
 */

/dts-v1/;
/plugin/;

#include "sda429-wdp.dtsi"
#include "sdm429-spyro-qrd-evt-audio.dtsi"

/ {
	model = "Qualcomm Technologies, Inc. SDA429 QRD BG WDP Overlay";
	compatible = "qcom,sdm429w-qrd", "qcom,sdm429w", "qcom,qrd";
	qcom,msm-id = <437 0x0>;
	qcom,board-id = <0x01000b 9>;
	qcom,pmic-id = <0x0002001b 0x0 0x0 0x0>;
};

