// SPDX-License-Identifier: GPL-2.0-only
/*
 * Copyright (c) 2019, The Linux Foundation. All rights reserved.
 */

/dts-v1/;

#include "kona-v2.dtsi"

/ {
	model = "Qualcomm Technologies, Inc. kona v2 SoC";
	compatible = "qcom,kona";
	qcom,board-id = <0 0>;
};
