/* Copyright (c) 2018, The Linux Foundation. All rights reserved.
 *
 * This program is free software; you can redistribute it and/or modify
 * it under the terms of the GNU General Public License version 2 and
 * only version 2 as published by the Free Software Foundation.
 *
 * This program is distributed in the hope that it will be useful,
 * but WITHOUT ANY WARRANTY; without even the implied warranty of
 * MERCHANTABILITY or FITNESS FOR A PARTICULAR PURPOSE.  See the
 * GNU General Public License for more details.
 */

/dts-v1/;
/plugin/;

#include <dt-bindings/interrupt-controller/arm-gic.h>
#include <dt-bindings/clock/qcom,camcc-sdmmagpie.h>

#include "davinci-audio-overlay.dtsi"
#include "davinci-sdmmagpie.dtsi"
#include "davinci-nfc-overlay.dtsi"

/ {
	model = "DAVINCI";
	compatible = "qcom,sdmmagpie-qrd", "qcom,sdmmagpie", "qcom,qrd";
	qcom,msm-id = <365 0x0>;
	qcom,board-id = <41 0>;
};

&dsi_sw43404_amoled_video_display {
	qcom,dsi-display-active;
};
