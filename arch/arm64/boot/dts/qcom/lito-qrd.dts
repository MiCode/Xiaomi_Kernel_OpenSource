// SPDX-License-Identifier: GPL-2.0-only
/*
 * Copyright (c) 2019, The Linux Foundation. All rights reserved.
 */

/dts-v1/;

#include "lito.dtsi"
#include "lito-qrd.dtsi"

/ {
	model = "Qualcomm Technologies, Inc. Lito QRD";
	compatible = "qcom,lito-qrd", "qcom,lito", "qcom,qrd";
	qcom,board-id = <11 0>;
};
