/* Copyright (c) 2020, The Linux Foundation. All rights reserved.
 *
 * This program is free software; you can redistribute it and/or modify
 * it under the terms of the GNU General Public License version 2 and
 * only version 2 as published by the Free Software Foundation.
 *
 * This program is distributed in the hope that it will be useful,
 * but WITHOUT ANY WARRANTY; without even the implied warranty of
 * MERCHANTABILITY or FITNESS FOR A PARTICULAR PURPOSE.  See the
 * GNU General Public License for more details.
 */

/dts-v1/;

#include "qcs6125.dtsi"
#include "qcs6125-iot-idp.dtsi"

/ {
	model = "Qualcomm Technologies,Inc. QCS6125IOT USBC Ext AudioCodec IDP";
	compatible = "qcom,qcs6125-idp", "qcom,qcs6125", "qcom,idp";
	qcom,board-id = <34 3>;
};
