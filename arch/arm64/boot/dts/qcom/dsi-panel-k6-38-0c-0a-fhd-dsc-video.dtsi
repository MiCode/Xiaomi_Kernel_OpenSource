/* Copyright (c) 2019, The Linux Foundation. All rights reserved.
 * Copyright (C) 2021 XiaoMi, Inc.
 *
 * This program is free software; you can redistribute it and/or modify
 * it under the terms of the GNU General Public License version 2 and
 * only version 2 as published by the Free Software Foundation.
 *
 * This program is distributed in the hope that it will be useful,
 * but WITHOUT ANY WARRANTY; without even the implied warranty of
 * MERCHANTABILITY or FITNESS FOR A PARTICULAR PURPOSE.  See the
 * GNU General Public License for more details.
 */

/*---------------------------------------------------------------------------
 * This file is autogenerated file using gcdb parser. Please do not edit it.
 * Update input XML file to add a new entry or update variable in this file
 * VERSION = "1.0"
 *---------------------------------------------------------------------------*/
&soc {
	dsi_k6_38_0c_0a_fhd_dsc_video: qcom,mdss_dsi_k6_38_0c_0a_fhd_dsc_video {
		qcom,mdss-dsi-panel-name = "xiaomi k6 38 0c 0a fhd dsc video dsi panel";
		qcom,mdss-dsi-panel-id = <0>;
		qcom,mdss-dsi-panel-type = "dsi_video_mode";
		qcom,mdss-dsi-virtual-channel-id = <0>;
		qcom,mdss-dsi-stream = <0>;
		qcom,mdss-dsi-bpp = <24>;
		qcom,mdss-dsi-color-order = "rgb_swap_rgb";
		qcom,mdss-dsi-underflow-color = <0xff>;
		qcom,mdss-dsi-border-color = <0>;
		qcom,mdss-dsi-traffic-mode = "burst_mode";
		qcom,mdss-dsi-bllp-eof-power-mode;
		qcom,mdss-dsi-bllp-power-mode;
		qcom,mdss-dsi-lp11-init;
		qcom,mdss-dsi-lane-0-state;
		qcom,mdss-dsi-lane-1-state;
		qcom,mdss-dsi-lane-2-state;
		qcom,mdss-dsi-lane-3-state;
		qcom,bl-update-flag = "delay_until_first_frame";
		qcom,mdss-dsi-dma-trigger = "trigger_sw";
		qcom,mdss-dsi-mdp-trigger = "none";
		qcom,mdss-dsi-bl-dcs-type-ss-ea;
		qcom,mdss-dsi-reset-sequence = <0 1>, <1 10>;
		qcom,mdss-pan-physical-width-dimension = <695>;
		qcom,mdss-pan-physical-height-dimension = <1546>;
		qcom,mdss-dsi-tx-eot-append;
		qcom,dispparam-enabled;
		qcom,mdss-dsi-panel-hdr-enabled;
		qcom,mdss-dsi-panel-hdr-color-primaries = <14500 15500 32000
			17000 15500 30000 8000 3000>;
		qcom,mdss-dsi-panel-peak-brightness = <4200000>;
		qcom,mdss-dsi-panel-blackness-level = <3230>;
		/* IRQF_ONESHOT | IRQF_TRIGGER_RISING */
		qcom,esd-err-irq-gpio = <&tlmm 32 0x2001>;
		/* hbm off param*/
		qcom,dispparam-f4-51-ctrl-flag;
		qcom,mdss-dsi-panel-hbm-off-51-index = <1>;

		/* DFPS */
		qcom,mdss-dsi-pan-enable-dynamic-fps;
		qcom,mdss-dsi-pan-fps-update = "dfps_immediate_porch_mode_vfp";
		qcom,dsi-supported-dfps-list = <120 60>;

		qcom,mdss-dsi-panel-dc-threshold = <488>;
		qcom,mdss-dsi-panel-k6-dc-flag;

		/* AOD brightness setting */
		mi,mdss-dsi-doze-hbm-brightness-value = <272>;
		mi,mdss-dsi-doze-lbm-brightness-value = <22>;
		qcom,mdss-dsi-oled-panel-video-mode;

		qcom,mdss-dsi-display-timings {
			timing@0{
				qcom,mdss-dsi-panel-width = <1080>;
				qcom,mdss-dsi-panel-height = <2400>;
				qcom,mdss-dsi-h-front-porch = <120>;
				qcom,mdss-dsi-h-back-porch = <120>;
				qcom,mdss-dsi-h-pulse-width = <28>;
				qcom,mdss-dsi-h-sync-skew = <0>;
				qcom,mdss-dsi-v-back-porch = <10>;
				qcom,mdss-dsi-v-front-porch = <20>;
				qcom,mdss-dsi-v-pulse-width = <2>;
				qcom,mdss-dsi-h-left-border = <0>;
				qcom,mdss-dsi-h-right-border = <0>;
				qcom,mdss-dsi-v-top-border = <0>;
				qcom,mdss-dsi-v-bottom-border = <0>;
				qcom,mdss-dsi-panel-framerate = <120>;
				qcom,mdss-dsi-on-command = [
					05 01 00 00 14 00 02 11 00
					39 01 00 00 00 00 03 F0 5A 5A
					39 01 00 00 00 00 03 B2 01 31
					39 01 00 00 00 00 06 DF 09 30 95 46 E9
					39 01 00 00 00 00 03 F0 A5 A5
					39 01 00 00 00 00 02 9D 01
					39 01 00 00 00 00 5A 9E 11 00 00 89 30 80 09 60 04 38 00 28 02 1C 02 1C 02 00 02 0E 00 20 03 DD 00 07 00 0C 02 77 02 8B 18 00 10 F0 03 0C 20 00 06 0B 0B 33 0E 1C 2A 38 46 54 62 69 70 77 79 7B 7D 7E 01 02 01 00 09 40 09 BE 19 FC 19 FA 19 F8 1A 38 1A 78 1A B6 2A F6 2B 34 2B 74 3B 74 6B F4 00
					39 01 00 00 00 00 03 F0 5A 5A
					39 01 00 00 00 00 02 60 21
					39 01 00 00 00 00 02 F7 0B
					39 01 00 00 00 00 03 F0 A5 A5
					39 01 00 00 00 00 03 F0 5A 5A
					39 01 00 00 00 00 04 B0 00 15 F6
					39 01 00 00 00 00 02 F6 F0
					39 01 00 00 00 00 04 B0 00 28 F6
					39 01 00 00 00 00 02 F6 F0
					39 01 00 00 00 00 04 B0 00 3B F6
					39 01 00 00 00 00 02 F6 F0
					39 01 00 00 00 00 04 B0 00 0A F4
					39 01 00 00 00 00 02 F4 98
					39 01 00 00 00 00 04 B0 00 11 F4
					39 01 00 00 00 00 02 F4 EE
					39 01 00 00 00 00 04 B0 00 18 B2
					39 01 00 00 00 00 02 B2 1C
					/*VINT Voltage control*/
					39 01 00 00 00 00 03 FC 5A 5A
					39 00 00 00 00 00 04 B0 00 11 FE
					39 00 00 00 00 00 02 FE 00
					39 01 00 00 00 00 03 FC A5 A5
					/*Dimming Setting*/
					39 01 00 00 00 00 04 B0 00 0D B2
					39 01 00 00 00 00 02 B2 20
					39 01 00 00 00 00 04 B0 00 0C B2
					39 01 00 00 00 00 02 B2 30
					39 01 00 00 00 00 02 F7 0B
					39 01 00 00 00 00 03 F0 A5 A5
					/* ESD Setting */
					39 01 00 00 00 00 03 F0 5A 5A
					39 01 00 00 00 00 03 FC 5A 5A
					39 01 00 00 00 00 08 E1 83 00 00 81 00 F9 F8
					39 01 00 00 00 00 03 ED 00 01
					39 01 00 00 00 00 04 B0 00 06 F4
					39 01 00 00 00 00 02 F4 1F
					39 01 00 00 00 00 03 F0 A5 A5
					39 01 00 00 00 00 03 FC A5 A5
					39 01 00 00 00 00 02 53 28
					39 01 00 00 64 00 03 51 00 00
					05 01 00 00 00 00 02 29 00];
					qcom,mdss-dsi-off-command = [
					05 01 00 00 0A 00 02 28 00
					05 01 00 00 96 00 02 10 00];
				qcom,mdss-dsi-on-command-state = "dsi_lp_mode";
				qcom,mdss-dsi-off-command-state = "dsi_hs_mode";
				qcom,mdss-dsi-dispparam-dimmingon-command = [39 01 00 00 01 00 02 53 28];
				qcom,mdss-dsi-dispparam-dimmingon-command-state = "dsi_lp_mode";
				qcom,mdss-dsi-dispparam-dimmingoff-command = [39 01 00 00 01 00 02 53 20];
				qcom,mdss-dsi-dispparam-dimmingoff-command-state = "dsi_lp_mode";
				qcom,mdss-dsi-dispparam-hbm-on-command = [
					39 01 00 00 00 00 02 53 E8
					/* Enter HBM Mode */
					39 01 00 00 00 00 03 51 07 FF
					39 01 00 00 00 00 02 F7 0B
					];
				qcom,mdss-dsi-dispparam-hbm-on-command-state = "dsi_lp_mode";
				qcom,mdss-dsi-dispparam-hbm-off-command = [
					/* Exit HBM Mode */
					39 00 00 00 00 00 02 53 28
					39 01 00 00 00 00 03 51 07 FF];
				qcom,mdss-dsi-dispparam-hbm-off-command-state = "dsi_lp_mode";
				qcom,mdss-dsi-doze-hbm-command = [39 01 00 00 00 00 03 51 01 10];
				qcom,mdss-dsi-doze-hbm-command-state = "dsi_lp_mode";
				qcom,mdss-dsi-doze-lbm-command = [39 01 00 00 00 00 03 51 00 16];
				qcom,mdss-dsi-doze-lbm-command-state = "dsi_lp_mode";
				qcom,mdss-dsi-dispparam-flat-mode-on-command =[
					39 01 00 00 00 00 03 F0 5A 5A
					39 01 00 00 00 00 04 B0 00 88 B1
					39 01 00 00 00 00 29 B1 27 2D FB 0F A4 86 01 FF 10 33 FF 10 FF 35 34 5A 0A 0A 0A 29 29 29 37 37 37 41 41 41 45 45 45 1B 2F DA 18 74 80 00 00 22
					39 01 00 00 00 00 03 F0 A5 A5];
				qcom,mdss-dsi-dispparam-flat-mode-on-command-state = "dsi_lp_mode";
				qcom,mdss-dsi-dispparam-flat-mode-off-command =[
					39 01 00 00 00 00 03 F0 5A 5A
					39 01 00 00 00 00 04 B0 00 88 B1
					39 01 00 00 00 00 29 B1 27 0D FB 0F A4 86 01 FF 10 33 FF 10 FF 35 34 5A 0A 0A 0A 29 29 29 37 37 37 41 41 41 45 45 45 1B 2F DA 18 74 80 00 00 22
					39 01 00 00 00 00 03 F0 A5 A5];
				qcom,mdss-dsi-dispparam-flat-mode-off-command-state = "dsi_lp_mode";
				qcom,mdss-dsi-dispparam-bc-120hz-command = [
					/* Brightness Control - Freq Setting */
					39 00 00 00 00 00 03 F0 5A 5A
					39 00 00 00 00 00 02 60 01
					39 00 00 00 00 00 02 F7 0B
					39 01 00 00 00 00 03 F0 A5 A5];
				qcom,mdss-dsi-dispparam-bc-120hz-command-state = "dsi_lp_mode";
				qcom,mdss-dsi-dispparam-bc-60hz-command = [
					/* Brightness Control - Freq Setting */
					39 00 00 00 00 00 03 F0 5A 5A
					39 00 00 00 00 00 02 60 21
					39 00 00 00 00 00 02 F7 0B
					39 01 00 00 00 00 03 F0 A5 A5];
				qcom,mdss-dsi-dispparam-bc-60hz-command-state = "dsi_lp_mode";
				qcom,compression-mode = "dsc";
				qcom,mdss-dsc-version = <0x11>;
				qcom,mdss-dsc-scr-version = <0x0>;
				qcom,mdss-dsc-slice-height = <20>;
				qcom,mdss-dsc-slice-width = <540>;
				qcom,mdss-dsc-slice-per-pkt = <2>;
				qcom,mdss-dsc-bit-per-component = <8>;
				qcom,mdss-dsc-bit-per-pixel = <8>;
				qcom,mdss-dsc-block-prediction-enable;

				qcom,mdss-dsi-dispparam-60hz-dc-crc-setting-command = [
					39 00 00 00 00 00 03 F0 5A 5A
					39 00 00 00 00 00 02 80 05
					39 00 00 00 00 00 02 B1 00
					39 00 00 00 00 00 04 B0 00 01 B1
					39 00 00 00 00 00 16 B1 01 00 00 00 01 00 00 00 01 00 01 01 01 00 01 01 01 00 01 01 01
					39 00 00 00 00 00 03 F0 A5 A5
					39 01 00 00 00 00 03 51 01 E8
				];
				qcom,mdss-dsi-dispparam-60hz-dc-crc-setting-command-state = "dsi_lp_mode";
				qcom,mdss-dsi-dispparam-120hz-dc-crc-setting-command = [
					39 01 00 00 00 00 03 F0 5A 5A
					39 00 00 00 00 00 02 80 05
					39 00 00 00 00 00 02 B1 00
					39 00 00 00 00 00 04 B0 00 01 B1
					39 00 00 00 00 00 16 B1 01 00 00 00 01 00 00 00 01 00 01 01 01 00 01 01 01 00 01 01 01
					39 00 00 00 00 00 03 F0 A5 A5
					39 01 00 00 00 00 03 51 01 E8
				];
				qcom,mdss-dsi-dispparam-120hz-dc-crc-setting-command-state = "dsi_hs_mode";
				qcom,mdss-dsi-dispparam-crc-off-command = [
         				/* CRC Disable (Normal mode) */
					39 00 00 00 00 00 03 F0 5A 5A
					39 00 00 00 00 00 02 80 00
					/* CRC Bypass */
					39 00 00 00 00 00 02 B1 01
					/* CRC Setting */
					39 01 00 00 00 00 03 F0 A5 A5];
				qcom,mdss-dsi-dispparam-crc-off-command-state = "dsi_lp_mode";
			};
		};
	};
};
