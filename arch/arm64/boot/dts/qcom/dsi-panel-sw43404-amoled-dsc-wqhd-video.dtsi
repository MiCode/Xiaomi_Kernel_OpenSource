/* Copyright (c) 2018-2019, The Linux Foundation. All rights reserved.
 *
 * This program is free software; you can redistribute it and/or modify
 * it under the terms of the GNU General Public License version 2 and
 * only version 2 as published by the Free Software Foundation.
 *
 * This program is distributed in the hope that it will be useful,
 * but WITHOUT ANY WARRANTY; without even the implied warranty of
 * MERCHANTABILITY or FITNESS FOR A PARTICULAR PURPOSE.  See the
 * GNU General Public License for more details.
 */

&mdss_mdp {
	dsi_sw43404_amoled_video: qcom,mdss_dsi_sw43404_amoled_wqhd_video {
	qcom,mdss-dsi-panel-name =
		"sw43404 amoled video mode dsi boe panel with DSC";
	qcom,mdss-dsi-panel-type = "dsi_video_mode";
	qcom,mdss-dsi-virtual-channel-id = <0>;
	qcom,mdss-dsi-stream = <0>;
	qcom,mdss-dsi-bpp = <24>;
	qcom,mdss-dsi-border-color = <0>;
	qcom,mdss-dsi-traffic-mode = "non_burst_sync_event";
	qcom,mdss-dsi-bllp-eof-power-mode;
	qcom,mdss-dsi-bllp-power-mode;
	qcom,mdss-dsi-lane-0-state;
	qcom,mdss-dsi-lane-1-state;
	qcom,mdss-dsi-lane-2-state;
	qcom,mdss-dsi-lane-3-state;
	qcom,mdss-dsi-dma-trigger = "trigger_sw";
	qcom,mdss-dsi-mdp-trigger = "none";
	qcom,mdss-dsi-reset-sequence = <1 10>, <0 10>, <1 10>;
	qcom,adjust-timer-wakeup-ms = <1>;
	qcom,mdss-dsi-panel-hdr-enabled;
	qcom,mdss-dsi-panel-hdr-color-primaries = <14500 15500 32000
		17000 15500 30000 8000 3000>;
	qcom,mdss-dsi-panel-peak-brightness = <4200000>;
	qcom,mdss-dsi-panel-blackness-level = <3230>;

	qcom,mdss-dsi-display-timings {
		timing@0{
			qcom,mdss-dsi-panel-width = <1440>;
			qcom,mdss-dsi-panel-height = <2880>;
			qcom,mdss-dsi-h-front-porch = <10>;
			qcom,mdss-dsi-h-back-porch = <10>;
			qcom,mdss-dsi-h-pulse-width = <12>;
			qcom,mdss-dsi-h-sync-skew = <0>;
			qcom,mdss-dsi-v-back-porch = <10>;
			qcom,mdss-dsi-v-front-porch = <10>;
			qcom,mdss-dsi-v-pulse-width = <1>;
			qcom,mdss-dsi-h-left-border = <0>;
			qcom,mdss-dsi-panel-framerate = <60>;
			qcom,mdss-dsi-on-command = [
			  39 01 00 00 00 00 03 b0 a5 00
			  07 01 00 00 00 00 02 01 00
			  39 01 00 00 00 00 06 b2 00 5d 04 80 49
			  15 01 00 00 00 00 02 3d 10
			  15 01 00 00 00 00 02 36 00
			  15 01 00 00 00 00 02 55 00
			  39 01 00 00 00 00 09 f8 00 08 10 08 2d
			     00 00 2d
			  39 01 00 00 3c 00 03 51 00 00
			  05 01 00 00 50 00 02 11 00
			  39 01 00 00 00 00 03 b0 34 04
			  39 01 00 00 00 00 05 c1 00 00 00 46
			  39 01 00 00 00 00 03 b0 a5 00
			  0a 01 00 00 00 00 80 11 00 00 89 30 80
			     0B 40 05 A0 02 d0 02 D0 02 D0 02 00
			     02 68 00 20 4e a8 00 0A 00 0C 00 23
			     00 1c 18 00 10 F0 03 0C 20 00 06 0B
			     0B 33 0E 1C 2A 38 46 54 62 69 70 77
			     79 7B 7D 7E 01 02 01 00 09 40 09 BE
			     19 FC 19 FA 19 F8 1A 38 1A 78 1A B6
			     2A F6 2B 34 2B 74 3B 74 6B F4 00 00
			     00 00 00 00 00 00 00 00 00 00 00 00
			     00 00 00 00 00 00 00 00 00 00 00 00
			     00 00 00 00 00 00 00 00 00 00 00 00
			     00 00
			  05 01 00 00 78 00 02 29 00
			];
			qcom,mdss-dsi-off-command = [05 01 00 00 78 00
			   02 28 00 05 01 00 00 78 00 02 10 00];
			qcom,mdss-dsi-on-command-state = "dsi_lp_mode";
			qcom,mdss-dsi-off-command-state = "dsi_hs_mode";
			qcom,compression-mode = "dsc";
			qcom,mdss-dsc-slice-height = <720>;
			qcom,mdss-dsc-slice-width = <720>;
			qcom,mdss-dsc-slice-per-pkt = <2>;
			qcom,mdss-dsc-bit-per-component = <8>;
			qcom,mdss-dsc-bit-per-pixel = <8>;
			qcom,mdss-dsc-block-prediction-enable;
			};
		};
	};
};
