/* Copyright (c) 2019, The Linux Foundation. All rights reserved.
 *
 * This program is free software; you can redistribute it and/or modify
 * it under the terms of the GNU General Public License version 2 and
 * only version 2 as published by the Free Software Foundation.
 *
 * This program is distributed in the hope that it will be useful,
 * but WITHOUT ANY WARRANTY; without even the implied warranty of
 * MERCHANTABILITY or FITNESS FOR A PARTICULAR PURPOSE.  See the
 * GNU General Public License for more details.
 */

/dts-v1/;
/plugin/;

#include <dt-bindings/interrupt-controller/arm-gic.h>

#include "trinket-idp.dtsi"

/ {
	model = "USB-C Ext Audio Codec IDP";
	compatible = "qcom,trinket-idp", "qcom,trinket", "qcom,idp";
	qcom,msm-id = <394 0x10000>;
	qcom,board-id = <34 3>;
};

&dsi_td4330_truly_cmd_display {
	qcom,dsi-display-active;
};
