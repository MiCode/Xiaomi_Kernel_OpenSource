/*
 * Copyright (c) 2015-2016, The Linux Foundation. All rights reserved.
 * Copyright (C) 2019 XiaoMi, Inc.
 *
 * This program is free software; you can redistribute it and/or modify
 * it under the terms of the GNU General Public License version 2 and
 * only version 2 as published by the Free Software Foundation.
 *
 * This program is distributed in the hope that it will be useful,
 * but WITHOUT ANY WARRANTY; without even the implied warranty of
 * MERCHANTABILITY or FITNESS FOR A PARTICULAR PURPOSE.  See the
 * GNU General Public License for more details.
 */

/*---------------------------------------------------------------------------
 * This file is autogenerated file using gcdb parser. Please do not edit it.
 * Update input XML file to add a new entry or update variable in this file
 * VERSION = "1.0"
 *---------------------------------------------------------------------------*/
&mdss_mdp {
	dsi_truly_otm1901a_720p_video: qcom,mdss_dsi_truly_otm1901a_720p_video {
		qcom,mdss-dsi-panel-name = "CSOT otm1901a video mode dsi panel";
		qcom,mdss-dsi-panel-controller = <&mdss_dsi0>;
		qcom,mdss-dsi-panel-type = "dsi_video_mode";
		qcom,mdss-dsi-panel-framerate = <60>;
		qcom,mdss-dsi-virtual-channel-id = <0>;
		qcom,mdss-dsi-stream = <0>;
		qcom,mdss-dsi-panel-width = <720>;
		qcom,mdss-dsi-panel-height = <1520>;
		qcom,mdss-dsi-h-front-porch = <236>;
		qcom,mdss-dsi-h-back-porch = <32>;
		qcom,mdss-dsi-h-pulse-width = <4>;
		qcom,mdss-dsi-h-sync-skew = <0>;
		qcom,mdss-dsi-v-back-porch = <9>;
		qcom,mdss-dsi-v-front-porch = <10>;
		qcom,mdss-dsi-v-pulse-width = <1>;
		qcom,mdss-dsi-h-left-border = <0>;
		qcom,mdss-dsi-h-right-border = <0>;
		qcom,mdss-dsi-v-top-border = <0>;
		qcom,mdss-dsi-v-bottom-border = <0>;
		qcom,mdss-dsi-bpp = <24>;
		qcom,mdss-dsi-underflow-color = <0xff>;
		qcom,mdss-dsi-border-color = <0>;
		qcom,mdss-pan-physical-width-dimension = <65>;
		qcom,mdss-pan-physical-height-dimension = <138>;
		qcom,mdss-dsi-on-command = [
				39 00 00 00 00 00 02 00 00
				39 01 00 00 00 00 04 FF 19 01 01
				39 01 00 00 00 00 02 00 80
				39 01 00 00 00 00 03 FF 19 01

				39 00 00 00 00 00 02 00 00//bypass mode
				39 00 00 00 00 00 02 1C 33
				39 00 00 00 00 00 02 00 A0//Video mode sync
				39 01 00 00 00 00 02 C1 E8
				39 01 00 00 00 00 02 00 82
				39 01 00 00 00 00 02 A5 1F
				39 01 00 00 00 00 02 00 B0
				39 01 00 00 00 00 02 CA 01
				39 01 00 00 00 00 02 00 B3
				39 01 00 00 00 00 02 CA 50

				39 00 00 00 00 00 02 00 F2
				39 00 00 00 0A 00 04 C1 00 00 00
				39 00 00 00 00 00 02 00 DA//reload OTP
				39 00 00 00 0A 00 02 F5 21
				39 00 00 00 00 00 02 00 00//reload OTP
				39 00 00 00 0A 00 02 FB 01
				39 00 00 00 00 00 02 00 00//reload OTP
				39 00 00 00 0A 00 02 EB 10
				39 00 00 00 00 00 02 00 02//Disable Qcomm
				39 00 00 00 00 00 02 ff 03
				39 00 00 00 00 00 02 00 00//Disable Qcomm
				39 00 00 00 00 00 02 C0 00
				39 00 00 00 00 00 02 00 02//Disable Qcomm
				39 00 00 00 00 00 02 ff 01

				05 01 00 00 78 00 02 11 00
				39 01 00 00 00 00 02 51 00
				39 01 00 00 00 00 02 53 24
				39 01 00 00 00 00 02 55 00
				05 01 00 00 0a 00 02 29 00];
		qcom,mdss-dsi-off-command = [
				05 01 00 00 24 00 02 28 00
				05 01 00 00 78 00 02 10 00];
		qcom,mdss-dsi-cabc-on-command = [
				39 00 00 00 00 00 02 00 90
				39 00 00 00 00 00 0A CA E6 FF 66 FF B3 FF 00 00 00
				39 00 00 00 00 00 02 00 00
				39 00 00 00 00 00 02 C6 10
				39 00 00 00 00 00 02 00 00
				39 00 00 00 00 00 13 C7 B0 AC DA 9C BA CC 88 88 88 78 66 66 66 66 66 66 66 66
				39 00 00 00 00 00 02 00 00
				39 00 00 00 00 00 02 C6 11
				39 00 00 00 00 00 02 00 00
				39 00 00 00 00 00 13 C7 A0 9D CA 9C B9 CB 88 88 88 78 77 77 66 66 66 66 66 66
				39 00 00 00 00 00 02 00 00
				39 00 00 00 00 00 02 C6 12
				39 00 00 00 00 00 02 00 00
				39 00 00 00 00 00 13 C7 A0 9C BA 9C A9 CB 88 88 88 78 77 77 77 67 66 66 66 66
				39 00 00 00 00 00 02 00 00
				39 00 00 00 00 00 02 C6 13
				39 00 00 00 00 00 02 00 00
				39 00 00 00 00 00 13 C7 A0 9B BA AB 98 CB 88 88 88 78 77 77 77 77 77 66 66 66
				39 00 00 00 00 00 02 00 00
				39 00 00 00 00 00 02 C6 14
				39 00 00 00 00 00 02 00 00
				39 00 00 00 00 00 13 C7 A0 9A BA 9B 89 CB 88 88 88 78 77 77 77 77 77 77 66 66
				39 00 00 00 00 00 02 00 00
				39 00 00 00 00 00 02 C6 15
				39 00 00 00 00 00 02 00 00
				39 00 00 00 00 00 13 C7 90 8B AA 9B 99 CA 88 88 88 78 77 77 77 77 77 77 77 66
				39 00 00 00 00 00 02 00 00
				39 00 00 00 00 00 02 C6 16
				39 00 00 00 00 00 02 00 00
				39 00 00 00 00 00 13 C7 90 9A A9 AA 98 BA 88 88 88 88 77 77 77 77 77 77 77 77
				39 00 00 00 00 00 02 00 00
				39 00 00 00 00 00 02 C6 17
				39 00 00 00 00 00 02 00 00
				39 00 00 00 00 00 13 C7 90 8A 9A 9A 89 BA 88 88 88 88 88 77 77 77 77 77 77 77
				39 00 00 00 00 00 02 00 00
				39 00 00 00 00 00 02 C6 18
				39 00 00 00 00 00 02 00 00
				39 00 00 00 00 00 13 C7 90 99 99 9A 89 B9 88 88 88 88 88 88 77 77 77 77 77 77
				39 00 00 00 00 00 02 00 00
				39 00 00 00 00 00 02 C6 19
				39 00 00 00 00 00 02 00 00
				39 00 00 00 00 00 13 C7 80 8A 99 9A 98 B8 88 88 88 88 88 88 88 77 77 77 77 77
				39 00 00 00 00 00 02 00 00
				39 00 00 00 00 00 02 C6 1A
				39 00 00 00 00 00 02 00 00
				39 00 00 00 00 00 13 C7 80 99 99 99 88 B8 88 88 88 88 88 88 88 88 77 77 77 77
				39 00 00 00 00 00 02 00 00
				39 00 00 00 00 00 02 C6 1B
				39 00 00 00 00 00 02 00 00
				39 00 00 00 00 00 13 C7 80 89 99 99 88 A8 88 88 88 88 88 88 88 88 88 77 77 77
				39 00 00 00 00 00 02 00 00
				39 00 00 00 00 00 02 C6 1C
				39 00 00 00 00 00 02 00 00
				39 00 00 00 00 00 13 C7 80 98 98 99 88 A8 88 88 88 88 88 88 88 88 88 78 77 77
				39 00 00 00 00 00 02 00 00
				39 00 00 00 00 00 02 C6 1D
				39 00 00 00 00 00 02 00 00
				39 00 00 00 00 00 13 C7 80 88 89 89 89 98 88 88 88 88 88 88 88 88 88 88 78 77
				39 00 00 00 00 00 02 00 00
				39 00 00 00 00 00 02 C6 1E
				39 00 00 00 00 00 02 00 00
				39 00 00 00 00 00 13 C7 80 88 98 88 89 98 88 88 88 88 88 88 88 88 88 88 88 77
				39 00 00 00 00 00 02 00 00
				39 00 00 00 00 00 02 C6 1F
				39 00 00 00 00 00 02 00 00
				39 00 00 00 00 00 13 C7 80 88 88 88 88 98 88 88 88 88 88 88 88 88 88 88 88 88
				39 00 00 00 00 00 02 00 00
				39 01 00 00 00 00 02 C6 00
				39 01 00 00 00 00 02 55 01
		];
		qcom,mdss-dsi-cabc-off-command = [
				39 01 00 00 00 00 02 55 00
		];
		qcom,mdss-dsi-cabc-movie-on-command = [
				39 00 00 00 00 00 02 00 90
				39 00 00 00 00 00 0A CA E6 FF 66 FF B3 FF 00 00 00
				39 00 00 00 00 00 02 00 00
				39 00 00 00 00 00 02 C6 10
				39 00 00 00 00 00 02 00 00
				39 00 00 00 00 00 13 C7 B0 AC DA 9C BA CC 88 88 88 78 66 66 66 66 66 66 66 66
				39 00 00 00 00 00 02 00 00
				39 00 00 00 00 00 02 C6 11
				39 00 00 00 00 00 02 00 00
				39 00 00 00 00 00 13 C7 A0 9D CA 9C B9 CB 88 88 88 78 77 77 66 66 66 66 66 66
				39 00 00 00 00 00 02 00 00
				39 00 00 00 00 00 02 C6 12
				39 00 00 00 00 00 02 00 00
				39 00 00 00 00 00 13 C7 A0 9C BA 9C A9 CB 88 88 88 78 77 77 77 67 66 66 66 66
				39 00 00 00 00 00 02 00 00
				39 00 00 00 00 00 02 C6 13
				39 00 00 00 00 00 02 00 00
				39 00 00 00 00 00 13 C7 A0 9B BA AB 98 CB 88 88 88 78 77 77 77 77 77 66 66 66
				39 00 00 00 00 00 02 00 00
				39 00 00 00 00 00 02 C6 14
				39 00 00 00 00 00 02 00 00
				39 00 00 00 00 00 13 C7 A0 9A BA 9B 89 CB 88 88 88 78 77 77 77 77 77 77 66 66
				39 00 00 00 00 00 02 00 00
				39 00 00 00 00 00 02 C6 15
				39 00 00 00 00 00 02 00 00
				39 00 00 00 00 00 13 C7 90 8B AA 9B 99 CA 88 88 88 78 77 77 77 77 77 77 77 66
				39 00 00 00 00 00 02 00 00
				39 00 00 00 00 00 02 C6 16
				39 00 00 00 00 00 02 00 00
				39 00 00 00 00 00 13 C7 90 9A A9 AA 98 BA 88 88 88 88 77 77 77 77 77 77 77 77
				39 00 00 00 00 00 02 00 00
				39 00 00 00 00 00 02 C6 17
				39 00 00 00 00 00 02 00 00
				39 00 00 00 00 00 13 C7 90 8A 9A 9A 89 BA 88 88 88 88 88 77 77 77 77 77 77 77
				39 00 00 00 00 00 02 00 00
				39 00 00 00 00 00 02 C6 18
				39 00 00 00 00 00 02 00 00
				39 00 00 00 00 00 13 C7 90 99 99 9A 89 B9 88 88 88 88 88 88 77 77 77 77 77 77
				39 00 00 00 00 00 02 00 00
				39 00 00 00 00 00 02 C6 19
				39 00 00 00 00 00 02 00 00
				39 00 00 00 00 00 13 C7 80 8A 99 9A 98 B8 88 88 88 88 88 88 88 77 77 77 77 77
				39 00 00 00 00 00 02 00 00
				39 00 00 00 00 00 02 C6 1A
				39 00 00 00 00 00 02 00 00
				39 00 00 00 00 00 13 C7 80 99 99 99 88 B8 88 88 88 88 88 88 88 88 77 77 77 77
				39 00 00 00 00 00 02 00 00
				39 00 00 00 00 00 02 C6 1B
				39 00 00 00 00 00 02 00 00
				39 00 00 00 00 00 13 C7 80 89 99 99 88 A8 88 88 88 88 88 88 88 88 88 77 77 77
				39 00 00 00 00 00 02 00 00
				39 00 00 00 00 00 02 C6 1C
				39 00 00 00 00 00 02 00 00
				39 00 00 00 00 00 13 C7 80 98 98 99 88 A8 88 88 88 88 88 88 88 88 88 78 77 77
				39 00 00 00 00 00 02 00 00
				39 00 00 00 00 00 02 C6 1D
				39 00 00 00 00 00 02 00 00
				39 00 00 00 00 00 13 C7 80 88 89 89 89 98 88 88 88 88 88 88 88 88 88 88 78 77
				39 00 00 00 00 00 02 00 00
				39 00 00 00 00 00 02 C6 1E
				39 00 00 00 00 00 02 00 00
				39 00 00 00 00 00 13 C7 80 88 98 88 89 98 88 88 88 88 88 88 88 88 88 88 88 77
				39 00 00 00 00 00 02 00 00
				39 00 00 00 00 00 02 C6 1F
				39 00 00 00 00 00 02 00 00
				39 00 00 00 00 00 13 C7 80 88 88 88 88 98 88 88 88 88 88 88 88 88 88 88 88 88
				39 00 00 00 00 00 02 00 00
				39 01 00 00 00 00 02 C6 00
				39 01 00 00 00 00 02 55 02
		];
		qcom,mdss-dsi-cabc-movie-off-command = [
				39 01 00 00 00 00 02 55 00
		];
		qcom,mdss-dsi-cabc-still-on-command = [
				39 00 00 00 00 00 02 00 90
				39 00 00 00 00 00 0A CA E6 FF 66 FF B3 FF 00 00 00
				39 00 00 00 00 00 02 00 00
				39 00 00 00 00 00 02 C6 10
				39 00 00 00 00 00 02 00 00
				39 00 00 00 00 00 13 C7 B0 AC DA 9C BA CC 88 88 88 78 66 66 66 66 66 66 66 66
				39 00 00 00 00 00 02 00 00
				39 00 00 00 00 00 02 C6 11
				39 00 00 00 00 00 02 00 00
				39 00 00 00 00 00 13 C7 A0 9D CA 9C B9 CB 88 88 88 78 77 77 66 66 66 66 66 66
				39 00 00 00 00 00 02 00 00
				39 00 00 00 00 00 02 C6 12
				39 00 00 00 00 00 02 00 00
				39 00 00 00 00 00 13 C7 A0 9C BA 9C A9 CB 88 88 88 78 77 77 77 67 66 66 66 66
				39 00 00 00 00 00 02 00 00
				39 00 00 00 00 00 02 C6 13
				39 00 00 00 00 00 02 00 00
				39 00 00 00 00 00 13 C7 A0 9B BA AB 98 CB 88 88 88 78 77 77 77 77 77 66 66 66
				39 00 00 00 00 00 02 00 00
				39 00 00 00 00 00 02 C6 14
				39 00 00 00 00 00 02 00 00
				39 00 00 00 00 00 13 C7 A0 9A BA 9B 89 CB 88 88 88 78 77 77 77 77 77 77 66 66
				39 00 00 00 00 00 02 00 00
				39 00 00 00 00 00 02 C6 15
				39 00 00 00 00 00 02 00 00
				39 00 00 00 00 00 13 C7 90 8B AA 9B 99 CA 88 88 88 78 77 77 77 77 77 77 77 66
				39 00 00 00 00 00 02 00 00
				39 00 00 00 00 00 02 C6 16
				39 00 00 00 00 00 02 00 00
				39 00 00 00 00 00 13 C7 90 9A A9 AA 98 BA 88 88 88 88 77 77 77 77 77 77 77 77
				39 00 00 00 00 00 02 00 00
				39 00 00 00 00 00 02 C6 17
				39 00 00 00 00 00 02 00 00
				39 00 00 00 00 00 13 C7 90 8A 9A 9A 89 BA 88 88 88 88 88 77 77 77 77 77 77 77
				39 00 00 00 00 00 02 00 00
				39 00 00 00 00 00 02 C6 18
				39 00 00 00 00 00 02 00 00
				39 00 00 00 00 00 13 C7 90 99 99 9A 89 B9 88 88 88 88 88 88 77 77 77 77 77 77
				39 00 00 00 00 00 02 00 00
				39 00 00 00 00 00 02 C6 19
				39 00 00 00 00 00 02 00 00
				39 00 00 00 00 00 13 C7 80 8A 99 9A 98 B8 88 88 88 88 88 88 88 77 77 77 77 77
				39 00 00 00 00 00 02 00 00
				39 00 00 00 00 00 02 C6 1A
				39 00 00 00 00 00 02 00 00
				39 00 00 00 00 00 13 C7 80 99 99 99 88 B8 88 88 88 88 88 88 88 88 77 77 77 77
				39 00 00 00 00 00 02 00 00
				39 00 00 00 00 00 02 C6 1B
				39 00 00 00 00 00 02 00 00
				39 00 00 00 00 00 13 C7 80 89 99 99 88 A8 88 88 88 88 88 88 88 88 88 77 77 77
				39 00 00 00 00 00 02 00 00
				39 00 00 00 00 00 02 C6 1C
				39 00 00 00 00 00 02 00 00
				39 00 00 00 00 00 13 C7 80 98 98 99 88 A8 88 88 88 88 88 88 88 88 88 78 77 77
				39 00 00 00 00 00 02 00 00
				39 00 00 00 00 00 02 C6 1D
				39 00 00 00 00 00 02 00 00
				39 00 00 00 00 00 13 C7 80 88 89 89 89 98 88 88 88 88 88 88 88 88 88 88 78 77
				39 00 00 00 00 00 02 00 00
				39 00 00 00 00 00 02 C6 1E
				39 00 00 00 00 00 02 00 00
				39 00 00 00 00 00 13 C7 80 88 98 88 89 98 88 88 88 88 88 88 88 88 88 88 88 77
				39 00 00 00 00 00 02 00 00
				39 00 00 00 00 00 02 C6 1F
				39 00 00 00 00 00 02 00 00
				39 00 00 00 00 00 13 C7 80 88 88 88 88 98 88 88 88 88 88 88 88 88 88 88 88 88
				39 00 00 00 00 00 02 00 00
				39 01 00 00 00 00 02 C6 00
				39 01 00 00 00 00 02 55 03
		];
		qcom,mdss-dsi-cabc-still-off-command = [
				39 01 00 00 00 00 02 55 00
		];
		qcom,mdss-dsi-ce-on-command = [
				39 00 00 00 00 00 02 00 00
				39 00 00 00 00 00 10 D4 00 40 00 40 00 40 00 40 00 40 00 40 00 40 00
				39 00 00 00 00 00 10 D4 40 00 40 00 40 00 40 00 40 00 40 00 40 00 40
				39 00 00 00 00 00 10 D4 00 40 00 40 00 40 00 40 00 40 00 40 00 40 00
				39 00 00 00 00 00 10 D4 40 00 40 00 40 00 40 00 40 00 40 00 40 00 40
				39 00 00 00 00 00 10 D4 00 40 00 40 00 40 00 40 00 40 00 40 00 40 00
				39 00 00 00 00 00 10 D4 40 00 40 00 40 00 40 00 40 00 40 00 40 00 40
				39 00 00 00 00 00 10 D4 00 40 00 40 00 40 00 40 00 40 00 40 00 40 00
				39 00 00 00 00 00 10 D4 40 00 40 00 40 00 40 00 40 00 40 00 40 00 40
				39 00 00 00 00 00 10 D4 00 40 00 40 00 40 00 40 00 40 00 40 00 40 00
				39 00 00 00 00 00 10 D4 40 00 40 00 40 00 40 00 40 00 40 00 40 00 40
				39 00 00 00 00 00 10 D4 00 40 00 40 00 40 00 40 00 40 00 40 00 40 00
				39 00 00 00 00 00 10 D4 40 00 40 00 40 00 40 00 40 00 40 00 40 00 40
				39 00 00 00 00 00 10 D4 00 40 00 40 00 40 00 40 00 40 00 40 00 40 00
				39 00 00 00 00 00 10 D4 40 00 40 00 40 00 40 00 40 00 40 00 40 00 40
				39 00 00 00 00 00 10 D4 00 40 00 40 00 40 00 40 00 40 00 40 00 40 00
				39 00 00 00 00 00 10 D4 40 00 40 00 40 00 40 00 40 00 40 00 40 00 40
				39 00 00 00 00 00 10 D4 00 40 00 40 00 40 00 40 00 40 00 40 00 40 00
				39 00 00 00 00 00 10 D4 40 00 40 00 40 00 40 00 40 00 40 00 40 00 40
				39 00 00 00 00 00 10 D4 00 40 00 40 00 40 00 40 00 40 00 40 00 40 00
				39 00 00 00 00 00 10 D4 40 00 40 00 40 00 40 00 40 00 40 00 40 00 40
				39 00 00 00 00 00 10 D4 00 40 00 40 00 40 00 40 00 40 00 40 00 40 00
				39 00 00 00 00 00 10 D4 40 00 40 00 40 00 40 00 40 00 40 00 40 00 40
				39 00 00 00 00 00 10 D4 00 40 00 40 00 40 00 40 00 40 00 40 00 40 00
				39 00 00 00 00 00 10 D4 40 00 40 00 40 00 40 00 40 00 40 00 40 00 40
				39 00 00 00 00 00 10 D4 FC 3B FC 3B FC 3B FC 3B FC 3B FC 3B FC 3B FC
				39 00 00 00 00 00 10 D4 3B FC 3B FC 3B FC 3B FC 3B FC 3B FC 3B FC 3B
				39 00 00 00 00 00 10 D4 FC 3B FC 3C FD 3C FD 3C FE 3C FE 3C FE 3C FF
				39 00 00 00 00 00 10 D4 3C FF 3D 00 3D 00 3D 01 3D 01 3D 01 3D 02 3D
				39 00 00 00 00 00 10 D4 02 3E 02 3E 02 3F 02 3F 01 40 01 41 01 41 01
				39 00 00 00 00 00 10 D4 42 01 42 01 43 01 44 01 44 00 45 00 45 00 46
				39 00 00 00 00 00 10 D4 00 47 00 47 00 47 00 48 00 48 00 49 00 49 00
				39 00 00 00 00 00 10 D4 49 00 4A 00 4A 00 4B 00 4B 00 4C 00 4C 00 4C
				39 00 00 00 00 00 10 D4 00 4D 00 4D 00 4D 00 4D 00 4D 00 4D 00 4D 00
				39 00 00 00 00 00 10 D4 4D 00 4D 00 4D 00 4D 00 4D 00 4D 00 4D 00 4D
				39 00 00 00 00 00 10 D4 00 4D 00 4D 00 4D 00 4D 00 4D 00 4D 00 4D 00
				39 00 00 00 00 00 10 D4 4D 00 4D 00 4D 00 4D 00 4D 00 4D 00 4D 00 4D
				39 00 00 00 00 00 10 D4 00 4D 00 4D 00 4D 00 4D 00 4D 00 4D 00 4D 00
				39 00 00 00 00 00 10 D4 4D 00 4D 00 4D 00 4D 00 4D 00 4D 00 4D 00 4D
				39 00 00 00 00 00 10 D4 00 4D 00 4C 00 4C 00 4B 00 4B 00 4B 00 4A 00
				39 00 00 00 00 00 10 D4 4A 00 49 00 49 00 48 00 48 00 48 00 47 00 47
				39 00 00 00 00 00 10 D4 00 46 00 46 00 45 00 45 00 45 00 44 00 44 00
				39 00 00 00 00 00 10 D4 43 00 43 00 42 00 42 00 42 00 41 00 41 00 40
				39 00 00 00 00 00 10 D4 00 40 00 40 00 40 00 40 00 40 00 40 00 40 00
				39 00 00 00 00 00 10 D4 40 00 40 00 40 00 40 00 40 00 40 00 40 00 40
				39 00 00 00 00 00 10 D4 00 40 00 40 00 40 00 40 00 40 00 40 00 40 00
				39 00 00 00 00 00 10 D4 40 00 40 00 40 00 40 00 40 00 40 00 40 00 40
				39 00 00 00 00 00 10 D4 00 40 00 40 FF 3F FF 3F FF 3F FF 3E FE 3E FE
				39 00 00 00 00 00 10 D4 3D FE 3D FD 3D FD 3C FD 3C FD 3C FC 3B FC 3B
				39 00 00 00 00 00 02 00 00
				39 00 00 00 00 00 10 D5 FE 3E FE 3E FE 3E FE 3E FE 3E FE 3E FE 3E FE
				39 00 00 00 00 00 10 D5 3E FE 3E FE 3E FE 3E FE 3E FE 3E FE 3E FE 3E
				39 00 00 00 00 00 10 D5 FE 3E FE 3E FE 3E FE 3E FF 3F FF 3F FF 3F FF
				39 00 00 00 00 00 10 D5 3F FF 3F FF 3F FF 3F FF 40 00 40 00 40 00 40
				39 00 00 00 00 00 10 D5 00 40 00 41 00 41 00 41 00 42 00 42 00 43 00
				39 00 00 00 00 00 10 D5 43 00 44 00 44 00 44 00 45 00 45 00 46 00 46
				39 00 00 00 00 00 10 D5 00 47 00 47 00 47 00 48 00 48 00 49 00 49 00
				39 00 00 00 00 00 10 D5 49 00 4A 00 4A 00 4B 00 4B 00 4C 00 4C 00 4C
				39 00 00 00 00 00 10 D5 00 4D 00 4D 00 4D 00 4D 00 4D 00 4D 00 4D 00
				39 00 00 00 00 00 10 D5 4D 00 4D 00 4D 00 4D 00 4D 00 4D 00 4D 00 4D
				39 00 00 00 00 00 10 D5 00 4D 00 4D 00 4D 00 4D 00 4D 00 4D 00 4D 00
				39 00 00 00 00 00 10 D5 4D 00 4D 00 4D 00 4D 00 4D 00 4D 00 4D 00 4D
				39 00 00 00 00 00 10 D5 00 4D 00 4D 00 4D 00 4D 00 4D 00 4D 00 4D 00
				39 00 00 00 00 00 10 D5 4D 00 4D 00 4D 00 4D 00 4D 00 4D 00 4D 00 4D
				39 00 00 00 00 00 10 D5 00 4D 00 4C 00 4C 00 4B 00 4B 00 4B 00 4A 00
				39 00 00 00 00 00 10 D5 4A 00 49 00 49 00 48 00 48 00 48 00 47 00 47
				39 00 00 00 00 00 10 D5 00 46 00 46 00 45 00 45 00 45 00 44 00 44 00
				39 00 00 00 00 00 10 D5 43 00 43 00 42 00 42 00 42 00 41 00 41 00 40
				39 00 00 00 00 00 10 D5 00 40 00 40 00 40 00 40 00 40 00 40 00 40 00
				39 00 00 00 00 00 10 D5 40 00 40 00 40 00 40 00 40 00 40 00 40 00 40
				39 00 00 00 00 00 10 D5 00 40 00 40 00 40 00 40 00 40 00 40 00 40 00
				39 00 00 00 00 00 10 D5 40 00 40 00 40 00 40 00 40 00 40 00 40 00 40
				39 00 00 00 00 00 10 D5 00 40 00 40 00 40 00 40 FF 3F FF 3F FF 3F FF
				39 00 00 00 00 00 10 D5 3F FF 3F FF 3F FF 3F FE 3F FE 3E FE 3E FE 3E
				39 00 00 00 00 00 10 D5 FC 3B FC 3B FC 3B FC 3B FC 3B FC 3B FC 3B FC
				39 00 00 00 00 00 10 D5 3B FC 3B FC 3B FC 3B FC 3B FC 3B FC 3B FC 3B
				39 00 00 00 00 00 10 D5 FC 3B FC 3C FD 3C FD 3C FE 3C FE 3C FE 3C FF
				39 00 00 00 00 00 10 D5 3C FF 3D 00 3D 00 3D 01 3D 01 3D 01 3D 02 3D
				39 00 00 00 00 00 10 D5 02 3E 02 3E 02 3F 02 3F 01 40 01 41 01 41 01
				39 00 00 00 00 00 10 D5 42 01 42 01 43 01 44 01 44 00 45 00 45 00 46
				39 00 00 00 00 00 10 D5 00 47 00 47 00 47 00 48 00 48 00 49 00 49 00
				39 00 00 00 00 00 10 D5 49 00 4A 00 4A 00 4B 00 4B 00 4C 00 4C 00 4C
				39 00 00 00 00 00 10 D5 00 4D 00 4D 00 4D 00 4D 00 4D 00 4D 00 4D 00
				39 00 00 00 00 00 10 D5 4D 00 4D 00 4D 00 4D 00 4D 00 4D 00 4D 00 4D
				39 00 00 00 00 00 10 D5 00 4D 00 4D 00 4D 00 4D 00 4D 00 4D 00 4D 00
				39 00 00 00 00 00 10 D5 4D 00 4D 00 4D 00 4D 00 4D 00 4D 00 4D 00 4D
				39 00 00 00 00 00 10 D5 00 4D 00 4D 00 4D 00 4D 00 4D 00 4D 00 4D 00
				39 00 00 00 00 00 10 D5 4D 00 4D 00 4D 00 4D 00 4D 00 4D 00 4D 00 4D
				39 00 00 00 00 00 10 D5 00 4D 00 4C 00 4C 00 4B 00 4B 00 4B 00 4A 00
				39 00 00 00 00 00 10 D5 4A 00 49 00 49 00 48 00 48 00 48 00 47 00 47
				39 00 00 00 00 00 10 D5 00 46 00 46 00 45 00 45 00 45 00 44 00 44 00
				39 00 00 00 00 00 10 D5 43 00 43 00 42 00 42 00 42 00 41 00 41 00 40
				39 00 00 00 00 00 10 D5 00 40 00 40 00 40 00 40 00 40 00 40 00 40 00
				39 00 00 00 00 00 10 D5 40 00 40 00 40 00 40 00 40 00 40 00 40 00 40
				39 00 00 00 00 00 10 D5 00 40 00 40 00 40 00 40 00 40 00 40 00 40 00
				39 00 00 00 00 00 10 D5 40 00 40 00 40 00 40 00 40 00 40 00 40 00 40
				39 00 00 00 00 00 10 D5 00 40 00 40 FF 3F FF 3F FF 3F FF 3E FE 3E FE
				39 01 00 00 00 00 10 D5 3D FE 3D FD 3D FD 3C FD 3C FD 3C FC 3B FC 3B

				39 00 00 00 00 00 02 81 80
		];
		qcom,mdss-dsi-ce-off-command = [
		39 00 00 00 00 00 02 81 00
		];
		qcom,mdss-dsi-srgb-on-command = [
		];
		qcom,mdss-dsi-srgb-off-command = [
		];
		qcom,mdss-dsi-on-command-state = "dsi_lp_mode";
		qcom,mdss-dsi-off-command-state = "dsi_hs_mode";
		qcom,mdss-dsi-ce-on-command-state = "dsi_hs_mode";
		qcom,mdss-dsi-ce-off-command-state = "dsi_hs_mode";
		qcom,mdss-dsi-cabc-on-command-state = "dsi_hs_mode";
		qcom,mdss-dsi-cabc-off-command-state = "dsi_hs_mode";
		qcom,mdss-dsi-cabc-movie-on-command-state = "dsi_hs_mode";
		qcom,mdss-dsi-cabc-movie-off-command-state = "dsi_hs_mode";
		qcom,mdss-dsi-cabc-still-on-command-state = "dsi_hs_mode";
		qcom,mdss-dsi-cabc-still-off-command-state = "dsi_hs_mode";
		qcom,mdss-dsi-srgb-on-command-state = "dsi_hs_mode";
		qcom,mdss-dsi-srgb-off-command-state = "dsi_hs_mode";
		qcom,mdss-dsi-h-sync-pulse = <1>;
		qcom,mdss-dsi-traffic-mode = "burst_mode";
		qcom,mdss-dsi-lane-map = "lane_map_0123";
		qcom,mdss-dsi-bllp-eof-power-mode;
		qcom,mdss-dsi-bllp-power-mode;
		qcom,mdss-dsi-lane-0-state;
		qcom,mdss-dsi-lane-1-state;
		qcom,mdss-dsi-lane-2-state;
		qcom,mdss-dsi-lane-3-state;
		qcom,mdss-dsi-panel-timings
				= [8B 1E 14 00 42 46 18 20 19 03 04 00];
		qcom,mdss-dsi-t-clk-post = <0x0a>;
		qcom,mdss-dsi-t-clk-pre = <0x1e>;
		qcom,mdss-dsi-bl-min-level = <1>;
		qcom,mdss-dsi-bl-max-level = <255>;
		qcom,mdss-dsi-dma-trigger = "trigger_sw";
		qcom,mdss-dsi-mdp-trigger = "none";
		qcom,mdss-dsi-bl-pmic-control-type = "bl_ctrl_dcs";
		qcom,mdss-dsi-bl-dcs-command-state = "dsi_hs_mode";
		qcom,mdss-dsi-reset-sequence = <1 5>, <0 5>, <1 5>;
		qcom,esd-check-enabled;
		qcom,mdss-dsi-panel-status-command = [06 01 00 01 05 00 01 0A];
		qcom,mdss-dsi-panel-status-command-state = "dsi_lp_mode";
		qcom,mdss-dsi-panel-status-check-mode = "reg_read";
		qcom,mdss-dsi-panel-status-read-length = <1>;
		qcom,mdss-dsi-panel-status-value = <0x9c>;
	};
};
