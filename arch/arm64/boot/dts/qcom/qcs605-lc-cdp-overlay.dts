/*
 * Copyright (c) 2018, The Linux Foundation. All rights reserved.
 *
 * This program is free software; you can redistribute it and/or modify
 * it under the terms of the GNU General Public License version 2 and
 * only version 2 as published by the Free Software Foundation.
 *
 * This program is distributed in the hope that it will be useful,
 * but WITHOUT ANY WARRANTY; without even the implied warranty of
 * MERCHANTABILITY or FITNESS FOR A PARTICULAR PURPOSE.  See the
 * GNU General Public License for more details.
 */

/dts-v1/;
/plugin/;

#include <dt-bindings/interrupt-controller/arm-gic.h>
#include "qcs605-lc-cdp.dtsi"
#include "qcs605-lc-audio-overlay.dtsi"

/ {
	model = "Qualcomm Technologies, Inc. QC605 LC Groot + PM8005 CDP";
	compatible = "qcom,qcs605-cdp", "qcom,qcs605", "qcom,cdp";
	qcom,msm-id = <347 0x0>;
	qcom,board-id = <1 4>;
};
