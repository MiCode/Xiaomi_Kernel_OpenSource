/* Copyright (c) 2019, The Linux Foundation. All rights reserved.
 *
 * This program is free software; you can redistribute it and/or modify
 * it under the terms of the GNU General Public License version 2 and
 * only version 2 as published by the Free Software Foundation.
 *
 * This program is distributed in the hope that it will be useful,
 * but WITHOUT ANY WARRANTY; without even the implied warranty of
 * MERCHANTABILITY or FITNESS FOR A PARTICULAR PURPOSE.  See the
 * GNU General Public License for more details.
 */

/ {
	mdss_qpic: qcom,msm_qpic@1b00000 {
		compatible = "qcom,mdss_qpic";
		reg = <0x1B00000 0x24000>;
		reg-names = "qpic_base";
		interrupts = <0 251 0>;

		qcom,msm-bus,name = "mdss_qpic";
		qcom,msm-bus,num-cases = <2>;
		qcom,msm-bus,num-paths = <1>;

		qcom,msm-bus,vectors-KBps =
			<91 512 0 0>,
			/* Voting for max b/w on PNOC bus for now */
			<91 512 400000 800000>;

		vdd-supply = <&pmxprairie_l6>;

		qcom,rst-gpio = <&tlmm 23 0>;
		qcom,cs-gpio = <&tlmm 21 0>;
		qcom,ad8-gpio = <&tlmm 20 0>;
		qcom,te-gpio = <&tlmm 22 0>;
		qcom,bl-gpio = <&pmxprairie_gpios 1 0>;

		clock-names = "core_clk";
		clocks = <&clock_rpmh RPMH_QPIC_CLK>;

		pinctrl-names= "mdss_default", "mdss_sleep";
		pinctrl-0 = <&mdss_cs_active &mdss_te_active
			&mdss_rs_active &mdss_ad_active>;
		pinctrl-1 = <&mdss_cs_sleep &mdss_te_sleep
			&mdss_rs_sleep &mdss_ad_sleep>;
	};
};
