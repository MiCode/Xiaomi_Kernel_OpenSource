qcom,e10_cos_4000mah {
	qcom, = <24>;
	qcom,max-voltage-uv = <4400000>;
	qcom,fastchg-current-ma = <2800>;
	qcom,nom-batt-capacity-mah = <4000>;
	qcom,fg-cc-cv-threshold-mv = <4390>;
	qcom,batt-id-kohm = <100>;
	qcom,battery-beta = <3380>;
	qcom,battery-type = "e10_cos_4000mAh";
	qcom,jeita-fcc-ranges = <0   50   390000
			51  100  1170000
			101 150  1170000
			151 450  2800000
			451 600  1950000>;
	qcom,jeita-fv-ranges =  <0   50  4400000
			51  100  4400000
			101 150  4400000
			151 450  4400000
			451 600  4100000>;
	qcom,dynamic-fv-ranges = <0    100  4400000
			101  200  4380000
			201  300  4360000
			301  400  4340000
			401  500  4340000>;
	qcom,checksum = <0x0920>;
	qcom,gui-version = "PMI8998GUI - 2.0.0.58";
	qcom,fg-profile-data = [
			3F 1F FC 05
			29 0A A5 06
			E8 1C E4 01
			D0 0D 8D 0A
			98 17 0E 2A
			00 44 A9 5A
			73 00 00 00
			10 00 00 00
			00 00 AC C5
			64 C4 96 C2
			20 00 08 00
			0C DB 6E E5
			68 05 D2 01
			E2 14 F6 05
			11 EC E7 23
			31 06 09 20
			27 00 14 00
			E0 1F 63 05
			A4 0A 24 06
			C1 1C 11 03
			E0 15 53 12
			82 18 F8 23
			C0 4D 8B 5B
			69 00 00 00
			0D 00 00 00
			00 00 40 CC
			10 CA 78 BC
			17 00 00 00
			9F E3 6E E5
			6D 06 04 01
			D7 06 8F FB
			EE F2 BC 1B
			BA 33 CC FF
			07 10 00 00
			9C 0F 66 46
			17 00 40 00
			6E 01 0A FA
			FF 00 00 00
			00 00 00 00
			00 00 00 00
			00 00 00 00
			00 00 00 00
			00 00 00 00
			00 00 00 00
			00 00 00 00
			00 00 00 00
			00 00 00 00
			00 00 00 00
			00 00 00 00
			00 00 00 00
			00 00 00 00
			00 00 00 00
			00 00 00 00
			00 00 00 00
			00 00 00 00
			00 00 00 00
	];
};

