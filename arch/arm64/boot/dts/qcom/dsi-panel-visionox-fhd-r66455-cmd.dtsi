/* Copyright (c) 2015, The Linux Foundation. All rights reserved.
 * Copyright (C) 2019 XiaoMi, Inc.
 *
 * This program is free software; you can redistribute it and/or modify
 * it under the terms of the GNU General Public License version 2 and
 * only version 2 as published by the Free Software Foundation.
 *
 * This program is distributed in the hope that it will be useful,
 * but WITHOUT ANY WARRANTY; without even the implied warranty of
 * MERCHANTABILITY or FITNESS FOR A PARTICULAR PURPOSE.  See the
 * GNU General Public License for more details.
 */

/*---------------------------------------------------------------------------
 * This file is autogenerated file using gcdb parser. Please do not edit it.
 * Update input XML file to add a new entry or update variable in this file
 * VERSION = "1.0"
 *---------------------------------------------------------------------------*/
&soc {
	dsi_visionox_fhd_r66455_cmd: qcom,mdss_dsi_visionox_fhd_r66455_cmd {
		qcom,mdss-dsi-panel-name = "visionox r66455 fhd cmd dsi panel";
		qcom,mdss-dsi-panel-id = <0>;
		qcom,mdss-dsi-panel-model = "VISIONOX FHD R66455 CMD PANEL";
		qcom,mdss-dsi-panel-type = "dsi_cmd_mode";
		qcom,mdss-dsi-virtual-channel-id = <0>;
		qcom,mdss-dsi-stream = <0>;
		qcom,mdss-dsi-bpp = <24>;
		qcom,mdss-dsi-color-order = "rgb_swap_rgb";
		qcom,mdss-dsi-underflow-color = <0xff>;
		qcom,mdss-dsi-border-color = <0>;
		qcom,mdss-dsi-traffic-mode = "burst_mode";
		qcom,mdss-dsi-bllp-eof-power-mode;
		qcom,mdss-dsi-bllp-power-mode;
		qcom,mdss-dsi-lp11-init;
		qcom,mdss-dsi-lane-0-state;
		qcom,mdss-dsi-lane-1-state;
		qcom,mdss-dsi-lane-2-state;
		qcom,mdss-dsi-lane-3-state;
		qcom,mdss-brightness-remap;
		qcom,mdss-doze-brightness-variable;
		qcom,mdss-brightness-max-level = <2047>;
		qcom,mdss-dsi-dma-trigger = "trigger_sw";
		qcom,mdss-dsi-mdp-trigger = "none";
		qcom,mdss-dsi-reset-sequence = <0 2>, <1 10>;
		qcom,mdss-pan-physical-width-dimension = <68>;
		qcom,mdss-pan-physical-height-dimension = <147>;
		qcom,mdss-dsi-te-pin-select = <1>;
		qcom,mdss-dsi-wr-mem-start = <0x2c>;
		qcom,mdss-dsi-wr-mem-continue = <0x3c>;
		qcom,mdss-dsi-te-dcs-command = <1>;
		qcom,mdss-dsi-tx-eot-append;

		qcom,mdss-dsi-panel-hdr-enabled;
		qcom,mdss-dsi-panel-hdr-color-primaries = <14500 15500 32000
			17000 15500 30000 8000 3000>;
		qcom,mdss-dsi-panel-peak-brightness = <4300000>;
		qcom,mdss-dsi-panel-blackness-level = <3230>;

		qcom,mdss-dsi-bl-dcs-type-ss;
		/* qcom,mdss-dsi-on-command-tuning; */
		qcom,dispparam-enabled;
		qcom,mdss-panel-on-dimming-delay = <120>;
		qcom,disp-doze-backlight-threshold = <8>;/*2047(8), 4096(16) */
		/* IRQF_ONESHOT | IRQF_TRIGGER_HIGH */
		/* qcom,esd-err-irq-gpio = <&tlmm 52 0x2004>; */

		qcom,bl-update-flag = "delay_until_first_frame";
		qcom,bl-update-delay = <28>;

		qcom,mdss-dsi-display-timings {
			timing@0{
				qcom,mdss-dsi-panel-width = <1080>;
				qcom,mdss-dsi-panel-height = <2340>;
				qcom,mdss-dsi-h-back-porch = <40>;
				qcom,mdss-dsi-h-front-porch = <96>;
				qcom,mdss-dsi-h-pulse-width = <4>;
				qcom,mdss-dsi-h-sync-skew = <0>;
				qcom,mdss-dsi-v-back-porch = <16>;
				qcom,mdss-dsi-v-front-porch = <25>;
				qcom,mdss-dsi-v-pulse-width = <3>;
				qcom,mdss-dsi-h-left-border = <0>;
				qcom,mdss-dsi-h-right-border = <0>;
				qcom,mdss-dsi-v-top-border = <0>;
				qcom,mdss-dsi-v-bottom-border = <0>;
				qcom,mdss-dsi-panel-framerate = <60>;
				qcom,mdss-dsi-on-command = [
					/* Bank 0 */
					39 01 00 00 00 00 02 B0 00
					/* mode switch 00:CMD mode 01:VDO mode */
					39 01 00 00 00 00 02 B3 00
					39 01 00 00 00 00 02 FA 9F
					39 01 00 00 00 00 0F C1 F0 61 00 00 00 00 00 20 02 00 00 00 00 81
					/* SET Column Start Adress */
					39 01 00 00 00 00 05 2A 00 00 04 37
					/* SET Row Start Adress */
					39 01 00 00 00 00 05 2B 00 00 09 23
					/* Bank 1 */
					39 01 00 00 00 00 02 B0 80
					39 01 00 00 00 00 02 E4 FE
					/* NVM load control */
					39 01 00 00 00 00 02 E6 00
					/* brightness control */
					39 01 00 00 00 00 03 51 01 00
					/* TE Control*/
					39 01 00 00 00 00 02 35 00
					/* Bank 0 */
					39 01 00 00 00 00 02 B0 00
					/* display on */
					05 01 00 00 00 00 02 29 00
					/* sleep out */
					05 01 00 00 64 00 02 11 00];
				qcom,mdss-dsi-off-command = [
					05 01 00 00 00 00 02 28 00
					05 01 00 00 78 00 02 10 00];
				qcom,mdss-dsi-on-command-state = "dsi_lp_mode";
				qcom,mdss-dsi-off-command-state = "dsi_lp_mode";

				qcom,mdss-dsi-doze-hbm-command = [
					/* AOD ON Sequence (Normal To AOD HBM) */
					05 01 00 00 00 00 02 39 00
					39 01 00 00 00 00 03 51 00 FF];
				qcom,mdss-dsi-doze-lbm-command = [
					/* AOD ON Sequence (Normal To AOD LBM) */
					05 01 00 00 00 00 02 39 00
					39 01 00 00 00 00 03 51 00 00];
				qcom,mdss-dsi-nolp-command = [
					/* AOD OFF Sequence (AOD To Normal) */
					05 01 00 00 00 00 02 38 00];
				qcom,mdss-dsi-doze-hbm-command-state = "dsi_lp_mode";
				qcom,mdss-dsi-doze-lbm-command-state = "dsi_lp_mode";
				qcom,mdss-dsi-nolp-command-state = "dsi_lp_mode";

				qcom,mdss-dsi-dispparam-acl-off-command = [39 01 00 00 00 00 02 55 00];
				qcom,mdss-dsi-dispparam-acl-off-command-state = "dsi_lp_mode";
				qcom,mdss-dsi-dispparam-acl-l1-command = [39 01 00 00 00 00 02 55 03];/* 40% */
				qcom,mdss-dsi-dispparam-acl-l1-command-state = "dsi_lp_mode";
				qcom,mdss-dsi-dispparam-acl-l2-command = [39 01 00 00 00 00 02 55 02];/* 30% */
				qcom,mdss-dsi-dispparam-acl-l2-command-state = "dsi_lp_mode";
				qcom,mdss-dsi-dispparam-acl-l3-command = [39 01 00 00 00 00 02 55 01];/* 15% */
				qcom,mdss-dsi-dispparam-acl-l3-command-state = "dsi_lp_mode";

				qcom,mdss-dsi-dispparam-hbm-off-command = [39 01 00 00 00 00 02 53 28];
				qcom,mdss-dsi-dispparam-hbm-off-command-state = "dsi_lp_mode";
				qcom,mdss-dsi-dispparam-hbm-on-command = [39 01 00 00 00 00 02 53 E8];
				qcom,mdss-dsi-dispparam-hbm-on-command-state = "dsi_lp_mode";

				qcom,mdss-dsi-dispparam-dimmingon-command = [39 01 00 00 00 00 02 53 28];
				qcom,mdss-dsi-dispparam-dimmingon-command-state = "dsi_lp_mode";
			};
		};
	};
};
