/*
 * Copyright (c) 2018, The Linux Foundation. All rights reserved.
 *
 * This program is free software; you can redistribute it and/or modify
 * it under the terms of the GNU General Public License version 2 and
 * only version 2 as published by the Free Software Foundation.
 *
 * This program is distributed in the hope that it will be useful,
 * but WITHOUT ANY WARRANTY; without even the implied warranty of
 * MERCHANTABILITY or FITNESS FOR A PARTICULAR PURPOSE.  See the
 * GNU General Public License for more details.
 */

/dts-v1/;

#include "qm215.dtsi"
#include "qm215-pm8916.dtsi"
#include "qm215-qrd.dtsi"

/ {
	model = "Qualcomm Technologies, Inc. qm215 QRD";
	compatible = "qcom,qm215-qrd", "qcom,qm215", "qcom,qrd";
	qcom,board-id = <0x01000b 4>;
	qcom,pmic-id = <0x010016 0x25 0x0 0x0>;
};
