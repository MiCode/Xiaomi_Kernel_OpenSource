// SPDX-License-Identifier: GPL-2.0-only
/*
 * Copyright (c) 2019, The Linux Foundation. All rights reserved.
 */

/dts-v1/;

#include "lito.dtsi"
#include "lito-atp.dtsi"

/ {
	model = "Qualcomm Technologies, Inc. Lito ATP";
	compatible = "qcom,lito-atp", "qcom,lito", "qcom,atp";
	qcom,board-id = <33 0>;
};
