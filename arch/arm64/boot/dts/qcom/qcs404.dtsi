/*
 * Copyright (c) 2018-2019, 2020 The Linux Foundation. All rights reserved.
 *
 * This program is free software; you can redistribute it and/or modify
 * it under the terms of the GNU General Public License version 2 and
 * only version 2 as published by the Free Software Foundation.
 *
 * This program is distributed in the hope that it will be useful,
 * but WITHOUT ANY WARRANTY; without even the implied warranty of
 * MERCHANTABILITY or FITNESS FOR A PARTICULAR PURPOSE.  See the
 * GNU General Public License for more details.
 */

#include "qcs405.dtsi"

/ {
	model = "Qualcomm Technologies, Inc. QCS404";
	qcom,msm-name = "QCS404";
	qcom,msm-id = <410 0x0>;

};

&adsp_fw_mem {
	reg = <0x0 0x87400000 0x0 0x1200000>;
};

&reserved_mem {
	linux,cma {
		size = <0 0x1000000>;
	};
};

