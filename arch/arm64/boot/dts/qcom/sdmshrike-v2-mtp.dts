/* Copyright (c) 2019, The Linux Foundation. All rights reserved.
 *
 * This program is free software; you can redistribute it and/or modify
 * it under the terms of the GNU General Public License version 2 and
 * only version 2 as published by the Free Software Foundation.
 *
 * This program is distributed in the hope that it will be useful,
 * but WITHOUT ANY WARRANTY; without even the implied warranty of
 * MERCHANTABILITY or FITNESS FOR A PARTICULAR PURPOSE.  See the
 * GNU General Public License for more details.
 */

/dts-v1/;

#include "sdmshrike-v2.dtsi"
#include "sdmshrike-mtp.dtsi"

/ {
	model = "Qualcomm Technologies, Inc. SDMSHRIKE V2 MTP";
	compatible = "qcom,sdmshrike-mtp", "qcom,sdmshrike", "qcom,mtp";
	qcom,board-id = <8 0>;
};
