/* Copyright (c) 2019, The Linux Foundation. All rights reserved.
 *
 * This program is free software; you can redistribute it and/or modify
 * it under the terms of the GNU General Public License version 2 and
 * only version 2 as published by the Free Software Foundation.
 *
 * This program is distributed in the hope that it will be useful,
 * but WITHOUT ANY WARRANTY; without even the implied warranty of
 * MERCHANTABILITY or FITNESS FOR A PARTICULAR PURPOSE.  See the
 * GNU General Public License for more details.
 */

/*---------------------------------------------------------------------------
 * This file is autogenerated file using gcdb parser. Please do not edit it.
 * Update input XML file to add a new entry or update variable in this file
 * VERSION = "1.0"
 *---------------------------------------------------------------------------*/
&soc {
	dsi_k6_38_0e_0b_fhd_dsc_video: qcom,mdss_dsi_k6_38_0e_0b_fhd_dsc_video {
		qcom,mdss-dsi-panel-name = "xiaomi k6 38 0e 0b fhd dsc video dsi panel";
		qcom,mdss-dsi-panel-id = <0>;
		qcom,mdss-dsi-panel-type = "dsi_video_mode";
		qcom,mdss-dsi-virtual-channel-id = <0>;
		qcom,mdss-dsi-stream = <0>;
		qcom,mdss-dsi-bpp = <24>;
		qcom,mdss-dsi-color-order = "rgb_swap_rgb";
		qcom,mdss-dsi-underflow-color = <0xff>;
		qcom,mdss-dsi-border-color = <0>;
		qcom,mdss-dsi-traffic-mode = "burst_mode";
		qcom,mdss-dsi-bllp-eof-power-mode;
		qcom,mdss-dsi-bllp-power-mode;
		qcom,mdss-dsi-lp11-init;
		qcom,mdss-dsi-lane-0-state;
		qcom,mdss-dsi-lane-1-state;
		qcom,mdss-dsi-lane-2-state;
		qcom,mdss-dsi-lane-3-state;
		qcom,bl-update-flag = "delay_until_first_frame";
		qcom,mdss-dsi-dma-trigger = "trigger_sw";
		qcom,mdss-dsi-mdp-trigger = "none";
		qcom,mdss-dsi-bl-dcs-type-ss-ea;
		qcom,mdss-dsi-reset-sequence = <0 1>, <1 10>;
		qcom,mdss-pan-physical-width-dimension = <695>;
		qcom,mdss-pan-physical-height-dimension = <1546>;
		qcom,mdss-dsi-tx-eot-append;
		qcom,dispparam-enabled;
		qcom,mdss-dsi-panel-hdr-enabled;
		qcom,mdss-dsi-panel-hdr-color-primaries = <14500 15500 32000
			17000 15500 30000 8000 3000>;
		qcom,mdss-dsi-panel-peak-brightness = <4200000>;
		qcom,mdss-dsi-panel-blackness-level = <3230>;
		/* IRQF_ONESHOT | IRQF_TRIGGER_FALLING */
		qcom,esd-err-irq-gpio = <&tlmm 32 0x2002>;
		/* hbm off param*/
		qcom,dispparam-f4-51-ctrl-flag;
		qcom,mdss-dsi-panel-hbm-off-51-index = <1>;

		/* DFPS */
		qcom,mdss-dsi-pan-enable-dynamic-fps;
		qcom,mdss-dsi-pan-fps-update = "dfps_immediate_porch_mode_vfp";
		qcom,dsi-supported-dfps-list = <120 60>;

		//qcom,mdss-dsi-panel-dc-threshold = <488>;
		//qcom,mdss-dsi-panel-k6-dc-flag;

		/* AOD brightness setting */
		mi,mdss-dsi-doze-hbm-brightness-value = <272>;
		mi,mdss-dsi-doze-lbm-brightness-value = <22>;
		qcom,mdss-dsi-oled-panel-video-mode;
		qcom,mdss-dsi-display-timings {
			timing@0{
				qcom,mdss-dsi-panel-width = <1080>;
				qcom,mdss-dsi-panel-height = <2400>;
				qcom,mdss-dsi-h-front-porch = <120>;
				qcom,mdss-dsi-h-back-porch = <120>;
				qcom,mdss-dsi-h-pulse-width = <28>;
				qcom,mdss-dsi-h-sync-skew = <0>;
				qcom,mdss-dsi-v-back-porch = <10>;
				qcom,mdss-dsi-v-front-porch = <20>;
				qcom,mdss-dsi-v-pulse-width = <2>;
				qcom,mdss-dsi-h-left-border = <0>;
				qcom,mdss-dsi-h-right-border = <0>;
				qcom,mdss-dsi-v-top-border = <0>;
				qcom,mdss-dsi-v-bottom-border = <0>;
				qcom,mdss-dsi-panel-framerate = <120>;
				qcom,mdss-dsi-on-one-command = [
					39 01 00 00 00 00 05 F1 5A 5A 5A 5A
					39 00 00 00 00 00 02 60 21
					39 00 00 00 00 00 02 F7 07
					39 01 00 00 00 00 05 F1 A5 A5 A5 A5
					/*dsc setting*/
					39 01 00 00 00 00 02 9D 01
					39 01 00 00 0B 00 5A 9E 11 00 00 89 30 80 09 60 04 38 00 28 02 1C 02 1C 02 00 02 0E 00 20 03 DD 00 07 00 0C 02 77 02 8B 18 00 10 F0 03 0C 20 00 06 0B 0B 33 0E 1C 2A 38 46 54 62 69 70 77 79 7B 7D 7E 01 02 01 00 09 40 09 BE 19 FC 19 FA 19 F8 1A 38 1A 78 1A B6 2A F6 2B 34 2B 74 3B 74 6B F4 00
					/*VDDUP Setting1*/
					39 00 00 00 00 00 06 F1 5A 5A 5A 5A 5A
					39 00 00 00 00 00 03 D8 01 01
					39 00 00 00 00 00 05 B0 00 46 00 00
					39 00 00 00 00 00 02 E1 01
					/*power on*/
					39 01 00 00 0B 00 03 9F 5A 5A
					05 01 00 00 15 00 01 11
					/*VDDUP Setting2*/
					39 00 00 00 00 00 05 B0 00 09 00 00
					39 00 00 00 00 00 02 E1 22
					39 00 00 00 00 00 05 B0 00 9C 00 00
					39 00 00 00 00 00 02 E0 D4
					39 00 00 00 00 00 05 B0 00 04 00 00
					39 00 00 00 00 00 02 E0 00
					39 00 00 00 00 00 05 B0 00 9A 00 00
					39 00 00 00 00 00 02 E0 00
					39 00 00 00 00 00 05 B0 00 03 00 00
					39 00 00 00 00 00 06 E1 FF FF FF 7A AA
				/*	39 00 00 00 00 00 05 B0 00 0F E0 01    */
				/*  Value A  */
				/*	39 00 00 00 00 00 02 E0 14             */
				/*	39 00 00 00 00 00 05 B0 00 1E E0 01    */
				/*  Value B  */
				/*	39 00 00 00 00 00 02 E0 0B             */
				/*	39 01 00 00 00 00 06 F1 A5 A5 A5 A5 A5 */
					];
				qcom,mdss-dsi-on-one-command-state = "dsi_lp_mode";
				qcom,mdss-dsi-on-three-command = [
					/*common setting*/
					/*FFC setting*/
					39 01 00 00 00 00 05 F1 5A 5A 5A 5A
					39 00 00 00 00 00 05 B0 00 2C 00 00
					39 00 00 00 00 00 11 E0 00 03 C2 07 85 03 39 05 6D 05 51 06 C3 12 9E 44
					39 00 00 00 00 00 05 B0 00 38 00 00
					39 00 00 00 00 00 02 E0 F3
					39 00 00 00 00 00 05 B0 00 41 00 00
					39 00 00 00 00 00 02 E0 13
					39 01 00 00 00 00 05 F1 A5 A5 A5 A5
					/*11bit diming setting*/
					39 01 00 00 00 00 05 F1 5A 5A 5A 5A
					39 00 00 00 00 00 03 B2 01 30
					39 01 00 00 00 00 05 F1 A5 A5 A5 A5
					/*Dimming Setting*/
					39 01 00 00 00 00 05 F1 5A 5A 5A 5A
					39 00 00 00 00 00 05 B0 00 0D B2 01
					39 00 00 00 00 00 02 B2 20
					39 00 00 00 00 00 05 B0 00 0C B2 01
					39 00 00 00 00 00 02 B2 30
					39 01 00 00 00 00 05 F1 A5 A5 A5 A5
					/*err flag*/
					39 01 00 00 00 00 05 F1 5A 5A 5A 5A
					39 00 00 00 00 00 05 B0 00 0B CE 01
					39 00 00 00 00 00 02 CE 11
					39 00 00 00 00 00 05 B0 00 08 EA 01
					39 00 00 00 00 00 03 EA F6 89
					39 00 00 00 00 00 05 B0 00 0A EA 01
					39 00 00 00 00 00 04 EA 55 01 04
					39 00 00 00 00 00 05 B0 00 0D EA 01
					39 00 00 00 00 00 03 EA FF FF
					39 00 00 00 00 00 05 B0 00 74 E1 01
					39 00 00 00 00 00 02 E1 3F
					39 00 00 00 00 00 05 B0 00 10 EA 01
					39 00 00 00 00 00 02 EA 01
					39 01 00 00 00 00 05 F1 A5 A5 A5 A5
					/*Source control*/
					39 01 00 00 00 00 05 F1 5A 5A 5A 5A
					39 00 00 00 00 00 05 B0 00 9D E0 01
					39 00 00 00 00 00 02 E0 00
					39 00 00 00 00 00 05 B0 00 04 E0 01
					39 00 00 00 00 00 02 E0 00
					39 00 00 00 00 00 05 B0 00 22 F6 01
					39 00 00 00 00 00 07 F6 20 50 2C 33 7A 7E
					39 00 00 00 00 00 05 B0 00 03 CC 01
					39 00 00 00 00 00 02 CC 30
					39 00 00 00 00 00 05 F1 A5 A5 A5 A5
					/*TE on*/
					39 01 00 00 00 00 02 35 00
					39 01 00 00 00 00 02 53 20
					39 01 00 00 00 00 03 51 00 00
					39 01 00 00 65 00 02 F7 07
					05 01 00 00 00 00 01 29
					];
				qcom,mdss-dsi-on-three-command-state = "dsi_lp_mode";
				qcom,mdss-dsi-off-command = [
					39 01 00 00 00 00 03 9F 5A 5A
					05 01 00 00 0B 00 01 28
					05 01 00 00 97 00 01 10];
				qcom,mdss-dsi-off-command-state = "dsi_hs_mode";
				qcom,mdss-dsi-dispparam-dimmingon-command = [39 01 00 00 01 00 02 53 30];
				qcom,mdss-dsi-dispparam-dimmingon-command-state = "dsi_lp_mode";
				qcom,mdss-dsi-dispparam-dimmingoff-command = [39 01 00 00 01 00 02 53 20];
				qcom,mdss-dsi-dispparam-dimmingoff-command-state = "dsi_lp_mode";
				qcom,mdss-dsi-dispparam-hbm-on-command = [
					39 01 00 00 00 00 02 53 F0
					39 01 00 00 00 00 03 51 07 FF
					39 01 00 00 00 00 02 F7 07];
				qcom,mdss-dsi-dispparam-hbm-on-command-state = "dsi_lp_mode";
				qcom,mdss-dsi-dispparam-lcd-hbm-l1-on-command = [
					/* Enter HBM L1 Mode */
					39 01 00 00 00 00 02 53 F0
					39 01 00 00 00 00 03 51 02 58
					39 01 00 00 00 00 02 F7 07
					];
				qcom,mdss-dsi-dispparam-lcd-hbm-l1-on-command-state = "dsi_lp_mode";
				qcom,mdss-dsi-dispparam-lcd-hbm-l2-on-command = [
					/* Enter HBM L2 Mode */
					39 01 00 00 00 00 02 53 F0
					39 01 00 00 00 00 03 51 04 B0
					39 01 00 00 00 00 02 F7 07
					];
				qcom,mdss-dsi-dispparam-lcd-hbm-l2-on-command-state = "dsi_lp_mode";
				qcom,mdss-dsi-dispparam-lcd-hbm-l3-on-command = [
					/* Enter HBM L3 Mode */
					39 01 00 00 00 00 02 53 F0
					39 01 00 00 00 00 03 51 07 FF
					39 01 00 00 00 00 02 F7 07
					];
				qcom,mdss-dsi-dispparam-lcd-hbm-l3-on-command-state = "dsi_lp_mode";
				qcom,mdss-dsi-dispparam-lcd-hbm-off-command = [
					39 01 00 00 00 00 02 53 30
					39 01 00 00 00 00 03 51 07 FF
					39 01 00 00 00 00 02 F7 07];
				qcom,mdss-dsi-dispparam-lcd-hbm-off-command-state = "dsi_lp_mode";
				qcom,mdss-dsi-dispparam-hbm-off-command = [
					39 01 00 00 00 00 02 53 30
					39 01 00 00 00 00 03 51 07 FF
					39 01 00 00 00 00 02 F7 07];
				qcom,mdss-dsi-dispparam-hbm-off-command-state = "dsi_lp_mode";
				qcom,mdss-dsi-doze-hbm-command = [39 01 00 00 00 00 03 9F 5A 5A
								  39 01 00 00 00 00 03 51 01 10
								 ];
				qcom,mdss-dsi-doze-hbm-command-state = "dsi_lp_mode";
				qcom,mdss-dsi-doze-lbm-command = [39 01 00 00 00 00 03 9F 5A 5A
								  39 01 00 00 00 00 03 51 00 16
								 ];
				qcom,mdss-dsi-doze-lbm-command-state = "dsi_lp_mode";
				qcom,mdss-dsi-dispparam-bc-120hz-command = [
					39 00 00 00 00 00 05 F1 5A 5A 5A 5A
					39 00 00 00 00 00 02 60 01
					39 01 00 00 00 00 02 F7 07];
				qcom,mdss-dsi-dispparam-bc-120hz-command-state = "dsi_hs_mode";
				qcom,mdss-dsi-dispparam-bc-60hz-command = [
					39 00 00 00 00 00 05 F1 5A 5A 5A 5A
					39 00 00 00 00 00 02 60 21
					39 01 00 00 00 00 02 F7 07];
				qcom,mdss-dsi-dispparam-bc-60hz-command-state = "dsi_hs_mode";
				qcom,compression-mode = "dsc";
				qcom,mdss-dsc-version = <0x11>;
				qcom,mdss-dsc-scr-version = <0x0>;
				qcom,mdss-dsc-slice-height = <40>;
				qcom,mdss-dsc-slice-width = <540>;
				qcom,mdss-dsc-slice-per-pkt = <2>;
				qcom,mdss-dsc-bit-per-component = <8>;
				qcom,mdss-dsc-bit-per-pixel = <8>;
				qcom,mdss-dsc-block-prediction-enable;
				qcom,mdss-dsi-dispparam-flat-mode-on-command =[
					39 01 00 00 00 00 03 F1 5A 5A
					39 00 00 00 00 00 05 B0 00 88 B1 01
					39 00 00 00 00 00 03 B1 27 2D
					39 01 00 00 00 00 03 F1 A5 A5];
				qcom,mdss-dsi-dispparam-flat-mode-on-command-state = "dsi_lp_mode";
				qcom,mdss-dsi-dispparam-flat-mode-off-command =[
					39 01 00 00 00 00 03 F1 5A 5A
					39 00 00 00 00 00 05 B0 00 88 B1 01
					39 00 00 00 00 00 03 B1 27 0D
					39 01 00 00 00 00 03 F1 A5 A5];
				qcom,mdss-dsi-dispparam-flat-mode-off-command-state = "dsi_lp_mode";
/*
				qcom,mdss-dsi-dispparam-60hz-dc-crc-setting-command = [
					39 01 00 00 00 00 03 F1 5A 5A
					39 00 00 00 00 00 02 80 05
					39 00 00 00 00 00 02 B1 00
					39 00 00 00 00 00 04 B0 00 01 B1
					39 00 00 00 00 00 16 B1 01 00 00 00 01 00 00 00 01 00 01 01 01 00 01 01 01 00 01 01 01
					39 01 00 00 00 00 03 F1 A5 A5
					39 01 00 00 00 00 03 51 01 E8
				];
				qcom,mdss-dsi-dispparam-60hz-dc-crc-setting-command-state = "dsi_lp_mode";
				qcom,mdss-dsi-dispparam-120hz-dc-crc-setting-command = [
					39 01 00 00 00 00 03 F1 5A 5A
					39 00 00 00 00 00 02 80 05
					39 00 00 00 00 00 02 B1 00
					39 00 00 00 00 00 04 B0 00 01 B1
					39 00 00 00 00 00 16 B1 01 00 00 00 01 00 00 00 01 00 01 01 01 00 01 01 01 00 01 01 01
					39 01 00 00 00 00 03 F1 A5 A5
					39 01 00 00 00 00 03 51 01 E8
				];
				qcom,mdss-dsi-dispparam-120hz-dc-crc-setting-command-state = "dsi_hs_mode";
				qcom,mdss-dsi-dispparam-crc-off-command = [
					39 01 00 00 00 00 03 F1 5A 5A
					39 00 00 00 00 00 02 80 00
					39 00 00 00 00 00 02 B1 01
					39 01 00 00 00 00 03 F1 A5 A5];
				qcom,mdss-dsi-dispparam-crc-off-command-state = "dsi_lp_mode";
*/
			};
		};
	};
};
