// SPDX-License-Identifier: GPL-2.0-only
/*
 * Copyright (c) 2019, The Linux Foundation. All rights reserved.
 */

/dts-v1/;

#include "lito.dtsi"
#include "lito-mtp.dtsi"

/ {
	model = "Qualcomm Technologies, Inc. Lito MTP";
	compatible = "qcom,lito-mtp", "qcom,lito", "qcom,mtp";
	qcom,board-id = <8 0>;
};
