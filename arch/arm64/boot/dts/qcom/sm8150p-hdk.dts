/* Copyright (c) 2018, The Linux Foundation. All rights reserved.
 *
 * This program is free software; you can redistribute it and/or modify
 * it under the terms of the GNU General Public License version 2 and
 * only version 2 as published by the Free Software Foundation.
 *
 * This program is distributed in the hope that it will be useful,
 * but WITHOUT ANY WARRANTY; without even the implied warranty of
 * MERCHANTABILITY or FITNESS FOR A PARTICULAR PURPOSE.  See the
 * GNU General Public License for more details.
 */

/dts-v1/;

#include "sm8150p.dtsi"
#include "sm8150-hdk.dtsi"

/ {
	model = "Qualcomm Technologies, Inc. SM8150P HDK";
	compatible = "qcom,sm8150p-hdk", "qcom,sm8150p", "qcom,hdk";
	qcom,board-id = <0x01001f 0x0>;
};
