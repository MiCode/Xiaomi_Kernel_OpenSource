/* Copyright (c) 2013, The Linux Foundation. All rights reserved.
 * Copyright (C) 2021 XiaoMi, Inc.
 *
 * This program is free software; you can redistribute it and/or modify
 * it under the terms of the GNU General Public License version 2 and
 * only version 2 as published by the Free Software Foundation.
 *
 * This program is distributed in the hope that it will be useful,
 * but WITHOUT ANY WARRANTY; without even the implied warranty of
 * MERCHANTABILITY or FITNESS FOR A PARTICULAR PURPOSE.  See the
 * GNU General Public License for more details.
 */

/*---------------------------------------------------------------------------
 * This file is autogenerated file using gcdb parser. Please do not edit it.
 * Update input XML file to add a new entry or update variable in this file
 * VERSION = "1.0"
 *---------------------------------------------------------------------------*/
&mdss_mdp {
	dsi_nvt36525b_hdplus_c3i_video: qcom,mdss_dsi_nvt36525b_hdplus_video_c3i {
		qcom,mdss-dsi-panel-name = "nvt36525b hdplus c3i video mode dsi panel";
		qcom,mdss-dsi-panel-controller = <&mdss_dsi0>;
		qcom,mdss-dsi-panel-type = "dsi_video_mode";
		qcom,mdss-dsi-panel-destination = "display_1";
		qcom,mdss-dsi-panel-framerate = <60>;
		qcom,mdss-dsi-virtual-channel-id = <0>;
		qcom,mdss-dsi-stream = <0>;
		qcom,mdss-dsi-panel-width = <720>;
		qcom,mdss-dsi-panel-height = <1520>;
		qcom,mdss-dsi-h-front-porch = <101>;
		qcom,mdss-dsi-h-back-porch = <100>;
		qcom,mdss-dsi-h-pulse-width = <8>;
		qcom,mdss-dsi-h-sync-skew = <0>;
		qcom,mdss-dsi-v-front-porch = <10>;
		qcom,mdss-dsi-v-back-porch = <8>;
		qcom,mdss-dsi-v-pulse-width = <2>;
		qcom,mdss-dsi-h-left-border = <0>;
		qcom,mdss-dsi-h-right-border = <0>;
		qcom,mdss-dsi-v-top-border = <0>;
		qcom,mdss-dsi-v-bottom-border = <0>;
		qcom,mdss-dsi-bpp = <24>;
		qcom,mdss-dsi-underflow-color = <0xff>;
		qcom,mdss-dsi-border-color = <0>;
		qcom,mdss-dsi-on-command = [
					29 01 00 00 00 00 02 FF 20
					29 01 00 00 00 00 02 FB 01
					39 01 00 00 00 00 11 C0 02 03 05 06 08 0D 0D 0E 0F 10 12 40 38 24 24 2C
					39 01 00 00 00 00 11 C2 02 03 05 06 08 0D 0D 0E 0F 10 12 12 38 24 24 2C
					29 01 00 00 00 00 02 FF 23
					29 01 00 00 00 00 02 FB 01
					29 01 00 00 00 00 02 00 68  //PWM 11BIT
					29 01 00 00 00 00 02 05 12
					29 01 00 00 00 00 02 06 00
					29 01 00 00 00 00 02 07 20
					29 01 00 00 00 00 02 08 01
					29 01 00 00 00 00 02 09 00
					29 01 00 00 00 00 02 12 AB
					29 01 00 00 00 00 02 15 7B
					29 01 00 00 00 00 02 16 0A
					29 01 00 00 00 00 02 30 FF  //UI mode PWM
					29 01 00 00 00 00 02 31 FE
					29 01 00 00 00 00 02 32 FC
					29 01 00 00 00 00 02 33 FA
					29 01 00 00 00 00 02 34 F8
					29 01 00 00 00 00 02 35 F6
					29 01 00 00 00 00 02 36 F4
					29 01 00 00 00 00 02 37 F2
					29 01 00 00 00 00 02 38 F1
					29 01 00 00 00 00 02 39 F0
					29 01 00 00 00 00 02 3A EF
					29 01 00 00 00 00 02 3B ED
					29 01 00 00 00 00 02 3D EB
					29 01 00 00 00 00 02 3F E9
					29 01 00 00 00 00 02 40 E7
					29 01 00 00 00 00 02 41 E5
					29 01 00 00 00 00 02 45 FF
					29 01 00 00 00 00 02 46 FC
					29 01 00 00 00 00 02 47 F6
					29 01 00 00 00 00 02 48 EC
					29 01 00 00 00 00 02 49 DF
					29 01 00 00 00 00 02 4A CD
					29 01 00 00 00 00 02 4B C0
					29 01 00 00 00 00 02 4C B3
					29 01 00 00 00 00 02 4D A6
					29 01 00 00 00 00 02 4E 98
					29 01 00 00 00 00 02 4F 8F
					29 01 00 00 00 00 02 50 86
					29 01 00 00 00 00 02 51 7D
					29 01 00 00 00 00 02 52 74
					29 01 00 00 00 00 02 53 6D
					29 01 00 00 00 00 02 54 66
					29 01 00 00 00 00 02 58 FF
					29 01 00 00 00 00 02 59 FD
					29 01 00 00 00 00 02 5A F9
					29 01 00 00 00 00 02 5B F2
					29 01 00 00 00 00 02 5C EC
					29 01 00 00 00 00 02 5D E6
					29 01 00 00 00 00 02 5E DE
					29 01 00 00 00 00 02 5F D9
					29 01 00 00 00 00 02 60 D2
					29 01 00 00 00 00 02 61 CC
					29 01 00 00 00 00 02 62 C7
					29 01 00 00 00 00 02 63 C3
					29 01 00 00 00 00 02 64 BE
					29 01 00 00 00 00 02 65 B9
					29 01 00 00 00 00 02 66 B5
					29 01 00 00 00 00 02 67 B3
					29 01 00 00 00 00 02 FF 22
					29 01 00 00 00 00 02 FB 01
					29 01 00 00 00 00 02 01 04
					29 01 00 00 00 00 02 02 08
					29 01 00 00 00 00 02 03 0C
					29 01 00 00 00 00 02 04 10
					29 01 00 00 00 00 02 05 14
					29 01 00 00 00 00 02 06 18
					29 01 00 00 00 00 02 07 20
					29 01 00 00 00 00 02 08 24
					29 01 00 00 00 00 02 09 28
					29 01 00 00 00 00 02 0A 30
					29 01 00 00 00 00 02 0B 38
					29 01 00 00 00 00 02 0C 38
					29 01 00 00 00 00 02 0D 30
					29 01 00 00 00 00 02 0E 28
					29 01 00 00 00 00 02 0F 20
					29 01 00 00 00 00 02 10 10
					29 01 00 00 00 00 02 11 00
					29 01 00 00 00 00 02 12 00
					29 01 00 00 00 00 02 13 00
					29 01 00 00 00 00 02 1A 00
					29 01 00 00 00 00 02 1B 00
					29 01 00 00 00 00 02 1C 04
					29 01 00 00 00 00 02 1D 08
					29 01 00 00 00 00 02 1E 0C
					29 01 00 00 00 00 02 1F 10
					29 01 00 00 00 00 02 20 14
					29 01 00 00 00 00 02 21 18
					29 01 00 00 00 00 02 22 20
					29 01 00 00 00 00 02 23 18
					29 01 00 00 00 00 02 24 10
					29 01 00 00 00 00 02 25 08
					29 01 00 00 00 00 02 26 00
					29 01 00 00 00 00 02 27 00
					29 01 00 00 00 00 02 28 00
					29 01 00 00 00 00 02 29 00
					29 01 00 00 00 00 02 2A 00
					29 01 00 00 00 00 02 2B 00
					29 01 00 00 00 00 02 2F 00
					29 01 00 00 00 00 02 30 00
					29 01 00 00 00 00 02 31 10
					29 01 00 00 00 00 02 32 9C
					29 01 00 00 00 00 02 33 94
					29 01 00 00 00 00 02 34 94
					29 01 00 00 00 00 02 35 1E
					29 01 00 00 00 00 02 36 14
					29 01 00 00 00 00 02 37 1E
					29 01 00 00 00 00 02 38 1E
					29 01 00 00 00 00 02 39 14
					29 01 00 00 00 00 02 3A 0A
					29 01 00 00 00 00 02 3B 0C
					29 01 00 00 00 00 02 3F 0E
					29 01 00 00 00 00 02 40 15
					29 01 00 00 00 00 02 41 1B
					29 01 00 00 00 00 02 42 20
					29 01 00 00 00 00 02 43 26
					29 01 00 00 00 00 02 44 1E
					29 01 00 00 00 00 02 45 17
					29 01 00 00 00 00 02 46 0F
					29 01 00 00 00 00 02 47 08
					29 01 00 00 00 00 02 48 0A
					29 01 00 00 00 00 02 49 12
					29 01 00 00 00 00 02 4A 23
					29 01 00 00 00 00 02 4B 28
					29 01 00 00 00 00 02 4C 9C
					29 01 00 00 00 00 02 4D 00
					29 01 00 00 00 00 02 53 00
					29 01 00 00 00 00 02 54 00
					29 01 00 00 00 00 02 55 00
					29 01 00 00 00 00 02 56 76
					29 01 00 00 00 00 02 68 76
					29 01 00 00 00 00 02 A2 20
					29 01 00 00 00 00 02 FF 26
					29 01 00 00 00 00 02 FB 01
					29 01 00 00 00 00 02 45 0E
					29 01 00 00 00 00 02 FF 10
					29 01 00 00 00 00 02 FB 01
					29 01 00 00 00 00 02 55 80
					29 01 00 00 00 00 02 BA 03
					29 01 00 00 00 00 03 51 0F FF
					29 01 00 00 00 00 02 53 2C
					29 01 00 00 14 00 02 29 00
					29 01 00 00 64 00 02 11 00
					29 01 00 00 00 00 02 FF 25
					29 01 00 00 00 00 02 FB 01
					29 01 00 00 00 00 02 24 A7
					29 01 00 00 00 00 02 46 13
					29 01 00 00 00 00 02 47 94
					29 01 00 00 00 00 02 FF 26
					29 01 00 00 00 00 02 FB 01
					29 01 00 00 00 00 02 31 11
					29 01 00 00 00 00 02 32 18
					29 01 00 00 00 00 02 36 67
					];
		qcom,mdss-dsi-off-command = [
					29 01 00 00 00 00 02 FF 10
					29 01 00 00 00 00 02 FB 01
					29 01 00 00 14 00 02 28 00
					29 01 00 00 78 00 02 10 00
					];
		qcom,mdss-dsi-CABC_UI_on-command = [
					29 00 00 00 00 00 02 FF 10
					29 00 00 00 00 00 02 FB 01
					29 01 00 00 00 00 02 55 81
					];
		qcom,mdss-dsi-CABC_STILL_on-command = [
					29 00 00 00 00 00 02 FF 10
					29 00 00 00 00 00 02 FB 01
					29 01 00 00 00 00 02 55 82
					];
		qcom,mdss-dsi-CABC_MOVIE_on-command = [
					29 00 00 00 00 00 02 FF 10
					29 00 00 00 00 00 02 FB 01
					29 01 00 00 00 00 02 55 83
					];
		qcom,mdss-dsi-CABC_off-command = [
					29 00 00 00 00 00 02 FF 10
					29 00 00 00 00 00 02 FB 01
					29 01 00 00 00 00 02 55 80
					];
		qcom,mdss-dsi-CE_on-command = [
					29 00 00 00 00 00 02 FF 22
					29 00 00 00 00 00 02 FB 01
					29 00 00 00 00 00 02 53 01
					29 01 00 00 00 00 02 54 01
					29 01 00 00 00 00 02 FF 10
					];
		qcom,mdss-dsi-CE_off-command = [
					29 00 00 00 00 00 02 FF 22
					29 00 00 00 00 00 02 FB 01
					29 00 00 00 00 00 02 53 00
					29 01 00 00 00 00 02 54 00
					29 01 00 00 00 00 02 FF 10
					];
		qcom,mdss-dsi-on-command-state = "dsi_lp_mode";
		qcom,mdss-dsi-off-command-state = "dsi_lp_mode";
		qcom,mdss-dsi-h-sync-pulse = <1>;
		qcom,mdss-dsi-traffic-mode = "burst_mode";
		qcom,mdss-dsi-lane-map = "lane_map_0123";
		qcom,mdss-dsi-bllp-eof-power-mode;
		qcom,mdss-dsi-bllp-power-mode;
		qcom,mdss-dsi-lane-0-state;
		qcom,mdss-dsi-lane-1-state;
		qcom,mdss-dsi-lane-2-state;
		qcom,mdss-dsi-lane-3-state;
		/delete-property/ qcom,mdss-dsi-panel-timings;
		qcom,mdss-dsi-panel-timings-phy-12nm = [
					0b 07 06 03 00 05 03 09];
		qcom,mdss-dsi-t-clk-post = <0x60>;
		qcom,mdss-dsi-t-clk-pre = <0x06>;
		qcom,mdss-dsi-bl-min-level = <1>;
		qcom,mdss-dsi-bl-max-level = <2047>;
		qcom,mdss-brightness-max-level = <2047>;
		qcom,mdss-brightness-max-level-factory = <255>;
		qcom,mdss-dsi-bl-pmic-control-type = "bl_mount";
		qcom,panel-supply-entries = <&dsi_panel_pwr_supply>;
		qcom,mdss-dsi-reset-sequence = <1 20>, <0 10>, <1 20>;
		qcom,esd-check-enabled;
		qcom,mdss-dsi-panel-status-command = [06 01 00 01 05 00 01 0A];
		qcom,mdss-dsi-panel-status-command-mode = "dsi_lp_mode";
		qcom,mdss-dsi-panel-status-check-mode = "reg_read";
		qcom,mdss-dsi-panel-status-read-length = <1>;
		qcom,mdss-dsi-panel-status-valid-params = <1>;
		qcom,mdss-dsi-panel-status-value = <0x9C>;
		qcom,mdss-dsi-panel-max-error-count = <3>;
		qcom,mdss-pan-physical-width-dimension = <68>;
		qcom,mdss-pan-physical-height-dimension = <143>;
	};
};
