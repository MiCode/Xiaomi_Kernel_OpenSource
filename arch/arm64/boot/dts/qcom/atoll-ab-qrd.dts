/* Copyright (c) 2019, The Linux Foundation. All rights reserved.
 *
 * This program is free software; you can redistribute it and/or modify
 * it under the terms of the GNU General Public License version 2 and
 * only version 2 as published by the Free Software Foundation.
 *
 * This program is distributed in the hope that it will be useful,
 * but WITHOUT ANY WARRANTY; without even the implied warranty of
 * MERCHANTABILITY or FITNESS FOR A PARTICULAR PURPOSE.  See the
 * GNU General Public License for more details.
 */

/dts-v1/;

#include "atoll-ab.dtsi"
#include "atoll-qrd.dtsi"

/ {
	model = "Qualcomm Technologies, Inc. ATOLL-AB PM6150 QRD";
	compatible = "qcom,atoll-ab-qrd", "qcom,atoll-ab", "qcom,qrd";
	qcom,board-id = <0x1000B 0>;
};

&tx_swr_gpios {
	qcom,chip-wakeup-reg = <0x01FFB000>;
	qcom,chip-wakeup-maskbit = <0>;
	qcom,chip-wakeup-default-val = <0x1>;
};
