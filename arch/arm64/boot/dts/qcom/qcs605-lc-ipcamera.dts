/*
 * Copyright (c) 2018, The Linux Foundation. All rights reserved.
 *
 * This program is free software; you can redistribute it and/or modify
 * it under the terms of the GNU General Public License version 2 and
 * only version 2 as published by the Free Software Foundation.
 *
 * This program is distributed in the hope that it will be useful,
 * but WITHOUT ANY WARRANTY; without even the implied warranty of
 * MERCHANTABILITY or FITNESS FOR A PARTICULAR PURPOSE.  See the
 * GNU General Public License for more details.
 */


/dts-v1/;

#include "qcs605-lc.dtsi"
#include "qcs605-lc-ipcamera.dtsi"

/ {
	model = "Qualcomm Technologies, Inc. QC605 LC Groot + PM8005 IPC";
	compatible = "qcom,qcs605-mtp", "qcom,qcs605", "qcom,mtp";
	qcom,board-id = <8 6>;
};
