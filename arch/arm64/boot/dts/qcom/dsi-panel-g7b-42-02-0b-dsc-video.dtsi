/* Copyright (c) 2015, The Linux Foundation. All rights reserved.
 * Copyright (C) 2021 XiaoMi, Inc.
 *
 * This program is free software; you can redistribute it and/or modify
 * it under the terms of the GNU General Public License version 2 and
 * only version 2 as published by the Free Software Foundation.
 *
 * This program is distributed in the hope that it will be useful,
 * but WITHOUT ANY WARRANTY; without even the implied warranty of
 * MERCHANTABILITY or FITNESS FOR A PARTICULAR PURPOSE.  See the
 * GNU General Public License for more details.
 */

/*---------------------------------------------------------------------------
 * This file is autogenerated file using gcdb parser. Please do not edit it.
 * Update input XML file to add a new entry or update variable in this file
 * VERSION = "1.0"
 *---------------------------------------------------------------------------*/
&soc {
	dsi_g7b_42_02_0b_video: qcom,mdss_dsi_g7b_42_02_0b_dsc_video {
		qcom,mdss-dsi-panel-name = "xiaomi 42 02 0b video mode dsc dsi panel";
		qcom,mdss-dsi-panel-id = <0>;
		qcom,mdss-dsi-panel-model = "xiaomi 42 02 0b VIDEO PANEL";
		qcom,mdss-dsi-panel-type = "dsi_video_mode";
		qcom,mdss-dsi-virtual-channel-id = <0>;
		qcom,mdss-dsi-stream = <0>;
		qcom,mdss-dsi-bpp = <24>;
		qcom,mdss-dsi-color-order = "rgb_swap_rgb";
		qcom,mdss-dsi-underflow-color = <0x0>;
		qcom,mdss-dsi-border-color = <0>;
		qcom,mdss-dsi-traffic-mode = "burst_mode";
		qcom,mdss-dsi-bllp-eof-power-mode;
		qcom,mdss-dsi-bllp-power-mode;
		qcom,mdss-dsi-lp11-init;
		qcom,mdss-dsi-lane-0-state;
		qcom,mdss-dsi-lane-1-state;
		qcom,mdss-dsi-lane-2-state;
		qcom,mdss-dsi-lane-3-state;
		qcom,mdss-brightness-max-level = <4095>;
		qcom,mdss-dsi-dma-trigger = "trigger_sw";
		qcom,mdss-dsi-mdp-trigger = "none";
		qcom,mdss-dsi-reset-sequence = <0 10>, <1 10>;
		qcom,mdss-pan-physical-width-dimension = <680>;
		qcom,mdss-pan-physical-height-dimension = <1360>;
		qcom,cont-splash-enabled;
		qcom,mdss-dsi-tx-eot-append;
		qcom,dispparam-enabled;
		qcom,mdss-panel-on-dimming-delay = <120>;
		qcom,bl-update-flag = "delay_until_first_frame";
		qcom,disp-panel-offon-mode-enabled;
		qcom,mdss-dsi-panel-hdr-enabled;
		qcom,mdss-dsi-panel-hdr-color-primaries = <14500 15500 32000
			17000 15500 30000 8000 3000>;
		qcom,mdss-dsi-panel-peak-brightness = <4200000>;
		qcom,mdss-dsi-panel-blackness-level = <3230>;
		qcom,mdss-dsi-panel-xy-coordinate = <0x0F 0x18>;
		qcom,mdss-dsi-panel-max-luminance = <0x0F 0x20>;
		qcom,mdss-dsi-panel-max-luminance-valid = <0x01 0x01>;

#if 1
		qcom,mdss-dsi-pan-enable-dynamic-fps;
		qcom,mdss-dsi-pan-enable-smart-fps;
		qcom,mdss-dsi-pan-fps-update =
			"dfps_immediate_porch_mode_vfp";
		qcom,dsi-supported-dfps-list = <30 60 90 120>;
#endif

		qcom,mdss-dsi-display-timings {
			timing@0{
				qcom,mdss-dsi-panel-framerate = <120>;
				qcom,mdss-dsi-panel-width = <1080>;
				qcom,mdss-dsi-panel-height = <2340>;
				qcom,mdss-dsi-h-pulse-width = <12>;
				qcom,mdss-dsi-h-back-porch = <120>;
				qcom,mdss-dsi-h-front-porch = <100>;
				qcom,mdss-dsi-h-sync-skew = <0>;
				qcom,mdss-dsi-v-pulse-width = <2>;
				qcom,mdss-dsi-v-back-porch = <8>;
				qcom,mdss-dsi-v-front-porch = <10>;
				qcom,mdss-dsi-h-left-border = <0>;
				qcom,mdss-dsi-h-right-border = <0>;
				qcom,mdss-dsi-v-top-border = <0>;
				qcom,mdss-dsi-v-bottom-border = <0>;

				qcom,mdss-dsi-on-command = [
						15 01 00 00 00 00 02 FF 10
						15 01 00 00 00 00 02 FB 01
						15 01 00 00 00 00 02 FB 01
						39 01 00 00 00 00 03 C2 1B A0
						15 01 00 00 00 00 02 FF 20
						15 01 00 00 00 00 02 FB 01
						15 01 00 00 00 00 02 FB 01
						15 01 00 00 00 00 02 06 50
						15 01 00 00 00 00 02 07 28
						15 01 00 00 00 00 02 69 EA
						15 01 00 00 00 00 02 95 D1
						15 01 00 00 00 00 02 96 D1
						15 01 00 00 00 00 02 89 0C
						15 01 00 00 00 00 02 8A 0C
						15 01 00 00 00 00 02 FF 24
						15 01 00 00 00 00 02 FB 01
						15 01 00 00 00 00 02 FB 01
						15 01 00 00 00 00 02 01 21
						15 01 00 00 00 00 02 02 21
						15 01 00 00 00 00 02 03 10
						15 01 00 00 00 00 02 04 24
						15 01 00 00 00 00 02 07 01
						15 01 00 00 00 00 02 08 0B
						15 01 00 00 00 00 02 0A 0C
						15 01 00 00 00 00 02 0B 0F
						15 01 00 00 00 00 02 0C 22
						15 01 00 00 00 00 02 0D 2C
						15 01 00 00 00 00 02 0E 2E
						15 01 00 00 00 00 02 0F 30
						15 01 00 00 00 00 02 10 32
						15 01 00 00 00 00 02 12 17
						15 01 00 00 00 00 02 13 17
						15 01 00 00 00 00 02 14 15
						15 01 00 00 00 00 02 15 15
						15 01 00 00 00 00 02 16 13
						15 01 00 00 00 00 02 17 13
						15 01 00 00 00 00 02 19 21
						15 01 00 00 00 00 02 1B 10
						15 01 00 00 00 00 02 1C 24
						15 01 00 00 00 00 02 1D 21
						15 01 00 00 00 00 02 1F 01
						15 01 00 00 00 00 02 20 0B
						15 01 00 00 00 00 02 22 0C
						15 01 00 00 00 00 02 23 0F
						15 01 00 00 00 00 02 24 22
						15 01 00 00 00 00 02 25 2D
						15 01 00 00 00 00 02 26 2F
						15 01 00 00 00 00 02 27 31
						15 01 00 00 00 00 02 28 33
						15 01 00 00 00 00 02 2A 17
						15 01 00 00 00 00 02 2B 17
						15 01 00 00 00 00 02 2D 15
						15 01 00 00 00 00 02 2F 15
						15 01 00 00 00 00 02 30 13
						15 01 00 00 00 00 02 31 13
						15 01 00 00 00 00 02 32 05
						15 01 00 00 00 00 02 33 03
						15 01 00 00 00 00 02 34 03
						15 01 00 00 00 00 02 35 01
						15 01 00 00 00 00 02 36 3C
						15 01 00 00 00 00 02 4E 3B
						15 01 00 00 00 00 02 4F 3B
						15 01 00 00 00 00 02 53 3B
						15 01 00 00 00 00 02 79 22
						15 01 00 00 00 00 02 7B 90
						15 01 00 00 00 00 02 7D 03
						15 01 00 00 00 00 02 80 03
						15 01 00 00 00 00 02 81 03
						15 01 00 00 00 00 02 82 13
						15 01 00 00 00 00 02 84 31
						15 01 00 00 00 00 02 85 04
						15 01 00 00 00 00 02 86 04
						15 01 00 00 00 00 02 87 04
						15 01 00 00 00 00 02 90 13
						15 01 00 00 00 00 02 92 31
						15 01 00 00 00 00 02 93 04
						15 01 00 00 00 00 02 94 04
						15 01 00 00 00 00 02 95 04
						15 01 00 00 00 00 02 9C F4
						15 01 00 00 00 00 02 9D 01
						15 01 00 00 00 00 02 A0 10
						15 01 00 00 00 00 02 A2 10
						15 01 00 00 00 00 02 A4 03
						15 01 00 00 00 00 02 A5 03
						15 01 00 00 00 00 02 C9 0C
						15 01 00 00 00 00 02 D1 34
						15 01 00 00 00 00 02 D9 80
						15 01 00 00 00 00 02 FF 25
						15 01 00 00 00 00 02 FB 01
						15 01 00 00 00 00 02 FB 01
						15 01 00 00 00 00 02 66 5D
						15 01 00 00 00 00 02 67 10
						15 01 00 00 00 00 02 68 58
						15 01 00 00 00 00 02 69 10
						15 01 00 00 00 00 02 6B 00
						15 01 00 00 00 00 02 71 6D
						15 01 00 00 00 00 02 77 72
						15 01 00 00 00 00 02 7E 2D
						15 01 00 00 00 00 02 81 00
						15 01 00 00 00 00 02 84 78
						15 01 00 00 00 00 02 85 75
						15 01 00 00 00 00 02 8D 00
						15 01 00 00 00 00 02 C1 A9
						15 01 00 00 00 00 02 C2 5A
						15 01 00 00 00 00 02 C3 07
						15 01 00 00 00 00 02 EF 08
						15 01 00 00 00 00 02 F1 14
						15 01 00 00 00 00 02 FF 26
						15 01 00 00 00 00 02 FB 01
						15 01 00 00 00 00 02 FB 01
						15 01 00 00 00 00 02 00 10
						15 01 00 00 00 00 02 01 7C
						15 01 00 00 00 00 02 03 00
						15 01 00 00 00 00 02 04 7C
						15 01 00 00 00 00 02 05 08
						15 01 00 00 00 00 02 06 21
						15 01 00 00 00 00 02 08 21
						15 01 00 00 00 00 02 14 02
						15 01 00 00 00 00 02 15 01
						15 01 00 00 00 00 02 74 AF
						15 01 00 00 00 00 02 81 10
						15 01 00 00 00 00 02 83 04
						15 01 00 00 00 00 02 84 02
						15 01 00 00 00 00 02 85 01
						15 01 00 00 00 00 02 86 02
						15 01 00 00 00 00 02 87 01
						15 01 00 00 00 00 02 88 06
						15 01 00 00 00 00 02 8A 1A
						15 01 00 00 00 00 02 8B 11
						15 01 00 00 00 00 02 8C 24
						15 01 00 00 00 00 02 8E 42
						15 01 00 00 00 00 02 8F 11
						15 01 00 00 00 00 02 90 11
						15 01 00 00 00 00 02 91 11
						15 01 00 00 00 00 02 9A 80
						15 01 00 00 00 00 02 9B 42
						15 01 00 00 00 00 02 9C 00
						15 01 00 00 00 00 02 9D 00
						15 01 00 00 00 00 02 9E 00
						15 01 00 00 00 00 02 FF 27
						15 01 00 00 00 00 02 FB 01
						15 01 00 00 00 00 02 FB 01
						15 01 00 00 00 00 02 20 81
						15 01 00 00 00 00 02 21 82
						15 01 00 00 00 00 02 25 81
						15 01 00 00 00 00 02 26 AB
						15 01 00 00 00 00 02 6E 12
						15 01 00 00 00 00 02 6F 00
						15 01 00 00 00 00 02 70 00
						15 01 00 00 00 00 02 71 00
						15 01 00 00 00 00 02 72 00
						15 01 00 00 00 00 02 73 76
						15 01 00 00 00 00 02 74 10
						15 01 00 00 00 00 02 75 32
						15 01 00 00 00 00 02 76 54
						15 01 00 00 00 00 02 77 00
						15 01 00 00 00 00 02 7D 09
						15 01 00 00 00 00 02 7E 27
						15 01 00 00 00 00 02 80 27
						15 01 00 00 00 00 02 82 09
						15 01 00 00 00 00 02 83 27
						15 01 00 00 00 00 02 88 03
						15 01 00 00 00 00 02 89 03
						15 01 00 00 00 00 02 FF 2A
						15 01 00 00 00 00 02 FB 01
						15 01 00 00 00 00 02 FB 01
						15 01 00 00 00 00 02 06 07
						15 01 00 00 00 00 02 0A 60
						15 01 00 00 00 00 02 15 07
						15 01 00 00 00 00 02 16 C3
						15 01 00 00 00 00 02 1A 40
						15 01 00 00 00 00 02 1B 0A
						15 01 00 00 00 00 02 1D 0A
						15 01 00 00 00 00 02 1E 42
						15 01 00 00 00 00 02 1F 42
						15 01 00 00 00 00 02 20 42
						15 01 00 00 00 00 02 37 70
						15 01 00 00 00 00 02 44 4C
						15 01 00 00 00 00 02 4A F0
						15 01 00 00 00 00 02 4E 04
						15 01 00 00 00 00 02 4F 04
						15 01 00 00 00 00 02 57 43
						15 01 00 00 00 00 02 58 43
						15 01 00 00 00 00 02 59 43
						15 01 00 00 00 00 02 62 1C
						15 01 00 00 00 00 02 63 4C
						15 01 00 00 00 00 02 79 4C
						15 01 00 00 00 00 02 7A 09
						15 01 00 00 00 00 02 7C 01
						15 01 00 00 00 00 02 7F F0
						15 01 00 00 00 00 02 83 04
						15 01 00 00 00 00 02 84 04
						15 01 00 00 00 00 02 8C 43
						15 01 00 00 00 00 02 8D 43
						15 01 00 00 00 00 02 8E 43
						15 01 00 00 00 00 02 97 1C
						15 01 00 00 00 00 02 98 4C
						15 01 00 00 00 00 02 A9 A0
						15 01 00 00 00 00 02 DE A0
						15 01 00 00 00 00 02 FF 2C
						15 01 00 00 00 00 02 FB 01
						15 01 00 00 00 00 02 FB 01
						15 01 00 00 00 00 02 03 0F
						15 01 00 00 00 00 02 04 0F
						15 01 00 00 00 00 02 05 0F
						15 01 00 00 00 00 02 0D 01
						15 01 00 00 00 00 02 0E 3C
						15 01 00 00 00 00 02 17 3B
						15 01 00 00 00 00 02 18 3B
						15 01 00 00 00 00 02 19 3B
						15 01 00 00 00 00 02 2F 10
						15 01 00 00 00 00 02 30 40
						15 01 00 00 00 00 02 32 00
						15 01 00 00 00 00 02 33 40
						15 01 00 00 00 00 02 35 21
						15 01 00 00 00 00 02 37 21
						15 01 00 00 00 00 02 3A 01
						15 01 00 00 00 00 02 3B 01
						15 01 00 00 00 00 02 4D 0F
						15 01 00 00 00 00 02 4E 04
						15 01 00 00 00 00 02 4F 0A
						15 01 00 00 00 00 02 56 0F
						15 01 00 00 00 00 02 58 0F
						15 01 00 00 00 00 02 59 0F
						15 01 00 00 00 00 02 61 01
						15 01 00 00 00 00 02 62 3C
						15 01 00 00 00 00 02 6B 3B
						15 01 00 00 00 00 02 6C 3B
						15 01 00 00 00 00 02 6D 3B
						15 01 00 00 00 00 02 81 10
						15 01 00 00 00 00 02 82 40
						15 01 00 00 00 00 02 84 00
						15 01 00 00 00 00 02 85 40
						15 01 00 00 00 00 02 87 21
						15 01 00 00 00 00 02 89 21
						15 01 00 00 00 00 02 8C 01
						15 01 00 00 00 00 02 8D 01
						15 01 00 00 00 00 02 9D 0F
						15 01 00 00 00 00 02 9E 04
						15 01 00 00 00 00 02 9F 0A
						15 01 00 00 00 00 02 FF E0
						15 01 00 00 00 00 02 FB 01
						15 01 00 00 00 00 02 FB 01
						15 01 00 00 00 00 02 FF F0
						15 01 00 00 00 00 02 FB 01
						15 01 00 00 00 00 02 FB 01
						15 01 00 00 00 00 02 FF D0
						15 01 00 00 00 00 02 FB 01
						15 01 00 00 00 00 02 FB 01
						//page selection cmd start
						15 01 00 00 00 00 02 FF 20
						15 01 00 00 00 00 02 FB 01
						15 01 00 00 00 00 02 FB 01
						//page selection cmd end
						//R(+) MCR cmd
						39 01 00 00 00 00 11 B0 00 00 00 17 00 3A 00 55 00 6D 00 81 00 94 00 A5
						39 01 00 00 00 00 11 B1 00 B5 00 EA 01 11 01 50 01 7E 01 CA 02 03 02 05
						39 01 00 00 00 00 11 B2 02 3E 02 7F 02 AC 02 E3 03 09 03 37 03 47 03 56
						39 01 00 00 00 00 0D B3 03 69 03 7F 03 9B 03 BB 03 D4 03 D8
						//G(+) MCR cmd
						39 01 00 00 00 00 11 B4 00 00 00 17 00 3A 00 55 00 6D 00 81 00 94 00 A5
						39 01 00 00 00 00 11 B5 00 B5 00 EA 01 11 01 50 01 7E 01 CA 02 03 02 05
						39 01 00 00 00 00 11 B6 02 3E 02 7F 02 AC 02 E3 03 09 03 37 03 47 03 56
						39 01 00 00 00 00 0D B7 03 69 03 7F 03 9B 03 BB 03 D4 03 D8
						//B(+) MCR cmd
						39 01 00 00 00 00 11 B8 00 00 00 17 00 3A 00 55 00 6D 00 81 00 94 00 A5
						39 01 00 00 00 00 11 B9 00 B5 00 EA 01 11 01 50 01 7E 01 CA 02 03 02 05
						39 01 00 00 00 00 11 BA 02 3E 02 7F 02 AC 02 E3 03 09 03 37 03 47 03 56
						39 01 00 00 00 00 0D BB 03 69 03 7F 03 9B 03 BB 03 D4 03 D8
						//page selection cmd start
						15 01 00 00 00 00 02 FF 21
						15 01 00 00 00 00 02 FB 01
						15 01 00 00 00 00 02 FB 01
						//page selection cmd end
						//R(-) MCR cmd
						39 01 00 00 00 00 11 B0 00 00 00 17 00 3A 00 55 00 6D 00 81 00 94 00 A5
						39 01 00 00 00 00 11 B1 00 B5 00 EA 01 11 01 50 01 7E 01 CA 02 03 02 05
						39 01 00 00 00 00 11 B2 02 3E 02 7F 02 AC 02 E3 03 09 03 37 03 47 03 56
						39 01 00 00 00 00 0D B3 03 69 03 7F 03 9B 03 BB 03 D4 03 D8
						//G(-) MCR cmd
						39 01 00 00 00 00 11 B4 00 00 00 17 00 3A 00 55 00 6D 00 81 00 94 00 A5
						39 01 00 00 00 00 11 B5 00 B5 00 EA 01 11 01 50 01 7E 01 CA 02 03 02 05
						39 01 00 00 00 00 11 B6 02 3E 02 7F 02 AC 02 E3 03 09 03 37 03 47 03 56
						39 01 00 00 00 00 0D B7 03 69 03 7F 03 9B 03 BB 03 D4 03 D8
						//B(-) MCR cmd
						39 01 00 00 00 00 11 B8 00 00 00 17 00 3A 00 55 00 6D 00 81 00 94 00 A5
						39 01 00 00 00 00 11 B9 00 B5 00 EA 01 11 01 50 01 7E 01 CA 02 03 02 05
						39 01 00 00 00 00 11 BA 02 3E 02 7F 02 AC 02 E3 03 09 03 37 03 47 03 56
						39 01 00 00 00 00 0D BB 03 69 03 7F 03 9B 03 BB 03 D4 03 D8

						15 01 00 00 00 00 02 FF 10
						15 01 00 00 00 00 02 FB 01
						15 01 00 00 00 00 02 FB 01
						15 01 00 00 00 00 02 51 ff
						15 01 00 00 00 00 02 53 2c
						15 01 00 00 00 00 02 55 01
						05 01 00 00 78 00 02 11 00
						05 01 00 00 00 00 02 29 00];
				qcom,mdss-dsi-off-command = [
						05 01 00 00 00 00 02 28 00
						05 01 00 00 46 00 02 10 00];
				qcom,mdss-dsi-displayoff-command = [05 01 00 00 20 00 02 28 00];
				qcom,mdss-dsi-displayon-command = [05 01 00 00 14 00 02 29 00];
				qcom,mdss-dsi-on-command-state = "dsi_lp_mode";
				qcom,mdss-dsi-off-command-state = "dsi_hs_mode";
				qcom,mdss-dsi-displayoff-command-state = "dsi_hs_mode";
				qcom,mdss-dsi-displayon-command-state = "dsi_hs_mode";
				qcom,mdss-dsi-h-sync-pulse = <1>;

				qcom,compression-mode = "dsc";
				qcom,mdss-dsc-version = <0x11>;
				qcom,mdss-dsc-scr-version = <0x0>;
				qcom,mdss-dsc-slice-height = <20>;
				qcom,mdss-dsc-slice-width = <540>;
				qcom,mdss-dsc-slice-per-pkt = <2>;
				qcom,mdss-dsc-bit-per-component = <8>;
				qcom,mdss-dsc-bit-per-pixel = <8>;
				qcom,mdss-dsc-block-prediction-enable;
			};
		};
	};
};

