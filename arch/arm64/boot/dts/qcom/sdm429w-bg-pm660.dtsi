/*
 * Copyright (c) 2019-2020, The Linux Foundation. All rights reserved.
 *
 * This program is free software; you can redistribute it and/or modify
 * it under the terms of the GNU General Public License version 2 and
 * only version 2 as published by the Free Software Foundation.
 *
 * This program is distributed in the hope that it will be useful,
 * but WITHOUT ANY WARRANTY; without even the implied warranty of
 * MERCHANTABILITY or FITNESS FOR A PARTICULAR PURPOSE.  See the
 * GNU General Public License for more details.
 */

#include "sdm429w-pm660.dtsi"

&pm660_misc {
	qcom,support-twm-config;
};

&pm660_pbs {
	status = "okay";
};

&pm660_pon {
	qcom,support-twm-config;
	qcom,pbs-client = <&pm660_pbs>;
};

&pm660_fg {
	qcom,fg-disable-in-twm;
};
