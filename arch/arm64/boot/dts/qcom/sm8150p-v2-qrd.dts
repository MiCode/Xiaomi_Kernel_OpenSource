/* Copyright (c) 2018, The Linux Foundation. All rights reserved.
 *
 * This program is free software; you can redistribute it and/or modify
 * it under the terms of the GNU General Public License version 2 and
 * only version 2 as published by the Free Software Foundation.
 *
 * This program is distributed in the hope that it will be useful,
 * but WITHOUT ANY WARRANTY; without even the implied warranty of
 * MERCHANTABILITY or FITNESS FOR A PARTICULAR PURPOSE.  See the
 * GNU General Public License for more details.
 */

/dts-v1/;

#include "sm8150p-v2.dtsi"
#include "sm8150-qrd.dtsi"

/ {
	model = "Qualcomm Technologies, Inc. SM8150P V2 QRD";
	compatible = "qcom,sm8150p-qrd", "qcom,sm8150p", "qcom,qrd";
	qcom,board-id = <11 0>;
};
