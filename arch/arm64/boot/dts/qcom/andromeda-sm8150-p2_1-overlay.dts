/* Copyright (c) 2017-2018, The Linux Foundation. All rights reserved.
 * Copyright (C) 2019 XiaoMi, Inc.
 *
 * This program is free software; you can redistribute it and/or modify
 * it under the terms of the GNU General Public License version 2 and
 * only version 2 as published by the Free Software Foundation.
 *
 * This program is distributed in the hope that it will be useful,
 * but WITHOUT ANY WARRANTY; without even the implied warranty of
 * MERCHANTABILITY or FITNESS FOR A PARTICULAR PURPOSE.  See the
 * GNU General Public License for more details.
 */

/dts-v1/;
/plugin/;

#include <dt-bindings/clock/qcom,gcc-sm8150.h>
#include <dt-bindings/clock/qcom,camcc-sm8150.h>
#include <dt-bindings/clock/qcom,rpmh.h>
#include <dt-bindings/interrupt-controller/arm-gic.h>

#include "andromeda-audio-overlay.dtsi"

#include "andromeda-sm8150-p2_1.dtsi"
#include "andromeda-pinctrl-p2_1.dtsi"

#include "sdx5xm-external-soc.dtsi"
#include "sm8150-sdx50m.dtsi"

/ {
	model = "SDX50M ANDROMEDA";
	compatible = "qcom,sm8150-mtp", "qcom,sm8150", "qcom,mtp";
	qcom,board-id = <0x2c 0x1>;

};

