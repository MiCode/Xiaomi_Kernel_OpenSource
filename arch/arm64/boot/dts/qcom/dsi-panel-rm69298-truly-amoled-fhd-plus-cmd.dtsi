/* Copyright (c) 2018, The Linux Foundation. All rights reserved.
 *
 * This program is free software; you can redistribute it and/or modify
 * it under the terms of the GNU General Public License version 2 and
 * only version 2 as published by the Free Software Foundation.
 *
 * This program is distributed in the hope that it will be useful,
 * but WITHOUT ANY WARRANTY; without even the implied warranty of
 * MERCHANTABILITY or FITNESS FOR A PARTICULAR PURPOSE.  See the
 * GNU General Public License for more details.
 */

&mdss_mdp {
	dsi_rm69298_truly_amoled_cmd: qcom,mdss_dsi_rm69298_truly_amoled_cmd {
		qcom,mdss-dsi-panel-name =
			"rm69298 amoled fhd+ cmd mode dsi truly panel";
		qcom,mdss-dsi-panel-type = "dsi_cmd_mode";

		qcom,mdss-dsi-virtual-channel-id = <0>;
		qcom,mdss-dsi-stream = <0>;
		qcom,mdss-dsi-bpp = <24>;
		qcom,mdss-dsi-color-order = "rgb_swap_rgb";
		qcom,mdss-dsi-underflow-color = <0xff>;
		qcom,mdss-dsi-border-color = <0>;
		qcom,mdss-dsi-h-sync-pulse = <0>;
		qcom,mdss-dsi-traffic-mode = "non_burst_sync_event";
		qcom,mdss-dsi-lane-map = "lane_map_0123";
		qcom,mdss-dsi-bllp-eof-power-mode;
		qcom,mdss-dsi-bllp-power-mode;
		qcom,mdss-dsi-tx-eot-append;
		qcom,mdss-dsi-lane-0-state;
		qcom,mdss-dsi-lane-1-state;
		qcom,mdss-dsi-lane-2-state;
		qcom,mdss-dsi-lane-3-state;
		qcom,mdss-dsi-dma-trigger = "trigger_sw";
		qcom,mdss-dsi-mdp-trigger = "none";
		qcom,mdss-dsi-lp11-init;
		qcom,mdss-dsi-bl-pmic-control-type = "bl_ctrl_dcs";
		qcom,mdss-dsi-reset-sequence = <1 10>, <0 10>, <1 10>;
		qcom,mdss-dsi-te-pin-select = <1>;
		qcom,mdss-dsi-wr-mem-start = <0x2c>;
		qcom,mdss-dsi-wr-mem-continue = <0x3c>;
		qcom,mdss-dsi-te-dcs-command = <1>;
		qcom,mdss-dsi-te-check-enable;
		qcom,mdss-dsi-te-using-te-pin;

		qcom,mdss-dsi-display-timings {
			timing@0 {
				qcom,mdss-dsi-panel-width = <1080>;
				qcom,mdss-dsi-panel-height = <2160>;
				qcom,mdss-dsi-h-front-porch = <30>;
				qcom,mdss-dsi-h-back-porch = <40>;
				qcom,mdss-dsi-h-pulse-width = <10>;
				qcom,mdss-dsi-h-sync-skew = <0>;
				qcom,mdss-dsi-v-back-porch = <16>;
				qcom,mdss-dsi-v-front-porch = <8>;
				qcom,mdss-dsi-v-pulse-width = <4>;
				qcom,mdss-dsi-panel-framerate = <60>;
				qcom,mdss-dsi-on-command = [
					15 01 00 00 00 00 02 FE 40
					15 01 00 00 00 00 02 0A 15
					15 01 00 00 00 00 02 0B CC
					15 01 00 00 00 00 02 0C 15
					15 01 00 00 00 00 02 0D 80
					15 01 00 00 00 00 02 0F 87
					15 01 00 00 00 00 02 05 08
					15 01 00 00 00 00 02 06 08
					15 01 00 00 00 00 02 08 08
					15 01 00 00 00 00 02 09 08
					15 01 00 00 00 00 02 16 15
					15 01 00 00 00 00 02 20 8D
					15 01 00 00 00 00 02 21 8D
					15 01 00 00 00 00 02 24 55
					15 01 00 00 00 00 02 26 55
					15 01 00 00 00 00 02 28 55
					15 01 00 00 00 00 02 2A 55
					15 01 00 00 00 00 02 2D 28
					15 01 00 00 00 00 02 2F 28
					15 01 00 00 00 00 02 30 1E
					15 01 00 00 00 00 02 31 1E
					15 01 00 00 00 00 02 37 80
					15 01 00 00 00 00 02 38 40
					15 01 00 00 00 00 02 39 90
					15 01 00 00 00 00 02 46 43
					15 01 00 00 00 00 02 47 43
					15 01 00 00 00 00 02 64 02
					15 01 00 00 00 00 02 6F 02
					15 01 00 00 00 00 02 74 2F
					15 01 00 00 00 00 02 80 16
					15 01 00 00 00 00 02 4E 01
					15 01 00 00 00 00 02 FE A0
					15 01 00 00 00 00 02 2B 22
					15 01 00 00 00 00 02 16 00
					15 01 00 00 00 00 02 2F 35
					15 01 00 00 00 00 02 FE 60
					15 01 00 00 00 00 02 00 AC
					15 01 00 00 00 00 02 01 0F
					15 01 00 00 00 00 02 02 FF
					15 01 00 00 00 00 02 03 05
					15 01 00 00 00 00 02 04 00
					15 01 00 00 00 00 02 05 06
					15 01 00 00 00 00 02 06 00
					15 01 00 00 00 00 02 07 00
					15 01 00 00 00 00 02 09 C0
					15 01 00 00 00 00 02 0A 00
					15 01 00 00 00 00 02 0B 02
					15 01 00 00 00 00 02 0C 00
					15 01 00 00 00 00 02 0E 00
					15 01 00 00 00 00 02 0E 04
					15 01 00 00 00 00 02 0F 0E
					15 01 00 00 00 00 02 10 A2
					15 01 00 00 00 00 02 12 C0
					15 01 00 00 00 00 02 13 00
					15 01 00 00 00 00 02 14 02
					15 01 00 00 00 00 02 15 00
					15 01 00 00 00 00 02 16 00
					15 01 00 00 00 00 02 17 05
					15 01 00 00 00 00 02 18 0E
					15 01 00 00 00 00 02 19 A2
					15 01 00 00 00 00 02 1b C0
					15 01 00 00 00 00 02 1c 00
					15 01 00 00 00 00 02 1d 04
					15 01 00 00 00 00 02 1E 01
					15 01 00 00 00 00 02 1F 00
					15 01 00 00 00 00 02 20 04
					15 01 00 00 00 00 02 21 24
					15 01 00 00 00 00 02 22 99
					15 01 00 00 00 00 02 24 C0
					15 01 00 00 00 00 02 25 00
					15 01 00 00 00 00 02 26 04
					15 01 00 00 00 00 02 27 01
					15 01 00 00 00 00 02 28 00
					15 01 00 00 00 00 02 29 06
					15 01 00 00 00 00 02 2a 24
					15 01 00 00 00 00 02 2b 99
					15 01 00 00 00 00 02 83 CA
					15 01 00 00 00 00 02 84 0F
					15 01 00 00 00 00 02 85 FF
					15 01 00 00 00 00 02 86 0A
					15 01 00 00 00 00 02 87 00
					15 01 00 00 00 00 02 88 08
					15 01 00 00 00 00 02 89 00
					15 01 00 00 00 00 02 8A 00
					15 01 00 00 00 00 02 8B 80
					15 01 00 00 00 00 02 C7 1F
					15 01 00 00 00 00 02 C8 00
					15 01 00 00 00 00 02 C9 01
					15 01 00 00 00 00 02 CA 1F
					15 01 00 00 00 00 02 CB 02
					15 01 00 00 00 00 02 CC 1F
					15 01 00 00 00 00 02 CD 1F
					15 01 00 00 00 00 02 CE 1F
					15 01 00 00 00 00 02 CF 1F
					15 01 00 00 00 00 02 D0 1F
					15 01 00 00 00 00 02 D1 1F
					15 01 00 00 00 00 02 D2 1F
					15 01 00 00 00 00 02 D3 1F
					15 01 00 00 00 00 02 D4 1F
					15 01 00 00 00 00 02 D5 1F
					15 01 00 00 00 00 02 D6 1F
					15 01 00 00 00 00 02 D7 1F
					15 01 00 00 00 00 02 D8 1F
					15 01 00 00 00 00 02 D9 1F
					15 01 00 00 00 00 02 DA 1F
					15 01 00 00 00 00 02 DB 1F
					15 01 00 00 00 00 02 DC 00
					15 01 00 00 00 00 02 DD 0E
					15 01 00 00 00 00 02 DE 1F
					15 01 00 00 00 00 02 DF 03
					15 01 00 00 00 00 02 E0 04
					15 01 00 00 00 00 02 E1 1F
					15 01 00 00 00 00 02 E2 01
					15 01 00 00 00 00 02 E3 02
					15 01 00 00 00 00 02 E4 1F
					15 01 00 00 00 00 02 E5 1F
					15 01 00 00 00 00 02 E6 1F
					15 01 00 00 00 00 02 E7 1F
					15 01 00 00 00 00 02 E8 1F
					15 01 00 00 00 00 02 E9 1F
					15 01 00 00 00 00 02 EA 1F
					15 01 00 00 00 00 02 EB 1F
					15 01 00 00 00 00 02 EC 1F
					15 01 00 00 00 00 02 ED 1F
					15 01 00 00 00 00 02 EE 1F
					15 01 00 00 00 00 02 EF 03
					15 01 00 00 00 00 02 FE E0
					15 01 00 00 00 00 02 C6 15
					15 01 00 00 00 00 02 C9 9E
					15 01 00 00 00 00 02 CB 3F
					15 01 00 00 00 00 02 D1 0F
					15 01 00 00 00 00 02 D3 15
					15 01 00 00 00 00 02 D4 15
					15 01 00 00 00 00 02 D5 00
					15 01 00 00 00 00 02 FE 90
					15 01 00 00 00 00 02 C8 00
					15 01 00 00 00 00 02 FE E0
					15 01 00 00 00 00 02 09 00
					15 01 00 00 00 00 02 FE 70
					15 01 00 00 00 00 02 A9 40
					15 01 00 00 00 00 02 CB 05
					15 01 00 00 00 00 02 FE 70
					15 01 00 00 00 00 02 5A FF
					15 01 00 00 00 00 02 5C FF
					15 01 00 00 00 00 02 5D 0A
					15 01 00 00 00 00 02 7D 31
					15 01 00 00 00 00 02 7E 4A
					15 01 00 00 00 00 02 52 80
					15 01 00 00 00 00 02 49 05
					15 01 00 00 00 00 02 4A 2E
					15 01 00 00 00 00 02 4B 58
					15 01 00 00 00 00 02 4C 77
					15 01 00 00 00 00 02 4D A1
					15 01 00 00 00 00 02 4E DE
					15 01 00 00 00 00 02 4F 2C
					15 01 00 00 00 00 02 50 97
					15 01 00 00 00 00 02 51 2A
					15 01 00 00 00 00 02 AD EC
					15 01 00 00 00 00 02 AE 80
					15 01 00 00 00 00 02 AF 00
					15 01 00 00 00 00 02 B0 50
					15 01 00 00 00 00 02 B1 3A
					15 01 00 00 00 00 02 FE 90
					15 01 00 00 00 00 02 56 91
					15 01 00 00 00 00 02 58 04
					15 01 00 00 00 00 02 59 24
					15 01 00 00 00 00 02 5A 05
					15 01 00 00 00 00 02 5B C6
					15 01 00 00 00 00 02 5C 05
					15 01 00 00 00 00 02 5D 66
					15 01 00 00 00 00 02 5E 06
					15 01 00 00 00 00 02 5F 17
					15 01 00 00 00 00 02 60 07
					15 01 00 00 00 00 02 61 CF
					15 01 00 00 00 00 02 62 07
					15 01 00 00 00 00 02 63 98
					15 01 00 00 00 00 02 64 08
					15 01 00 00 00 00 02 65 65
					15 01 00 00 00 00 02 66 09
					15 01 00 00 00 00 02 67 37
					15 01 00 00 00 00 02 68 0A
					15 01 00 00 00 00 02 6B 02
					15 01 00 00 00 00 02 6C 0C
					15 01 00 00 00 00 02 71 02
					15 01 00 00 00 00 02 72 0F
					15 01 00 00 00 00 02 73 93
					15 01 00 00 00 00 02 74 0F
					15 01 00 00 00 00 02 FE 20
					15 01 00 00 00 00 02 98 CF
					15 01 00 00 00 00 02 FE 20
					15 01 00 00 00 00 02 72 11
					15 01 00 00 00 00 02 B4 31
					15 01 00 00 00 00 02 B7 42
					15 01 00 00 00 00 02 AA 03
					15 01 00 00 00 00 02 09 13
					15 01 00 00 00 00 02 FE 20
					15 01 00 00 00 00 02 01 41
					15 01 00 00 00 00 02 02 00
					15 01 00 00 00 00 02 03 00
					15 01 00 00 00 00 02 04 FF
					15 01 00 00 00 00 02 05 00
					15 01 00 00 00 00 02 06 C0
					15 01 00 00 00 00 02 07 40
					15 01 00 00 00 00 02 08 20
					15 01 00 00 00 00 02 19 E0
					15 01 00 00 00 00 02 1A 40
					15 01 00 00 00 00 02 1B 00
					15 01 00 00 00 00 02 1C 80
					15 01 00 00 00 00 02 60 40
					15 01 00 00 00 00 02 61 40
					15 01 00 00 00 00 02 62 40
					15 01 00 00 00 00 02 63 40
					15 01 00 00 00 00 02 64 40
					15 01 00 00 00 00 02 65 40
					15 01 00 00 00 00 02 72 11
					15 01 00 00 00 00 02 73 00
					15 01 00 00 00 00 02 74 02
					15 01 00 00 00 00 02 75 10
					15 01 00 00 00 00 02 76 14
					15 01 00 00 00 00 02 77 1C
					15 01 00 00 00 00 02 78 20
					15 01 00 00 00 00 02 79 0A
					15 01 00 00 00 00 02 7A 00
					15 01 00 00 00 00 02 7B 00
					15 01 00 00 00 00 02 7C 00
					15 01 00 00 00 00 02 7D 00
					15 01 00 00 00 00 02 7E 00
					15 01 00 00 00 00 02 7F 00
					15 01 00 00 00 00 02 80 00
					15 01 00 00 00 00 02 81 00
					15 01 00 00 00 00 02 82 00
					15 01 00 00 00 00 02 83 00
					15 01 00 00 00 00 02 84 00
					15 01 00 00 00 00 02 85 00
					15 01 00 00 00 00 02 86 20
					15 01 00 00 00 00 02 87 0A
					15 01 00 00 00 00 02 88 02
					15 01 00 00 00 00 02 89 2B
					15 01 00 00 00 00 02 8A 14
					15 01 00 00 00 00 02 8B 01
					15 01 00 00 00 00 02 8C 00
					15 01 00 00 00 00 02 8D 00
					15 01 00 00 00 00 02 8E 00
					15 01 00 00 00 00 02 8F 00
					15 01 00 00 00 00 02 90 00
					15 01 00 00 00 00 02 91 00
					15 01 00 00 00 00 02 92 00
					15 01 00 00 00 00 02 93 00
					15 01 00 00 00 00 02 94 00
					15 01 00 00 00 00 02 95 00
					15 01 00 00 00 00 02 96 00
					15 01 00 00 00 00 02 B2 40
					15 01 00 00 00 00 02 B7 42
					15 01 00 00 00 00 02 B8 D0
					15 01 00 00 00 00 02 B9 06
					15 01 00 00 00 00 02 BA 00
					15 01 00 00 00 00 02 FE 00
					39 01 00 00 00 00 05 51 00 00 FF FF
					15 01 00 00 00 00 02 C2 08
					15 01 00 00 00 00 02 35 00
					05 01 00 00 96 00 01 11
					05 01 00 00 32 00 01 29];
				qcom,mdss-dsi-off-command = [
					05 01 00 00 32 00 02 28 00
					05 01 00 00 96 00 02 10 00];
				qcom,mdss-dsi-on-command-state = "dsi_lp_mode";
				qcom,mdss-dsi-off-command-state = "dsi_hs_mode";
			};
		};
	};
};
