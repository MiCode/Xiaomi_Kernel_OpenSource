/* Copyright (c) 2017, The Linux Foundation. All rights reserved.
 * Copyright (C) 2018 XiaoMi, Inc.
 *
 * This program is free software; you can redistribute it and/or modify
 * it under the terms of the GNU General Public License version 2 and
 * only version 2 as published by the Free Software Foundation.
 *
 * This program is distributed in the hope that it will be useful,
 * but WITHOUT ANY WARRANTY; without even the implied warranty of
 * MERCHANTABILITY or FITNESS FOR A PARTICULAR PURPOSE.  See the
 * GNU General Public License for more details.
 */

/dts-v1/;

#include "sdm845-v2.1.dtsi"
#include "sdm845-sde-display.dtsi"
#include "dipper-p2-pinctrl.dtsi"
#include "dipper-p2.dtsi"
#include "dipper-audio-overlay.dtsi"

/ {
	model = "Xiaomi Technologies, Inc. Dipper new P2 v2.1";
	compatible = "qcom,sdm845-mtp", "qcom,sdm845", "qcom,mtp";
	qcom,board-id = <54 0>;
};
