// SPDX-License-Identifier: GPL-2.0-only
/*
 * Copyright (c) 2019, The Linux Foundation. All rights reserved.
 */

/dts-v1/;

#include "lito.dtsi"
#include "lito-cdp.dtsi"

/ {
	model = "Qualcomm Technologies, Inc. Lito CDP";
	compatible = "qcom,lito-cdp", "qcom,lito", "qcom,cdp";
	qcom,board-id = <1 0>;
};
