/* Copyright (c) 2018-2019, The Linux Foundation. All rights reserved.
 *
 * This program is free software; you can redistribute it and/or modify
 * it under the terms of the GNU General Public License version 2 and
 * only version 2 as published by the Free Software Foundation.
 *
 * This program is distributed in the hope that it will be useful,
 * but WITHOUT ANY WARRANTY; without even the implied warranty of
 * MERCHANTABILITY or FITNESS FOR A PARTICULAR PURPOSE.  See the
 * GNU General Public License for more details.
 */

#include "sa8155-adp-common.dtsi"
#include "sa8155-adp-star-display.dtsi"

&pcie1 {
	qcom,boot-option = <0x0>;
};

&pcie_rc1 {
	nvme_x8: qcom,nvme@pcie_rc1 {
		reg = <0 0 0 0 0>;
		compatible = "qcom,nvme";
		pci-ids =
			"8086:0953",
			"8086:0a54",
			"8086:0a55",
			"8086:f1a5",
			"8086:f1a5",
			"1c58:0003",
			"1c58:0023",
			"1c5c:1327",
			"1c5f:0540",
			"144d:a821",
			"144d:a822",
			"144d:a808",
			"1d1d:1f1f",
			"1d1d:2807",
			"1d1d:2601",
			"106b:2001",
			"106b:2003",
			"1179:0115",
			"1179:0116";

		qcom,smmu;
		qcom,smmu-iova-base = /bits/ 64 <0x20000000>;
		qcom,smmu-iova-size = /bits/ 64 <0x40000000>;

		qcom,smmu-attr-atomic;
		qcom,smmu-attr-s1-bypass;
	};
};
