/*
 * Copyright (c) 2018, The Linux Foundation. All rights reserved.
 * This program is free software; you can redistribute it and/or modify
 * it under the terms of the GNU General Public License version 2 and
 * only version 2 as published by the Free Software Foundation.
 *
 * This program is distributed in the hope that it will be useful,
 * but WITHOUT ANY WARRANTY; without even the implied warranty of
 * MERCHANTABILITY or FITNESS FOR A PARTICULAR PURPOSE.  See the
 *GNU General Public License for more details.
 */

qcom,mlp466076_3250mah_averaged_masterslave_jun15th2018 {
	/* #mlp466076_3250mAh_averaged_MasterSlave_Jun15th2018 */
	qcom,max-voltage-uv = <4400000>;
	qcom,nom-batt-capacity-mah = <3250>;
	qcom,fastchg-current-ma = <6000>;
	qcom,jeita-fcc-ranges = <0  150  650000
				151 450  4875000
				451 550  1625000>;
	qcom,jeita-fv-ranges =  <0   150 4150000
				151 450 4400000
				451 550 4150000>;
	qcom,batt-id-kohm = <133>;
	qcom,battery-beta = <4250>;
	qcom,fg-cc-cv-threshold-mv = <4390>;
	qcom,battery-type = "mlp466076_3250mah_jun15th2018";
	qcom,checksum = <0x8905>;
	qcom,gui-version = "PM660GUI - 0.0.0.45";
	qcom,fg-profile-data = [
		5E 21 D2 0D
		E3 0B 04 05
		EC 1C 8B 01
		4F 05 31 03
		80 18 D2 22
		C2 45 73 52
		90 00 00 00
		13 00 00 00
		00 00 82 C3
		A3 CC 92 BC
		2F 00 08 00
		14 DA CE E5
		B0 04 41 02
		C5 F4 C4 12
		0C 07 3F 32
		2B 06 09 20
		27 00 14 00
		4C 20 E0 04
		1A 0B A1 05
		C4 1C E7 02
		3E 0C 02 12
		9D 18 4C 23
		DC 44 15 5A
		70 00 00 00
		10 00 00 00
		00 00 F6 07
		1D CB 02 B4
		20 00 00 00
		5B E3 CE E5
		C8 05 54 01
		A6 06 BD FB
		35 F4 47 23
		C5 33 CC FF
		07 10 00 00
		38 0D 66 46
		20 00 40 00
		61 01 0A FA
		FF 00 00 00
		00 00 00 00
		00 00 00 00
		00 00 00 00
		00 00 00 00
		00 00 00 00
		00 00 00 00
		00 00 00 00
		00 00 00 00
		00 00 00 00
		00 00 00 00
		00 00 00 00
		00 00 00 00
		00 00 00 00
		00 00 00 00
		00 00 00 00
		00 00 00 00
		00 00 00 00
		00 00 00 00
	];
};
