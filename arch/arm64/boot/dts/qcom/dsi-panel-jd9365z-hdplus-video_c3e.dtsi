/* Copyright (c) 2013, The Linux Foundation. All rights reserved.
 * Copyright (C) 2021 XiaoMi, Inc.
 *
 * This program is free software; you can redistribute it and/or modify
 * it under the terms of the GNU General Public License version 2 and
 * only version 2 as published by the Free Software Foundation.
 *
 * This program is distributed in the hope that it will be useful,
 * but WITHOUT ANY WARRANTY; without even the implied warranty of
 * MERCHANTABILITY or FITNESS FOR A PARTICULAR PURPOSE.  See the
 * GNU General Public License for more details.
 */

/*---------------------------------------------------------------------------
 * This file is autogenerated file using gcdb parser. Please do not edit it.
 * Update input XML file to add a new entry or update variable in this file
 * VERSION = "1.0"
 *---------------------------------------------------------------------------*/
&mdss_mdp {
	dsi_jd9365z_hdplus_c3e_video: qcom,mdss_dsi_jd9365z_hdplus_video_c3e {
		qcom,mdss-dsi-panel-name = "jd9365z hdplus c3e video mode dsi panel";
		qcom,mdss-dsi-panel-controller = <&mdss_dsi0>;
		qcom,mdss-dsi-panel-type = "dsi_video_mode";
		qcom,mdss-dsi-panel-destination = "display_1";
		qcom,mdss-dsi-panel-framerate = <60>;
		qcom,mdss-dsi-virtual-channel-id = <0>;
		qcom,mdss-dsi-stream = <0>;
		qcom,mdss-dsi-panel-width = <720>;
		qcom,mdss-dsi-panel-height = <1440>;
		qcom,mdss-dsi-h-front-porch = <30>;
		qcom,mdss-dsi-h-back-porch = <20>;
		qcom,mdss-dsi-h-pulse-width = <20>;
		qcom,mdss-dsi-h-sync-skew = <0>;
		qcom,mdss-dsi-v-back-porch = <16>;
		qcom,mdss-dsi-v-front-porch = <8>;
		qcom,mdss-dsi-v-pulse-width = <2>;
		qcom,mdss-dsi-h-left-border = <0>;
		qcom,mdss-dsi-h-right-border = <0>;
		qcom,mdss-dsi-v-top-border = <0>;
		qcom,mdss-dsi-v-bottom-border = <0>;
		qcom,mdss-dsi-bpp = <24>;
		qcom,mdss-dsi-underflow-color = <0xff>;
		qcom,mdss-dsi-border-color = <0>;
		qcom,mdss-dsi-on-command = [
					29 01 00 00 00 00 04 df 93 65 f8
					29 01 00 00 00 00 02 51 ff
					29 01 00 00 00 00 02 53 2c
					29 01 00 00 00 00 02 55 00
					29 01 00 00 78 00 02 11 00
					29 01 00 00 00 00 02 35 00
					29 01 00 00 1e 00 02 29 00
					];
		qcom,mdss-dsi-off-command = [
					29 01 00 00 00 00 04 df 93 65 f8
					29 01 00 00 14 00 02 28 00
					29 01 00 00 78 00 02 10 00
					];
		qcom,mdss-dsi-CABC_UI_on-command = [
					29 01 00 00 00 00 02 DE 01
					29 01 00 00 00 00 02 BB 00
					29 01 00 00 00 00 02 DE 02
					29 01 00 00 1e 00 02 D4 05
					29 01 00 00 00 00 02 55 F1
					29 01 00 00 00 00 02 53 2C
					29 01 00 00 00 00 02 51 FF
					29 01 00 00 00 00 02 DE 01
					29 01 00 00 00 00 02 BB 55
					29 01 00 00 00 00 03 B5 06 02
					29 01 00 00 00 00 02 B6 00
					29 01 00 00 00 00 12 B7 00 E5 E7 EA EE F2 F5 F8 FC FF 66 C0 80 34 01 12 0F
					29 01 00 00 00 00 02 DE 02
					29 01 00 00 00 00 02 D2 00
					29 01 00 00 00 00 04 ED 11 5B 2D
					29 01 00 00 00 00 02 DE 00
					];
		qcom,mdss-dsi-CABC_STILL_on-command = [
					29 01 00 00 00 00 02 DE 01
					29 01 00 00 00 00 02 BB 00
					29 01 00 00 00 00 02 DE 02
					29 01 00 00 1e 00 02 D4 05
					29 01 00 00 00 00 02 55 F2
					29 01 00 00 00 00 02 53 2C
					29 01 00 00 00 00 02 51 FF
					29 01 00 00 00 00 02 DE 01
					29 01 00 00 00 00 02 BB 55
					29 01 00 00 00 00 03 B5 06 02
					29 01 00 00 00 00 02 B6 00
					29 01 00 00 00 00 12 B7 00 B2 C0 CD CE D9 E4 EE F7 FF 66 C0 80 34 01 12 0F
					29 01 00 00 00 00 02 DE 02
					29 01 00 00 00 00 02 D2 00
					29 01 00 00 00 00 04 ED 11 5B 2D
					29 01 00 00 00 00 02 DE 00
					];
		qcom,mdss-dsi-CABC_MOVIE_on-command = [
					29 01 00 00 00 00 02 DE 01
					29 01 00 00 00 00 02 BB 00
					29 01 00 00 00 00 02 DE 02
					29 01 00 00 1e 00 02 D4 05
					29 01 00 00 00 00 02 55 F3
					29 01 00 00 00 00 02 53 2C
					29 01 00 00 00 00 02 51 FF
					29 01 00 00 00 00 02 DE 01
					29 01 00 00 00 00 02 BB 55
					29 01 00 00 00 00 03 B5 06 02
					29 01 00 00 00 00 02 B6 00
					29 01 00 00 00 00 12 B7 00 66 7E 92 A2 B2 CF ED F6 FF 66 C0 80 34 01 12 0F
					29 01 00 00 00 00 02 DE 02
					29 01 00 00 00 00 02 D2 00
					29 01 00 00 00 00 04 ED 11 5B 2D
					29 01 00 00 00 00 02 DE 00
					];
		qcom,mdss-dsi-CABC_off-command = [
					29 01 00 00 00 00 02 55 F0
					];
		qcom,mdss-dsi-CE_on-command = [
					29 01 00 00 00 00 02 DE 01
					29 01 00 00 00 00 02 B0 00
					29 01 00 00 00 00 02 B2 01
					29 01 00 00 00 00 24 B3 03 45 30 20 30 05 50 0F FF FF FF 17 13 14 19 1C 18 16 16 17 19 1B 1E 1B 17 14 14 14 12 14 15 16 18 18 17
					29 01 00 00 00 00 02 DE 00
					];
		qcom,mdss-dsi-CE_off-command = [
					29 01 00 00 00 00 02 DE 01
					29 01 00 00 00 00 02 B2 00
					29 01 00 00 00 00 02 DE 00
					];
		qcom,mdss-dsi-on-command-state = "dsi_lp_mode";
		qcom,mdss-dsi-off-command-state = "dsi_lp_mode";
		qcom,mdss-dsi-h-sync-pulse = <1>;
		qcom,mdss-dsi-traffic-mode = "burst_mode";
		qcom,mdss-dsi-lane-map = "lane_map_0123";
		qcom,mdss-dsi-bllp-eof-power-mode;
		qcom,mdss-dsi-bllp-power-mode;
		qcom,mdss-dsi-lane-0-state;
		qcom,mdss-dsi-lane-1-state;
		qcom,mdss-dsi-lane-2-state;
		qcom,mdss-dsi-lane-3-state;
		/delete-property/ qcom,mdss-dsi-panel-timings;
		qcom,mdss-dsi-panel-timings-phy-12nm = [
					08 06 05 02 00 05 02 08];
		qcom,mdss-dsi-t-clk-post = <0x04>;
		qcom,mdss-dsi-t-clk-pre = <0x1a>;
		qcom,mdss-dsi-bl-min-level = <1>;
		qcom,mdss-dsi-bl-max-level = <2047>;
		qcom,mdss-brightness-max-level = <2047>;
		qcom,mdss-brightness-max-level-factory = <255>;
		qcom,mdss-dsi-bl-pmic-control-type = "bl_mount";
		qcom,panel-supply-entries = <&dsi_panel_pwr_supply>;
		qcom,mdss-dsi-reset-sequence = <1 5>, <0 10>, <1 120>;
		qcom,esd-check-enabled;
		qcom,mdss-dsi-panel-status-command = [06 01 00 01 05 00 01 0A];
		qcom,mdss-dsi-panel-status-command-mode = "dsi_lp_mode";
		qcom,mdss-dsi-panel-status-check-mode = "reg_read";
		qcom,mdss-dsi-panel-status-read-length = <1>;
		qcom,mdss-dsi-panel-status-valid-params = <1>;
		qcom,mdss-dsi-panel-status-value = <0x1C>;
		qcom,mdss-dsi-panel-max-error-count = <3>;
		qcom,mdss-dsi-post-init-delay = <1>;
		qcom,mdss-pan-physical-width-dimension = <62>;
		qcom,mdss-pan-physical-height-dimension = <124>;
	};
};
