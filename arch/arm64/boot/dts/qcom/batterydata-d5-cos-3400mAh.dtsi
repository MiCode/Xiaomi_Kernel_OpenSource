
qcom,d5_cos_3400mah {
	qcom,max-voltage-uv = <4400000>;
	qcom,fastchg-current-ma = <3300>;
	qcom,nom-batt-capacity-mah = <3400>;
	qcom,fg-cc-cv-threshold-mv = <4390>;
	qcom,batt-id-kohm = <100>;
	qcom,battery-beta = <3380>;
	qcom,battery-type = "d5_cos";
	qcom,jeita-fcc-ranges = <0   50   330000
			51  100  990000
				101  150  990000
			151 450  3300000
			451 600  1650000>;
	qcom,jeita-fv-ranges =  <0   50   4400000
			51  100  4400000
				101  150  4400000
			151 450  4400000
			451 600  4100000>;
	qcom,dynamic-fv-ranges = <0    100  4400000
				101  200  4380000
				201  300  4360000
				301  400  4340000
				401  500  4340000>;
	qcom,checksum = <0x1313>;
	qcom,gui-version = "PMI8998GUI - 2.0.0.58";
	qcom,fg-profile-data = [
			A1 20 86 04
			28 0B C6 05
			01 1D 7B 01
			47 05 43 03
			A3 17 C6 23
			A1 44 0E 5A
			8C 00 00 00
			11 00 00 00
			00 00 FB BC
			CA CD D1 BA
			26 00 08 00
			A2 DB AA E4
			43 FC 28 01
			61 0C 6C 01
			5C 06 41 32
			21 06 09 20
			27 00 14 00
			96 20 97 04
			34 0B A3 05
			D8 1C AD 02
			9A 0C 98 0B
			90 18 B6 23
			11 44 E1 5A
			76 00 00 00
			0E 00 00 00
			00 00 AE D5
			2A CA 82 C3
			1E 00 00 00
			6E EA AA E4
			8F FD B2 00
			44 ED 03 03
			BD 03 48 22
			C3 33 CC FF
			07 10 00 00
			33 0D 66 46
			1E 00 40 00
			60 01 0A FA
			FF 00 00 00
			00 00 00 00
			00 00 00 00
			00 00 00 00
			00 00 00 00
			00 00 00 00
			00 00 00 00
			00 00 00 00
			00 00 00 00
			00 00 00 00
			00 00 00 00
			00 00 00 00
			00 00 00 00
			00 00 00 00
			00 00 00 00
			00 00 00 00
			00 00 00 00
			00 00 00 00
			00 00 00 00
	];
};
