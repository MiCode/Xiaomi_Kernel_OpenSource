/* Copyright (c) 2019-2020, The Linux Foundation. All rights reserved.
 *
 * This program is free software; you can redistribute it and/or modify
 * it under the terms of the GNU General Public License version 2 and
 * only version 2 as published by the Free Software Foundation.
 *
 * This program is distributed in the hope that it will be useful,
 * but WITHOUT ANY WARRANTY; without even the implied warranty of
 * MERCHANTABILITY or FITNESS FOR A PARTICULAR PURPOSE.  See the
 * GNU General Public License for more details.
 */

/dts-v1/;
/plugin/;

#include <dt-bindings/interrupt-controller/arm-gic.h>
#include <dt-bindings/clock/qcom,camcc-sm6150.h>

#include "sa6155-adp-air.dtsi"

/ {
	model = "Qualcomm Technologies, Inc. SA6155P ADP-AIR V2";
	compatible = "qcom,sa6155p-adp-air", "qcom,sa6155p", "qcom,adp-air";
	qcom,msm-id = <377 0x0>, <380 0>;
	qcom,board-id = <0x03020019 0>;
};

/* For Voice Call Use-Case*/
&dai_pri_auxpcm {
	qcom,msm-cpudai-auxpcm-sync = <0>, <0>;
	qcom,msm-cpudai-auxpcm-pcm-clk-rate = <0>, <0>;
};

&soc {
	qcom,diag {
		compatible = "qcom,diag";
		qcom,usb-enabled;
	};
};
