/*
 * Copyright (c) 2017-2018, The Linux Foundation. All rights reserved.
 *
 * This program is free software; you can redistribute it and/or modify
 * it under the terms of the GNU General Public License version 2 and
 * only version 2 as published by the Free Software Foundation.
 *
 * This program is distributed in the hope that it will be useful,
 * but WITHOUT ANY WARRANTY; without even the implied warranty of
 * MERCHANTABILITY or FITNESS FOR A PARTICULAR PURPOSE.  See the
 * GNU General Public License for more details.
 */

&i2c_3 {
	status = "ok";
};

&i2c_3 {
	otp_eeprom: qcom,msm_eeprom@6e{
		status = "ok";
		cell-index = <0>;
		reg = <0x6e>;
		compatible = "msm_eeprom";
		qcom,eeprom-name = "sunny_imx241_otp";
		qcom,slave-addr = <0x6e>;
		qcom,i2c-freq-mode = <1>;

		cam_vdig-supply = <&pm8916_l2>;
		cam_vio-supply = <&pm8916_l6>;
		cam_vana-supply = <&pm8916_l17>;
		qcom,cam-vreg-name = "cam_vdig", "cam_vio", "cam_vana";
		qcom,cam-vreg-min-voltage = <1200000 1800000 2850000>;
		qcom,cam-vreg-max-voltage = <1200000 1800000 2850000>;
		qcom,cam-vreg-op-mode = <200000 0 80000>;
		qcom,cam-vreg-type = <0 0 0>;
		pinctrl-names = "cam_default", "cam_suspend";
		pinctrl-0 = <&cam_sensor_mclk0_default
					&cam_sensor_rear_default>;
		pinctrl-1 = <&cam_sensor_mclk0_sleep
					&cam_sensor_rear_sleep>;
		gpios = <&msm_gpio 26 0>,
				<&msm_gpio 35 0>;
		qcom,gpio-reset = <1>;
		qcom,gpio-req-tbl-num = <0 1>;
		qcom,gpio-req-tbl-flags = <1 0>;
		qcom,gpio-req-tbl-label = "CAMIF_MCLK", "CAM_RESET";

		qcom,cam-power-seq-type = "sensor_vreg",
						"sensor_vreg",
						"sensor_vreg",
						"sensor_gpio",
						"sensor_clk",
						"sensor_i2c_mux";
		qcom,cam-power-seq-val =  "cam_vana",
						"cam_vdig",
						"cam_vio",
						"sensor_gpio_reset",
						"sensor_cam_mclk",
						"none";
		qcom,cam-power-seq-cfg-val = <2850000 1200000
						1800000 1 24000000 0>;
		qcom,cam-power-seq-delay =   <1 1 1 1 1 0>;

		clocks = <&clock_gcc clk_mclk0_clk_src>,
				<&clock_gcc clk_gcc_camss_mclk0_clk>;
		clock-names = "cam_src_clk", "cam_clk";
		qcom,clock-rates = <24000000 0>;

		qcom,num-blocks = <12>;
		qcom,page0 = <1 0x34C5 2 0x02 1 1>;
		qcom,poll0 = <0 0x0 2 0 1 1>;
		qcom,mem0 = <0 0x0 2 0 1 0>;
		qcom,page1 = <1 0x34C9 2 0x02 1 10>;
		qcom,poll1 = <0 0x0 2 0 1 1>;
		qcom,mem1 = <8 0x3510 2 0 1 0>;
		qcom,page2 = <1 0x34C5 2 0x03 1 1>;
		qcom,poll2 = <0 0x0 2 0 1 1>;
		qcom,mem2 = <0 0x0 2 0 1 0>;
		qcom,page3 = <1 0x34C9 2 0x03 1 10>;
		qcom,poll3 = <0 0x0 2 0 1 1>;
		qcom,mem3 = <8 0x3518 2 0 1 0>;
		qcom,page4 = <1 0x34C5 2 0x06 1 1>;
		qcom,poll4 = <0 0x0 2 0 1 1>;
		qcom,mem4 = <0 0x0 2 0 1 0>;
		qcom,page5 = <1 0x34C9 2 0x06 1 10>;
		qcom,poll5 = <0 0x0 2 0 1 1>;
		qcom,mem5 = <8 0x3530 2 0 1 0>;
		qcom,page6 = <1 0x34C5 2 0x07 1 1>;
		qcom,poll6 = <0 0x0 2 0 1 1>;
		qcom,mem6 = <0 0x0 2 0 1 0>;
		qcom,page7 = <1 0x34C9 2 0x07 1 10>;
		qcom,poll7 = <0 0x0 2 0 1 1>;
		qcom,mem7 = <8 0x3538 2 0 1 0>;
		qcom,page8 = <1 0x34C5 2 0x0A 1 1>;
		qcom,poll8 = <0 0x0 2 0 1 1>;
		qcom,mem8 = <0 0x0 2 0 1 0>;
		qcom,page9 = <1 0x34C9 2 0x0A 1 10>;
		qcom,poll9 = <0 0x0 2 0 1 1>;
		qcom,mem9 = <8 0x3550 2 0 1 0>;
		qcom,page10 = <1 0x34C5 2 0x0B 1 1>;
		qcom,poll10 = <0 0x0 2 0 1 1>;
		qcom,mem10 = <0 0x0 2 0 1 0>;
		qcom,page11 = <1 0x34C9 2 0x0B 1 10>;
		qcom,poll11 = <0 0x0 2 0 1 1>;
		qcom,mem11 = <8 0x3558 2 0 1 0>;
	};

	qcom,camera@0 {
		cell-index = <0>;
		compatible = "qcom,camera";
		reg = <0x2>;
		qcom,csiphy-sd-index = <0>;
		qcom,csid-sd-index = <0>;
		qcom,mount-angle = <90>;
		cam_vdig-supply = <&pm8916_l2>;
		cam_vana-supply = <&pm8916_l17>;
		cam_vio-supply = <&pm8916_l6>;
		qcom,cam-vreg-type = <0 0 0>;
		qcom,cam-vreg-name = "cam_vdig", "cam_vio", "cam_vana";
		qcom,cam-vreg-min-voltage = <1200000 1800000 2850000>;
		qcom,cam-vreg-max-voltage = <1200000 1800000 2850000>;
		qcom,cam-vreg-op-mode = <200000 0 80000>;
		pinctrl-names = "cam_default", "cam_suspend";
		pinctrl-0 = <&cam_sensor_mclk0_default
				&cam_sensor_rear_default>;
		pinctrl-1 = <&cam_sensor_mclk0_sleep &cam_sensor_rear_sleep>;
		gpios = <&msm_gpio 26 0>,
			<&msm_gpio 35 0>,
			<&msm_gpio 34 0>;
		qcom,gpio-reset = <1>;
		qcom,gpio-standby = <2>;
		qcom,gpio-req-tbl-num = <0 1 2>;
		qcom,gpio-req-tbl-flags = <1 0 0>;
		qcom,gpio-req-tbl-label = "CAMIF_MCLK",
			"CAM_RESET",
			"CAM_STANDBY";
		qcom,sensor-position = <0>;
		qcom,sensor-mode = <0>;
		qcom,eeprom-src = <&otp_eeprom>;
		status = "ok";
		clocks = <&clock_gcc clk_mclk0_clk_src>,
				<&clock_gcc clk_gcc_camss_mclk0_clk>;
		clock-names = "cam_src_clk", "cam_clk";
		qcom,clock-rates = <24000000 0>;
	};
};
