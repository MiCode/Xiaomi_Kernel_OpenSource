/* Copyright (c) 2019, The Linux Foundation. All rights reserved.
 *
 * This program is free software; you can redistribute it and/or modify
 * it under the terms of the GNU General Public License version 2 and
 * only version 2 as published by the Free Software Foundation.
 *
 * This program is distributed in the hope that it will be useful,
 * but WITHOUT ANY WARRANTY; without even the implied warranty of
 * MERCHANTABILITY or FITNESS FOR A PARTICULAR PURPOSE.  See the
 * GNU General Public License for more details.
 */

/dts-v1/;
/plugin/;

#include <dt-bindings/interrupt-controller/arm-gic.h>
#include "atoll-idp.dtsi"
#include "atoll-wcd937x-idp-audio-overlay.dtsi"

/ {
	model = "wcd937x Audio Codec IDP";
	compatible = "qcom,atoll-idp", "qcom,atoll", "qcom,idp";
	qcom,msm-id = <407 0x0>;
	qcom,board-id = <34 1>;
};

&dsi_rm69299_visionox_amoled_vid_display {
	qcom,dsi-display-active;
};
