/* Copyright (c) 2019, The Linux Foundation. All rights reserved.
 * Copyright (C) 2021 XiaoMi, Inc.
 *
 * This program is free software; you can redistribute it and/or modify
 * it under the terms of the GNU General Public License version 2 and
 * only version 2 as published by the Free Software Foundation.
 *
 * This program is distributed in the hope that it will be useful,
 * but WITHOUT ANY WARRANTY; without even the implied warranty of
 * MERCHANTABILITY or FITNESS FOR A PARTICULAR PURPOSE.  See the
 * GNU General Public License for more details.
 */

/*---------------------------------------------------------------------------
 * This file is autogenerated file using gcdb parser. Please do not edit it.
 * Update input XML file to add a new entry or update variable in this file
 * VERSION = "1.0"
 *---------------------------------------------------------------------------*/
&soc {
	dsi_xiaomi_f4_36_02_0b_fhd_cmd: qcom,mdss_dsi_xiaomi_f4_36_02_0b_fhd_cmd {
		qcom,mdss-dsi-panel-name = "xiaomi f4 36 02 0b fhd cmd dsi panel";
		qcom,mdss-dsi-panel-id = <0>;
		qcom,mdss-dsi-panel-sleepwrmod = <0>;
		qcom,mdss-dsi-panel-type = "dsi_cmd_mode";
		qcom,mdss-dsi-virtual-channel-id = <0>;
		qcom,mdss-dsi-stream = <0>;
		qcom,mdss-dsi-bpp = <24>;
		qcom,mdss-dsi-underflow-color = <0xff>;
		qcom,mdss-dsi-border-color = <0>;
		qcom,mdss-dsi-traffic-mode = "non_burst_sync_event";
		/* qcom,mdss-dsi-traffic-mode = "burst_mode"; */
		qcom,mdss-dsi-bllp-eof-power-mode;
		qcom,mdss-dsi-bllp-power-mode;
		qcom,ulps-enabled;
		qcom,mdss-dsi-lp11-init;
		qcom,mdss-dsi-lane-0-state;
		qcom,mdss-dsi-lane-1-state;
		qcom,mdss-dsi-lane-2-state;
		qcom,mdss-dsi-lane-3-state;
		qcom,mdss-brightness-max-level = <2047>;
		qcom,mdss-dsi-bl-default-level = <536>;
		qcom,bl-update-flag = "delay_until_first_frame";
		qcom,mdss-dsi-dma-trigger = "trigger_sw";
		qcom,mdss-dsi-mdp-trigger = "none";
		qcom,mdss-dsi-bl-dcs-type-ss-ea;
		qcom,mdss-dsi-bl-xiaomi-f4-36-flag;
		qcom,mdss-dsi-reset-sequence = <1 10>, <0 10>, <1 10>;
		qcom,mdss-pan-physical-width-dimension = <69>;
		qcom,mdss-pan-physical-height-dimension = <149>;
		qcom,mdss-dsi-te-pin-select = <1>;
		qcom,mdss-dsi-wr-mem-start = <0x2c>;
		qcom,mdss-dsi-wr-mem-continue = <0x3c>;
		qcom,mdss-dsi-te-dcs-command = <1>;
		qcom,mdss-dsi-te-check-enable;
		qcom,mdss-dsi-te-using-te-pin;
		qcom,mdss-dsi-tx-eot-append;
		qcom,mdss-dsi-panel-hdr-enabled;
		qcom,mdss-dsi-panel-hdr-color-primaries = <14500 15500 32000
			17000 15500 30000 8000 3000>;
		qcom,mdss-dsi-panel-peak-brightness = <4300000>;
		qcom,mdss-dsi-panel-blackness-level = <3230>;

		qcom,dispparam-enabled;
		qcom,mdss-dsi-panel-fod-dimlayer-enabled;
		qcom,mdss-panel-on-dimming-delay = <200>;
		/* IRQF_ONESHOT | IRQF_TRIGGER_FALLING */
		qcom,esd-err-irq-gpio = <&tlmm 32 0x2002>;

		qcom,disp-doze-backlight-threshold = <8>;
		qcom,disp-fod-off-dimming-delay = <85>;
		qcom,dispparam-f4-51-ctrl-flag;
		qcom,mdss-dsi-panel-hbm-off-51-index = <1>;
		qcom,mdss-dsi-panel-fod-off-51-index = <1>;
		qcom,disp-backlight-pulse-threshold = <1038>;

		qcom,mdss-dsi-display-timings {
			timing@0{
				qcom,mdss-dsi-panel-width = <1080>;
				qcom,mdss-dsi-panel-height = <2340>;
				qcom,mdss-dsi-h-front-porch = <8>;
				qcom,mdss-dsi-h-back-porch = <8>;
				qcom,mdss-dsi-h-pulse-width = <4>;
				qcom,mdss-dsi-h-sync-skew = <0>;
				qcom,mdss-dsi-v-back-porch = <12>;
				qcom,mdss-dsi-v-front-porch = <12>;
				qcom,mdss-dsi-v-pulse-width = <4>;
				qcom,mdss-dsi-h-left-border = <0>;
				qcom,mdss-dsi-h-right-border = <0>;
				qcom,mdss-dsi-v-top-border = <0>;
				qcom,mdss-dsi-v-bottom-border = <0>;
				qcom,mdss-dsi-panel-framerate = <60>;
				qcom,mdss-dsi-panel-jitter = <0x8 0xa>;
				qcom,mdss-dsi-on-command = [
					/* -- VESA Power Saving -- */
					39 00 00 00 00 00 05 FF AA 55 A5 80
					39 00 00 00 00 00 02 6F 0A
					39 01 00 00 00 00 02 FC 02
					/* -- Page 0 -- */
					39 01 00 00 00 00 06 F0 55 AA 52 08 00
					/* -- dimming 16 -- */
					39 01 00 00 00 00 05 B2 19 00 10 10
					/* -- 4 Pulse */
					39 00 00 00 00 00 02 6F 09
					39 01 00 00 00 00 02 B2 20
					/* Pulse Threshold Setting */
					15 01 00 00 00 00 02 6F 13
					39 01 00 00 00 00 03 B2 03 B8
					/* 0x56: cmd mode */
					39 00 00 00 00 00 02 C0 56
					/* SWIRE map_C seting */
					39 00 00 00 00 00 02 6F 06
					39 00 00 00 00 00 0B B5 2B 1C 00 00 00 2B 1C 00 00 00
					/* ESD */
					39 00 00 00 00 00 03 BE 0E 0B
					39 00 00 00 00 00 02 6F 05
					39 01 00 00 00 00 02 BE 8A
					/* -- Page 1 -- */
					39 01 00 00 00 00 06 F0 55 AA 52 08 01
					39 00 00 00 00 00 02 6F 03
					39 00 00 00 00 00 02 CF 09
					39 00 00 00 00 00 02 6F 02
					39 00 00 00 00 00 02 D2 22
					/* VDC setting code */
					39 00 00 00 00 00 07 B6 00 98 00 98 00 98
					/* VDC_OST_OFF=0 (vmode on) */
					39 00 00 00 00 00 05 FF AA 55 A5 81
					39 00 00 00 00 00 02 6F 04
					39 01 00 00 00 00 02 F5 08
					/* -- Page 0 -- */
					39 01 00 00 00 00 06 F0 55 AA 52 08 00
					/* VDC_en = 1,Comp_type=1 */
					39 00 00 00 00 00 02 DF 81
					/* VDC_WEIGHT_R/G/B=(SPR 255/2,Normal 255/3) */
					39 00 00 00 00 00 02 6F 01
					39 00 00 00 00 00 04 DF 80 80 00
					/* Power UD=1 */
					39 00 00 00 00 00 02 6F 04
					39 00 00 00 00 00 02 DF 02
					/* V_Center=1 ;Max_COM */
					39 00 00 00 00 00 02 6F 22
					39 01 00 00 00 00 06 DF 35 80 7F 15 50
					/* P1.0 FOD SET */
					39 00 00 00 00 00 03 89 00 0F
					39 01 00 00 00 00 05 88 02 1B 07 11
					/* CMD4 OSC SET*/
					39 00 00 00 00 00 05 FF AA 55 A5 81
					39 00 00 00 00 00 02 6F 05
					39 01 00 00 00 00 03 FD 00 DB
					/* CMD4 */
					39 00 00 00 00 00 05 FF AA 55 A5 81
					39 00 00 00 00 00 02 6F 0D
					39 00 00 00 00 00 02 F3 A7
					/* VBP/VFP Video Mode */
					39 01 00 00 00 00 05 3B 00 10 00 0C
					/* COMPRESSION_METHOD = 1 VESA, Slice 12 */
					39 00 00 00 00 00 02 90 01
					39 00 00 00 00 00 13 93 89 28 00 0C 02 00 02 0E 01 1F 00 07 08 BB 08 7A 10 F0
					39 00 00 00 00 00 02 03 11
					39 01 00 00 00 00 02 2C 00
					/* DBV = 4095 */
					39 00 00 00 00 00 05 51 00 00 00 00
					/* BCTRL = 1 */
					39 00 00 00 00 00 02 53 20
					/* TE Enable */
					39 01 00 00 00 00 02 35 00
					39 00 00 00 00 00 05 2A 00 00 04 37
					39 01 00 00 00 00 05 2B 00 00 09 23
					05 01 00 00 80 00 02 11 00
					05 01 00 00 00 00 02 29 00];
					qcom,mdss-dsi-off-command = [
					05 01 00 00 00 00 02 28 00
					05 01 00 00 66 00 02 10 00];
				qcom,mdss-dsi-on-command-state = "dsi_lp_mode";
				qcom,mdss-dsi-off-command-state = "dsi_lp_mode";

				qcom,mdss-dsi-dispparam-hbm-fod-on-command = [
					/* Exit AOD Mode */
					39 00 00 00 00 00 02 65 00
					39 00 00 00 00 00 02 38 00
					15 01 00 00 00 00 02 2C 00
					/* 20h----dimming off */
					39 00 00 00 00 00 02 53 20
					/* Enter FOD HBM Mode */
					39 01 00 00 00 00 03 51 0F FF];
				qcom,mdss-dsi-dispparam-hbm-fod-on-command-state = "dsi_hs_mode";
				qcom,mdss-dsi-dispparam-hbm-fod-off-command = [
					/* 20h----dimming off */
					39 00 00 00 00 00 02 53 20
					/* Exit FOD HBM Mode */
					39 01 00 00 00 00 03 51 07 FF];
				qcom,mdss-dsi-dispparam-hbm-fod-off-command-state = "dsi_hs_mode";

				qcom,mdss-dsi-dispparam-hbm-on-command = [
					/* 28h----dimming on */
					39 01 00 00 00 00 02 53 28
					/* Enter HBM Mode */
					39 01 00 00 00 00 03 51 0F FF];
				qcom,mdss-dsi-dispparam-hbm-on-command-state = "dsi_lp_mode";
				qcom,mdss-dsi-dispparam-hbm-off-command = [
					/* 28h----dimming on */
					39 01 00 00 00 00 02 53 28
					/* Exit HBM Mode */
					39 01 00 00 00 00 03 51 07 FF];
				qcom,mdss-dsi-dispparam-hbm-off-command-state = "dsi_lp_mode";

				qcom,mdss-dsi-dispparam-dimmingon-command = [39 01 00 00 01 00 02 53 28];
				qcom,mdss-dsi-dispparam-dimmingon-command-state = "dsi_lp_mode";
				qcom,mdss-dsi-dispparam-dimmingoff-command = [39 01 00 00 01 00 02 53 20];
				qcom,mdss-dsi-dispparam-dimmingoff-command-state = "dsi_lp_mode";

				qcom,mdss-dsi-doze-hbm-command = [
					/* 20h----dimming off */
					39 00 00 00 00 00 02 53 20
					/* Exit HBM Mode */
					39 01 00 00 00 00 03 51 00 1F
					39 00 00 00 00 00 02 6F 02
					39 00 00 00 00 00 03 51 00 EE
					39 00 00 00 00 00 02 39 00
					39 00 00 00 00 00 02 65 01
					15 01 00 00 00 00 02 2C 00];
				qcom,mdss-dsi-doze-lbm-command = [
					/* 20h----dimming off */
					39 00 00 00 00 00 02 53 20
					/* Exit HBM Mode */
					39 01 00 00 00 00 03 51 00 1F
					39 00 00 00 00 00 02 6F 02
					39 00 00 00 00 00 03 51 00 0A
					39 00 00 00 00 00 02 39 00
					39 00 00 00 00 00 02 65 01
					15 01 00 00 00 00 02 2C 00];
				qcom,mdss-dsi-nolp-command = [
					39 00 00 00 00 00 02 65 00
					39 00 00 00 00 00 02 38 00
					15 01 00 00 00 00 02 2C 00];
				qcom,mdss-dsi-doze-hbm-command-state = "dsi_lp_mode";
				qcom,mdss-dsi-doze-lbm-command-state = "dsi_lp_mode";
				qcom,mdss-dsi-nolp-command-state = "dsi_lp_mode";

				/* For the f4_36_02 panel, we need to switch the
				pulse according to the value of the 51 register. */
				qcom,mdss-dsi-dispparam-one-pluse-command = [
					39 00 00 00 00 00 06 F0 55 AA 52 08 00
					39 00 00 00 00 00 02 6F 09
					39 01 00 00 00 00 02 B2 00];
				qcom,mdss-dsi-dispparam-one-pluse-command-state = "dsi_lp_mode";
				qcom,mdss-dsi-dispparam-four-pluse-command = [
					39 00 00 00 00 00 06 F0 55 AA 52 08 00
					39 00 00 00 00 00 02 6F 09
					39 01 00 00 00 00 02 B2 20];
				qcom,mdss-dsi-dispparam-four-pluse-command-state = "dsi_lp_mode";

				qcom,mdss-dsi-dispparam-dc-on-command = [
					/* Page 0 */
					39 00 00 00 00 00 06 F0 55 AA 52 08 00
					/* Enable DC */
					39 00 00 00 00 00 0B B2 C9 00 10 10 00 08 08 00 00 00
					/* Make 51 00-7FF only call Band7 */
					39 01 00 00 00 00 25 B3 00 00 00 00 00 00 00 00 00 00 00 00 00 00 00 00 00 00 00 00 00 00 00 00 00 00 00 00 07 FF 0B FF 0B FF 0F FF
					39 00 00 00 00 00 06 F0 55 AA 52 08 04
					39 00 00 00 00 00 15 D0 00 1f 00 00 85 0B 17 20 40 80 00 B6 00 F8 01 5C 01 E6 07 FF
					39 01 00 00 00 00 4C D2 08 08 08 08 08 20 20 20 20 20 2a 2a 2a 2a 2a 40 40 40 40 40 40 40 40 40 40 08 08 08 08 08 20 20 20 20 20 2a 2a 2a 2a 2a 40 40 40 40 40 40 40 40 40 40 08 08 08 08 08 20 20 20 20 20 2a 2a 2a 2a 2a 40 40 40 40 40 40 40 40 40 40];
				qcom,mdss-dsi-dispparam-dc-on-command-state = "dsi_hs_mode";
				qcom,mdss-dsi-dispparam-dc-off-command = [
					/* Page 0 */
					39 00 00 00 00 00 06 F0 55 AA 52 08 00
					/* -- Enable PWM & dimming 16 -- */
					39 00 00 00 00 00 0B B2 59 00 10 10 00 08 08 00 00 20
					/* PWM-51 */
					39 01 00 00 00 00 25 B3 00 02 00 0A 00 0A 00 24 00 24 00 5E 00 5E 00 EE 00 EE 01 E6 01 E6 03 B8 03 B8 07 FF 07 FF 0B FF 0B FF 0F FF
					39 00 00 00 00 00 06 F0 55 AA 52 08 04
					39 00 00 00 00 00 15 D0 00 1f 00 00 85 0b 17 20 40 80 00 0a 00 5e 00 ee 01 e6 07 ff
					39 01 00 00 00 00 4C D2 00 08 00 08 08 10 50 40 3c 20 60 60 50 40 2a 60 60 50 50 40 60 60 54 50 40 00 08 00 08 08 10 50 40 3c 20 60 60 50 40 2a 60 60 50 50 40 60 60 54 50 40 00 08 00 08 08 10 50 40 3c 20 60 60 50 40 2a 60 60 50 50 40 60 60 54 50 40];
				qcom,mdss-dsi-dispparam-dc-off-command-state = "dsi_hs_mode";

				/*
				qcom,mdss-dsi-dispparam-crc-srgb-on-command = [
					];
				qcom,mdss-dsi-dispparam-crc-srgb-on-command-state = "dsi_lp_mode";
				qcom,mdss-dsi-dispparam-crc-dcip3-on-command = [
					];
				qcom,mdss-dsi-dispparam-crc-dcip3-on-command-state = "dsi_lp_mode";
				qcom,mdss-dsi-dispparam-crc-off-command = [
					];
				qcom,mdss-dsi-dispparam-crc-off-command-state = "dsi_lp_mode";
				*/
				qcom,mdss-dsi-h-sync-pulse = <0>;

				qcom,compression-mode = "dsc";
				qcom,mdss-dsc-version = <0x11>;
				qcom,mdss-dsc-scr-version = <0x0>;
				qcom,lm-split = <540 540>;
				qcom,mdss-dsc-encoders = <2>;
				qcom,mdss-dsc-slice-height = <12>;
				qcom,mdss-dsc-slice-width = <540>;
				qcom,mdss-dsc-slice-per-pkt = <2>;
				qcom,mdss-dsc-bit-per-component = <8>;
				qcom,mdss-dsc-bit-per-pixel = <8>;
				qcom,mdss-dsc-block-prediction-enable;
			};
		};
	};
};
