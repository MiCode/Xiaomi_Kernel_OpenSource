/*
 * Copyright (c) 2018-2019, The Linux Foundation. All rights reserved.
 *
 * This program is free software; you can redistribute it and/or modify
 * it under the terms of the GNU General Public License version 2 and
 * only version 2 as published by the Free Software Foundation.
 *
 * This program is distributed in the hope that it will be useful,
 * but WITHOUT ANY WARRANTY; without even the implied warranty of
 * MERCHANTABILITY or FITNESS FOR A PARTICULAR PURPOSE.  See the
 * GNU General Public License for more details.
 */

#include "qcs405-tasha.dtsi"

&q6core {
	bolero: bolero-cdc {
		compatible = "qcom,bolero-codec";
		clock-names = "lpass_core_hw_vote";
		clocks = <&lpass_core_hw_vote 0>;
	};
};

&qcs405_snd {
	qcom,model = "qcs405-amic-snd-card";
	qcom,tasha-codec = <1>;
	asoc-codec = <&stub_codec>, <&bolero>;
	asoc-codec-names = "msm-stub-codec.1", "bolero_codec";
	qcom,audio-routing =
		"lineout booster", "LINEOUT1",
		"lineout booster", "LINEOUT2",
		"LINEOUT1", "rx regulator",
		"LINEOUT2", "rx regulator",
		"AMIC3", "tx regulator",
		"AMIC4", "tx regulator",
		"AMIC3", "MIC BIAS3",
		"AMIC4", "MIC BIAS4",
		"MIC BIAS3", "Analog Mic3",
		"MIC BIAS4", "Analog Mic4";
};
