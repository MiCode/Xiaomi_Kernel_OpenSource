/* Copyright (c) 2019, The Linux Foundation. All rights reserved.
 *
 * This program is free software; you can redistribute it and/or modify
 * it under the terms of the GNU General Public License version 2 and
 * only version 2 as published by the Free Software Foundation.
 *
 * This program is distributed in the hope that it will be useful,
 * but WITHOUT ANY WARRANTY; without even the implied warranty of
 * MERCHANTABILITY or FITNESS FOR A PARTICULAR PURPOSE.  See the
 * GNU General Public License for more details.
 */

/dts-v1/;

#include "sa2150p-ccard.dtsi"

/ {
	model = "Qualcomm Technologies, Inc. SA2150P CCARD EMMC";
	compatible = "qcom,sa2150p-ccard", "qcom,qcs405", "qcom,sa2150p",
				"qcom,ccard";
	qcom,board-id = <25 0>, <25 0x100>;
};
