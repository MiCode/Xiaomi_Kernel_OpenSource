// SPDX-License-Identifier: GPL-2.0-only
/*
 * Copyright (c) 2018, The Linux Foundation. All rights reserved.
 */

/dts-v1/;
/memreserve/ 0x90000000 0x00000100;

#include "lito.dtsi"
#include "lito-rumi.dtsi"

/ {
	model = "Qualcomm Technologies, Inc. Lito RUMI";
	compatible = "qcom,lito-rumi", "qcom,lito", "qcom,rumi";
	qcom,board-id = <15 0>;
};
