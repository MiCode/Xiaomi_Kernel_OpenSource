
/* Copyright (c) 2016-2017, The Linux Foundation. All rights reserved.
 * Copyright (C) 2018 XiaoMi, Inc.
 *
 * This program is free software; you can redistribute it and/or modify
 * it under the terms of the GNU General Public License version 2 and
 * only version 2 as published by the Free Software Foundation.
 *
 * This program is distributed in the hope that it will be useful,
 * but WITHOUT ANY WARRANTY; without even the implied warranty of
 * MERCHANTABILITY or FITNESS FOR A PARTICULAR PURPOSE.  See the
 * GNU General Public License for more details.
 */
#include "polaris-p1.dtsi"
&qupv3_se5_i2c {
       /*smart PA*/
       tas2559@4c{
               ti,tas2559-reset-gpio = <&tlmm 14 0>;
       };

};

&qusb_phy0 {
        pinctrl-names = "atest_usb13_suspend","atest_usb13_active";
        pinctrl-0 = <&atest_usb13_suspend>;
        pinctrl-1 = <&atest_usb13_active>;
};
