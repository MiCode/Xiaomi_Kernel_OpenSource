/* Copyright (c) 2018, The Linux Foundation. All rights reserved.
 *
 * This program is free software; you can redistribute it and/or modify
 * it under the terms of the GNU General Public License version 2 and
 * only version 2 as published by the Free Software Foundation.
 *
 * This program is distributed in the hope that it will be useful,
 * but WITHOUT ANY WARRANTY; without even the implied warranty of
 * MERCHANTABILITY or FITNESS FOR A PARTICULAR PURPOSE.  See the
 * GNU General Public License for more details.
 */

#include "sdm670.dtsi"

/ {
	model = "Qualcomm Technologies, Inc. SDM710";
	compatible = "qcom,sdm670";
	qcom,msm-id = <360 0x0>;
};

&msm_gpu {
	qcom,chipid = <0x06010600>;
	/delete-property/qcom,gpu-quirk-limit-uche-gbif-rw;
	/delete-property/qcom,soc-hw-rev-efuse;
	/delete-node/qcom,soc-hw-revisions;
};
