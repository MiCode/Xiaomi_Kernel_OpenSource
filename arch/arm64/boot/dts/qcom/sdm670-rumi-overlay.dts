/* Copyright (c) 2017, The Linux Foundation. All rights reserved.
 *
 * This program is free software; you can redistribute it and/or modify
 * it under the terms of the GNU General Public License version 2 and
 * only version 2 as published by the Free Software Foundation.
 *
 * This program is distributed in the hope that it will be useful,
 * but WITHOUT ANY WARRANTY; without even the implied warranty of
 * MERCHANTABILITY or FITNESS FOR A PARTICULAR PURPOSE.  See the
 * GNU General Public License for more details.
 */

/dts-v1/;
/plugin/;

#include <dt-bindings/interrupt-controller/arm-gic.h>
#include "sdm670-rumi.dtsi"

/ {
	model = "Qualcomm Technologies, Inc. SDM670 RUMI";
	compatible = "qcom,sdm670-rumi", "qcom,sdm670", "qcom,rumi";
	qcom,msm-id = <336 0x0>;
	qcom,board-id = <15 0>;
};

&soc {
	wdog: qcom,wdt@17980000{
		status = "disabled";
	};
};
