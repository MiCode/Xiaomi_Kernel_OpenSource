/* Copyright (c) 2018, The Linux Foundation. All rights reserved.
 *
 * This program is free software; you can redistribute it and/or modify
 * it under the terms of the GNU General Public License version 2 and
 * only version 2 as published by the Free Software Foundation.
 *
 * This program is distributed in the hope that it will be useful,
 * but WITHOUT ANY WARRANTY; without even the implied warranty of
 * MERCHANTABILITY or FITNESS FOR A PARTICULAR PURPOSE.  See the
 * GNU General Public License for more details.
 */

/dts-v1/;

#include "sdmmagpie.dtsi"
#include "sdmmagpie-idp.dtsi"
#include "sdmmagpie-ext-codec-audio-overlay.dtsi"
#include "sdmmagpie-external-codec.dtsi"

/ {
	model = "Qualcomm Technologies, Inc. SDMMAGPIE PM6150 External Audio Codec IDP";
	compatible = "qcom,sdmmagpie-idp", "qcom,sdmmagpie", "qcom,idp";
	qcom,board-id = <34 1>;
};
