/* Copyright (c) 2018-2019, The Linux Foundation. All rights reserved.
 *
 * This program is free software; you can redistribute it and/or modify
 * it under the terms of the GNU General Public License version 2 and
 * only version 2 as published by the Free Software Foundation.
 *
 * This program is distributed in the hope that it will be useful,
 * but WITHOUT ANY WARRANTY; without even the implied warranty of
 * MERCHANTABILITY or FITNESS FOR A PARTICULAR PURPOSE.  See the
 * GNU General Public License for more details.
 */

/dts-v1/;
/plugin/;

#include "sa8155-adp-alcor.dtsi"

/ {
	model = "ADP-ALCOR";
	compatible = "qcom,sa8155-adp-alcor", "qcom,sa8155",
		"qcom,adp-alcor";
	qcom,board-id = <0x02000019 0>;
};
