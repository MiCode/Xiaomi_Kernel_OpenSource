
qcom,e20_atl_3100mAh {
	qcom, = <24>;
	/* #3406528_Xiaomi_E20atl_3100mAh_averaged_MasterSlave_Apr10th2018*/
	qcom,max-voltage-uv = <4400000>;
	qcom,fastchg-current-ma = <3100>;
	qcom,nom-batt-capacity-mah = <3100>;
	qcom,batt-id-kohm = <68>;
	qcom,battery-beta = <3435>;
	qcom,battery-type = "e20_atl_3100mAh";
	qcom,jeita-fcc-ranges = <0   50   310000
				 51  150  930000
				 151 450  3100000
				 451 600  1550000>;
	qcom,jeita-fv-ranges =  <0   50   4400000
				 51  150  4400000
				 151 450  4400000
				 451 600  4100000>;
	qcom,checksum = <0x3F42>;
	qcom,gui-version = "PM660GUI - 0.0.0.45";
	qcom,fg-profile-data = [
		 FA 1E BB FC
		 B1 03 F8 06
		 E1 1C E7 01
		 E0 0D 76 0A
		 1E 17 39 2A
		 D6 4D E2 5A
		 72 00 00 00
		 10 00 00 00
		 00 00 CD BD
		 0C CD 0C C3
		 27 00 08 00
		 15 D3 A2 E4
		 67 FD CE F2
		 1D 04 37 0A
		 2E 07 AA 2B
		 1B 06 09 20
		 27 00 14 00
		 8E 1F C9 05
		 55 0A 72 06
		 B9 1C 2B 03
		 C1 15 7F 12
		 72 18 BE 23
		 0F 44 E2 5A
		 65 00 00 00
		 0E 00 00 00
		 00 00 97 D5
		 44 CA 2E C2
		 22 00 00 00
		 FC EA A2 E4
		 4A F4 7F EB
		 ED 06 B2 F2
		 05 ED 75 1B
		 B7 33 CC FF
		 07 10 00 00
		 55 0C 66 46
		 22 00 40 00
		 4D 01 0A FA
		 FF 00 00 00
		 00 00 00 00
		 00 00 00 00
		 00 00 00 00
		 00 00 00 00
		 00 00 00 00
		 00 00 00 00
		 00 00 00 00
		 00 00 00 00
		 00 00 00 00
		 00 00 00 00
		 00 00 00 00
		 00 00 00 00
		 00 00 00 00
		 00 00 00 00
		 00 00 00 00
		 00 00 00 00
		 00 00 00 00
		 00 00 00 00
	];
};
