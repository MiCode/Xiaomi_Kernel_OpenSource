/* Copyright (c) 2019-2020, The Linux Foundation. All rights reserved.
 *
 * This program is free software; you can redistribute it and/or modify
 * it under the terms of the GNU General Public License version 2 and
 * only version 2 as published by the Free Software Foundation.
 *
 * This program is distributed in the hope that it will be useful,
 * but WITHOUT ANY WARRANTY; without even the implied warranty of
 * MERCHANTABILITY or FITNESS FOR A PARTICULAR PURPOSE.  See the
 * GNU General Public License for more details.
 */

/dts-v1/;

#include "sa8195-vm.dtsi"
#include "sa8195-vm-lv-mt.dtsi"

/ {
	model = "Qualcomm Technologies, Inc. SA8195 Multi LV Virtual Machine";
	compatible = "qcom,sa8195p";
	qcom,pmic-name = "PM8195";
	qcom,board-id = <0x2000002 0>;
};
