/* Copyright (c) 2017, The Linux Foundation. All rights reserved.
 *
 * This program is free software; you can redistribute it and/or modify
 * it under the terms of the GNU General Public License version 2 and
 * only version 2 as published by the Free Software Foundation.
 *
 * This program is distributed in the hope that it will be useful,
 * but WITHOUT ANY WARRANTY; without even the implied warranty of
 * MERCHANTABILITY or FITNESS FOR A PARTICULAR PURPOSE.  See the
 * GNU General Public License for more details.
 */


/dts-v1/;

#include "sdm845-interposer-sdm670.dtsi"
#include "sdm845-sde-display.dtsi"
#include "sdm845-interposer-sdm670-cdp.dtsi"
#include "sdm670-audio.dtsi"
#include "sdm845-interposer-sdm670-audio.dtsi"

/ {
	model = "Qualcomm Technologies, Inc. MSM sdm845 v1 Interposer SDM670 CDP";
	compatible = "qcom,sdm845-cdp", "qcom,sdm845", "qcom,cdp";
	qcom,board-id = <1 4>;
};
