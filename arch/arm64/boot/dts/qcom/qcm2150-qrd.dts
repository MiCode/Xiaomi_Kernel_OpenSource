/*
 * Copyright (c) 2019, The Linux Foundation. All rights reserved.
 *
 * This program is free software; you can redistribute it and/or modify
 * it under the terms of the GNU General Public License version 2 and
 * only version 2 as published by the Free Software Foundation.
 *
 * This program is distributed in the hope that it will be useful,
 * but WITHOUT ANY WARRANTY; without even the implied warranty of
 * MERCHANTABILITY or FITNESS FOR A PARTICULAR PURPOSE.  See the
 * GNU General Public License for more details.
 */

/dts-v1/;

#include "qcm2150.dtsi"
#include "qcm2150-qrd.dtsi"

/ {
	model = "Qualcomm Technologies, Inc. QCM2150 QRD";
	compatible = "qcom,qcm2150-qrd", "qcom,qcm2150", "qcom,qrd";
	qcom,board-id = <0x01000b 4>;
	qcom,pmic-id = <0x010016 0x25 0x0 0x0>;
};
