/* Copyright (c) 2017-2018, The Linux Foundation. All rights reserved.
 * Copyright (C) 2020 XiaoMi, Inc.
 * This program is free software; you can redistribute it and/or modify
 * it under the terms of the GNU General Public License version 2 and
 * only version 2 as published by the Free Software Foundation.
 *
 * This program is distributed in the hope that it will be useful,
 * but WITHOUT ANY WARRANTY; without even the implied warranty of
 * MERCHANTABILITY or FITNESS FOR A PARTICULAR PURPOSE.  See the
 * GNU General Public License for more details.
 */

&mdss_mdp {
	dsi_nt36672c_huaxing_fhd_video: qcom,mdss_dsi_nt36672c_huaxing_fhd_video {
		qcom,mdss-dsi-panel-name = "nt36672c huaxing fhd video mode dsi panel";
		qcom,mdss-dsi-panel-id = <0>;
		qcom,mdss-dsi-panel-type = "dsi_video_mode";
		qcom,mdss-dsi-virtual-channel-id = <0>;
		qcom,mdss-dsi-stream = <0>;
		qcom,mdss-dsi-bpp = <24>;
		qcom,mdss-dsi-color-order = "rgb_swap_rgb";
		qcom,mdss-dsi-underflow-color = <0xff>;
		qcom,mdss-dsi-border-color = <0>;
		qcom,mdss-dsi-traffic-mode = "non_burst_sync_event";
		qcom,mdss-dsi-bllp-eof-power-mode;
		qcom,mdss-dsi-bllp-power-mode;
		qcom,mdss-dsi-lp11-init;
		qcom,mdss-dsi-lane-0-state;
		qcom,mdss-dsi-lane-1-state;
		qcom,mdss-dsi-lane-2-state;
		qcom,mdss-dsi-lane-3-state;
		qcom,mdss-brightness-max-level = <4095>;
		qcom,mdss-dsi-dma-trigger = "trigger_sw";
		qcom,mdss-dsi-mdp-trigger = "none";
		qcom,mdss-dsi-reset-sequence = <1 5>, <0 1>, <1 10>;
		qcom,mdss-pan-physical-width-dimension = <70>;
		qcom,mdss-pan-physical-height-dimension = <154>;
		qcom,cont-splash-enabled;
		qcom,mdss-dsi-tx-eot-append;
		qcom,dispparam-enabled;
		qcom,mdss-dsi-panel-hdr-enabled;
		qcom,mdss-dsi-panel-hdr-color-primaries = <14500 15500 32000
			17000 15500 30000 8000 3000>;
		qcom,mdss-dsi-panel-peak-brightness = <4200000>;
		qcom,mdss-dsi-panel-blackness-level = <3230>;
		qcom,mdss-dsi-bl-pmic-control-type = "bl_ctrl_wled";
		qcom,mdss-dsi-bl-min-level = <1>;
		qcom,mdss-dsi-bl-max-level = <4095>;
		qcom,mdss-dsi-post-init-delay = <1>;
		qcom,mdss-dsi-qsync-min-refresh-rate = <30>;
		qcom,mdss-dsi-pan-enable-dynamic-fps;
		qcom,mdss-dsi-pan-enable-smart-fps;
		qcom,mdss-dsi-pan-fps-update =
			"dfps_immediate_porch_mode_vfp";
		qcom,dsi-supported-dfps-list = <120 90 60 50 30>;

		qcom,mdss-dsi-display-timings {
			timing@0{
				qcom,mdss-dsi-panel-width = <1080>;
				qcom,mdss-dsi-panel-height = <2400>;
				qcom,mdss-dsi-h-front-porch = <73>;
				qcom,mdss-dsi-h-back-porch = <40>;
				qcom,mdss-dsi-h-pulse-width = <12>;
				qcom,mdss-dsi-h-sync-skew = <0>;
				qcom,mdss-dsi-h-sync-pulse = <0>;
				qcom,mdss-dsi-v-back-porch = <30>;
				qcom,mdss-dsi-v-front-porch = <32>;
				qcom,mdss-dsi-v-pulse-width = <2>;
				qcom,mdss-dsi-panel-framerate = <120>;
				qcom,mdss-dsi-h-left-border = <0>;
				qcom,mdss-dsi-h-right-border = <0>;
				qcom,mdss-dsi-v-top-border = <0>;
				qcom,mdss-dsi-v-bottom-border = <0>;

				qcom,mdss-dsi-on-command = [
					//give by huaxing, use for panel on cmd begin
					15 01 00 00 00 00 02 FF 10
					15 01 00 00 00 00 02 FB 01
					15 01 00 00 00 00 02 B0 00

					15 01 00 00 00 00 02 FF E0
					15 01 00 00 00 00 02 FB 01
					15 01 00 00 00 00 02 35 82

					15 01 00 00 00 00 02 FF F0
					15 01 00 00 00 00 02 FB 01
					15 01 00 00 00 00 02 5A 00
					15 01 00 00 00 00 02 9C 00
					15 01 00 00 00 00 02 BE 08

					15 01 00 00 00 00 02 FF C0
					15 01 00 00 00 00 02 FB 01
					15 01 00 00 00 00 02 9C 11
					15 01 00 00 00 00 02 9D 11
					//give by huaxing, use for panel on cmd end

					//PWN ON
					15 01 00 00 00 00 02 FF 10
					15 01 00 00 00 00 02 FB 01
					15 01 00 00 00 00 02 51 C1
					15 01 00 00 00 00 02 53 2C
					15 01 00 00 00 00 02 55 00

					//give by nova, use for cabc begin
					//1080*2400
					15 01 00 00 00 00 02 FF 23
					15 01 00 00 00 00 02 FB 01
					15 01 00 00 00 00 02 10 82
					15 01 00 00 00 00 02 11 01
					15 01 00 00 00 00 02 12 95
					15 01 00 00 00 00 02 15 68
					15 01 00 00 00 00 02 16 0B

					//UI_PWM DUTY
					15 01 00 00 00 00 02 30 FF
					15 01 00 00 00 00 02 31 FD
					15 01 00 00 00 00 02 32 FB
					15 01 00 00 00 00 02 33 FA
					15 01 00 00 00 00 02 34 F9
					15 01 00 00 00 00 02 35 F7
					15 01 00 00 00 00 02 36 F5
					15 01 00 00 00 00 02 37 F4
					15 01 00 00 00 00 02 38 F1
					15 01 00 00 00 00 02 39 EF
					15 01 00 00 00 00 02 3A ED
					15 01 00 00 00 00 02 3B EB
					15 01 00 00 00 00 02 3D EA
					15 01 00 00 00 00 02 3F E8
					15 01 00 00 00 00 02 40 E6
					15 01 00 00 00 00 02 41 E5

					//Still_PWM DUTY
					15 01 00 00 00 00 02 45 FF
					15 01 00 00 00 00 02 46 F3
					15 01 00 00 00 00 02 47 E8
					15 01 00 00 00 00 02 48 DD
					15 01 00 00 00 00 02 49 D3
					15 01 00 00 00 00 02 4A C9
					15 01 00 00 00 00 02 4B BE
					15 01 00 00 00 00 02 4C B3
					15 01 00 00 00 00 02 4D A9
					15 01 00 00 00 00 02 4E 9F
					15 01 00 00 00 00 02 4F 95
					15 01 00 00 00 00 02 50 8B
					15 01 00 00 00 00 02 51 81
					15 01 00 00 00 00 02 52 77
					15 01 00 00 00 00 02 53 6D
					15 01 00 00 00 00 02 54 65

					//MOV_PWM DUTY
					15 01 00 00 00 00 02 58 FF
					15 01 00 00 00 00 02 59 F8
					15 01 00 00 00 00 02 5A F3
					15 01 00 00 00 00 02 5B EE
					15 01 00 00 00 00 02 5C E9
					15 01 00 00 00 00 02 5D E4
					15 01 00 00 00 00 02 5E DF
					15 01 00 00 00 00 02 5F DA
					15 01 00 00 00 00 02 60 D4
					15 01 00 00 00 00 02 61 CF
					15 01 00 00 00 00 02 62 CA
					15 01 00 00 00 00 02 63 C5
					15 01 00 00 00 00 02 64 C0
					15 01 00 00 00 00 02 65 BB
					15 01 00 00 00 00 02 66 B6
					15 01 00 00 00 00 02 67 B1
					15 01 00 00 00 00 02 A0 11
					//give by nova, use for cabc end

					//give by nova, use for esd check begin
					15 01 00 00 00 00 02 FF 27
					15 01 00 00 00 00 02 FB 01
					15 01 00 00 00 00 02 40 25
					//give by nova, use for esd check end

					15 01 00 00 00 00 02 FF 10
					15 01 00 00 00 00 02 FB 01
					05 01 00 00 46 00 02 11 00
					05 01 00 00 28 00 02 29 00

					//give by nova, use for esd check begin
					15 01 00 00 00 00 02 FF 27
					15 01 00 00 00 00 02 FB 01
					15 01 00 00 00 00 02 3F 01
					15 01 00 00 00 00 02 43 08
					//give by nova, use for esd check end
				];
				qcom,mdss-dsi-off-command = [
					15 01 00 00 00 00 02 FF 10
					15 01 00 00 00 00 02 FB 01
					05 01 00 00 10 00 02 28 00
					05 01 00 00 3C 00 02 10 00
				];

				qcom,mdss-dsi-dispparam-cabcuion-command = [
					15 01 00 00 00 00 02 FF 10
					15 01 00 00 00 00 02 FB 01
					15 01 00 00 00 00 02 53 2C
					15 01 00 00 14 00 02 55 01
				];
				qcom,mdss-dsi-dispparam-cabcmovieon-command = [
					15 01 00 00 00 00 02 FF 10
					15 01 00 00 00 00 02 FB 01
					15 01 00 00 00 00 02 53 2C
					15 01 00 00 14 00 02 55 03
				];
				qcom,mdss-dsi-dispparam-cabcstillon-command = [
					15 01 00 00 00 00 02 FF 10
					15 01 00 00 00 00 02 FB 01
					15 01 00 00 00 00 02 53 2C
					15 01 00 00 14 00 02 55 02
				];
				qcom,mdss-dsi-dispparam-cabcoff-command = [
					15 01 00 00 00 00 02 FF 10
					15 01 00 00 00 00 02 FB 01
					15 01 00 00 00 00 02 53 2C
					15 01 00 00 14 00 02 55 00
				];
				qcom,mdss-dsi-dispparam-lcd-hbm-l1-on-command = [
					15 01 00 00 00 00 02 FF 10
					15 01 00 00 00 00 02 FB 01
					15 01 00 00 00 00 02 53 2C
					15 01 00 00 00 00 02 51 E6
				];
				qcom,mdss-dsi-dispparam-lcd-hbm-l2-on-command = [
					15 01 00 00 00 00 02 FF 10
					15 01 00 00 00 00 02 FB 01
					15 01 00 00 00 00 02 53 2C
					15 01 00 00 00 00 02 51 FF
				];
				qcom,mdss-dsi-dispparam-lcd-hbm-off-command = [
					15 01 00 00 00 00 02 FF 10
					15 01 00 00 00 00 02 FB 01
					15 01 00 00 00 00 02 53 2C
					15 01 00 00 00 00 02 51 C1
				];
				qcom,mdss-dsi-dispparam-hbm-on-command = [
					15 01 00 00 00 00 02 51 E6
				];
				qcom,mdss-dsi-dispparam-hbm-off-command = [
					15 01 00 00 00 00 02 51 B8
				];
				qcom,mdss-dsi-hbm1-on-command = [
					15 01 00 00 00 00 02 51 E6
				];
				qcom,mdss-dsi-hbm2-on-command = [
					15 01 00 00 00 00 02 51 FF
				];

				qcom,mdss-dsi-on-command-state = "dsi_lp_mode";
				qcom,mdss-dsi-off-command-state = "dsi_lp_mode";

				qcom,mdss-dsi-dispparam-cabcuion-command-state = "dsi_lp_mode";
				qcom,mdss-dsi-dispparam-cabcstillon-command-state = "dsi_lp_mode";
				qcom,mdss-dsi-dispparam-cabcmovieon-command-state = "dsi_lp_mode";
				qcom,mdss-dsi-dispparam-cabcoff-command-state = "dsi_lp_mode";

				qcom,mdss-dsi-dispparam-lcd-hbm-l1-on-command-state = "dsi_lp_mode";
				qcom,mdss-dsi-dispparam-lcd-hbm-l2-on-command-state = "dsi_lp_mode";
				qcom,mdss-dsi-dispparam-lcd-hbm-off-command-state = "dsi_lp_mode";

				qcom,mdss-dsi-dispparam-hbm-on-command-state = "dsi_lp_mode";
				qcom,mdss-dsi-hbm1-on-command-state = "dsi_lp_mode";
				qcom,mdss-dsi-hbm2-on-command-state = "dsi_lp_mode";
				qcom,mdss-dsi-dispparam-hbm-off-command-state = "dsi_lp_mode";




				//delay dimming on
				qcom,mdss-dsi-dispparam-dimmingon-command = [15 01 00 00 01 00 02 53 2C];
				qcom,mdss-dsi-dispparam-dimmingon-command-state = "dsi_lp_mode";
				qcom,mdss-dsi-dispparam-dimmingoff-command = [15 01 00 00 01 00 02 53 24];
				qcom,mdss-dsi-dispparam-dimmingoff-command-state = "dsi_lp_mode";

				//coordinate
				qcom,mdss-dsi-panel-xy-coordinate = <0x0F 0x18>;
				qcom,mdss-dsi-dispparam-xy-coordinate-command = [
					15 01 00 00 00 00 02 FF 10
					06 01 00 01 00 00 01 A1
				];
				qcom,mdss-dsi-dispparam-xy-coordinate-command-state = "dsi_hs_mode";

				qcom,compression-mode = "dsc";
				qcom,mdss-dsc-version = <0x11>;
				qcom,mdss-dsc-scr-version = <0x0>;
				qcom,mdss-dsc-encoders = <1>;
				qcom,mdss-dsc-slice-height = <20>;
				qcom,mdss-dsc-slice-width = <540>;
				qcom,mdss-dsc-slice-per-pkt = <2>;
				qcom,mdss-dsc-bit-per-component = <8>;
				qcom,mdss-dsc-bit-per-pixel = <8>;
				qcom,mdss-dsc-block-prediction-enable;
			};
		};
	};
};
