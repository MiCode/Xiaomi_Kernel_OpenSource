/* Copyright (c) 2019, The Linux Foundation. All rights reserved.
 * Copyright (C) 2021 XiaoMi, Inc.
 *
 * This program is free software; you can redistribute it and/or modify
 * it under the terms of the GNU General Public License version 2 and
 * only version 2 as published by the Free Software Foundation.
 *
 * This program is distributed in the hope that it will be useful,
 * but WITHOUT ANY WARRANTY; without even the implied warranty of
 * MERCHANTABILITY or FITNESS FOR A PARTICULAR PURPOSE.  See the
 * GNU General Public License for more details.
 */

/*---------------------------------------------------------------------------
 * This file is autogenerated file using gcdb parser. Please do not edit it.
 * Update input XML file to add a new entry or update variable in this file
 * VERSION = "1.0"
 *---------------------------------------------------------------------------*/
&soc {
	dsi_xiaomi_f4_41_06_0a_fhd_cmd: qcom,mdss_dsi_xiaomi_f4_41_06_0a_fhd_cmd {
		qcom,mdss-dsi-panel-name = "xiaomi f4 41 06 0a fhd cmd dsi panel";
		qcom,mdss-dsi-panel-id = <0>;
		qcom,mdss-dsi-panel-sleepwrmod = <0>;
		qcom,mdss-dsi-panel-type = "dsi_cmd_mode";
		qcom,mdss-dsi-virtual-channel-id = <0>;
		qcom,mdss-dsi-stream = <0>;
		qcom,mdss-dsi-bpp = <24>;
		qcom,mdss-dsi-underflow-color = <0xff>;
		qcom,mdss-dsi-border-color = <0>;
		qcom,mdss-dsi-traffic-mode = "burst_mode";
		qcom,mdss-dsi-bllp-eof-power-mode;
		qcom,mdss-dsi-bllp-power-mode;
		qcom,ulps-enabled;
		qcom,mdss-dsi-lp11-init;
		qcom,mdss-dsi-lane-0-state;
		qcom,mdss-dsi-lane-1-state;
		qcom,mdss-dsi-lane-2-state;
		qcom,mdss-dsi-lane-3-state;
		qcom,mdss-brightness-max-level = <2047>;
		qcom,mdss-dsi-bl-default-level = <536>;
		qcom,bl-update-flag = "delay_until_first_frame";
		qcom,mdss-dsi-dma-trigger = "trigger_sw";
		qcom,mdss-dsi-mdp-trigger = "none";
		qcom,mdss-dsi-bl-dcs-type-ss-ea;
		qcom,mdss-dsi-bl-xiaomi-f4-41-flag;
		qcom,mdss-dsi-reset-sequence = <0 1>, <1 10>;
		qcom,mdss-pan-physical-width-dimension = <690>;
		qcom,mdss-pan-physical-height-dimension = <1490>;
		qcom,mdss-dsi-te-pin-select = <1>;
		qcom,mdss-dsi-wr-mem-start = <0x2c>;
		qcom,mdss-dsi-wr-mem-continue = <0x3c>;
		qcom,mdss-dsi-te-dcs-command = <1>;
		qcom,mdss-dsi-te-check-enable;
		qcom,mdss-dsi-te-using-te-pin;
		qcom,mdss-dsi-tx-eot-append;
		qcom,mdss-dsi-panel-hdr-enabled;
		qcom,mdss-dsi-panel-hdr-color-primaries = <14500 15500 32000
			17000 15500 30000 8000 3000>;
		qcom,mdss-dsi-panel-peak-brightness = <4300000>;
		qcom,mdss-dsi-panel-blackness-level = <3230>;

		qcom,dispparam-enabled;
		qcom,mdss-dsi-panel-fod-dimlayer-enabled;
		qcom,mdss-panel-on-dimming-delay = <200>;
		/* IRQF_ONESHOT | IRQF_TRIGGER_FALLING */
		qcom,esd-err-irq-gpio = <&tlmm 32 0x2002>;

		qcom,disp-doze-backlight-threshold = <8>;
		qcom,disp-fod-off-dimming-delay = <85>;
		qcom,mdss-dsi-panel-dc-demura-threshold = <262>;

		qcom,mdss-dsi-display-timings {
			timing@0{
				qcom,mdss-dsi-panel-width = <1080>;
				qcom,mdss-dsi-panel-height = <2340>;
				qcom,mdss-dsi-h-front-porch = <28>;
				qcom,mdss-dsi-h-back-porch = <36>;
				qcom,mdss-dsi-h-pulse-width = <4>;
				qcom,mdss-dsi-h-sync-skew = <0>;
				qcom,mdss-dsi-v-back-porch = <4>;
				qcom,mdss-dsi-v-front-porch = <8>;
				qcom,mdss-dsi-v-pulse-width = <4>;
				qcom,mdss-dsi-h-left-border = <0>;
				qcom,mdss-dsi-h-right-border = <0>;
				qcom,mdss-dsi-v-top-border = <0>;
				qcom,mdss-dsi-v-bottom-border = <0>;
				qcom,mdss-dsi-panel-framerate = <60>;
				qcom,mdss-dsi-panel-clockrate = <1100000000>;
				qcom,mdss-dsi-panel-jitter = <0x5 0x1>;
				qcom,mdss-dsi-on-command = [
					39 00 00 00 00 00 02 FE 40
					39 00 00 00 00 00 02 70 04
					39 01 00 00 00 00 02 4D 32
					39 00 00 00 00 00 02 FE 40
					39 00 00 00 00 00 02 BE 17
					39 00 00 00 00 00 02 BF BB /* 560 nit */
					39 00 00 00 00 00 02 C0 DD /* 580 nit */
					39 01 00 00 00 00 02 C1 FF /* set max 600 nit */
					39 00 00 00 00 00 02 FE D0
					39 00 00 00 00 00 02 03 24
					39 01 00 00 00 00 02 04 03
					39 00 00 00 00 00 02 FE 00
					39 00 00 00 00 00 02 C2 08
					39 00 00 00 00 00 02 FE 00
					39 00 00 00 00 00 02 35 00
					39 01 00 00 00 00 03 51 00 00
					05 01 00 00 64 00 02 11 00
					05 01 00 00 00 00 02 29 00];
					qcom,mdss-dsi-off-command = [
					05 01 00 00 32 00 02 28 00
					05 01 00 00 14 00 02 10 00];
				qcom,mdss-dsi-on-command-state = "dsi_lp_mode";
				qcom,mdss-dsi-off-command-state = "dsi_lp_mode";

				qcom,mdss-dsi-dispparam-hbm-fod-on-command = [
					39 01 00 00 03 00 02 FE A0
					39 00 00 00 00 00 02 25 06
					39 00 00 00 00 00 02 FE A0
					39 00 00 00 00 00 02 1F 08
					39 00 00 00 00 00 02 2F 15
					39 00 00 00 00 00 02 29 C0
					39 00 00 00 00 00 02 FE 22
					39 00 00 00 00 00 02 77 00
					39 00 00 00 00 00 02 FE 00
					39 00 00 00 00 00 02 38 00
					39 00 00 00 00 00 02 FE 00
					39 01 00 00 00 00 02 53 E0];
				qcom,mdss-dsi-dispparam-hbm-fod-off-command = [
					39 01 00 00 03 00 02 FE 00
					39 01 00 00 00 00 02 53 20];
				qcom,mdss-dsi-dispparam-hbm-fod-on-command-state = "dsi_hs_mode";
				qcom,mdss-dsi-dispparam-hbm-fod-off-command-state = "dsi_hs_mode";

				qcom,mdss-dsi-doze-hbm-command = [
					39 00 00 00 00 00 02 FE 00
					39 01 00 00 00 00 02 53 20
					39 01 00 00 00 00 02 FE 00
					39 01 00 00 00 00 02 39 00 /* enter aod */
					39 01 00 00 00 00 02 FE 72
					39 01 00 00 00 00 02 69 FF /* 60 nit */
					39 01 00 00 00 00 02 FE 22
					39 01 00 00 00 00 02 77 02
					39 01 00 00 00 00 02 FE A0
					39 01 00 00 00 00 02 1F 00
					39 01 00 00 00 00 02 2F 05
					39 01 00 00 00 00 02 29 C1
					39 01 00 00 00 00 02 FE A0
					39 01 00 00 00 00 02 25 16];
				qcom,mdss-dsi-doze-lbm-command = [
					39 00 00 00 00 00 02 FE 00
					39 01 00 00 00 00 02 53 20
					39 01 00 00 00 00 02 FE 00
					39 01 00 00 00 00 02 39 00 /* enter aod */
					39 01 00 00 00 00 02 FE 72
					39 01 00 00 00 00 02 69 0a /* ~2 nit */
					39 01 00 00 00 00 02 FE 22
					39 01 00 00 00 00 02 77 02
					39 01 00 00 00 00 02 FE A0
					39 01 00 00 00 00 02 1F 00
					39 01 00 00 00 00 02 2F 05
					39 01 00 00 00 00 02 29 C1
					39 01 00 00 00 00 02 FE A0
					39 01 00 00 00 00 02 25 16];
				qcom,mdss-dsi-nolp-command = [
					39 01 00 00 00 00 02 FE A0
					39 01 00 00 00 00 02 25 06
					39 01 00 00 00 00 02 FE A0
					39 01 00 00 00 00 02 1F 08
					39 01 00 00 00 00 02 2F 15
					39 01 00 00 00 00 02 29 C0
					39 01 00 00 00 00 02 FE 22
					39 01 00 00 00 00 02 77 00
					39 01 00 00 00 00 02 FE 00
					39 01 00 00 00 00 02 38 00];
				qcom,mdss-dsi-doze-hbm-command-state = "dsi_lp_mode";
				qcom,mdss-dsi-doze-lbm-command-state = "dsi_lp_mode";
				qcom,mdss-dsi-nolp-command-state = "dsi_lp_mode";

				/* For the f4_41_06 panel, we need to switch the
				DEMURA_LEVEL according to the value of the 51 register. */
				qcom,mdss-dsi-dispparam-demura-level2-command = [
					39 01 00 00 00 00 02 FE 20
					39 01 00 00 00 00 02 BC 02
					39 01 00 00 00 00 02 FE 00];
				qcom,mdss-dsi-dispparam-demura-level2-command-state = "dsi_lp_mode";
				qcom,mdss-dsi-dispparam-demura-level8-command = [
					39 01 00 00 00 00 02 FE 20
					39 01 00 00 00 00 02 BC 08
					39 01 00 00 00 00 02 FE 00];
				qcom,mdss-dsi-dispparam-demura-level8-command-state = "dsi_lp_mode";
				qcom,mdss-dsi-dispparam-demura-leveld-command = [
					39 01 00 00 00 00 02 FE 20
					39 01 00 00 00 00 02 BC 0D
					39 01 00 00 00 00 02 FE 00];
				qcom,mdss-dsi-dispparam-demura-leveld-command-state = "dsi_lp_mode";
				qcom,mdss-dsi-dispparam-dc-demura-l1-command = [
					39 01 00 00 00 00 02 FE 20
					39 01 00 00 00 00 02 BC 00
					39 01 00 00 00 00 02 FE 00];
				qcom,mdss-dsi-dispparam-dc-demura-l1-command-state = "dsi_lp_mode";
				qcom,mdss-dsi-dispparam-dc-demura-l2-command = [
					39 01 00 00 00 00 02 FE 20
					39 01 00 00 00 00 02 BC 04
					39 01 00 00 00 00 02 FE 00];
				qcom,mdss-dsi-dispparam-dc-demura-l2-command-state = "dsi_lp_mode";
				qcom,mdss-dsi-dispparam-dc-on-command = [
					39 00 00 00 00 00 02 FE 40
					39 00 00 00 00 00 02 1D B8
					39 00 00 00 00 00 02 FE D0
					39 00 00 00 00 00 02 71 01
					39 01 00 00 01 00 02 FB AA
					39 00 00 00 00 00 02 FE 74
					39 00 00 00 00 00 02 0E 60
					39 00 00 00 00 00 02 10 01
					39 00 00 00 00 00 02 11 00
					39 00 00 00 00 00 02 12 00
					39 00 00 00 00 00 02 13 00
					39 00 00 00 00 00 02 14 00
					39 00 00 00 00 00 02 15 00
					39 00 00 00 00 00 02 22 60
					39 00 00 00 00 00 02 43 00
					39 00 00 00 00 00 02 45 1F
					39 00 00 00 00 00 02 4A FF
					39 00 00 00 00 00 02 61 60
					39 00 00 00 00 00 02 FE 40
					39 00 00 00 00 00 02 1D F8
					39 00 00 00 00 00 02 FE D0
					39 00 00 00 00 00 02 71 02
					39 01 00 00 14 00 02 FB AA
					39 01 00 00 00 00 02 FE 00];
				qcom,mdss-dsi-dispparam-dc-on-command-state = "dsi_hs_mode";
				qcom,mdss-dsi-dispparam-dc-off-command = [
					39 00 00 00 00 00 02 FE 40
					39 00 00 00 00 00 02 1D B8
					39 00 00 00 00 00 02 FE D0
					39 00 00 00 00 00 02 71 01
					39 01 00 00 01 00 02 FB AA
					39 00 00 00 00 00 02 FE 74
					39 00 00 00 00 00 02 0E 7F
					39 00 00 00 00 00 02 10 08
					39 00 00 00 00 00 02 11 08
					39 00 00 00 00 00 02 12 07
					39 00 00 00 00 00 02 13 06
					39 00 00 00 00 00 02 14 05
					39 00 00 00 00 00 02 15 02
					39 00 00 00 00 00 02 22 7F
					39 00 00 00 00 00 02 43 3F
					39 00 00 00 00 00 02 45 11
					39 00 00 00 00 00 02 4A 6F
					39 00 00 00 00 00 02 61 7F
					39 00 00 00 00 00 02 FE 40
					39 00 00 00 00 00 02 1D F8
					39 00 00 00 00 00 02 FE D0
					39 00 00 00 00 00 02 71 02
					39 01 00 00 14 00 02 FB AA
					39 01 00 00 00 00 02 FE 00];
				qcom,mdss-dsi-dispparam-dc-off-command-state = "dsi_hs_mode";

				qcom,mdss-dsi-dispparam-hbm-on-command = [
					39 01 00 00 00 00 02 FE 00
					39 01 00 00 00 00 02 53 E8];
				qcom,mdss-dsi-dispparam-hbm-off-command = [
					39 01 00 00 00 00 02 FE 00
					39 01 00 00 00 00 02 53 28];
				qcom,mdss-dsi-dispparam-hbm-on-command-state = "dsi_lp_mode";
				qcom,mdss-dsi-dispparam-hbm-off-command-state = "dsi_lp_mode";

				qcom,mdss-dsi-dispparam-dimmingon-command = [
					15 01 00 00 00 00 02 FE 00
					39 01 00 00 00 00 02 53 28];
				qcom,mdss-dsi-dispparam-dimmingon-command-state = "dsi_lp_mode";
				qcom,mdss-dsi-dispparam-dimmingoff-command = [
					15 01 00 00 00 00 02 FE 00
					39 01 00 00 00 00 02 53 20];
				qcom,mdss-dsi-dispparam-dimmingoff-command-state = "dsi_lp_mode";
				/*
				qcom,mdss-dsi-dispparam-crc-srgb-on-command = [
					];
				qcom,mdss-dsi-dispparam-crc-srgb-on-command-state = "dsi_lp_mode";
				qcom,mdss-dsi-dispparam-crc-dcip3-on-command = [
					];
				qcom,mdss-dsi-dispparam-crc-dcip3-on-command-state = "dsi_lp_mode";
				qcom,mdss-dsi-dispparam-crc-off-command = [
					];
				qcom,mdss-dsi-dispparam-crc-off-command-state = "dsi_lp_mode";
				*/
				qcom,mdss-dsi-h-sync-pulse = <0>;
			};
		};
	};
};
