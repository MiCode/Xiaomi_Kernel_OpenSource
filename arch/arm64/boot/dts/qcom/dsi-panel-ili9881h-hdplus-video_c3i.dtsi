/* Copyright (c) 2013, The Linux Foundation. All rights reserved.
 * Copyright (C) 2021 XiaoMi, Inc.
 *
 * This program is free software; you can redistribute it and/or modify
 * it under the terms of the GNU General Public License version 2 and
 * only version 2 as published by the Free Software Foundation.
 *
 * This program is distributed in the hope that it will be useful,
 * but WITHOUT ANY WARRANTY; without even the implied warranty of
 * MERCHANTABILITY or FITNESS FOR A PARTICULAR PURPOSE.  See the
 * GNU General Public License for more details.
 */

/*---------------------------------------------------------------------------
 * This file is autogenerated file using gcdb parser. Please do not edit it.
 * Update input XML file to add a new entry or update variable in this file
 * VERSION = "1.0"
 *---------------------------------------------------------------------------*/
&mdss_mdp {
	dsi_ili9881h_hdplus_c3i_video: qcom,mdss_dsi_ili9881h_hdplus_video_c3i {
		qcom,mdss-dsi-panel-name = "ili9881h hdplus c3i video mode dsi panel";
		qcom,mdss-dsi-panel-controller = <&mdss_dsi0>;
		qcom,mdss-dsi-panel-type = "dsi_video_mode";
		qcom,mdss-dsi-panel-destination = "display_1";
		qcom,mdss-dsi-panel-framerate = <60>;
		qcom,mdss-dsi-virtual-channel-id = <0>;
		qcom,mdss-dsi-stream = <0>;
		qcom,mdss-dsi-panel-width = <720>;
		qcom,mdss-dsi-panel-height = <1520>;
		qcom,mdss-dsi-h-front-porch = <76>;
		qcom,mdss-dsi-h-back-porch = <76>;
		qcom,mdss-dsi-h-pulse-width = <32>;
		qcom,mdss-dsi-h-sync-skew = <0>;
		qcom,mdss-dsi-v-front-porch = <41>;
		qcom,mdss-dsi-v-back-porch = <20>;
		qcom,mdss-dsi-v-pulse-width = <4>;
		qcom,mdss-dsi-h-left-border = <0>;
		qcom,mdss-dsi-h-right-border = <0>;
		qcom,mdss-dsi-v-top-border = <0>;
		qcom,mdss-dsi-v-bottom-border = <0>;
		qcom,mdss-dsi-bpp = <24>;
		qcom,mdss-dsi-underflow-color = <0xff>;
		qcom,mdss-dsi-border-color = <0>;
		qcom,mdss-dsi-on-command = [
					29 01 00 00 00 00 04 ff 98 81 00
					29 01 00 00 78 00 02 11 00
					29 01 00 00 00 00 03 51 0F FE
					29 01 00 00 00 00 02 53 2C
					29 01 00 00 00 00 02 55 00
					29 01 00 00 00 00 02 35 00
					29 01 00 00 00 00 04 ff 98 81 06	//disable R11 reload OTP
					29 01 00 00 00 00 02 3E 62
					29 01 00 00 00 00 04 ff 98 81 01	//4H-3H & GIP duty
					29 01 00 00 00 00 02 00 45
					29 01 00 00 00 00 02 01 32
					29 01 00 00 00 00 02 04 C9
					29 01 00 00 00 00 02 05 12
					29 01 00 00 00 00 02 08 81
					29 01 00 00 00 00 02 0A 72
					29 01 00 00 00 00 02 0C 0A
					29 01 00 00 00 00 02 0D 0A
					29 01 00 00 00 00 02 0E 03
					29 01 00 00 00 00 02 0F 03
					29 01 00 00 00 00 02 B0 34
					29 01 00 00 00 00 02 B2 04
					29 01 00 00 00 00 04 ff 98 81 02	//Source off to gate off delay time @ normal display & notch region
					29 01 00 00 00 00 02 73 08
					29 01 00 00 00 00 02 40 49
					29 01 00 00 00 00 04 ff 98 81 0E	//TP2&TP3 timing
					29 01 00 00 00 00 02 47 88
					29 01 00 00 00 00 02 4E 9F
					29 01 00 00 00 00 02 4F A0
					29 01 00 00 00 00 02 46 4E
					29 01 00 00 00 00 02 D0 35
					29 01 00 00 00 00 02 D9 88
					29 01 00 00 00 00 02 D8 98
					29 01 00 00 00 00 04 ff 98 81 0E
					29 01 00 00 00 00 02 00 A0
					29 01 00 00 00 00 04 ff 98 81 06
					29 01 00 00 00 00 02 C7 05
					29 01 00 00 00 00 04 ff 98 81 02
					29 01 00 00 00 00 02 06 88
					29 01 00 00 00 00 04 ff 98 81 05	//VGL temperature sensor
					29 01 00 00 00 00 02 CC 79
					29 01 00 00 00 00 02 CD 79
					29 01 00 00 00 00 02 CE 79
					29 01 00 00 00 00 02 CF 79
					29 01 00 00 00 00 02 D4 6B
					29 01 00 00 00 00 02 D5 6B
					29 01 00 00 00 00 02 D6 6B
					29 01 00 00 00 00 02 D7 6B
					29 01 00 00 00 00 04 FF 98 81 04  //CE  code
					29 01 00 00 00 00 02 07 07
					29 01 00 00 00 00 02 08 09
					29 01 00 00 00 00 02 09 0C
					29 01 00 00 00 00 02 3C 12
					29 01 00 00 00 00 02 3D 11
					29 01 00 00 00 00 02 3E 11
					29 01 00 00 00 00 02 3F 01
					29 01 00 00 00 00 02 40 01
					29 01 00 00 00 00 02 41 02
					29 01 00 00 00 00 02 42 03
					29 01 00 00 00 00 02 43 01
					29 01 00 00 00 00 02 44 00
					29 01 00 00 00 00 02 45 00
					29 01 00 00 00 00 02 46 01
					29 01 00 00 00 00 02 47 02
					29 01 00 00 00 00 02 48 01
					29 01 00 00 00 00 02 49 02
					29 01 00 00 00 00 02 4A 09
					29 01 00 00 00 00 02 4B 06
					29 01 00 00 00 00 02 4C 04
					29 01 00 00 00 00 02 4D 03
					29 01 00 00 00 00 02 4E 01
					29 01 00 00 00 00 02 4F 11
					29 01 00 00 00 00 02 50 11
					29 01 00 00 00 00 02 51 11
					29 01 00 00 00 00 02 52 12
					29 01 00 00 00 00 02 53 12
					29 01 00 00 00 00 02 0A 01
					29 01 00 00 00 00 02 0B 01
					29 01 00 00 00 00 02 0C 01
					29 01 00 00 00 00 02 0D 03
					29 01 00 00 00 00 02 0E 03
					29 01 00 00 00 00 02 0F 02
					29 01 00 00 00 00 02 10 02
					29 01 00 00 00 00 02 11 02
					29 01 00 00 00 00 02 12 02
					29 01 00 00 00 00 02 13 02
					29 01 00 00 00 00 02 14 02
					29 01 00 00 00 00 02 15 02
					29 01 00 00 00 00 02 16 02
					29 01 00 00 00 00 02 17 02
					29 01 00 00 00 00 02 18 02
					29 01 00 00 00 00 02 19 02
					29 01 00 00 00 00 02 1A 02
					29 01 00 00 00 00 02 1B 02
					29 01 00 00 00 00 02 1C 02
					29 01 00 00 00 00 02 1D 02
					29 01 00 00 00 00 02 1E 02
					29 01 00 00 00 00 02 1F 02
					29 01 00 00 00 00 02 20 02
					29 01 00 00 00 00 02 21 01
					29 01 00 00 00 00 04 ff 98 81 03  //UI
					29 01 00 00 00 00 02 89 40
					29 01 00 00 00 00 02 90 14
					29 01 00 00 00 00 02 91 F6
					29 01 00 00 00 00 02 92 16
					29 01 00 00 00 00 02 93 F7
					29 01 00 00 00 00 02 94 0E   //moving
					29 01 00 00 00 00 02 95 0F
					29 01 00 00 00 00 02 96 10
					29 01 00 00 00 00 02 97 11
					29 01 00 00 00 00 02 98 12
					29 01 00 00 00 00 02 99 13
					29 01 00 00 00 00 02 9A 14
					29 01 00 00 00 00 02 9B 15
					29 01 00 00 00 00 02 9C 16
					29 01 00 00 00 00 02 9D 16
					29 01 00 00 00 00 02 9E 02   //still
					29 01 00 00 00 00 02 9f 04
					29 01 00 00 00 00 02 A0 07
					29 01 00 00 00 00 02 A1 0A
					29 01 00 00 00 00 02 A2 0D
					29 01 00 00 00 00 02 A3 0F
					29 01 00 00 00 00 02 A4 11
					29 01 00 00 00 00 02 A5 13
					29 01 00 00 00 00 02 A6 95
					29 01 00 00 00 00 02 A7 96
					29 01 00 00 00 00 04 ff 98 81 00
					29 01 00 00 14 00 02 29 00
					];
		qcom,mdss-dsi-off-command = [
					29 01 00 00 00 00 04 ff 98 81 00
					29 01 00 00 14 00 02 28 00
					29 01 00 00 78 00 02 10 00
					];
		qcom,mdss-dsi-CABC_UI_on-command = [
					29 01 00 00 00 00 04 FF 98 81 00
					29 01 00 00 00 00 02 55 01
					];
		qcom,mdss-dsi-CABC_MOVIE_on-command = [
					29 01 00 00 00 00 04 FF 98 81 00
					29 01 00 00 00 00 02 55 02
					];
		qcom,mdss-dsi-CABC_STILL_on-command = [
					29 01 00 00 00 00 04 ff 98 81 00
					29 01 00 00 00 00 02 55 03
					];
		qcom,mdss-dsi-CABC_off-command = [
					29 01 00 00 00 00 04 FF 98 81 00
					29 01 00 00 00 00 02 55 00
					];
		qcom,mdss-dsi-CE_on-command = [
					29 01 00 00 00 00 04 FF 98 81 04
					29 01 00 00 00 00 02 00 83
					29 01 00 00 00 00 02 02 45
					29 01 00 00 00 00 04 FF 98 81 00
					];
		qcom,mdss-dsi-CE_off-command = [
					29 01 00 00 00 00 04 FF 98 81 04
					29 01 00 00 00 00 02 00 83
					29 01 00 00 00 00 02 02 40
					29 01 00 00 00 00 04 FF 98 81 00
					];
		qcom,mdss-dsi-on-command-state = "dsi_lp_mode";
		qcom,mdss-dsi-off-command-state = "dsi_lp_mode";
		qcom,mdss-dsi-h-sync-pulse = <1>;
		qcom,mdss-dsi-traffic-mode = "burst_mode";
		qcom,mdss-dsi-lp11-init;
		qcom,mdss-dsi-lane-map = "lane_map_0123";
		qcom,mdss-dsi-bllp-eof-power-mode;
		qcom,mdss-dsi-bllp-power-mode;
		qcom,mdss-dsi-lane-0-state;
		qcom,mdss-dsi-lane-1-state;
		qcom,mdss-dsi-lane-2-state;
		qcom,mdss-dsi-lane-3-state;
		/delete-property/ qcom,mdss-dsi-panel-timings;
		qcom,mdss-dsi-panel-timings-phy-12nm = [
					0b 07 06 03 00 05 03 09];
		qcom,mdss-dsi-t-clk-post = <0x60>;
		qcom,mdss-dsi-t-clk-pre = <0x06>;
		qcom,mdss-dsi-bl-min-level = <1>;
		qcom,mdss-dsi-bl-max-level = <2047>;
		qcom,mdss-brightness-max-level = <2047>;
		qcom,mdss-brightness-max-level-factory = <255>;
		qcom,mdss-dsi-bl-pmic-control-type = "bl_mount";
		qcom,panel-supply-entries = <&dsi_panel_pwr_supply>;
		qcom,mdss-dsi-reset-sequence = <1 20>, <0 2>, <1 20>;
		qcom,esd-check-enabled;
		qcom,mdss-dsi-panel-status-command = [
					14 01 00 01 00 00 01 0A
					14 01 00 01 00 00 01 0D
					];
		qcom,mdss-dsi-panel-status-command-mode = "dsi_lp_mode";
		qcom,mdss-dsi-panel-status-check-mode = "reg_read";
		qcom,mdss-dsi-panel-status-read-length = <1 1>;
		qcom,mdss-dsi-panel-status-valid-params = <1>;
		qcom,mdss-dsi-panel-status-value = <0x9C>,<0x00>;
		qcom,mdss-dsi-panel-max-error-count = <3>;
		qcom,mdss-dsi-tx-eot-append;
		qcom,mdss-pan-physical-width-dimension = <68>;
		qcom,mdss-pan-physical-height-dimension = <143>;
	};
};
