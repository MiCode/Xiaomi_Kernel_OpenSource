/* Copyright (c) 2015, The Linux Foundation. All rights reserved.
 * Copyright (C) 2021 XiaoMi, Inc.
 *
 * This program is free software; you can redistribute it and/or modify
 * it under the terms of the GNU General Public License version 2 and
 * only version 2 as published by the Free Software Foundation.
 *
 * This program is distributed in the hope that it will be useful,
 * but WITHOUT ANY WARRANTY; without even the implied warranty of
 * MERCHANTABILITY or FITNESS FOR A PARTICULAR PURPOSE.  See the
 * GNU General Public License for more details.
 */

/*---------------------------------------------------------------------------
 * This file is autogenerated file using gcdb parser. Please do not edit it.
 * Update input XML file to add a new entry or update variable in this file
 * VERSION = "1.0"
 *---------------------------------------------------------------------------*/
&soc {
	dsi_tianma_fhd_nt36672a_video: qcom,mdss_dsi_tianma_fhd_nt36672a_video {
		qcom,mdss-dsi-panel-name = "tianma  fhd vide dsi panel";
		qcom,mdss-dsi-panel-id = <0>;
		qcom,mdss-dsi-panel-model = "TIANMA FHD NT36672A VIDE PANEL";
		qcom,mdss-dsi-panel-sleepwrmod = <0>;

//
		qcom,mdss-dsi-panel-type = "dsi_video_mode";
		qcom,mdss-dsi-virtual-channel-id = <0>;
		qcom,mdss-dsi-stream = <0>;
		qcom,mdss-dsi-bpp = <24>;
		qcom,mdss-dsi-color-order = "rgb_swap_rgb";
		qcom,mdss-dsi-underflow-color = <0x0>;
		qcom,mdss-dsi-border-color = <0>;
		qcom,mdss-dsi-traffic-mode = "burst_mode";
		qcom,mdss-dsi-bllp-eof-power-mode;
		qcom,mdss-dsi-bllp-power-mode;
		qcom,mdss-dsi-lp11-init;
		qcom,mdss-dsi-lane-0-state;
		qcom,mdss-dsi-lane-1-state;
		qcom,mdss-dsi-lane-2-state;
		qcom,mdss-dsi-lane-3-state;
		qcom,mdss-dsi-bl-min-level = <1>;
		qcom,mdss-dsi-bl-max-level = <4095>;
		qcom,mdss-brightness-max-level = <255>;
		qcom,mdss-dsi-dma-trigger = "trigger_sw";
		qcom,mdss-dsi-mdp-trigger = "none";
		qcom,mdss-dsi-reset-sequence = <0 10>, <1 10>;
		qcom,mdss-pan-physical-width-dimension = <68>;
		qcom,mdss-pan-physical-height-dimension = <136>;
		qcom,cont-splash-enabled;
		qcom,mdss-dsi-tx-eot-append;
        qcom,esd-err-irq-gpio = <&tlmm 5 0x2001>;
        qcom,mdss-dsi-panel-hdr-enabled;
        qcom,mdss-dsi-panel-hdr-color-primaries = <14500 15500 32000
        17000 15500 30000 8000 3000>;
        qcom,dispparam-enabled;
		qcom,mdss-panel-on-dimming-delay = <120>;

        qcom,mdss-dsi-display-timings {
          timing@0{
				qcom,mdss-dsi-panel-framerate = <60>;
				qcom,mdss-dsi-panel-width = <1080>;
				qcom,mdss-dsi-panel-height = <2340>;
				qcom,mdss-dsi-h-front-porch = <40>;
				qcom,mdss-dsi-h-back-porch = <44>;//debug
				qcom,mdss-dsi-h-pulse-width = <20>;
				qcom,mdss-dsi-h-sync-skew = <0>;
				qcom,mdss-dsi-v-back-porch = <8>;
				qcom,mdss-dsi-v-front-porch = <15>;
				qcom,mdss-dsi-v-pulse-width = <2>;
				qcom,mdss-dsi-h-left-border = <0>;
				qcom,mdss-dsi-h-right-border = <0>;
				qcom,mdss-dsi-v-top-border = <0>;
				qcom,mdss-dsi-v-bottom-border = <0>;

			 qcom,mdss-dsi-on-command = [
						/* skin enhancement mode */
						15 01 00 00 00 00 02 FF 22
						15 00 00 00 00 00 02 00 40
						15 00 00 00 00 00 02 01 C0
						15 00 00 00 00 00 02 02 40
						15 00 00 00 00 00 02 03 40
						15 00 00 00 00 00 02 04 40
						15 00 00 00 00 00 02 05 40
						15 00 00 00 00 00 02 06 40
						15 00 00 00 00 00 02 07 40
						15 00 00 00 00 00 02 08 40
						15 00 00 00 00 00 02 09 40
						15 00 00 00 00 00 02 0A 40
						15 00 00 00 00 00 02 0B 40
						15 00 00 00 00 00 02 0C 40
						15 00 00 00 00 00 02 0D 40
						15 00 00 00 00 00 02 0E 40
						15 00 00 00 00 00 02 0F 40
						15 00 00 00 00 00 02 10 40
						15 00 00 00 00 00 02 11 50
						15 00 00 00 00 00 02 12 60
						15 00 00 00 00 00 02 13 70
						15 00 00 00 00 00 02 14 58
						15 00 00 00 00 00 02 15 68
						15 00 00 00 00 00 02 16 78
						15 01 00 00 00 00 02 17 77
						15 00 00 00 00 00 02 18 39
						15 00 00 00 00 00 02 19 2D
						15 00 00 00 00 00 02 1A 2E
						15 00 00 00 00 00 02 1B 32
						15 00 00 00 00 00 02 1C 37
						15 00 00 00 00 00 02 1D 3A
						15 00 00 00 00 00 02 1E 40
						15 00 00 00 00 00 02 1F 40
						15 00 00 00 00 00 02 20 40
						15 00 00 00 00 00 02 21 40
						15 00 00 00 00 00 02 22 40
						15 00 00 00 00 00 02 23 40
						15 00 00 00 00 00 02 24 40
						15 00 00 00 00 00 02 25 40
						15 00 00 00 00 00 02 26 40
						15 00 00 00 00 00 02 27 40
						15 00 00 00 00 00 02 28 40
						15 00 00 00 00 00 02 2D 00
						15 00 00 00 00 00 02 2F 40
						15 00 00 00 00 00 02 30 40
						15 00 00 00 00 00 02 31 40
						15 00 00 00 00 00 02 32 40
						15 00 00 00 00 00 02 33 40
						15 00 00 00 00 00 02 34 40
						15 01 00 00 00 00 02 35 40
						15 00 00 00 00 00 02 36 40
						15 00 00 00 00 00 02 37 40
						15 00 00 00 00 00 02 38 40
						15 00 00 00 00 00 02 39 40
						15 00 00 00 00 00 02 3A 40
						15 00 00 00 00 00 02 3B 40
						15 00 00 00 00 00 02 3D 40
						15 00 00 00 00 00 02 3F 40
						15 00 00 00 00 00 02 40 40
						15 00 00 00 00 00 02 41 40
						15 00 00 00 00 00 02 42 40
						15 00 00 00 00 00 02 43 40
						15 00 00 00 00 00 02 44 40
						15 00 00 00 00 00 02 45 40
						15 00 00 00 00 00 02 46 40
						15 00 00 00 00 00 02 47 40
						15 00 00 00 00 00 02 48 40
						15 00 00 00 00 00 02 49 40
						15 00 00 00 00 00 02 4A 40
						15 00 00 00 00 00 02 4B 40
						15 00 00 00 00 00 02 4C 40
						15 00 00 00 00 00 02 4D 40
						15 00 00 00 00 00 02 4E 40
						15 00 00 00 00 00 02 4F 40
						15 01 00 00 00 00 02 50 40
						15 00 00 00 00 00 02 51 40
						15 00 00 00 00 00 02 52 40
						15 00 00 00 00 00 02 53 01
						15 00 00 00 00 00 02 54 01
						15 00 00 00 00 00 02 55 FE
						15 00 00 00 00 00 02 56 77
						15 00 00 00 00 00 02 58 CD
						15 00 00 00 00 00 02 59 D0
						15 00 00 00 00 00 02 5A D0
						15 00 00 00 00 00 02 5B 50
						15 00 00 00 00 00 02 5C 50
						15 00 00 00 00 00 02 5D 50
						15 00 00 00 00 00 02 5E 50
						15 00 00 00 00 00 02 5F 50
						15 00 00 00 00 00 02 60 50
						15 00 00 00 00 00 02 61 50
						15 00 00 00 00 00 02 62 50
						15 00 00 00 00 00 02 63 50
						15 00 00 00 00 00 02 64 50
						15 00 00 00 00 00 02 65 50
						15 00 00 00 00 00 02 66 50
						15 00 00 00 00 00 02 67 50
						15 00 00 00 00 00 02 68 50
						15 00 00 00 00 00 02 69 50
						15 01 00 00 00 00 02 6A 50
						15 00 00 00 00 00 02 6B 50
						15 00 00 00 00 00 02 6C 50
						15 00 00 00 00 00 02 6D 50
						15 00 00 00 00 00 02 6E 50
						15 00 00 00 00 00 02 6F 50
						15 00 00 00 00 00 02 70 07
						15 00 00 00 00 00 02 71 00
						15 00 00 00 00 00 02 72 00
						15 00 00 00 00 00 02 73 00
						15 00 00 00 00 00 02 74 06
						15 00 00 00 00 00 02 75 0C
						15 00 00 00 00 00 02 76 03
						15 00 00 00 00 00 02 77 09
						15 00 00 00 00 00 02 78 0F
						15 00 00 00 00 00 02 79 68
						15 00 00 00 00 00 02 7A 88
						15 00 00 00 00 00 02 7C 80
						15 00 00 00 00 00 02 7D 80
						15 00 00 00 00 00 02 7E 80
						15 00 00 00 00 00 02 7F 00
						15 00 00 00 00 00 02 80 00
						15 00 00 00 00 00 02 81 00
						15 00 00 00 00 00 02 83 01
						15 00 00 00 00 00 02 84 00
						15 01 00 00 00 00 02 85 80
						15 00 00 00 00 00 02 86 80
						15 00 00 00 00 00 02 87 80
						15 00 00 00 00 00 02 88 40
						15 00 00 00 00 00 02 89 91
						15 00 00 00 00 00 02 8A 98
						15 00 00 00 00 00 02 8B 80
						15 00 00 00 00 00 02 8C 80
						15 00 00 00 00 00 02 8D 80
						15 00 00 00 00 00 02 8E 80
						15 00 00 00 00 00 02 8F 80
						15 00 00 00 00 00 02 90 80
						15 00 00 00 00 00 02 91 80
						15 00 00 00 00 00 02 92 80
						15 00 00 00 00 00 02 93 80
						15 00 00 00 00 00 02 94 80
						15 00 00 00 00 00 02 95 80
						15 00 00 00 00 00 02 96 80
						15 00 00 00 00 00 02 97 80
						15 00 00 00 00 00 02 98 80
						15 00 00 00 00 00 02 99 80
						15 00 00 00 00 00 02 9A 80
						15 00 00 00 00 00 02 9B 80
						15 00 00 00 00 00 02 9C 80
						15 00 00 00 00 00 02 9D 80
						15 01 00 00 00 00 02 9E 80
						15 00 00 00 00 00 02 9F 80
						15 00 00 00 00 00 02 A0 8A
						15 00 00 00 00 00 02 A2 80
						15 00 00 00 00 00 02 A6 80
						15 00 00 00 00 00 02 A7 80
						15 00 00 00 00 00 02 A9 80
						15 00 00 00 00 00 02 AA 80
						15 00 00 00 00 00 02 AB 80
						15 00 00 00 00 00 02 AC 80
						15 00 00 00 00 00 02 AD 80
						15 00 00 00 00 00 02 AE 80
						15 00 00 00 00 00 02 AF 80
						15 00 00 00 00 00 02 B7 76
						15 00 00 00 00 00 02 B8 76
						15 00 00 00 00 00 02 B9 05
						15 00 00 00 00 00 02 BA 0D
						15 00 00 00 00 00 02 BB 14
						15 00 00 00 00 00 02 BC 0F
						15 00 00 00 00 00 02 BD 18
						15 00 00 00 00 00 02 BE 1F
						15 00 00 00 00 00 02 BF 05
						15 00 00 00 00 00 02 C0 0D
						15 00 00 00 00 00 02 C1 14
						15 00 00 00 00 00 02 C2 03
						15 01 00 00 00 00 02 C3 07
						15 00 00 00 00 00 02 C4 0A
						15 00 00 00 00 00 02 C5 A0
						15 00 00 00 00 00 02 C6 55
						15 00 00 00 00 00 02 C7 FF
						15 00 00 00 00 00 02 C8 39
						15 00 00 00 00 00 02 C9 44
						15 00 00 00 00 00 02 CA 12
						15 00 00 00 00 00 02 CD 80
						15 00 00 00 00 00 02 DB 80
						15 00 00 00 00 00 02 DC 80
						15 00 00 00 00 00 02 DD 80
						15 00 00 00 00 00 02 E0 80
						15 00 00 00 00 00 02 E1 80
						15 00 00 00 00 00 02 E2 80
						15 00 00 00 00 00 02 E3 80
						15 00 00 00 00 00 02 E4 80
						15 00 00 00 00 00 02 E5 40
						15 00 00 00 00 00 02 E6 40
						15 00 00 00 00 00 02 E7 40
						15 00 00 00 00 00 02 E8 40
						15 00 00 00 00 00 02 E9 40
						15 00 00 00 00 00 02 EA 40
						15 00 00 00 00 00 02 EB 40
						15 00 00 00 00 00 02 EC 40
						15 00 00 00 00 00 02 ED 40
						15 00 00 00 00 00 02 EE 40
						15 00 00 00 00 00 02 EF 40
						15 00 00 00 00 00 02 F0 40
						15 00 00 00 00 00 02 F1 40
						15 00 00 00 00 00 02 F2 40
						15 00 00 00 00 00 02 F3 40
						15 00 00 00 00 00 02 F4 40
						15 00 00 00 00 00 02 F5 40
						15 00 00 00 00 00 02 F6 40
						15 01 00 00 00 00 02 FB 01
						15 01 00 00 00 00 02 FF 23
						15 00 00 00 00 00 02 FB 01
					/* dimming enable */
						15 00 00 00 00 00 02 01 84
						15 00 00 00 00 00 02 05 2D
						15 00 00 00 00 00 02 06 00
						/* resolution 1080*2246 */
						15 00 00 00 00 00 02 11 01
						15 00 00 00 00 00 02 12 7B
						15 00 00 00 00 00 02 15 6F
						15 00 00 00 00 00 02 16 0B
					/* UI mode */
						15 00 00 00 00 00 02 29 0A
						15 00 00 00 00 00 02 30 FF
						15 00 00 00 00 00 02 31 FF
						15 00 00 00 00 00 02 32 FF
						15 00 00 00 00 00 02 33 FF
						15 00 00 00 00 00 02 34 FF
						15 00 00 00 00 00 02 35 FF
						15 00 00 00 00 00 02 36 FF
						15 00 00 00 00 00 02 37 FF
						15 00 00 00 00 00 02 38 FC
						15 01 00 00 00 00 02 39 F8
						15 00 00 00 00 00 02 3A F4
						15 00 00 00 00 00 02 3B F1
						15 00 00 00 00 00 02 3D EE
						15 00 00 00 00 00 02 3F EB
						15 00 00 00 00 00 02 40 E8
						15 00 00 00 00 00 02 41 E5
					/* STILL mode */
						15 00 00 00 00 00 02 2A 13
						15 00 00 00 00 00 02 45 FF
						15 00 00 00 00 00 02 46 FF
						15 00 00 00 00 00 02 47 FF
						15 00 00 00 00 00 02 48 FF
						15 00 00 00 00 00 02 49 FF
						15 00 00 00 00 00 02 4A FF
						15 00 00 00 00 00 02 4B FF
						15 00 00 00 00 00 02 4C FF
						15 00 00 00 00 00 02 4D ED
						15 00 00 00 00 00 02 4E D5
						15 00 00 00 00 00 02 4F BF
						15 00 00 00 00 00 02 50 A6
						15 01 00 00 00 00 02 51 96
						15 00 00 00 00 00 02 52 86
						15 00 00 00 00 00 02 53 76
						15 00 00 00 00 00 02 54 66
						/* MOVING mode */
						15 00 00 00 00 00 02 2B 0E
						15 00 00 00 00 00 02 58 FF
						15 00 00 00 00 00 02 59 FF
						15 00 00 00 00 00 02 5A FF
						15 00 00 00 00 00 02 5B FF
						15 00 00 00 00 00 02 5C FF
						15 00 00 00 00 00 02 5D FF
						15 00 00 00 00 00 02 5E FF
						15 00 00 00 00 00 02 5F FF
						15 00 00 00 00 00 02 60 F6
						15 00 00 00 00 00 02 61 EA
						15 00 00 00 00 00 02 62 E1
						15 00 00 00 00 00 02 63 D8
						15 00 00 00 00 00 02 64 CE
						15 00 00 00 00 00 02 65 C3
						15 00 00 00 00 00 02 66 BA
						15 01 00 00 00 00 02 67 B3
						15 01 00 00 00 00 02 FF 25
						15 00 00 00 00 00 02 FB 01
						15 00 00 00 00 00 02 05 04
						15 01 00 00 00 00 02 FF 26
						15 00 00 00 00 00 02 FB 01
						15 00 00 00 00 00 02 1C AF
						15 01 00 00 00 00 02 FF 10
						15 00 00 00 00 00 02 FB 01
						15 00 00 00 00 00 02 51 FF
						15 00 00 00 00 00 02 53 24
						15 00 00 00 00 00 02 55 00
						05 01 00 00 00 00 02 29 00
						05 01 00 00 46 00 02 11 00
						15 01 00 00 00 00 02 FF 24
						15 00 00 00 00 00 02 FB 01
						15 00 00 00 00 00 02 C3 01
						15 00 00 00 00 00 02 C4 55
						15 00 00 00 00 00 02 C5 55
						15 01 00 00 00 00 02 FF 10
				];

		        qcom,mdss-dsi-off-command = [
		        15 01 00 00 00 00 02 FF 24
		        15 00 00 00 00 00 02 FB 01
		        15 00 00 00 00 00 02 C3 00
		        15 01 00 00 00 00 02 FF 10
		        05 01 00 00 00 00 02 28 00
		        05 01 00 00 3C 00 02 10 00];
		        qcom,mdss-dsi-on-command-state = "dsi_lp_mode";
		        qcom,mdss-dsi-off-command-state = "dsi_hs_mode";
		        qcom,mdss-dsi-h-sync-pulse = <1>;
			};
		};
	};
};
