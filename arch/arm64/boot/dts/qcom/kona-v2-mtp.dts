// SPDX-License-Identifier: GPL-2.0-only
/*
 * Copyright (c) 2019, The Linux Foundation. All rights reserved.
 */

/dts-v1/;

#include "kona-v2.dtsi"
#include "kona-mtp.dtsi"

/ {
	model = "Qualcomm Technologies, Inc. kona MTP";
	compatible = "qcom,kona-mtp", "qcom,kona", "qcom,mtp";
	qcom,board-id = <8 0>;
};
