/* Copyright (c) 2018-2019, The Linux Foundation. All rights reserved.
 * Copyright (C) 2021 XiaoMi, Inc.
 *
 * This program is free software; you can redistribute it and/or modify
 * it under the terms of the GNU General Public License version 2 and
 * only version 2 as published by the Free Software Foundation.
 *
 * This program is distributed in the hope that it will be useful,
 * but WITHOUT ANY WARRANTY; without even the implied warranty of
 * MERCHANTABILITY or FITNESS FOR A PARTICULAR PURPOSE.  See the
 * GNU General Public License for more details.
 */

&mdss_mdp {
	dsi_ft8719_huaxing_video: qcom,mdss_dsi_ft8719_huaxing_video {
		qcom,mdss-dsi-panel-name =
			"ft8719 video mode dsi huaxing panel";
		qcom,mdss-dsi-panel-type = "dsi_video_mode";

		qcom,mdss-dsi-virtual-channel-id = <0>;
		qcom,mdss-dsi-stream = <0>;
		qcom,mdss-dsi-h-left-border = <0>;
		qcom,mdss-dsi-h-right-border = <0>;
		qcom,mdss-dsi-v-top-border = <0>;
		qcom,mdss-dsi-v-bottom-border = <0>;
		qcom,mdss-dsi-bpp = <24>;
		qcom,mdss-dsi-color-order = "rgb_swap_rgb";
		qcom,mdss-dsi-underflow-color = <0xff>;
		qcom,mdss-dsi-border-color = <0>;
		qcom,mdss-dsi-h-sync-pulse = <0>;
		qcom,mdss-dsi-traffic-mode = "non_burst_sync_event";
		qcom,mdss-dsi-lane-map = "lane_map_0123";
		qcom,mdss-dsi-bllp-eof-power-mode;
		qcom,mdss-dsi-bllp-power-mode;
		qcom,mdss-dsi-tx-eot-append;
		qcom,mdss-dsi-lane-0-state;
		qcom,mdss-dsi-lane-1-state;
		qcom,mdss-dsi-lane-2-state;
		qcom,mdss-dsi-lane-3-state;
		qcom,mdss-dsi-dma-trigger = "trigger_sw";
		qcom,mdss-dsi-mdp-trigger = "none";
		qcom,mdss-dsi-lp11-init;
		qcom,mdss-dsi-bl-pmic-control-type = "bl_ctrl_dcs";
		qcom,mdss-dsi-bl-min-level = <1>;
		qcom,mdss-dsi-bl-max-level = <4095>;
		qcom,mdss-dsi-reset-sequence = <1 10>, <0 10>, <1 10>;
		qcom,mdss-pan-physical-width-dimension = <67>;
		qcom,mdss-pan-physical-height-dimension = <145>;

		qcom,mdss-dsi-display-timings {
			timing@0 {
				qcom,mdss-dsi-panel-width = <1080>;
				qcom,mdss-dsi-panel-height = <2340>;
				qcom,mdss-dsi-h-front-porch = <72>;
				qcom,mdss-dsi-h-back-porch = <80>;
				qcom,mdss-dsi-h-pulse-width = <4>;
				qcom,mdss-dsi-h-sync-skew = <0>;
				qcom,mdss-dsi-v-back-porch = <12>;
				qcom,mdss-dsi-v-front-porch = <112>;
				qcom,mdss-dsi-v-pulse-width = <4>;
				qcom,mdss-dsi-panel-framerate = <60>;
				qcom,mdss-dsi-on-command = [
					39 01 00 00 00 00 02 00 00
					39 01 00 00 00 00 04 ff 87 19 01
					39 01 00 00 00 00 02 00 80
					39 01 00 00 00 00 03 ff 87 19

					39 01 00 00 00 00 02 00 80
					39 01 00 00 00 00 0D CA 80 80 80 80 80 80 80 80 80 80 80 80
					39 01 00 00 00 00 02 00 90
					39 01 00 00 00 00 0A CA FE FF 66 F6 FF 66 FB FF 32
										
					39 01 00 00 00 00 02 00 B5
					39 01 00 00 00 00 02 CA 06
                                	39 01 00 00 00 00 02 00 B2
                                	39 01 00 00 00 00 02 CA 0c
											
					15 01 00 00 55 00 02 11 00
					15 01 00 00 00 00 02 29 00
					15 01 00 00 00 00 02 51 B8
					15 01 00 00 00 00 02 53 24
					15 01 00 00 00 00 02 55 00
					];
				qcom,mdss-dsi-off-command = [
				  15 01 00 00 00 00 02 53 24
				  39 01 00 00 14 00 02 28 00
				  39 01 00 00 78 00 02 10 00
				  39 01 00 00 00 00 02 00 00
				  39 01 00 00 00 00 05 f7 5a a5 95 27];
 	        	qcom,mdss-dsi-cabc-on-command = [
				39 01 00 00 00 00 02 55 01
 	        	];
 	        	qcom,mdss-dsi-cabc-off-command = [
				39 01 00 00 00 00 02 55 00
 	        	];
			qcom,mdss-dsi-cabc_movie-on-command = [
				39 01 00 00 00 00 02 55 03
			];
			qcom,mdss-dsi-cabc_still-on-command = [
				39 01 00 00 00 00 02 55 02
			];
	        	qcom,mdss-dsi-hbm1-on-command = [
     	        	15 01 00 00 00 00 02 53 2c
	        		15 01 00 00 00 00 02 51 CC
	        	];
	        	qcom,mdss-dsi-hbm2-on-command = [
	            	15 01 00 00 00 00 02 53 2c
	        		15 01 00 00 00 00 02 51 E6
	        	];
	        	qcom,mdss-dsi-hbm3-on-command = [
	            	15 01 00 00 00 00 02 53 2c
	        		15 01 00 00 00 00 02 51 FF
	        	];
	        	qcom,mdss-dsi-hbm-off-command = [
	            	15 01 00 00 00 00 02 53 2c
	        		15 01 00 00 00 00 02 51 B8
				];
      			qcom,mdss-dsi-on-command-state = "dsi_lp_mode";
	    		qcom,mdss-dsi-off-command-state = "dsi_hs_mode";
		    	qcom,mdss-dsi-cabc-on-command-state = "dsi_hs_mode";
     		    	qcom,mdss-dsi-cabc-off-command-state = "dsi_hs_mode";
			qcom,mdss-dsi-cabc_movie-on-command-state = "dsi_hs_mode";
			qcom,mdss-dsi-cabc_still-on-command-state = "dsi_hs_mode";
		        qcom,mdss-dsi-hbm1-on-command-state = "dsi_hs_mode";
		        qcom,mdss-dsi-hbm2-on-command-state = "dsi_hs_mode";
		        qcom,mdss-dsi-hbm3-on-command-state = "dsi_hs_mode";
		        qcom,mdss-dsi-hbm-off-command-state = "dsi_hs_mode";

			qcom,esd-check-enabled;
			qcom,mdss-dsi-panel-status-command = [06 01 00 01 05 00 01 0A];
			qcom,mdss-dsi-panel-status-command-state = "dsi_hs_mode";
			qcom,mdss-dsi-panel-status-check-mode = "reg_read";
			qcom,mdss-dsi-panel-status-read-length = <1>;
			qcom,mdss-dsi-panel-status-value = <0x9c>;
			qcom,mdss-dsi-panel-max-error-count = <3>;
			};
		};
	};
};
