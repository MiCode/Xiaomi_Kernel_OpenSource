/* Copyright (c) 2015, The Linux Foundation. All rights reserved.
 * Copyright (C) 2019 XiaoMi, Inc.
 *
 * This program is free software; you can redistribute it and/or modify
 * it under the terms of the GNU General Public License version 2 and
 * only version 2 as published by the Free Software Foundation.
 *
 * This program is distributed in the hope that it will be useful,
 * but WITHOUT ANY WARRANTY; without even the implied warranty of
 * MERCHANTABILITY or FITNESS FOR A PARTICULAR PURPOSE.  See the
 * GNU General Public License for more details.
 */

/*---------------------------------------------------------------------------
 * This file is autogenerated file using gcdb parser. Please do not edit it.
 * Update input XML file to add a new entry or update variable in this file
 * VERSION = "1.0"
 *---------------------------------------------------------------------------*/
&soc {
	dsi_ss_notch_fhd_ea8074_cmd: qcom,mdss_dsi_ss_notch_fhd_ea8074_cmd {
		qcom,mdss-dsi-panel-name = "ss notch fhd cmd dsi panel";
		qcom,mdss-dsi-panel-id = <0>;
		qcom,mdss-dsi-panel-model = "SS NOTCH FHD EA8074 CMD PANEL";
		qcom,mdss-dsi-panel-sleepwrmod = <0>;
		qcom,mdss-dsi-panel-type = "dsi_cmd_mode";
		qcom,mdss-dsi-virtual-channel-id = <0>;
		qcom,mdss-dsi-stream = <0>;
		qcom,mdss-dsi-bpp = <24>;
		qcom,mdss-dsi-underflow-color = <0xff>;
		qcom,mdss-dsi-border-color = <0>;
		qcom,mdss-dsi-traffic-mode = "burst_mode";
		qcom,mdss-dsi-bllp-eof-power-mode;
		qcom,mdss-dsi-bllp-power-mode;
		qcom,ulps-enabled;
		qcom,mdss-dsi-lp11-init;
		qcom,mdss-dsi-lane-0-state;
		qcom,mdss-dsi-lane-1-state;
		qcom,mdss-dsi-lane-2-state;
		qcom,mdss-dsi-lane-3-state;
		qcom,mdss-brightness-max-level = <1023>;
		qcom,mdss-dsi-dma-trigger = "trigger_sw";
		qcom,mdss-dsi-mdp-trigger = "none";
		qcom,mdss-dsi-bl-dcs-type-ss;
		qcom,mdss-dsi-reset-sequence = <1 1>, <0 1>, <1 10>;
		qcom,mdss-pan-physical-width-dimension = <68>;
		qcom,mdss-pan-physical-height-dimension = <142>;
		qcom,mdss-dsi-te-pin-select = <1>;
		qcom,mdss-dsi-wr-mem-start = <0x2c>;
		qcom,mdss-dsi-wr-mem-continue = <0x3c>;
		qcom,mdss-dsi-te-dcs-command = <1>;
		qcom,mdss-dsi-te-check-enable;
		qcom,mdss-dsi-te-using-te-pin;
		qcom,mdss-dsi-tx-eot-append;
		qcom,mdss-dsi-panel-hdr-enabled;
		qcom,mdss-dsi-panel-hdr-color-primaries = <14500 15500 32000
			17000 15500 30000 8000 3000>;
		qcom,mdss-dsi-panel-peak-brightness = <4300000>;
		qcom,mdss-dsi-panel-blackness-level = <3230>;
		qcom,dispparam-enabled;
		qcom,mdss-panel-on-dimming-delay = <200>;
		qcom,mdss-dsi-panel-dc-threshold = <320>;
		qcom,mdss-dsi-display-timings {
			timing@0{
				qcom,mdss-dsi-panel-width = <1080>;
				qcom,mdss-dsi-panel-height = <2248>;
				qcom,mdss-dsi-h-front-porch = <56>;
				qcom,mdss-dsi-h-back-porch = <56>;
				qcom,mdss-dsi-h-pulse-width = <18>;
				qcom,mdss-dsi-h-sync-skew = <0>;
				qcom,mdss-dsi-v-back-porch = <24>;
				qcom,mdss-dsi-v-front-porch = <26>;
				qcom,mdss-dsi-v-pulse-width = <12>;
				qcom,mdss-dsi-h-left-border = <0>;
				qcom,mdss-dsi-h-right-border = <0>;
				qcom,mdss-dsi-v-top-border = <0>;
				qcom,mdss-dsi-v-bottom-border = <0>;
				qcom,mdss-dsi-panel-framerate = <60>;
				qcom,mdss-dsi-on-command = [
				05 01 00 00 0a 00 02 11 00
				39 00 00 00 00 00 05 2B 00 00 08 c7
				39 00 00 00 00 00 03 F0 5A 5A
				39 00 00 00 00 00 08 EF F0 31 00 33 31 14 35
				39 00 00 00 00 00 02 B0 01
				39 00 00 00 00 00 02 BB 03
				39 00 00 00 00 00 02 B0 4F
				39 00 00 00 00 00 02 CB 00
				39 00 00 00 00 00 02 B0 6B
				39 00 00 00 00 00 02 CB 00
				39 00 00 00 00 00 02 F7 03
				39 00 00 00 00 00 02 B0 05
				39 00 00 00 00 00 02 B1 10
				39 00 00 00 00 00 02 B0 02
				39 00 00 00 00 00 05 D5 02 17 54 14
				39 01 00 00 00 00 03 F0 A5 A5
				39 00 00 00 00 00 03 F0 5A 5A
				39 00 00 00 00 00 03 Fc 5A 5A
				39 00 00 00 00 00 03 D2 9F F0
				39 00 00 00 00 00 02 B0 0E
				39 00 00 00 00 00 02 d2 70
				39 00 00 00 00 00 02 b0 04
				39 00 00 00 00 00 02 d2 20
				39 00 00 00 00 00 03 F0 A5 A5
				39 01 00 00 00 00 03 Fc A5 a5
				39 00 00 00 00 00 02 35 00
				39 00 00 00 00 00 03 51 00 00
				39 00 00 00 00 00 02 53 20
				39 01 00 00 6E 00 02 55 00
				05 01 00 00 00 00 02 29 00];
				qcom,mdss-dsi-off-command = [
						05 01 00 00 11 00 02 28 00
						39 00 00 00 00 00 03 F0 5A 5A
						39 00 00 00 00 00 02 B0 49
						39 00 00 00 00 00 02 CB FF
						39 00 00 00 00 00 02 B0 4F
						39 00 00 00 00 00 02 CB C8
						39 00 00 00 00 00 02 F7 03
						39 01 00 00 11 00 03 F0 A5 A5
						05 01 00 00 78 00 02 10 00];
				qcom,mdss-dsi-on-command-state = "dsi_lp_mode";
				qcom,mdss-dsi-off-command-state = "dsi_lp_mode";
				qcom,mdss-dsi-doze-hbm-command = [
				39 00 00 00 00 00 03 F0 5A 5A
				39 00 00 00 00 00 02 ef b0
				39 00 00 00 00 00 02 b0 17
				39 00 00 00 00 00 04 E3 00 00 00
				39 01 00 00 01 00 02 53 22
				39 01 00 00 00 00 03 F0 A5 A5];
				qcom,mdss-dsi-doze-lbm-command = [
				39 00 00 00 00 00 03 F0 5A 5A
				39 00 00 00 00 00 02 ef b0
				39 00 00 00 00 00 02 b0 17
				39 00 00 00 00 00 04 E3 00 00 00
				39 01 00 00 01 00 02 53 23
				39 01 00 00 00 00 03 F0 A5 A5];
				qcom,mdss-dsi-nolp-command = [
				05 01 00 00 00 00 02 28 00
				39 00 00 00 00 00 03 F0 5A 5A
				39 00 00 00 00 00 02 b0 17
				39 00 00 00 00 00 04 E3 86 80 01
				39 00 00 00 00 00 02 53 20
				39 01 00 00 00 00 03 F0 A5 A5
				05 01 00 00 00 00 02 29 00];
				qcom,mdss-dsi-doze-hbm-command-state = "dsi_lp_mode";
				qcom,mdss-dsi-doze-lbm-command-state = "dsi_lp_mode";
				qcom,mdss-dsi-nolp-command-state = "dsi_lp_mode";
				qcom,mdss-dsi-dispparam-acl-off-command = [39 01 00 00 00 00 02 55 00];
				qcom,mdss-dsi-dispparam-acl-off-command-state = "dsi_lp_mode";
				qcom,mdss-dsi-dispparam-acl-l1-command = [39 01 00 00 00 00 02 55 01];/* 50% */
				qcom,mdss-dsi-dispparam-acl-l1-command-state = "dsi_lp_mode";
				qcom,mdss-dsi-dispparam-acl-l2-command = [39 01 00 00 00 00 02 55 02];/* 40% */
				qcom,mdss-dsi-dispparam-acl-l2-command-state = "dsi_lp_mode";
				qcom,mdss-dsi-dispparam-acl-l3-command = [39 01 00 00 00 00 02 55 03];/* 30% */
				qcom,mdss-dsi-dispparam-acl-l3-command-state = "dsi_lp_mode";
				qcom,mdss-dsi-dispparam-hbm-off-command = [39 01 00 00 00 00 02 53 28];
				qcom,mdss-dsi-dispparam-hbm-off-command-state = "dsi_lp_mode";
				qcom,mdss-dsi-dispparam-hbm-on-command = [39 01 00 00 00 00 02 53 e8];
				qcom,mdss-dsi-dispparam-hbm-on-command-state = "dsi_lp_mode";
				qcom,mdss-dsi-dispparam-hbm-fod-off-command = [39 00 00 00 00 00 02 53 20
									39 00 00 00 00 00 03 F0 5A 5A
									39 00 00 00 00 00 03 B2 00 40
									39 00 00 00 00 00 02 B0 04
									39 00 00 00 00 00 02 B2 80
									39 00 00 00 00 00 02 F7 03
									39 01 00 00 00 00 03 F0 A5 A5];
				qcom,mdss-dsi-dispparam-hbm-fod-off-command-state = "dsi_lp_mode";
				qcom,mdss-dsi-dispparam-hbm-fod-on-command = [
									39 01 00 00 00 00 02 53 20
									39 00 00 00 00 00 03 F0 5A 5A
									39 00 00 00 00 00 03 B2 00 10
									39 00 00 00 00 00 02 B0 04
									39 00 00 00 00 00 02 B2 00
									39 00 00 00 00 00 02 F7 03
									39 00 00 00 00 00 03 F0 A5 A5
									39 01 00 00 00 00 02 53 e0];
				qcom,mdss-dsi-dispparam-hbm-fod-on-command-state = "dsi_lp_mode";
				qcom,mdss-dsi-dispparam-hbm-fod2norm-command = [39 00 00 00 00 00 03 F0 5A 5A
									39 00 00 00 00 00 03 B2 00 40
									39 00 00 00 00 00 02 B0 04
									39 00 00 00 00 00 02 B2 80
									39 00 00 00 00 00 02 F7 03
									39 01 00 00 00 00 03 F0 A5 A5];
				qcom,mdss-dsi-dispparam-hbm-fod2norm-command-state = "dsi_lp_mode";
				qcom,mdss-dsi-dispparam-dimmingon-command = [39 01 00 00 01 00 02 53 28];
				qcom,mdss-dsi-dispparam-dimmingon-command-state = "dsi_lp_mode";
				qcom,mdss-dsi-dispparam-dimmingoff-command = [39 01 00 00 01 00 02 53 20];
				qcom,mdss-dsi-dispparam-dimmingoff-command-state = "dsi_lp_mode";
				qcom,mdss-dsi-panel-jitter = <0x1 0x1>;
				qcom,mdss-dsi-read-panel-id-command = [
					06 01 00 01 05 00 02 DB 00];
				qcom,mdss-dsi-read-panel-id-command-state = "dsi_hs_mode";
				qcom,mdss-dsi-dispparam-flash-test-on-command = [
					/* AOR 100% Code */
					39 00 00 00 00 00 03 F0 5A 5A
					39 00 00 00 00 00 03 51 03 FF
					39 00 00 00 00 00 02 B0 0B
					39 00 00 00 00 00 02 B2 82
					39 00 00 00 00 00 02 B0 16
					39 00 00 00 00 00 02 B2 D8
					39 00 00 00 00 00 02 F7 03
					39 01 00 00 6E 00 03 F0 A5 A5
					/* Flashing Test Code */
					39 00 00 00 00 00 03 F0 5A 5A
					39 00 00 00 00 00 02 B0 32
					39 00 00 00 00 00 02 CB 01
					39 00 00 00 00 00 02 B0 40
					39 00 00 00 00 00 02 CB 3E
					39 00 00 00 00 00 02 B0 4F
					39 00 00 00 00 00 02 CB 00
					39 00 00 00 00 00 02 B0 0B
					39 00 00 00 00 00 02 CB C0
					39 00 00 00 00 00 02 F7 03
					39 01 00 00 00 00 03 F0 A5 A5];
				qcom,mdss-dsi-dispparam-flash-test-on-command-state = "dsi_lp_mode";
				qcom,mdss-dsi-dispparam-flash-test-off-command = [
					/* Normal Condition Code */
					39 00 00 00 00 00 03 F0 5A 5A
					39 00 00 00 00 00 02 B0 32
					39 00 00 00 00 00 02 CB 68
					39 00 00 00 00 00 02 B0 40
					39 00 00 00 00 00 02 CB 6E
					39 00 00 00 00 00 02 B0 4F
					39 00 00 00 00 00 02 CB 03
					39 00 00 00 00 00 02 B0 0B
					39 00 00 00 00 00 02 CB CB
					39 00 00 00 00 00 02 F7 03
					39 01 00 00 6E 00 03 F0 A5 A5
					/* AOR Normal Code */
					39 00 00 00 00 00 03 F0 5A 5A
					39 00 00 00 00 00 03 51 03 FF
					39 00 00 00 00 00 02 B0 0B
					39 00 00 00 00 00 02 B2 02
					39 00 00 00 00 00 02 B0 16
					39 00 00 00 00 00 02 B2 40
					39 00 00 00 00 00 02 F7 03
					39 01 00 00 00 00 03 F0 A5 A5];
				qcom,mdss-dsi-dispparam-flash-test-off-command-state = "dsi_lp_mode";
				qcom,mdss-dsi-h-sync-pulse = <0>;
				qcom,mdss-dsi-dispparam-crc-off-command = [
					39 00 00 00 00 00 03 F0 5A 5A
					39 00 00 00 00 00 03 E2 00 40
					39 01 00 00 00 00 03 F0 A5 A5
					];
				qcom,mdss-dsi-dispparam-crc-off-command-state = "dsi_lp_mode";
			};
		};
	};
};
