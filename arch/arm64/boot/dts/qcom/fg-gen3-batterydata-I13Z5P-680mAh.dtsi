/*
 * Copyright (c) 2019, The Linux Foundation. All rights reserved.
 *
 * This program is free software; you can redistribute it and/or modify
 * it under the terms of the GNU General Public License version 2 and
 * only version 2 as published by the Free Software Foundation.
 *
 * This program is distributed in the hope that it will be useful,
 * but WITHOUT ANY WARRANTY; without even the implied warranty of
 * MERCHANTABILITY or FITNESS FOR A PARTICULAR PURPOSE.  See the
 * GNU General Public License for more details.
 */

qcom,3388014_i13z5p_680mah_averaged_masterslave_mar26th2018 {
	qcom,fastchg-current-ma = <480>;
	/* #3388014_I13Z5P_680mAh_averaged_MasterSlave_Mar26th2018*/
	qcom,max-voltage-uv = <4400000>;
	qcom,fg-cc-cv-threshold-mv = <4390>;
	qcom,nom-batt-capacity-mah = <680>;
	qcom,batt-id-kohm = <200>;
	qcom,battery-beta = <3435>;
	qcom,battery-type =
		"3388014_i13z5p_680mah_averaged_masterslave_mar26th2018";
	qcom,checksum = <0x8C0B>;
	qcom,gui-version = "PM660GUI - 0.0.0.45";
	qcom,fg-profile-data = [
		 5E 24 56 0C
		 E9 12 B0 0D
		 05 1D 59 01
		 F8 05 8C 02
		 24 1B CF 13
		 D6 35 86 3B
		 A2 00 00 00
		 1A 00 00 00
		 00 00 1F CD
		 57 AD 6C CA
		 47 00 08 00
		 FD DA E6 ED
		 09 EC 03 E2
		 58 07 89 01
		 21 14 BA 5A
		 0A 06 09 20
		 27 00 14 00
		 55 20 C3 04
		 3A 0B 7C 05
		 01 1D 39 02
		 41 0D 1A 0B
		 89 18 A6 2B
		 2E 54 B7 72
		 75 00 00 00
		 07 00 00 00
		 00 00 9C CC
		 DE C3 51 A4
		 48 00 00 00
		 77 EB E6 ED
		 6F EC D3 D2
		 FF 07 DF F3
		 91 E3 56 1A
		 99 33 CC FF
		 07 10 00 00
		 BB 02 66 46
		 48 00 40 00
		 D8 02 0A FA
		 FF 00 00 00
		 00 00 00 00
		 00 00 00 00
		 00 00 00 00
		 00 00 00 00
		 00 00 00 00
		 00 00 00 00
		 00 00 00 00
		 00 00 00 00
		 00 00 00 00
		 00 00 00 00
		 00 00 00 00
		 00 00 00 00
		 00 00 00 00
		 00 00 00 00
		 00 00 00 00
		 00 00 00 00
		 00 00 00 00
		 00 00 00 00
	 ];
};
