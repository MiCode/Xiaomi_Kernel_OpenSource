// SPDX-License-Identifier: (GPL-2.0+ OR MIT)
/*
 * Unisoc I2C dts file
 *
 * Copyright (C) 2020, Unisoc Inc.
 *
 */
/ {
	power_debug: debuglog {
		compatible                        = "sprd,debuglog";
		sprd,pdbg-irq-domain-gic          = "GICv3";
		sprd,pdbg-irq-domain-gpio         = "sprd-gpio";
		sprd,pdbg-irq-domain-ana          = "spi4.0";
		sprd,pdbg-irq-domain-ana-eic      = "sc27xx-eic";
		sprd,pdbg-irq-domain-ap-eic-dbnc  = "64200000.gpio";
		sprd,pdbg-irq-domain-ap-eic-latch = "64200080.gpio";
		sprd,pdbg-irq-domain-ap-eic-async = "642000a0.gpio";
		sprd,pdbg-irq-domain-ap-eic-sync  = "642000c0.gpio";
	};

	power_stat: debugstat {
		compatible = "sprd,debugstat";
		soc_slp_cnt_reg = <&pmu_apb_regs REG_PMU_APB_PUB_DEEP_SLEEP_CNT 0xff>;
	};
};
