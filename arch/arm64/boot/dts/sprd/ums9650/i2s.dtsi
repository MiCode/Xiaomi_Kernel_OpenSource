// SPDX-License-Identifier: GPL-2.0-only
/*
 * Unisoc UMS9620 SIPA dts file
 *
 * Copyright (C) 2020~2021, Unisoc Communications Inc.
 */

&apahb {
	i2s0: i2s@0x202b0000 {
		compatible = "sprd,i2s";
		reg = <0 0x202b0000 0 0x1000>;
		sprd,dai_name = "i2s_bt_sco0";
		sprd,hw_port = <0>;
		sprd,syscon-ap-apb = <&ap_apb_regs>;
		#sound-dai-cells = <0>;
		status = "disable";
		clock-names = "clk_iis0";
		clocks = <&ap_clk CLK_AP_IIS0>;
	};
};
