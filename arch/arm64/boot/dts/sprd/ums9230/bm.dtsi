// SPDX-License-Identifier: (GPL-2.0+ OR MIT)
/*
 * Unisoc busmonitor dts file
 *
 * Copyright (C) 2020, Unisoc Inc.
 *
 */
#include <dt-bindings/debug/busmonitor/busmonitor.h>
#include <dt-bindings/soc/sprd,qogirl6-regs.h>
#include <dt-bindings/soc/sprd,qogirl6-mask.h>

&aon {
	djtag: djtag@64740000 {
		compatible = "sprd,djtag";
		reg = <0 0x64740000 0 0x1000>;
		clock-names = "enable", "tck";
		syscon = <&aon_apb_regs REG_AON_APB_APB_RST3
			MASK_AON_APB_DJTAG_SOFT_RST>;
		clocks = <&aonapb_gate CLK_DJTAG_EB>,
			<&aonapb_gate CLK_DJTAG_TCK_EB>;
		hwlocks = <&hwlock 10>;
		hwlock-names = "djtag";

		#address-cells = <1>;
		#size-cells = <0>;

		aon-bm@8{
			compatible = "sprd,busmonitor";
			interrupts = <GIC_SPI 81 IRQ_TYPE_LEVEL_HIGH>;
			reg = <0x8>;
			sprd,bm-num = <7>;
			sprd,bm-name =
				"AP", "WTLCP", "AUDCP", "PUBCP",
				"USBOTG", "CM4", "WCN";
			sprd,bm-type =
				<AXI>, <AXI>, <AXI>, <AXI>,
				<AXI>, <AXI>, <AXI>;
			sprd,bm-dap = <0>, <1>, <2>, <3>,
				<4>, <5>, <8>;
			sprd,bm-config =
				<DISABLE MON_WRITE MON_INSIDE>,
				<DISABLE MON_WRITE MON_INSIDE>,
				<DISABLE MON_WRITE MON_INSIDE>,
				<DISABLE MON_WRITE MON_INSIDE>,
				<DISABLE MON_WRITE MON_INSIDE>,
				<DISABLE MON_WRITE MON_INSIDE>,
				<DISABLE MON_WRITE MON_INSIDE>;
			sprd,bm-id =
				<DISABLE 0 AXIID>,
				<DISABLE 0 AXIID>,
				<DISABLE 0 AXIID>,
				<DISABLE 0 AXIID>,
				<DISABLE 0 AXIID>,
				<DISABLE 0 AXIID>,
				<DISABLE 0 AXIID>;
			sprd,bm-ranges =
				<0 0>,
				<0 0>,
				<0 0>,
				<0 0>,
				<0 0>,
				<0 0>,
				<0 0>;
		};
	};

	apb_bm: apb-bm@64510000 {
		compatible = "sprd,apb-busmonitor";
		reg = <0 0x64510000 0 0x1000>;
		interrupts = <GIC_SPI 102 IRQ_TYPE_LEVEL_HIGH>;
		sprd,target-addr = <0 0>;
		sprd,target-data = <0 0>;
	};
};
