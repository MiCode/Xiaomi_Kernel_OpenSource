// SPDX-License-Identifier: (GPL-2.0+ OR MIT)
/*
 * Unisoc serdes dts file
 *
 * Copyright (C) 2020, Unisoc Inc.
 *
 */
&aon {
	modem_dbg_log: modem-dbg-log@64750000 {
			compatible = "sprd,dbg-log-qogirl6";
			reg = <0 0x64750000 0 0x4000>;
			sprd,syscon-mm-ahb = <&mm_ahb_regs>;
			sprd,syscon-dsi-apb = <&anlg_phy_g10_regs>;
			sprd,syscon-pmu-apb = <&pmu_apb_regs>;
			sprd,ch-name = "TRAINING", "WTL", "MADR", "TPIU", "DBUS", "WCN";
			sprd,ch-index = <15 1 0 2 3 4>;
			sprd,dcfix;
			sprd,mm;
			clock-names =
				"serdes_eb",
				"mm_eb",
				"ana_eb",
				"dsi_csi_test_eb",
				"cphy_cfg_eb";
			clocks =
				<&aonapb_gate CLK_SERDES_EB>,
				<&aonapb_gate CLK_MM_EB>,
				<&aonapb_gate CLK_ANA_EB>,
				<&aonapb_gate CLK_DSI_CSI_TEST_EB>,
				<&aonapb_gate CLK_CPHY_CFG_EN>;
			status = "disabled";
	};
};
