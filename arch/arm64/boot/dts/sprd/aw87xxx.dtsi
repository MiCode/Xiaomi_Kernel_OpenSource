/*mono dtsi config*/
&i2c4 {
/* AWINIC AW87XXX Smart K PA */
	aw87xxx_pa@5B {
		compatible = "awinic,aw87xxx_pa";
		reg = <0x5B>;
		reset-gpio = <&ap_gpio 113 0>;
		dev_index = < 0 >;
		status = "okay";
	};
/* AWINIC AW87XXX Smart K PA End */
};

