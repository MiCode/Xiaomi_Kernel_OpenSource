// SPDX-License-Identifier: (GPL-2.0+ OR MIT)
/*
 * Unisoc PCIe dts file
 *
 * Copyright (C) 2020, Unisoc Inc.
 *
 */
&soc {
	pcie1: pcie@26100000 {
		compatible = "sprd,pcie", "snps,dw-pcie";
		reg = <0x0 0x26100000 0x0 0x100000>,
		      <0x8 0x87ffe000 0x0 0x100000>;
		reg-names = "dbi", "config";
		#address-cells = <3>;
		#size-cells = <2>;
		device_type = "pci";
		ranges = <0x01000000 0x0 0x00000000 0x8 0x87fee000 0x0 0x00010000
			  0x03000000 0x0 0x10000000 0x8 0x80000000 0x0 0x07fee000>;
		bus-range = <16 31>;
		num-lanes = <1>;
		num-vectors = <256>;
		num-viewport = <8>;
		pcie-wakeup-gpios = <&eic_async 12
				     GPIO_ACTIVE_HIGH>;
		status = "disabled";
		dummy@0 {
			label = "msi_int";
			interrupt-parent = <&gic>;
			#interrupt-cells = <3>;
			interrupts = <GIC_SPI 82
				      IRQ_TYPE_LEVEL_HIGH>;
		};
		dummy@1 {
			label = "aer_int";
			interrupt-parent = <&gic>;
			#interrupt-cells = <3>;
			interrupts = <GIC_SPI 83
				      IRQ_TYPE_LEVEL_HIGH>;
		};
	};
};
