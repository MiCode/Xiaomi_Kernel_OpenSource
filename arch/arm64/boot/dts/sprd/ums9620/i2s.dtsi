// SPDX-License-Identifier: (Licenseref-Unisoc-General-1.0 OR GPL-2.0-only)
/* 
 * i2s.dtsi - Unisoc platform device
 *
 * Copyright 2022 Unisoc(Shanghai) Technologies Co.Ltd
 *
 * Licensed under the Unisoc General Software License, version 1.0 (the
 * License);
 * you may not use this file except in compliance with the License.
 * You may obtain a copy of the License at
 * https://www.unisoc.com/en_us/license/UNISOC_GENERAL_LICENSE_V1.0-EN_US
 * Software distributed under the License is distributed on an "AS IS" BASIS,
 * WITHOUT WARRANTIES OF ANY KIND, either express or implied.
 * See the Unisoc General Software License, version 1.0 for more details.
 *
 * Alternatively you can use and distribute this file under the terms of the
 * GNU General Public License version 2, provided that it has to be used
 *  (including but not limited to combining, linking) with any other file under
 * the GNU General Public License version 2 on platforms that use Unisoc Chips.
 */

#include <dt-bindings/sound/sprd,sprd-dai.h>

&apahb {
	i2s0: i2s@0x202b0000 {
		compatible = "sprd,i2s";
		reg = <0 0x202b0000 0 0x1000>;
		sprd,dai_name = "i2s_bt_sco0";
		sprd,hw_port = <0>;
		sprd,syscon-ap-apb = <&ap_apb_regs>;
		#sound-dai-cells = <0>;
		status = "disable";
		clock-names = "clk_iis0";
		clocks = <&ap_clk CLK_AP_IIS0>;
	};
};

&apagcp {
	agcp_i2s0: i2s@56270800 {
		compatible = "sprd,agcp-i2s-dai";
		reg = <0 0x56270800 0 0x80>;
		#sound-dai-cells = <1>;
		sprd,syscon-agcp-ahb = <&audcp_glb_regs>;
		sprd,id = <AGCP_IIS0_TX>;
		sprd,tx-dma-no = <24>;
		sprd,rx-dma-no = <23>;
		sprd,div-mode = <2>;
		sprd,rate-multi = <512>;
		sprd,fifo-depth = <256>;
		sprd,bus-type = <0>;
		sprd,hw-port = <0>;
		sprd,work-mode = <0>;
		sprd,trans-mode = <0>;
		sprd,rtx-mode = <3>;
		sprd,sync-mode = <0>;
		sprd,bus-frame-mode = <1>;
		sprd,multi-ch = <0x1>;
		sprd,left-ch-lvl = <0>;
		sprd,clk-inv = <0>;
		sprd,tx-watermark = <0x40>;
		sprd,rx-watermark = <0xc0>;
		power-domains = <&agdsp_domain>;
		status = "okay";
	};
};
