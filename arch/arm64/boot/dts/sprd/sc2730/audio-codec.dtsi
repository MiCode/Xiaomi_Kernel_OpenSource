// SPDX-License-Identifier: (GPL-2.0+ OR MIT)
/*
 * Unisoc SC2730 PMIC audio-codec dts file
 *
 * Copyright (C) 2020, Unisoc Inc.
 *
 */

&sc2730_pmic {
	sprd_audio_codec_ana: audio-codec@1000 {
		compatible = "unisoc,sc2730-audio-codec",
			"unisoc,sc2731-audio-codec";
		#sound-dai-cells = <1>;
		reg = <0x1000>;
		sprd,syscon-pmu-apb = <&pmu_apb_regs>;
		nvmem-cells = <&aud_pabst_vcal>,
			<&neg_cp_efuse>,
			<&fgu_calib>,
			<&codec_product_info>;
		nvmem-cell-names = "aud_pabst_vcal_efuse",
				"neg_cp_efuse",
				"fgu_4p2_efuse",
				"codec_product_info";
		status = "disabled";
	};
};
