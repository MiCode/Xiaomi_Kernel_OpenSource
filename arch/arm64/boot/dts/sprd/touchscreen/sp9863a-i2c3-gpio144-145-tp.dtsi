// SPDX-License-Identifier: (GPL-2.0+ OR MIT)
/*
 * Unisoc TP dts file
 *
 * Copyright (C) 2020, Unisoc Inc.
 *
 */
#include <dt-bindings/gpio/gpio.h>

&i2c3 {
	#address-cells = <1>;
	#size-cells = <0>;
	status = "okay";

	touchscreen@38 {
		compatible = "focaltech,ft5436-touchscreen";
		reg = <0x38>;
		gpios = <&ap_gpio 145 GPIO_ACTIVE_HIGH
			&ap_gpio 144 GPIO_ACTIVE_HIGH>;
		controller = "focaltech,FT5436";
		virtualkeys = <580 60 1320 60 45
			172 360 1320 60 45
			158 600 1320 60 45>;
		surface-width = <1080>;
		surface-height = <1920>;
		firmware-auto-upgrade;
		private-data {
			a8 = /bits/ 8 <0x5a>;
		};
	};
};

