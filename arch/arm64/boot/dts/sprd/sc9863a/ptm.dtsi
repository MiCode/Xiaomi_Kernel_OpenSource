// SPDX-License-Identifier: (GPL-2.0+ OR MIT)
/*
 * Unisoc ptm dts file
 *
 * Copyright (C) 2020, Unisoc Inc.
 *
 */

&pub {
	ptm_trace: ptm@30010000 {
			compatible = "sprd,sharkl3-ptm";
			reg = <0x0 0x30010000 0x0 0x10000>,
				<0x0 0x10001000 0x0 0x1000>,
				<0x0 0x10003000 0x0 0x1000>,
				<0x0 0x10004000 0x0 0x1000>,
				<0x0 0x10008000 0x0 0x1000>,
				<0x0 0x10005000 0x0 0x1000>;
			interrupts = <GIC_SPI 86 IRQ_TYPE_LEVEL_HIGH>;
			enable-syscon = <&pub_apb_regs 0x31cc 0x80>;
			clock-names = "clk_cs", "cs_src";
			clocks = <&aon_clk CLK_CSSYS>, <&pll CLK_TWPLL_153M6>;
			sprd,funnel-port = <2>;
			sprd,ddr-chn = <8>;
			sprd,chn-name = "MM", "GPU", "DPU",
				"CPU", "AP/PUBCP", "WTLCP",
				"WCN/AON/ETR", "VSP";
	};
};
