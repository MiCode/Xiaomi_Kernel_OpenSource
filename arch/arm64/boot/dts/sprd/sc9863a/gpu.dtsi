// SPDX-License-Identifier: (GPL-2.0+ OR MIT)
/*
 * Spreadtrum Sharkl3 platform DTS file
 *
 * Copyright (C) 2023, Spreadtrum Communications Inc.
 */

&mm {
	gpu: gpu@60000000 {
		compatible = "sprd,rogue";
		reg = <0x0 0x60000000 0x0 0x100000>;
		top_force_shutdown = <&pmu_apb_regs
			REG_PMU_APB_PD_GPU_TOP_CFG
			MASK_PMU_APB_PD_GPU_TOP_FORCE_SHUTDOWN>;
		core_force_shutdown = <&pmu_apb_regs
			REG_PMU_APB_PD_GPU_CORE_CFG
			MASK_PMU_APB_PD_GPU_CORE_FORCE_SHUTDOWN>;
		core_auto_shutdown = <&pmu_apb_regs
			REG_PMU_APB_PD_GPU_CORE_CFG
			MASK_PMU_APB_PD_GPU_CORE_AUTO_SHUTDOWN_EN>;
		gpu_top_state = <&pmu_apb_regs
			REG_PMU_APB_PWR_STATUS0_DBG
			MASK_PMU_APB_PD_GPU_TOP_STATE>;
		gpu_core_state = <&pmu_apb_regs
			REG_PMU_APB_PWR_STATUS5_DBG
			MASK_PMU_APB_PD_GPU_CORE_STATE>;
		clk_gpu_eb = <&aon_apb_regs
			REG_AON_CLK_TOP_CFG
			MASK_AON_CLK_GPU_EB>;
		interrupts = <GIC_SPI 39 IRQ_TYPE_LEVEL_HIGH>;

		nvmem-cells = <&gpu_bin>;
		nvmem-cell-names = "gpu_bin";

		operating-points = <
			/* kHz    uV */
			256000    0
			384000    0
			550000    0
			600000    0
			>;

		sprd,dvfs-lists = <
			/* kHz  uV  idx div */
			256000  0    5   1
			384000  0    7   1
			550000  0    9   1
			600000  0    9   1
			>;

		sprd,dvfs-default = <0>;
		sprd,dvfs-scene-extreme = <2>;
		sprd,dvfs-scene-high = <1>;
		sprd,dvfs-scene-medium = <1>;
		sprd,dvfs-scene-low = <0>;
		sprd,dvfs-range-max = <2>;
		sprd,dvfs-range-min = <0>;

		clocks = <&aonapb_gate CLK_GNU_EB>,
			   <&aon_clk CLK_GPU_CORE>,<&aon_clk CLK_GPU_SOC>,
			   <&pll CLK_TWPLL_153M6>, <&pll CLK_TWPLL_192M>,
			   <&pll CLK_TWPLL_256M>, <&pll CLK_TWPLL_307M2>,
			   <&pll CLK_TWPLL_384M>, <&pll CLK_TWPLL_512M>,
			   <&pll CLK_GPLL>;
	};
};

