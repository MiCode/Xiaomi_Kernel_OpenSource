// SPDX-License-Identifier: (GPL-2.0+ OR MIT)
/*
 * Unisoc ptm dts file
 *
 * Copyright (C) 2020, Unisoc Inc.
 *
 */

&pub {
	ptm_trace: ptm@31060000 {
		compatible = "sprd,sharkl5-ptm";
		reg = <0x0 0x31060000 0x0 0x10000>,
			<0x0 0x3c002000 0x0 0x1000>,
			<0x0 0x3c003000 0x0 0x1000>,
			<0x0 0x3c006000 0x0 0x1000>,
			<0x0 0x3c004000 0x0 0x1000>,
			<0x0 0x3c005000 0x0 0x1000>;
		interrupts = <GIC_SPI 109 IRQ_TYPE_LEVEL_HIGH>;
		clock-names = "clk_cs", "cs_src";
		clocks = <&aon_clk CLK_CSSYS>, <&pll2 CLK_TWPLL_153M6>;
		sprd,funnel-port = <3>;
		sprd,ddr-chn = <7>;
		sprd,chn-name = "CPU", "GPU", "DPU/DCAM",
			"ISP", "AP/VSP/AON", "WTLCP",
			"PUBCP/AUDCP";
	};

};
