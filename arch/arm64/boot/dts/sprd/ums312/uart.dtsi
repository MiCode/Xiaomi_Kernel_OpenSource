// SPDX-License-Identifier: (GPL-2.0+ OR MIT)
/*
 * Unisoc UART dts file
 *
 * Copyright (C) 2020, Unisoc Inc.
 *
 */

&apapb {
	uart0: serial@70000000 {
		compatible = "sprd,ums312-uart",
			     "sprd,sc9836-uart";
		reg = <0 0x70000000 0 0x100>;
		interrupts = <GIC_SPI 2 IRQ_TYPE_LEVEL_HIGH>;
		source-base = <0x20200024>;
		clock-names = "enable", "uart", "source";
		clocks = <&apapb_gate CLK_UART0_EB>,
			<&ap_clk CLK_AP_UART0>, <&ext_26m>;
		status = "disabled";
	};

	uart1: serial@70100000 {
		compatible = "sprd,ums312-uart",
			     "sprd,sc9836-uart";
		reg = <0 0x70100000 0 0x100>;
		interrupts = <GIC_SPI 3 IRQ_TYPE_LEVEL_HIGH>;
		source-base = <0x20200028>;
		clock-names = "enable", "uart", "source";
		clocks = <&apapb_gate CLK_UART1_EB>,
			<&ap_clk CLK_AP_UART1>, <&ext_26m>;
		status = "disabled";
	};

	uart2: serial@70200000 {
		compatible = "sprd,ums312-uart",
			     "sprd,sc9836-uart";
		reg = <0 0x70200000 0 0x100>;
		interrupts = <GIC_SPI 4 IRQ_TYPE_LEVEL_HIGH>;
		source-base = <0x2020002c>;
		clock-names = "enable", "uart", "source";
		clocks = <&apapb_gate CLK_UART2_EB>,
			<&ap_clk CLK_AP_UART2>, <&ext_26m>;
		status = "disabled";
	};

};
