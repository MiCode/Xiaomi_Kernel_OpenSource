// SPDX-License-Identifier: (GPL-2.0+ OR MIT)
/*
 * Spreadtrum Sharkl5 platform DTS file
 *
 * Copyright (C) 2018, Spreadtrum Communications Inc.
 */

&mm {

	gpu: gpu@60000000 {
		compatible = "sprd,rogue";
		reg = <0x0 0x60000000 0x0 0x100000>;
		gpu-supply = <&vddgpu>;
		top_force_shutdown = <&pmu_apb_regs
		REG_PMU_APB_PD_GPU_TOP_CFG0
			MASK_PMU_APB_PD_GPU_TOP_FORCE_SHUTDOWN>;
		rgx_dust_force_shutdown = <&pmu_apb_regs
			REG_PMU_APB_PD_GPU_RGX_DUST_CFG0
			MASK_PMU_APB_PD_GPU_RGX_DUST_FORCE_SHUTDOWN>;
		rgx_dust_auto_shutdown = <&pmu_apb_regs
			REG_PMU_APB_PD_GPU_RGX_DUST_CFG0
			MASK_PMU_APB_PD_GPU_RGX_DUST_AUTO_SHUTDOWN_EN>;
		top_dvfs_cfg = <&top_dvfs_apb_regs
			REG_TOP_DVFS_APB_SUBSYS_SW_DVFS_EN_CFG
			MASK_TOP_DVFS_APB_GPU_SW_DVFS_EN>;
		sw_tune_en = <&top_dvfs_apb_regs
			REG_TOP_DVFS_DCDC_MM_SW_DVFS_CTRL
			MASK_TOP_DVFS_DCDC_MM_SW_DVFS_CTRL>;
		gpu_qos_sel = <&gpu_apb_regs
			REG_GPU_APB_GPU_NIC400_QOS
			MASK_GPU_APB_GPU_QOS_SEL>;
		gpu_qos = <&gpu_apb_regs
			REG_GPU_APB_GPU_NIC400_QOS
			(MASK_GPU_APB_AWQOS_THRESHOLD_GPU |
			MASK_GPU_APB_ARQOS_THRESHOLD_GPU |
			MASK_GPU_APB_AWQOS_GPU |
			MASK_GPU_APB_ARQOS_GPU)>;
		dvfs_index_cfg = <&gpu_dvfs_apb_regs
			REG_GPU_DVFS_APB_GPU_DVFS_INDEX_CFG
			MASK_GPU_DVFS_APB_GPU_DVFS_INDEX>;
		sw_dvfs_ctrl = <&gpu_dvfs_apb_regs
			REG_GPU_DVFS_APB_GPU_SW_DVFS_CTRL
			(MASK_GPU_DVFS_APB_GPU_DVFS_ACK |
			MASK_GPU_DVFS_APB_GPU_DVFS_VOLTAGE_SW |
			MASK_GPU_DVFS_APB_GPU_DVFS_REQ_SW)>;
		pdvfs_cfg = <&gpu_dvfs_apb_regs
			REG_GPU_DVFS_APB_GPU_PROACTIVE_DVFS_CFG
			MASK_GPU_DVFS_APB_GPU_PROACTIVE_DVFS_SEL>;
		gpu_top_state = <&pmu_apb_regs REG_PMU_APB_PWR_STATUS3_DBG
			MASK_PMU_APB_PD_GPU_TOP_STATE>;
		gpu_rgx_dust_state =  <&pmu_apb_regs REG_PMU_APB_PWR_STATUS3_DBG
			MASK_PMU_APB_PD_GPU_RGX_DUST_STATE>;
		freq_upd_cfg = <&gpu_dvfs_apb_regs
			REG_GPU_DVFS_APB_GPU_FREQ_UPD_TYPE_CFG
			(MASK_GPU_DVFS_APB_GPU_CORE_FREQ_UPD_HDSK_EN |
			MASK_GPU_DVFS_APB_GPU_CORE_FREQ_UPD_DELAY_EN |
			MASK_GPU_DVFS_APB_GPU_MEM_FREQ_UPD_HDSK_EN |
			MASK_GPU_DVFS_APB_GPU_MEM_FREQ_UPD_DELAY_EN)>;
		interrupts = <GIC_SPI 60 IRQ_TYPE_LEVEL_HIGH>;

		operating-points = <
			/* kHz    uV */
			384000    700000
			512000    750000
			614400    750000
			768000    800000
			800000    800000
			>;

		sprd,dvfs-lists = <
			/* kHz   uV      idx div */
			384000  700000    6    1
			512000  750000    7    1
			614400  750000    8    1
			768000  800000    9    1
			800000  800000    10   1
			>;

		sprd,dvfs-default = <0>;
		sprd,qos = <&gpu_qos>;
		sprd,dvfs-scene-extreme = <2>;
		sprd,dvfs-scene-high = <1>;
		sprd,dvfs-scene-medium = <1>;
		sprd,dvfs-scene-low = <0>;
		sprd,dvfs-range-max = <2>;
		sprd,dvfs-range-min = <0>;

		clocks = <&aonapb_gate CLK_GPU_EB>,
			<&gpu_clk CLK_GPU_CORE_EB>, <&gpu_clk CLK_GPU_CORE>,
			<&gpu_clk CLK_GPU_MEM_EB>, <&gpu_clk CLK_GPU_MEM>,
			<&gpu_clk CLK_GPU_SYS_EB>,
			<&pll2 CLK_TWPLL_384M>, <&pll2 CLK_TWPLL_512M>,
			<&pll2 CLK_LPLL_614M4>, <&pll2 CLK_TWPLL_768M>,
			<&pll2 CLK_GPLL>;
	};
};

