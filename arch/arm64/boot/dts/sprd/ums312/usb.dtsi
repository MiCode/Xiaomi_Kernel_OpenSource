// SPDX-License-Identifier: (GPL-2.0+ OR MIT)
/*
 * Unisoc USB dts file
 *
 * Copyright (C) 2022, Unisoc Inc.
 *
 */

&aon {
	hsphy: hsphy@323b0000 {
				compatible = "sprd,sharkl5-phy";
				sprd,syscon-enable = <&aon_apb_regs>;
				sprd,syscon-anag2 = <&anlg_phy_g2_regs>;
				sprd,vdd-voltage = <3300000>;
				io-channels = <&pmic_adc 30>, <&pmic_adc 31>;
				io-channel-names = "dp", "dm";
				#phy-cells = <0>;
			};

	usb: usb@5fff0000 {
				compatible = "sprd,sharkl5-musb", "sprd,sharkl3-musb";
				reg = <0 0x5fff0000 0 0x2000>;
				interrupts = <GIC_SPI 69 IRQ_TYPE_LEVEL_HIGH>;
				interrupt-names = "mc";
				clocks = <&aonapb_gate CLK_OTG_UTMI_EB>;
				clock-names = "core_clk";
				syscons = <&pmu_apb_regs
					REG_PMU_APB_PUB_SYS_DEEP_SLEEP_POLL1
					MASK_PMU_APB_AON_PUB_SYS_DEEP_SLEEP_POLL>,
					<&aon_apb_regs
					REG_AON_APB_AON_CHIP_ID0
					MASK_AON_APB_AON_CHIP_ID0>;
				syscon-names = "usb_pub_slp_poll", "chip_id";
				usb-phy = <&hsphy>;
				phy-names = "usb";
				dr-mode = "otg";
				wakeup-source;
				use-single-fifo;
			};
};
