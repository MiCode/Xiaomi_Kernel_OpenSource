// SPDX-License-Identifier: (GPL-2.0+ OR MIT)
/*
 * Unisoc dmc_mpu dts file
 *
 * Copyright (C) 2020, Unisoc Inc.
 *
 */
#include <dt-bindings/soc/sprd,sharkl5-regs.h>
#include <dt-bindings/soc/sprd,sharkl5-mask.h>
#include <dt-bindings/debug/common.h>

&pub {
	dmc_mpu: dmc-mpu@31030000 {
		compatible = "sprd,dmc-mpu";
		reg = <0 0x31030000 0 0x10000>;
		interrupts = <GIC_SPI 111 IRQ_TYPE_LEVEL_HIGH>;
		syscon-names = "irq_clr", "irq_en";
		mpu-irq-clr-syscon = <&pub_apb_regs
			REG_PUB_APB_PUB_INT_CTRL
			MASK_PUB_APB_DMC_MPU_VIO_INT_CLR>;
		mpu-irq-en-syscon = <&pub_apb_regs
			REG_PUB_APB_PUB_INT_CTRL
			MASK_PUB_APB_DMC_MPU_VIO_INT_EN>;
		sprd,channel-num = <7>;
		sprd,mpu-num = <16>;
		sprd,channel-names =
			"CPU", "GPU", "DPU/DCAM","ISP",
			"AP/VSP/AON", "WTLCP", "PUBCP/AUDCP",
			"SHARED0", "SHARED1", "SHARED2",
			"SHARED3", "SHARED4", "SHARED5",
			"SHARED6", "SHARED7", "SHARED8";
		sprd,ranges = <0 0 0 0>, <0 0 0 0>, <0 0 0 0>,
			<0 0 0 0>, <0 0 0 0>, <0 0 0 0>,
			<0 0 0 0>, <0 0 0 0>, <0 0 0 0>,
			<0 0 0 0>, <0 0 0 0>, <0 0 0 0>,
			<0 0 0 0>, <0 0 0 0>, <0 0 0 0>,
			<0 0 0 0>;
		sprd,chn-config =
			<DISABLE MON_INSIDE MON_WRITE>,
			<DISABLE MON_INSIDE MON_WRITE>,
			<DISABLE MON_INSIDE MON_WRITE>,
			<DISABLE MON_INSIDE MON_WRITE>,
			<DISABLE MON_INSIDE MON_WRITE>,
			<DISABLE MON_INSIDE MON_WRITE>,
			<DISABLE MON_INSIDE MON_WRITE>,
			<DISABLE MON_INSIDE MON_WRITE>,
			<DISABLE MON_INSIDE MON_WRITE>,
			<DISABLE MON_INSIDE MON_WRITE>,
			<DISABLE MON_INSIDE MON_WRITE>,
			<DISABLE MON_INSIDE MON_WRITE>,
			<DISABLE MON_INSIDE MON_WRITE>,
			<DISABLE MON_INSIDE MON_WRITE>,
			<DISABLE MON_INSIDE MON_WRITE>,
			<DISABLE MON_INSIDE MON_WRITE>;
		sprd,id-config =
			<MPUID 0 0xffff>, <MPUID 0 0xffff>,
			<MPUID 0 0xffff>, <MPUID 0 0xffff>,
			<MPUID 0 0xffff>, <MPUID 0 0xffff>,
			<MPUID 0 0xffff>, <MPUID 0 0xffff>,
			<MPUID 0 0xffff>, <MPUID 0 0xffff>,
			<MPUID 0 0xffff>, <MPUID 0 0xffff>,
			<MPUID 0 0xffff>, <MPUID 0 0xffff>,
			<MPUID 0 0xffff>, <MPUID 0 0xffff>;
		sprd,port-map = <0>, <1>, <2>, <3>, <4>,
			<5>, <6>, <0>, <0>, <0>,
			<0>, <0>, <0>, <0>, <0>,
			<0>;
		sprd,ddr-offset = <0x80000000>;
	};

};
