qcom,xiaomi_j2gybm4n_4780mah_averaged_masterslave_aug26th2019 {
	qcom,profile-revision = <24>;
	/* #4174016_Xiaomi_J2GYBM4N_4780mAh_averaged_MasterSlave_Aug26th2019*/
	qcom,max-voltage-uv = <4480000>;
        qcom,fastchg-current-ma = <6000>;
	qcom,jeita-fcc-ranges = <(-100)  0   0
				1  50  936000
				51  100  1872000
				101 150  2808000
				151 450  6000000
				451 580  3276000>;
	qcom,jeita-fv-ranges = <(-100)  0   4400000
				1   50  4400000
				51  100  4400000
				101 150  4400000
				151 450  4480000
				451 580  4100000>;
	qcom,jeita-too-hot = <580>;
	qcom,jeita-too-cold = <0>;
	qcom,jeita-warm-th= <450>;
	qcom,jeita-cool-th= <150>;
	qcom,use-bq-pump;
	mi,six-pin-battery;
	qcom,ffc-term-current-ma = <(-941)>;
	qcom,fg-cc-cv-threshold-mv = <4390>;
	qcom,fg-ffc-cc-cv-threshold-mv = <4460>;
	qcom,nom-batt-capacity-mah = <4780>;
	qcom,batt-id-kohm = <100>;
	qcom,battery-beta = <4250>;
	qcom,therm-room-temp = <100000>;
	qcom,battery-type = "j2gybm4n_4780mah";
	qcom,therm-coefficients = <0x2318 0xd0c 0xdaf7 0xc556 0x848d>;
	qcom,therm-center-offset = <0x70>;
	qcom,therm-pull-up = <100>;
	qcom,rslow-normal-coeffs = <0xc7 0xf4 0x85 0x13>;
	qcom,rslow-low-coeffs = <0x31 0xfa 0x82 0x13>;
	qcom,checksum = <0x5DBF>;
	qcom,gui-version = "PM855GUI - 1.0.0.13";
	qcom,fg-profile-data = [
		 09 00 7A E3
		 C6 DD 23 E2
		 90 DD 00 00
		 41 B5 FB 81
		 00 00 27 8D
		 4D 8D 30 80
		 13 00 C7 F4
		 85 13 A2 05
		 52 01 CE 07
		 32 00 13 EB
		 BA ED 69 A2
		 96 0A 45 C2
		 04 BD D5 1B
		 D7 01 FF C2
		 60 00 48 00
		 47 00 45 00
		 34 00 31 00
		 38 00 41 00
		 3E 00 43 00
		 3F 00 60 00
		 36 00 3F 00
		 42 00 3D 00
		 3A 00 7E 00
		 58 64 45 00
		 41 00 44 08
		 60 F8 46 00
		 49 00 68 10
		 53 10 4B 00
		 8C 28 62 48
		 53 60 4D 0B
		 51 00 D8 00
		 AF 1F 84 05
		 50 02 6F 05
		 88 1C 33 0B
		 BE 0D 6B 22
		 9F 17 C8 42
		 17 5C C8 03
		 6A 11 01 1F
		 4E 06 C3 03
		 F4 F6 C9 1C
		 62 02 E3 04
		 8E 0B D7 17
		 A4 23 B1 44
		 11 5A 68 10
		 AE 1E B6 E6
		 26 C3 E7 B4
		 D7 1C C2 C1
		 6D 04 17 B2
		 C8 17 CB 83
		 6B 84 50 9A
		 74 98 09 80
		 5A D3 76 0C
		 E2 04 04 03
		 00 F8 1D D5
		 C6 EA FD 07
		 6D DA 1E BC
		 48 18 10 00
		 E3 DD 12 03
		 64 05 AD 01
		 CE 07 32 00
		 25 03 D3 02
		 DE 05 CF 03
		 25 03 CA 05
		 F5 02 68 01
		 9F 05 56 00
		 3F 00 41 00
		 42 64 45 00
		 42 00 41 00
		 47 E8 46 00
		 48 00 4B 10
		 43 10 3A 00
		 46 28 48 48
		 4E 60 5B 0C
		 3C 00 47 00
		 4D 08 4D 00
		 40 00 49 00
		 49 08 5A 10
		 58 00 68 28
		 7E 48 50 60
		 5F 0D 59 00
		 4F 00 31 00
		 D8 F8 29 1F
		 C6 06 83 0A
		 04 0D D8 1C
		 5D 23 9A 45
		 93 5A 6B 18
		 52 02 09 05
		 A0 02 61 0F
		 3F 0A E0 1F
		 8F 05 5F 02
		 80 06 D7 1C
		 E2 02 26 04
		 0D 02 87 18
		 15 02 89 05
		 04 02 6D 00
		 18 1F 54 06
		 C2 03 D5 05
		 CD 1C 90 02
		 AC 04 BC 03
		 96 18 89 03
		 61 04 91 02
		 68 00 44 01
		 C0 00 FA 00
		 0A 13 00 00
	];
};
