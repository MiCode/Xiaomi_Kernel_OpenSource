/dts-v1/;
/plugin/;

#include <dt-bindings/interrupt-controller/arm-gic.h>
#include "lito-mtp.dtsi"
#include "lito-v2-audio.dtsi"

/ {
	model = "Qualcomm Technologies, Inc. Lito v2 MTP";
	compatible = "qcom,lito-mtp", "qcom,lito", "qcom,mtp";
	qcom,msm-id = <400 0x20000>, <440 0x20000>;
	qcom,board-id = <8 0>;
};
