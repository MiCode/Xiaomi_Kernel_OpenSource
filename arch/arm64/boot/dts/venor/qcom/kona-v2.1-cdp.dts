/dts-v1/;

#include "kona-v2.1.dtsi"
#include "kona-cdp.dtsi"

/ {
	model = "Qualcomm Technologies, Inc. kona v2.1 CDP";
	compatible = "qcom,kona-cdp", "qcom,kona", "qcom,cdp";
	qcom,board-id = <0x10001 0>;
};
