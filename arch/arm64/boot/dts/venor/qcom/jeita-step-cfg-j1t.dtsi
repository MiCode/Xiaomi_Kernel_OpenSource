/* Copyright (c) 2018-2019, The Linux Foundation. All rights reserved.
 *
 * This program is free software; you can redistribute it and/or modify
 * it under the terms of the GNU General Public License version 2 and
 * only version 2 as published by the Free Software Foundation.
 *
 * This program is distributed in the hope that it will be useful,
 * but WITHOUT ANY WARRANTY; without even the implied warranty of
 * MERCHANTABILITY or FITNESS FOR A PARTICULAR PURPOSE.  See the
 * GNU General Public License for more details.
 */

qcom,j1t {
	/* j1t jeita, step charge and other important charging parameters */
	qcom,fastchg-current-ma = <12000>;
	qcom,jeita-fcc-ranges = <(-100) (-1) 1090000
				0  50    1090000
				51  100  2180000
				101 150  3270000
				151 480  12000000
				481 580  1526000>;
	qcom,jeita-fv-ranges = <(-100) (-1) 8900000
				0   50   8900000
				51  100  8900000
				101 150  8900000
				151 480  8960000
				481 580  8200000>;
	qcom,step-chg-ranges = <3100000  4099000  12000000
				4100000  8399000  12000000
				8400000  8459000  10000000
				8460000  8699000   8000000
				8700000  8899000   6500000
				8900000  8960000   5500000>;
	qcom,taper-fcc-rate = < 0000000  6000000   30
				6001000  7000000   30
				7001000  8000000   30
				8001000  9000000   35
				9001000  10000000  40
				10001000 12000000 100 >;
	qcom,soc-fcc-ranges = <	0   20	12000000
				21  30	10000000
				31  55  8000000
				56  70	7000000
				71  80	6000000
				81 100	5000000>;
	qcom,cold-step-chg-ranges = <6000000  8499000  1090000
				     8500000  8900000  540000>;
	qcom,jeita-too-hot = <580>;
	qcom,jeita-too-cold = <(-100)>;
	qcom,jeita-warm-th= <480>;
	qcom,jeita-cool-th= <150>;
	qcom,ocv-based-step-chg;
	qcom,taper-fcc;
	qcom,taper-fcc-limit = <5500000>;
	qcom,use-ext-gauge;
	qcom,max-voltage-uv = <8960000>;
	qcom,batt-id-kohm = <100>;
	qcom,battery-type = "j1t_profile";
};
