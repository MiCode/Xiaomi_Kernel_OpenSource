/dts-v1/;
/plugin/;

#include <dt-bindings/interrupt-controller/arm-gic.h>
#include "lito-rumi.dtsi"

/ {
	model = "Qualcomm Technologies, Inc. Lito RUMI";
	compatible = "qcom,lito-rumi", "qcom,lito", "qcom,rumi";
	qcom,msm-id = <400 0x10000>;
	qcom,board-id = <15 0>;
};
