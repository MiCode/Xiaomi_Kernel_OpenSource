/dts-v1/;

#include "lito.dtsi"
#include "lito-cdp.dtsi"

/ {
	model = "Qualcomm Technologies, Inc. Lito CDP";
	compatible = "qcom,lito-cdp", "qcom,lito", "qcom,cdp";
	qcom,board-id = <1 0>;
};

&ufsphy_mem {
	vdda-phy-always-on;
};
