/dts-v1/;
/plugin/;

#include <dt-bindings/interrupt-controller/arm-gic.h>
#include "lito-cdp.dtsi"
#include "lito-v2-audio.dtsi"

/ {
	model = "Qualcomm Technologies, Inc. Lito v2 CDP";
	compatible = "qcom,lito-cdp", "qcom,lito", "qcom,cdp";
	qcom,msm-id = <400 0x20000>, <440 0x20000>;
	qcom,board-id = <1 0>;
};
