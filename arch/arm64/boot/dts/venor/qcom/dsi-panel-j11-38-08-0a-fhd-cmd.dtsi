&mdss_mdp {
	dsi_j11_38_08_0a_fhd_cmd: qcom,mdss_dsi_j11_38_08_0a_fhd_cmd {
		qcom,mdss-dsi-panel-name = "xiaomi j11 38 08 0a fhd panel";
		qcom,mdss-dsi-panel-type = "dsi_cmd_mode";
		qcom,mdss-dsi-virtual-channel-id = <0>;
		qcom,mdss-dsi-stream = <0>;
		qcom,mdss-dsi-bpp = <24>;
		qcom,mdss-dsi-color-order = "rgb_swap_rgb";
		qcom,mdss-dsi-underflow-color = <0xff>;
		qcom,mdss-dsi-border-color = <0>;

		qcom,dsi-ctrl-num = <0>;
		qcom,dsi-phy-num = <0>;

		qcom,mdss-dsi-traffic-mode = "burst_mode";
		qcom,mdss-dsi-lane-map = "lane_map_0123";
		qcom,mdss-dsi-bllp-eof-power-mode;
		qcom,mdss-dsi-bllp-power-mode;
		qcom,mdss-dsi-lane-0-state;
		qcom,mdss-dsi-lane-1-state;
		qcom,mdss-dsi-lane-2-state;
		qcom,mdss-dsi-lane-3-state;
		qcom,mdss-dsi-dma-trigger = "trigger_sw";
		qcom,mdss-dsi-mdp-trigger = "none";
		qcom,mdss-dsi-reset-sequence = <0 1>, <1 10>;
		qcom,mdss-pan-physical-width-dimension = <695>;
		qcom,mdss-pan-physical-height-dimension = <1545>;

		qcom,mdss-dsi-te-pin-select = <1>;
		qcom,mdss-dsi-wr-mem-start = <0x2c>;
		qcom,mdss-dsi-wr-mem-continue = <0x3c>;
		qcom,mdss-dsi-te-dcs-command = <1>;
		qcom,mdss-dsi-te-check-enable;
		qcom,mdss-dsi-te-using-te-pin;
		qcom,mdss-dsi-tx-eot-append;
		qcom,mdss-dsi-dma-schedule-line = <5>;
		qcom,mdss-dsi-lp11-init;

		qcom,mdss-dsi-panel-hdr-enabled;
		qcom,mdss-dsi-panel-hdr-color-primaries = <14500 15500 32000
			17000 15500 30000 8000 3000>;
		qcom,mdss-dsi-panel-peak-brightness = <4200000>;
		qcom,mdss-dsi-panel-blackness-level = <3230>;

		qcom,bl-update-flag = "delay_until_first_frame";

		qcom,mdss-dsi-display-timings {
			timing@0{
				qcom,mdss-dsi-panel-width = <1080>;
				qcom,mdss-dsi-panel-height = <2400>;
				qcom,mdss-dsi-h-front-porch = <64>;
				qcom,mdss-dsi-h-back-porch = <64>;
				qcom,mdss-dsi-h-pulse-width = <20>;
				qcom,mdss-dsi-h-sync-skew = <0>;
				qcom,mdss-dsi-v-back-porch = <34>;
				qcom,mdss-dsi-v-front-porch = <34>;
				qcom,mdss-dsi-v-pulse-width = <20>;
				qcom,mdss-dsi-h-sync-pulse = <0>;
				qcom,mdss-dsi-h-left-border = <0>;
				qcom,mdss-dsi-h-right-border = <0>;
				qcom,mdss-dsi-v-top-border = <0>;
				qcom,mdss-dsi-v-bottom-border = <0>;
				qcom,mdss-dsi-panel-framerate = <60>;
				qcom,mdss-dsi-panel-clockrate = <1106000000>;
				qcom,mdss-dsi-panel-jitter = <0x5 0x1>;
				qcom,mdss-dsi-on-command = [
					05 01 00 00 0A 00 02 11 00
					39 00 00 00 00 00 03 F0 5A 5A
					39 00 00 00 00 00 02 35 00
					39 00 00 00 00 00 03 B7 01 4B
					39 01 00 00 00 00 03 F0 A5 A5
					39 01 00 00 00 00 05 2B 00 00 09 5F
					39 00 00 00 00 00 03 F0 5A 5A
					39 00 00 00 00 00 03 FC 5A 5A
					/* OFC setting */
					39 00 00 00 00 00 0C E9 11 75 A5 8E 76 A6 37 BE 00 32 32
					/* esd */
					39 00 00 00 00 00 07 E1 00 00 02 02 42 02
					39 00 00 00 00 00 07 E2 00 00 00 00 00 00
					39 00 00 00 00 00 02 B0 0C
					39 00 00 00 00 00 02 E1 19
					/*change VGL -6.6v */
					39 00 00 00 00 00 02 B0 09
					39 00 00 00 00 00 02 EE 07
					39 00 00 00 00 00 03 F0 A5 A5
					39 01 00 00 00 00 03 FC A5 A5
					39 00 00 00 00 00 02 53 20
					39 00 00 00 00 00 03 51 00 00
					39 01 00 00 43 00 02 55 00
					05 01 00 00 00 00 02 29 00];
				qcom,mdss-dsi-off-command = [
					05 01 00 00 20 00 02 28 00
					05 01 00 00 78 00 02 10 00];
				qcom,mdss-dsi-on-command-state = "dsi_lp_mode";
				qcom,mdss-dsi-off-command-state = "dsi_lp_mode";

				qcom,mdss-dsi-nolp-command = [
					05 01 00 00 22 00 02 28 00
					39 01 00 00 00 00 02 53 20
					05 01 00 00 00 00 02 29 00];
				qcom,mdss-dsi-nolp-command-state = "dsi_lp_mode";
			};
		};
	};
};

&dsi_j11_38_08_0a_fhd_cmd {
	mi,panel-id = <0x4A3232 0x00380801>;
	mi,feature-enabled;
	mi,mdss-dsi-bl-dcs-big-endian-type;
	mi,mdss-dsi-panel-hbm-51-ctrl-flag;
	mi,mdss-dsi-panel-hbm-off-51-index = <1>;
	mi,mdss-dsi-panel-fod-off-51-index = <1>;
	/* IRQF_ONESHOT | IRQF_TRIGGER_FALLING */
	/* trig-flags: falling-0x0002 rasing-0x0001 */
	mi,esd-err-irq-gpio = <&tlmm 51 0x2002>;

	mi,mdss-panel-on-dimming-delay = <120>;
	mi,disp-fod-off-dimming-delay = <85>;
	mi,mdss-panel-prepare-before-fod-hbm-on;

	/* mi,elvss_dimming_check_enable; */
	mi,mdss-dsi-elvss-dimming-register-read-length = <1>;
	mi,mdss-dsi-elvss-dimming-update-hbm-fod-on-index = <4>;
	mi,mdss-dsi-elvss-dimming-update-hbm-fod-off-index = <7>;
	mi,mdss-dsi-panel-dc-threshold = <470>;
	mi,mdss-dsi-panel-dc-type = <2>; /* differ to cmi */

	mi,mdss-dsi-panel-fod-dimlayer-enabled;
	mi,mdss-panel-fod-hbm-on-need-prepare;
	mi,mdss-panel-delay-before-fod-hbm-on;
	mi,mdss-panel-delay-before-fod-hbm-off;
	mi,mdss-panel-delay-after-fod-hbm-off;

	/* gamma update setting  */
	mi,mdss-dsi-greenish-update-gamma-flag;
	mi,mdss-dsi-greenish-update-gamma-offset = <0x14>;
	mi,mdss-dsi-greenish-update-gamma-length = <2>;
	mi,mdss-dsi-update-gamma-param-count = <6>;
	mi,mdss-dsi-update-gamma-1st-index = <4>;
	mi,mdss-dsi-update-gamma-2nd-index = <6>;
	mi,mdss-dsi-update-gamma-3rd-index = <8>;
	mi,mdss-dsi-update-gamma-4th-index = <10>;
	mi,mdss-dsi-update-gamma-5th-index = <12>;
	mi,mdss-dsi-update-gamma-6th-index = <14>;


	mi,mdss-dsi-dimlayer-brightness-alpha-lut-item-count = <21>;
	mi,mdss-dsi-dimlayer-brightness-alpha-lut =
	/* brightness  alpha */
		<0          0xFF
		 4          0xEB
		 8          0xEA
		 12         0xE9
		 13         0xE8
		 20         0xE5
		 24         0xE3
		 30         0xE0
		 68         0xD0
		 133        0xC0
		 218        0xB0
		 328        0xA0
		 486        0x90
		 642        0x80
		 832        0x70
		 1043       0x60
		 1267       0x50
		 1500       0x40
		 1770       0x30
		 2000       0x24
		 2047       0x21>;

	qcom,mdss-dsi-display-timings {
		timing@0{
			mi,mdss-dsi-doze-hbm-command = [
				05 01 00 00 10 00 02 28 00
				39 00 00 00 00 00 03 F0 5A 5A
				39 00 00 00 00 00 02 D4 8B
				39 01 00 00 00 00 02 53 22
				39 01 00 00 10 00 03 F0 A5 A5
				05 01 00 00 00 00 02 29 00];
			mi,mdss-dsi-doze-lbm-command = [
				05 01 00 00 10 00 02 28 00
				39 00 00 00 00 00 03 F0 5A 5A
				39 00 00 00 00 00 02 D4 8B
				39 01 00 00 00 00 02 53 23
				39 01 00 00 10 00 03 F0 A5 A5
				05 01 00 00 00 00 02 29 00];
			mi,mdss-dsi-doze-hbm-command-state = "dsi_lp_mode";
			mi,mdss-dsi-doze-lbm-command-state = "dsi_lp_mode";

			mi,mdss-dsi-hbm-fod-on-command = [
				39 00 00 00 00 00 03 F0 5A 5A
				/* elvss dimming off */
				39 00 00 00 00 00 02 B0 07
				39 00 00 00 00 00 02 B7 51
				39 01 00 00 00 00 03 F0 A5 A5
				/* HBM on */
				39 01 00 00 01 00 02 53 E0
				/* HBM ON 800nit */
				39 01 00 00 01 00 03 51 03 FF];
			mi,mdss-dsi-hbm-fod-on-command-state = "dsi_hs_mode";
			mi,mdss-dsi-hbm-fod-off-command = [
				15 01 00 00 00 00 02 53 20
				/* parameter will be updated base on last brightness */
				39 01 00 00 00 00 03 51 03 FF
				39 00 00 00 00 00 03 F0 5A 5A
				/* elvss dimming on */
				39 00 00 00 00 00 02 B0 07
				39 00 00 00 00 00 02 B7 D1
				39 01 00 00 00 00 03 F0 A5 A5];
			mi,mdss-dsi-hbm-fod-off-command-state = "dsi_hs_mode";

			mi,mdss-dsi-hbm-off-command = [
				15 01 00 00 00 00 02 53 28
				/* parameter will be updated base on last brightness */
				39 01 00 00 00 00 03 51 03 FF];
			mi,mdss-dsi-hbm-off-command-state = "dsi_lp_mode";
			mi,mdss-dsi-hbm-on-command = [
				15 01 00 00 00 00 02 53 E8
				/* HBM ON 700nit */
				39 01 00 00 00 00 03 51 03 FF];
			mi,mdss-dsi-hbm-on-command-state = "dsi_lp_mode";

			mi,mdss-dsi-flat-on-command = [
				/* Level2 key enable */
				39 00 00 00 00 00 03 F0 5A 5A
				/* Flat mode on */
				39 00 00 00 00 00 1D BE
				82 29 00 00 00 3C 3C 3C
				50 50 50 5E 5E 5E 64 64
				64 5C 4B 8B A4 79 00 33
				69 12 7A 70
				/* Update key */
				39 00 00 00 00 00 02 F7 01
				/* Level2 key disable */
				39 01 00 00 00 00 03 F0 A5 A5];
			mi,mdss-dsi-flat-off-command = [
				/* Level2 key enable */
				39 00 00 00 00 00 03 F0 5A 5A
				/* Flat mode on */
				39 00 00 00 00 00 1D BE
				82 09 00 00 00 3C 3C 3C
				50 50 50 5E 5E 5E 64 64
				64 5C 4B 8B CB 79 00 33
				69 12 7A 70
				/* Update key */
				39 00 00 00 00 00 02 F7 01
				/* Level2 key disable */
				39 01 00 00 00 00 03 F0 A5 A5];
			mi,mdss-dsi-flat-on-command-state = "dsi_hs_mode";
			mi,mdss-dsi-flat-off-command-state = "dsi_hs_mode";

			mi,mdss-dsi-dimmingon-command = [39 01 00 00 01 00 02 53 28];
			mi,mdss-dsi-dimmingon-command-state = "dsi_hs_mode";
			mi,mdss-dsi-dimmingoff-command = [
				39 01 00 00 01 00 02 53 20
				05 01 00 00 00 00 02 29 00];
			mi,mdss-dsi-dimmingoff-command-state = "dsi_hs_mode";

			mi,mdss-dsi-elvss-dimming-offset-command = [39 01 00 00 00 00 02 B0 07];
			mi,mdss-dsi-elvss-dimming-offset-command-state = "dsi_hs_mode";
			mi,mdss-dsi-elvss-dimming-read-command = [06 01 00 01 00 00 01 B7];
			mi,mdss-dsi-elvss-dimming-read-command-state = "dsi_hs_mode";
			mi,mdss-dsi-elvss-dimming-off-command = [
				39 00 00 00 00 00 03 F0 5A 5A
				39 00 00 00 00 00 02 B0 07
				39 00 00 00 00 00 02 B7 91
				39 01 00 00 01 00 03 F0 A5 A5];
			mi,mdss-dsi-elvss-dimming-off-command-state = "dsi_lp_mode";

			mi,mdss-dsi-acl-off-command = [39 01 00 00 00 00 02 55 00];
			mi,mdss-dsi-acl-off-command-state = "dsi_lp_mode";
			mi,mdss-dsi-acl-l1-command = [39 01 00 00 00 00 02 55 01];/* 50% */
			mi,mdss-dsi-acl-l1-command-state = "dsi_lp_mode";
			mi,mdss-dsi-acl-l2-command = [39 01 00 00 00 00 02 55 02];/* 40% */
			mi,mdss-dsi-acl-l2-command-state = "dsi_lp_mode";
			mi,mdss-dsi-acl-l3-command = [39 01 00 00 00 00 02 55 03];/* 30% */
			mi,mdss-dsi-acl-l3-command-state = "dsi_lp_mode";

			mi,mdss-dsi-crc-srgb-command = [
				/* CRC Enable + sRGB mode */
				39 01 00 00 00 00 02 81 90
				39 01 00 00 00 00 03 F0 5A 5A
				/* CRC Enable */
				39 01 00 00 00 00 02 B1 00
				/* Set Offset P2*/
				39 01 00 00 00 00 02 B0 01
				/* CRC LUT(sRGB mode) */
				39 01 00 00 00 00 16 B1 AE 0C 05 3F C6 14 05 07 AA 4A DD C8 C3 14 C0 E8 DC 19 FF F4 D9
				/* Set Offset P23*/
				39 01 00 00 00 00 02 B0 16
				/* CRC LUT(DCI-P3 mode) */
				39 01 00 00 00 00 16 B1 BD 02 00 14 D1 00 04 07 AA 0C EC CB C8 0F DD D9 E4 05 FF FF FF
				39 01 00 00 00 00 03 F0 A5 A5];
			mi,mdss-dsi-crc-srgb-command-state = "dsi_lp_mode";
			mi,mdss-dsi-crc-dcip3-command = [
				/* CRC Enable + DCI-P3 mode */
				39 01 00 00 00 00 02 81 91
				39 01 00 00 00 00 03 F0 5A 5A
				/* CRC Enable */
				39 01 00 00 00 00 02 B1 00
				/* Set Offset P2*/
				39 01 00 00 00 00 02 B0 01
				/* CRC LUT(sRGB mode) */
				39 01 00 00 00 00 16 B1 AE 0C 05 3F C6 14 05 07 AA 4A DD C8 C3 14 C0 E8 DC 19 FF F4 D9
				/* Set Offset P23*/
				39 01 00 00 00 00 02 B0 16
				/* CRC LUT(DCI-P3 mode) */
				39 01 00 00 00 00 16 B1 D2 0A 05 1A E6 00 04 07 F5 0C DC DB E8 0F DD EE E9 05 FF FF FF
				39 01 00 00 00 00 03 F0 A5 A5];
			mi,mdss-dsi-crc-dcip3-command-state = "dsi_lp_mode";
			mi,mdss-dsi-crc-off-command = [
				/* CRC Disable (Normal mode) */
				39 01 00 00 00 00 02 81 00
				39 00 00 00 00 00 03 F0 5A 5A
				/* CRC Bypass */
				39 00 00 00 00 00 02 B1 01
				39 01 00 00 00 00 03 F0 A5 A5];
			mi,mdss-dsi-crc-off-command-state = "dsi_lp_mode";

			/* gamma update setting  */
			mi,mdss-dsi-level2-key-enable-command = [
				39 01 00 00 00 00 03 F0 5A 5A];
			mi,mdss-dsi-update-gamma-pre-read-command = [
				39 01 00 00 00 00 02 B0 23
				39 01 00 00 00 00 03 B7 05 05];
			mi,mdss-dsi-update-gamma-read-1st-pre-command = [
				15 01 00 00 00 00 02 B0 5F];
			mi,mdss-dsi-update-gamma-read-2nd-pre-command = [
				15 01 00 00 00 00 02 B0 63];
			mi,mdss-dsi-update-gamma-read-3rd-pre-command = [
				15 01 00 00 00 00 02 B0 67];
			mi,mdss-dsi-update-gamma-read-4th-pre-command = [
				15 01 00 00 00 00 02 B0 8A];
			mi,mdss-dsi-update-gamma-read-5th-pre-command = [
				15 01 00 00 00 00 02 B0 8E];
			mi,mdss-dsi-update-gamma-read-6th-pre-command = [
				15 01 00 00 00 00 02 B0 92];
			mi,mdss-dsi-update-gamma-read-b7-command = [
				06 01 00 00 00 00 02 B7 00];
			mi,mdss-dsi-level2-key-disable-command = [
				39 01 00 00 00 00 03 F0 A5 A5];

			/* need update 1st~6th param after read ic */
			mi,mdss-dsi-greenish-gamma-set-command = [
				39 00 00 00 00 00 03 F0 5A 5A
				/* pre write */
				39 00 00 00 00 00 02 B0 23
				39 00 00 00 00 00 03 B7 05 05
				/* 1st param */
				39 00 00 00 00 00 02 B0 5F
				39 00 00 00 00 00 03 B7 01 01
				/* 2nd param */
				39 00 00 00 00 00 02 B0 63
				39 00 00 00 00 00 03 B7 01 01
				/* 3rd param */
				39 00 00 00 00 00 02 B0 67
				39 00 00 00 00 00 03 B7 01 01
				/* 4th param */
				39 00 00 00 00 00 02 B0 8A
				39 00 00 00 00 00 03 B7 01 01
				/* 5th param */
				39 00 00 00 00 00 02 B0 8E
				39 00 00 00 00 00 03 B7 01 01
				/* 6th param */
				39 00 00 00 00 00 02 B0 92
				39 00 00 00 00 00 03 B7 01 01
				39 01 00 00 00 00 03 F0 A5 A5];

			mi,mdss-dsi-level2-key-enable-command-state = "dsi_hs_mode";
			mi,mdss-dsi-update-gamma-pre-read-command-state = "dsi_hs_mode";
			mi,mdss-dsi-update-gamma-read-1st-pre-command-state = "dsi_hs_mode";
			mi,mdss-dsi-update-gamma-read-2nd-pre-command-state = "dsi_hs_mode";
			mi,mdss-dsi-update-gamma-read-3rd-pre-command-state = "dsi_hs_mode";
			mi,mdss-dsi-update-gamma-read-4th-pre-command-state = "dsi_hs_mode";
			mi,mdss-dsi-update-gamma-read-5th-pre-command-state = "dsi_hs_mode";
			mi,mdss-dsi-update-gamma-read-6th-pre-command-state = "dsi_hs_mode";
			mi,mdss-dsi-update-gamma-read-b7-command-state = "dsi_hs_mode";
			mi,mdss-dsi-level2-key-disable-command-state = "dsi_hs_mode";
			mi,mdss-dsi-greenish-gamma-set-command-state = "dsi_hs_mode";
		};
	};
};
