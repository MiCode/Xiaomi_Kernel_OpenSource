/* Copyright (c) 2015, The Linux Foundation. All rights reserved.
 *
 * This program is free software; you can redistribute it and/or modify
 * it under the terms of the GNU General Public License version 2 and
 * only version 2 as published by the Free Software Foundation.
 *
 * This program is distributed in the hope that it will be useful,
 * but WITHOUT ANY WARRANTY; without even the implied warranty of
 * MERCHANTABILITY or FITNESS FOR A PARTICULAR PURPOSE.  See the
 * GNU General Public License for more details.
 */

/*---------------------------------------------------------------------------
 * This file is autogenerated file using gcdb parser. Please do not edit it.
 * Update input XML file to add a new entry or update variable in this file
 * VERSION = "1.0"
 *---------------------------------------------------------------------------*/
&mdss_mdp {
	dsi_j3s_37_02_0a_dsc_video: qcom,mdss_dsi_j3s_37_02_0a_dsc_video {
		qcom,mdss-dsi-panel-name = "xiaomi 37 02 0a video mode dsc dsi panel";
		qcom,mdss-dsi-panel-id = <0>;
		qcom,mdss-dsi-panel-model = "xiaomi 37 02 0a VIDEO PANEL";
		qcom,mdss-dsi-panel-type = "dsi_video_mode";
		qcom,dsi-ctrl-num = <0>;
		qcom,dsi-phy-num = <0>;
		qcom,mdss-dsi-virtual-channel-id = <0>;
		qcom,mdss-dsi-stream = <0>;
		qcom,mdss-dsi-bpp = <24>;
		qcom,mdss-dsi-color-order = "rgb_swap_rgb";
		qcom,mdss-dsi-underflow-color = <0xff>;
		qcom,mdss-dsi-border-color = <0>;
		qcom,mdss-dsi-traffic-mode = "burst_mode";
		qcom,mdss-dsi-bllp-eof-power-mode;
		qcom,mdss-dsi-bllp-power-mode;
		qcom,mdss-dsi-lp11-init;
		qcom,mdss-dsi-lane-0-state;
		qcom,mdss-dsi-lane-1-state;
		qcom,mdss-dsi-lane-2-state;
		qcom,mdss-dsi-lane-3-state;
		qcom,mdss-brightness-max-level = <4095>;
		qcom,mdss-dsi-dma-trigger = "trigger_sw";
		qcom,mdss-dsi-mdp-trigger = "none";
		qcom,mdss-dsi-reset-sequence = <1 2>, <0 10>, <1 5>, <0 1>, <1 10>;
		qcom,mdss-pan-physical-width-dimension = <695>;
		qcom,mdss-pan-physical-height-dimension = <1544>;
		qcom,mdss-dsi-tx-eot-append;
		qcom,bl-update-flag = "delay_until_first_frame";
		qcom,disp-panel-offon-mode-enabled;
		qcom,mdss-dsi-panel-hdr-enabled;
		qcom,mdss-dsi-panel-hdr-color-primaries = <14500 15500 32000
			17000 15500 30000 8000 3000>;
		qcom,mdss-dsi-panel-peak-brightness = <4200000>;
		qcom,mdss-dsi-panel-blackness-level = <3230>;
		/* qcom,mdss-dsi-qsync-min-refresh-rate = <60>; */
		qcom,mdss-dsi-pan-enable-dynamic-fps;
		qcom,mdss-dsi-pan-fps-update =
				"dfps_immediate_porch_mode_vfp";
		qcom,dsi-supported-dfps-list = <144 120 90 60 50 48 30>;

		qcom,mdss-dsi-display-timings {
			timing@0{
				qcom,mdss-dsi-panel-framerate = <144>;
				qcom,mdss-dsi-panel-width = <1080>;
				qcom,mdss-dsi-panel-height = <2400>;
				qcom,mdss-dsi-h-pulse-width = <12>;
				qcom,mdss-dsi-h-back-porch = <43>;
				qcom,mdss-dsi-h-front-porch = <40>;
				qcom,mdss-dsi-h-sync-skew = <0>;
				qcom,mdss-dsi-v-pulse-width = <2>;
				qcom,mdss-dsi-v-back-porch = <26>;
				qcom,mdss-dsi-v-front-porch = <28>;
				qcom,mdss-dsi-h-left-border = <0>;
				qcom,mdss-dsi-h-right-border = <0>;
				qcom,mdss-dsi-v-top-border = <0>;
				qcom,mdss-dsi-v-bottom-border = <0>;

				qcom,mdss-dsi-on-command = [
						15 01 00 00 00 00 02 FF E0
						15 00 00 00 00 00 02 FB 01
						15 00 00 00 00 00 02 35 82
						15 01 00 00 00 00 02 FF F0
						15 00 00 00 00 00 02 FB 01
						15 00 00 00 00 00 02 5A 00
						15 00 00 00 00 00 02 9F 19
						15 00 00 00 00 00 02 9C 00
						15 01 00 00 00 00 02 FF D0
						15 00 00 00 00 00 02 FB 01
						15 00 00 00 00 00 02 FF C0
						15 00 00 00 00 00 02 FB 01
						15 01 00 00 00 00 02 9C 11
						15 00 00 00 00 00 02 9D 11
						15 01 00 00 00 00 02 FF 23
						15 00 00 00 00 00 02 FB 01
						15 00 00 00 00 00 02 00 80
						15 00 00 00 00 00 02 01 84
						15 00 00 00 00 00 02 05 2D
						15 00 00 00 00 00 02 06 00
						15 00 00 00 00 00 02 07 00
						15 00 00 00 00 00 02 08 01
						15 00 00 00 00 00 02 09 45
						15 00 00 00 00 00 02 11 01
						15 00 00 00 00 00 02 12 95
						15 00 00 00 00 00 02 15 68
						15 00 00 00 00 00 02 16 0B
						15 01 00 00 00 00 02 29 0A
						/* CABC begin */
						15 01 00 00 00 00 02 30 FF
						15 01 00 00 00 00 02 31 FE
						15 01 00 00 00 00 02 32 FD
						15 01 00 00 00 00 02 33 FB
						15 01 00 00 00 00 02 34 F8
						15 01 00 00 00 00 02 35 F5
						15 01 00 00 00 00 02 36 F3
						15 01 00 00 00 00 02 37 F2
						15 01 00 00 00 00 02 38 F2
						15 01 00 00 00 00 02 39 F2
						15 01 00 00 00 00 02 3A EF
						15 01 00 00 00 00 02 3B EC
						15 01 00 00 00 00 02 3D E9
						15 01 00 00 00 00 02 3F E5
						15 01 00 00 00 00 02 40 E5
						15 01 00 00 00 00 02 41 E5
						15 01 00 00 00 00 02 2A 13
						15 01 00 00 00 00 02 45 FF
						15 01 00 00 00 00 02 46 F4
						15 01 00 00 00 00 02 47 E7
						15 01 00 00 00 00 02 48 DA
						15 01 00 00 00 00 02 49 CD
						15 01 00 00 00 00 02 4A C0
						15 01 00 00 00 00 02 4B B3
						15 01 00 00 00 00 02 4C B2
						15 01 00 00 00 00 02 4D B2
						15 01 00 00 00 00 02 4E B2
						15 01 00 00 00 00 02 4F 99
						15 01 00 00 00 00 02 50 80
						15 01 00 00 00 00 02 51 68
						15 01 00 00 00 00 02 52 66
						15 01 00 00 00 00 02 53 66
						15 01 00 00 00 00 02 54 66
						15 01 00 00 00 00 02 2B 0E
						15 01 00 00 00 00 02 58 FF
						15 01 00 00 00 00 02 59 FB
						15 01 00 00 00 00 02 5A F7
						15 01 00 00 00 00 02 5B F3
						15 01 00 00 00 00 02 5C EF
						15 01 00 00 00 00 02 5D E3
						15 01 00 00 00 00 02 5E DA
						15 01 00 00 00 00 02 5F D8
						15 01 00 00 00 00 02 60 D8
						15 01 00 00 00 00 02 61 D8
						15 01 00 00 00 00 02 62 CB
						15 01 00 00 00 00 02 63 BF
						15 01 00 00 00 00 02 64 B3
						15 01 00 00 00 00 02 65 B2
						15 01 00 00 00 00 02 66 B2
						15 01 00 00 00 00 02 67 B2
						15 01 00 00 00 00 02 FF 27
						15 01 00 00 00 00 02 FB 01
						15 01 00 00 00 00 02 40 20
						/* CABC end */
						15 01 00 00 00 00 02 FF 10
						39 00 00 00 00 00 03 51 0B BB
						15 00 00 00 00 00 02 53 24
						15 01 00 00 00 00 02 FF 10
						15 00 00 00 00 00 02 FB 01
						15 00 00 00 00 00 02 35 00
						15 01 00 00 46 00 02 11 00
						15 01 00 00 00 00 02 29 00
						/* ESD */
						15 01 00 00 00 00 02 FF 27
						15 01 00 00 00 00 02 FB 01
						15 01 00 00 00 00 02 3F 01
						15 01 00 00 00 00 02 43 08
						15 01 00 00 00 00 02 40 25
						15 01 00 00 00 00 02 FF 10];
				qcom,mdss-dsi-off-command = [
						15 01 00 00 00 00 02 FF 27
						15 01 00 00 00 00 02 FB 01
						15 01 00 00 00 00 02 3F 00
						15 01 00 00 00 00 02 FF 10
						05 01 00 00 00 00 02 28 00
						05 01 00 00 46 00 02 10 00];
				qcom,mdss-dsi-displayoff-command = [05 01 00 00 20 00 02 28 00];
				qcom,mdss-dsi-displayon-command = [05 01 00 00 14 00 02 29 00];
				qcom,mdss-dsi-on-command-state = "dsi_lp_mode";
				qcom,mdss-dsi-off-command-state = "dsi_hs_mode";
				qcom,mdss-dsi-displayoff-command-state = "dsi_hs_mode";
				qcom,mdss-dsi-displayon-command-state = "dsi_hs_mode";
				mi,mdss-dsi-lcd-hbm-l1-on-command = [
						/* max brightness 80% */
						15 01 00 00 00 00 02 FF 10
						39 01 00 00 00 00 03 51 0C CC];
				mi,mdss-dsi-lcd-hbm-l1-on-command-state = "dsi_lp_mode";
				mi,mdss-dsi-lcd-hbm-l2-on-command = [
						/* max brightness 85% */
						15 01 00 00 00 00 02 FF 10
						39 01 00 00 00 00 03 51 0D 98];
				mi,mdss-dsi-lcd-hbm-l2-on-command-state = "dsi_lp_mode";
				mi,mdss-dsi-lcd-hbm-l3-on-command = [
						/* max brightness 91% */
						15 01 00 00 00 00 02 FF 10
						39 01 00 00 00 00 03 51 0E 8C];
				mi,mdss-dsi-lcd-hbm-l3-on-command-state = "dsi_lp_mode";
				mi,mdss-dsi-lcd-hbm-off-command = [
						15 01 00 00 00 00 02 FF 10
						39 01 00 00 00 00 03 51 0B BB];
				mi,mdss-dsi-lcd-hbm-off-command-state = "dsi_lp_mode";

				qcom,mdss-dsi-h-sync-pulse = <1>;
				qcom,compression-mode = "dsc";
				qcom,mdss-dsc-version = <0x11>;
				qcom,mdss-dsc-scr-version = <0x0>;
				qcom,mdss-dsc-slice-height = <20>;
				qcom,mdss-dsc-slice-width = <540>;
				qcom,mdss-dsc-slice-per-pkt = <2>;
				qcom,mdss-dsc-bit-per-component = <8>;
				qcom,mdss-dsc-bit-per-pixel = <8>;
				qcom,mdss-dsc-block-prediction-enable;
			};
		};
	};
};

&dsi_j3s_37_02_0a_dsc_video {
	mi,feature-enabled;
	mi,is-tddi-flag;
	mi,mdss-panel-on-dimming-delay = <120>;
	mi,mdss-dsi-panel-xy-coordinate = <0x6 0x18>;
	mi,mdss-dsi-panel-max-luminance = <0x6 0x4>;
	mi,mdss-dsi-pan-enable-smart-fps;

	qcom,mdss-dsi-display-timings {
		timing@0{
			mi,mdss-dsi-read-lockdown-info-command = [
				15 01 00 00 00 00 02 FF 21
				06 01 00 00 00 00 01 F1];
			mi,mdss-dsi-read-lockdown-info-command-state = "dsi_lp_mode";

			mi,mdss-dsi-cabcuion-command = [
				15 01 00 00 00 00 02 FF 10
				15 01 00 00 00 00 02 55 01
			];
			mi,mdss-dsi-cabcstillon-command = [
				15 01 00 00 00 00 02 FF 10
				15 01 00 00 00 00 02 55 02
			];
			mi,mdss-dsi-cabcmovieon-command = [
				15 01 00 00 00 00 02 FF 10
				15 01 00 00 00 00 02 55 03
			];
			mi,mdss-dsi-cabcoff-command = [
				15 01 00 00 00 00 02 FF 10
				15 01 00 00 00 00 02 55 00
			];
			mi,mdss-dsi-dimmingon-command = [
				/* CABC DIMMING ON */
				15 01 00 00 00 00 02 FF 10
				15 01 00 00 00 00 02 53 2C
			];

			mi,mdss-dsi-cabcuion-command-state = "dsi_hs_mode";
			mi,mdss-dsi-cabcstillon-command-state = "dsi_hs_mode";
			mi,mdss-dsi-cabcmovieon-command-state = "dsi_hs_mode";
			mi,mdss-dsi-cabcoff-command-state = "dsi_hs_mode";
			mi,mdss-dsi-dimmingon-command-state = "dsi_hs_mode";

			mi,mdss-dsi-xy-coordinate-command = [
				15 01 00 00 00 00 02 FF 10
				06 01 00 00 00 00 01 A1];
			mi,mdss-dsi-xy-coordinate-command-state = "dsi_lp_mode";

			mi,mdss-dsi-max-luminance-write-command = [
				15 01 00 00 00 00 02 FF 10];
			mi,mdss-dsi-max-luminance-write-command-state = "dsi_lp_mode";
			mi,mdss-dsi-max-luminance-read-command = [
				06 01 00 00 00 00 01 A1];
			mi,mdss-dsi-max-luminance-read-command-state = "dsi_lp_mode";
		};
	};
};
