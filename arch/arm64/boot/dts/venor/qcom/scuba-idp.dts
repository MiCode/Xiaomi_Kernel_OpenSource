/dts-v1/;

#include "scuba.dtsi"
#include "scuba-idp.dtsi"

/ {
	model = "Qualcomm Technologies, Inc. Scuba IDP";
	compatible = "qcom,scuba-idp", "qcom,scuba", "qcom,idp";
	qcom,board-id = <34 0>;
};
