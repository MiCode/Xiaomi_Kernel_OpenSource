/dts-v1/;
/plugin/;

#include <dt-bindings/clock/qcom,gcc-kona.h>
#include <dt-bindings/clock/qcom,camcc-kona.h>
#include <dt-bindings/clock/qcom,rpmh.h>
#include <dt-bindings/interrupt-controller/arm-gic.h>

#include "umi-sm8250.dtsi"
#include "umi-sm8250-camera-sensor-mtp.dtsi"
/ {
	model = "Qualcomm Technologies, Inc. xiaomi umi";
	compatible = "qcom,kona-mtp", "qcom,kona", "qcom,mtp";
	qcom,board-id = <35 0>;
};
