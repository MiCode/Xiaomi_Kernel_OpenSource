/dts-v1/;
/memreserve/ 0x90000000 0x00000100;

#include "scuba.dtsi"
#include "scuba-rumi.dtsi"

/ {
	model = "Qualcomm Technologies, Inc. Scuba RUMI";
	compatible = "qcom,scuba-rumi", "qcom,scuba", "qcom,rumi";
	qcom,board-id = <15 0>;
};
