&scuba_snd {
	qcom,msm-mbhc-usbc-audio-supported = <1>;
	qcom,msm-mbhc-hphl-swh = <1>;
	qcom,msm-mbhc-gnd-swh = <1>;
};

&adsp_loader {
	adsp-fuse-not-supported = <1>;
	adsp-fw-name = "adsp2";
};

&va_cdc_dma_0_tx {
	qcom,msm-dai-is-island-supported = <0>;
};
