/dts-v1/;

#include "lahaina-v2.1.dtsi"
#include "lahaina-mtp.dtsi"

/ {
	model = "Qualcomm Technologies, Inc. Lahaina V2.1 MTP";
	compatible = "qcom,lahaina-mtp", "qcom,lahaina", "qcom,mtp";
	qcom,board-id = <0x10008 0>;
};
