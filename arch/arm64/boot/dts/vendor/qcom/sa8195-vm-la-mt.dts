/dts-v1/;

#include "sa8195-vm.dtsi"
#include "sa8195-vm-la-mt.dtsi"

/ {
	model = "Qualcomm Technologies, Inc. SA8195 Multi LA Virtual Machine";
	compatible = "qcom,sa8195p";
	qcom,pmic-name = "PM8195";
	qcom,board-id = <0x2000001 0>;
};
