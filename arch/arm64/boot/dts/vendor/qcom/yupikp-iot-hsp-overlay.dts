/dts-v1/;
/plugin/;

#include <dt-bindings/interconnect/qcom,yupik.h>
#include "yupikp-iot-hsp.dtsi"

/ {
	model = "Qualcomm Technologies, Inc. YupikP IoT HSP";
	compatible = "qcom,yupikp-iot-idp", "qcom,yupikp-iot", "qcom,idp";
	qcom,msm-id = <498 0x10000>;
	qcom,board-id = <34 1>;
};
