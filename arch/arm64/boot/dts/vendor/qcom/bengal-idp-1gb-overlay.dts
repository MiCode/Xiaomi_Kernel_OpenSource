/dts-v1/;
/plugin/;

#include <dt-bindings/interrupt-controller/arm-gic.h>
#include "bengal-idp-low-ram.dtsi"

/ {
	model = "Qualcomm Technologies, Inc. BENGAL IDP 1Gb DDR HD+";
	compatible = "qcom,bengal-idp", "qcom,bengal", "qcom,idp";
	qcom,msm-id = <417 0x10000>, <444 0x10000>;
	qcom,board-id = <34 0x303>;
};
