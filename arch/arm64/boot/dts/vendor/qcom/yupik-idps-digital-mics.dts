/dts-v1/;

#include "yupik.dtsi"
#include "yupik-idps-digital-mics.dtsi"

/ {
	model = "Qualcomm Technologies, Inc. Yupik IDPS + DIGITAL MICS";
	compatible = "qcom,yupik-idp", "qcom,yupik", "qcom,idp";
	qcom,board-id = <34 1>;
};
