/dts-v1/;
/plugin/;

#include "haydn-sm8350.dtsi"

/ {
	model = "Haydn based on Qualcomm Technologies, Inc SM8350";
	compatible = "qcom,lahaina-mtp", "qcom,lahaina", "qcom,mtp";
	qcom,board-id = <0x10008 0>;
	xiaomi,board-id = <0x4 0>;
};
