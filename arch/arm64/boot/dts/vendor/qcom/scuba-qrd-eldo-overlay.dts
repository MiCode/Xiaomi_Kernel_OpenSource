/dts-v1/;
/plugin/;

#include <dt-bindings/interrupt-controller/arm-gic.h>
#include "scuba-qrd-eldo.dtsi"

/ {
	model = "Qualcomm Technologies, Inc. Scuba QRD ELDO";
	compatible = "qcom,scuba-qrd", "qcom,scuba", "qcom,qrd";
	qcom,msm-id = <441 0x10000>, <471 0x10000>;
	qcom,board-id = <0x2000B 0>;
};
