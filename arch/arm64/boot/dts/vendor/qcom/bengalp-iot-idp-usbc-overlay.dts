/dts-v1/;
/plugin/;

#include <dt-bindings/interrupt-controller/arm-gic.h>
#include "bengalp-iot-idp.dtsi"
#include "bengalp-iot-idp-usbc.dtsi"

/ {
	model = "Qualcomm Technologies, Inc. BENGALP-IOT IDP USBC Audio";
	compatible = "qcom,bengalp-iot-idp", "qcom,bengalp-iot", "qcom,idp";
	qcom,msm-id = <470 0x10000>;
	qcom,board-id = <34 1>;
};
