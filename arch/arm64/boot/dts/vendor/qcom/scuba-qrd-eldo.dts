/dts-v1/;

#include "scuba.dtsi"
#include "scuba-qrd-eldo.dtsi"

/ {
	model = "Qualcomm Technologies, Inc. Scuba QRD ELDO";
	compatible = "qcom,scuba-qrd", "qcom,scuba", "qcom,qrd";
	qcom,board-id = <0x2000B 0>;
};
