/dts-v1/;
/plugin/;

#include <dt-bindings/interrupt-controller/arm-gic.h>
#include "scuba-rumi.dtsi"

/ {
	model = "Qualcomm Technologies, Inc. Scuba RUMI";
	compatible = "qcom,scuba-rumi", "qcom,scuba", "qcom,rumi";
	qcom,msm-id = <441 0x10000>;
	qcom,board-id = <15 0>;
};
