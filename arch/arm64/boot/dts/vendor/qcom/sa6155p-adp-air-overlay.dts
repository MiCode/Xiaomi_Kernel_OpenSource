/dts-v1/;
/plugin/;

#include "sa6155-adp-air.dtsi"
#include "display/sa6155-display-shd.dtsi"

/ {
	model = "Qualcomm Technologies, Inc. SA6155P ADP-AIR";
	compatible = "qcom,sa6155p-adp-air", "qcom,sa6155p", "qcom,adp-air";
	qcom,msm-id = <377 0x0>, <380 0>;
	qcom,board-id = <0x03010019 0>;
};
