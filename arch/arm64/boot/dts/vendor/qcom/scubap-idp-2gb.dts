/dts-v1/;

#include "scuba-low-ram.dtsi"
#include "scuba-idp.dtsi"

/ {
	model = "Qualcomm Technologies, Inc. Scubap IDP 2GB DDR";
	compatible = "qcom,scuba-idp", "qcom,scuba", "qcom,idp";
	qcom,msm-id = <471 0x10000>;
	qcom,board-id = <34 0x400>;
};
