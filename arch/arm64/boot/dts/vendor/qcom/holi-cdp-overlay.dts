/dts-v1/;
/plugin/;

#include "holi-cdp.dtsi"

/ {
	model = "Qualcomm Technologies, Inc. Holi CDP";
	compatible = "qcom,holi-cdp", "qcom,holi", "qcom,cdp";
	qcom,msm-id = <454 0x10000>, <472 0x10000>;
	qcom,board-id = <1 0>;
};

&wsa881x_analog_reset_gpio {
	pinctrl-0 = <&spkr_1_sd_n_active>;
	pinctrl-1 = <&spkr_1_sd_n_sleep>;
};
