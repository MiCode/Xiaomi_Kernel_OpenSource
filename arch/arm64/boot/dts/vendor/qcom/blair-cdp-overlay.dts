/dts-v1/;
/plugin/;

#include "blair-cdp.dtsi"

/ {
	model = "Qualcomm Technologies, Inc. Blair CDP";
	compatible = "qcom,blair-cdp", "qcom,blair", "qcom,cdp";
	qcom,msm-id = <507 0x10000>;
	qcom,board-id = <1 0>;
};
