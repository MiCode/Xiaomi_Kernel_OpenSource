&mdss_mdp {
	dsi_ft8719_truly_v2_video: qcom,mdss_dsi_ft8719_truly_v2_video {
		qcom,mdss-dsi-panel-name =
			"ft8719 v2 video mode dsi truly panel";
		qcom,mdss-dsi-panel-type = "dsi_video_mode";

		qcom,dsi-ctrl-num = <0>;
		qcom,dsi-phy-num = <0>;

		//qcom,mdss-dsi-panel-mode-switch;
		qcom,mdss-dsi-virtual-channel-id = <0>;
		qcom,mdss-dsi-stream = <0>;
		qcom,mdss-dsi-h-left-border = <0>;
		qcom,mdss-dsi-h-right-border = <0>;
		qcom,mdss-dsi-v-top-border = <0>;
		qcom,mdss-dsi-v-bottom-border = <0>;
		qcom,mdss-dsi-bpp = <24>;
		qcom,mdss-dsi-color-order = "rgb_swap_rgb";
		qcom,mdss-dsi-underflow-color = <0xff>;
		qcom,mdss-dsi-border-color = <0>;
		qcom,mdss-dsi-h-sync-pulse = <0>;
		qcom,mdss-dsi-traffic-mode = "non_burst_sync_event";
		qcom,mdss-dsi-lane-map = "lane_map_0123";
		qcom,mdss-dsi-bllp-eof-power-mode;
		qcom,mdss-dsi-bllp-power-mode;
		qcom,mdss-dsi-tx-eot-append;
		qcom,mdss-dsi-lane-0-state;
		qcom,mdss-dsi-lane-1-state;
		qcom,mdss-dsi-lane-2-state;
		qcom,mdss-dsi-lane-3-state;
		qcom,mdss-dsi-dma-trigger = "trigger_sw";
		qcom,mdss-dsi-mdp-trigger = "none";
		qcom,mdss-dsi-lp11-init;
		qcom,mdss-dsi-reset-sequence = <1 5>, <0 2>, <1 20>;
		qcom,mdss-pan-physical-width-dimension = <65>;
		qcom,mdss-pan-physical-height-dimension = <129>;
		qcom,mdss-dsi-te-pin-select = <1>;
		qcom,mdss-dsi-wr-mem-start = <0x2c>;
		qcom,mdss-dsi-wr-mem-continue = <0x3c>;
		qcom,mdss-dsi-te-dcs-command = <1>;
		qcom,mdss-dsi-te-check-enable;
		qcom,mdss-dsi-te-using-te-pin;
		qcom,mdss-dsi-display-timings {
			timing@0 {
		        qcom,mdss-dsi-panel-width = <1080>;
		        qcom,mdss-dsi-panel-height = <2340>;
		        qcom,mdss-dsi-h-front-porch = <50>;
		        qcom,mdss-dsi-h-back-porch = <32>;
		        qcom,mdss-dsi-h-pulse-width = <4>;
		        qcom,mdss-dsi-h-sync-skew = <0>;
		        qcom,mdss-dsi-v-back-porch = <26>;
		        qcom,mdss-dsi-v-front-porch = <112>;
		        qcom,mdss-dsi-v-pulse-width = <4>;
		        qcom,mdss-dsi-panel-framerate = <60>;
				qcom,mdss-dsi-on-command = [
					39 01 00 00 00 00 02 00 00
					39 01 00 00 00 00 04 FF 87 19 01
					39 01 00 00 00 00 02 00 80
					39 01 00 00 00 00 03 FF 87 19
					39 01 00 00 00 00 02 00 80
					39 01 00 00 00 00 0D CA EB D2 B6 AE A6 9A 96 90 89 86 83 80
					39 01 00 00 00 00 02 00 90
					39 01 00 00 00 00 0A CA FE FF 66 F6 FF 66 FB FF 32
					39 01 00 00 00 00 02 00 B0
					39 01 00 00 00 00 02 CA 00//pwm31K
					39 01 00 00 00 00 02 00 B2
					39 01 00 00 00 00 02 CA 0C//12 bit
					39 01 00 00 00 00 02 00 B5
					39 01 00 00 00 00 02 CA 06 //dimming
					39 01 00 00 00 00 02 FF 10
					39 01 00 00 00 00 02 35 00
					39 01 00 00 00 00 03 51 FF 0F//max brightness
					39 01 00 00 00 00 02 53 2C
					39 01 00 00 00 00 02 55 01
					05 01 00 00 55 00 02 11 00
					05 01 00 00 02 00 02 29 00
								];
				qcom,mdss-dsi-off-command = [
					05 01 00 00 14 00 02 28 00
					05 01 00 00 8C 00 02 10 00
					39 01 00 00 00 00 02 00 00
					39 01 00 00 00 00 05 F7 5A A5 95 27];
				qcom,mdss-dsi-cabc-on-command = [
				39 01 00 00 00 00 02 55 01
				];
				qcom,mdss-dsi-cabc-off-command = [
				39 01 00 00 00 00 02 55 00
				];
				qcom,mdss-dsi-cabc_movie-on-command = [
				39 01 00 00 00 00 02 55 03
				];
				qcom,mdss-dsi-cabc_still-on-command = [
				39 01 00 00 00 00 02 55 02
				];
				qcom,mdss-dsi-on-command-state = "dsi_lp_mode";
				qcom,mdss-dsi-off-command-state = "dsi_hs_mode";
				qcom,mdss-dsi-cabc-on-command-state = "dsi_hs_mode";
				qcom,mdss-dsi-cabc-off-command-state = "dsi_hs_mode";
				qcom,mdss-dsi-cabc_movie-on-command-state = "dsi_hs_mode";
				qcom,mdss-dsi-cabc_still-on-command-state = "dsi_hs_mode";
			};
		};
	};
};
