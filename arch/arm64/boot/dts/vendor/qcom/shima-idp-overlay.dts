/dts-v1/;
/plugin/;

#include "shima-idp.dtsi"

/ {
	model = "Qualcomm Technologies, Inc. Shima IDP";
	compatible = "qcom,shima-idp", "qcom,shima", "qcom,idp";
	qcom,msm-id = <450 0x10000>;
	qcom,board-id = <34 0>;
};
