/dts-v1/;

#include "lahaina.dtsi"
#include "lahaina-mtp-hsp.dtsi"

/ {
	model = "Qualcomm Technologies, Inc. Lahaina MTP-HSP";
	compatible = "qcom,lahaina-mtp", "qcom,lahaina", "qcom,mtp";
	qcom,board-id = <0x1010008 0>;
};
