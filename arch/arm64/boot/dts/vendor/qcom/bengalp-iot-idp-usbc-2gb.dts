/dts-v1/;

#include "bengalp-iot-low-ram.dtsi"
#include "bengalp-iot-idp-low-ram.dtsi"

/ {
	model = "Qualcomm Technologies, Inc. BENGALP-IOT IDP AATC 2Gb DDR";
	compatible = "qcom,bengalp-iot-idp", "qcom,bengalp-iot", "qcom,idp";
	qcom,board-id = <34 0x401>;
};
