
&lpi_tlmm {
	qcom,lpi-slew-base-tbl = <0x00000000>, <0x00000000>,
				 <0x00000000>, <0x00000000>,
				 <0x00000000>, <0x00000000>,
				 <0x00000000>, <0x00000000>,
				 <0x00000000>, <0x00000000>,
				 <0x00000000>, <0x00000000>,
				 <0x00000000>, <0x00000000>,
				 <0x0355C000>;
};
