/dts-v1/;
/plugin/;

#include <dt-bindings/interrupt-controller/arm-gic.h>
#include "bengal-iot-idp.dtsi"

/ {
	model = "Qualcomm Technologies, Inc. BENGAL-IOT IDP Overlay";
	compatible = "qcom,bengal-iot-idp", "qcom,bengal-iot", "qcom,idp";
	qcom,msm-id = <469 0x10000>;
	qcom,board-id = <34 0>;
};
