/dts-v1/;

#include "scuba.dtsi"
#include "scuba-idp.dtsi"
#include "scuba-idp-usbc.dtsi"

/ {
	model = "Qualcomm Technologies, Inc. Scuba IDP USBC Audio";
	compatible = "qcom,scuba-idp", "qcom,scuba", "qcom,idp";
	qcom,board-id = <34 1>;
};
