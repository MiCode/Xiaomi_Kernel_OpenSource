&mdss_mdp {
	dsi_td4328_truly_video: qcom,mdss_dsi_td4328_truly_video {
		qcom,mdss-dsi-panel-name =
			"td4328 video mode dsi truly panel";
		qcom,mdss-dsi-panel-type = "dsi_video_mode";

		qcom,dsi-ctrl-num = <0>;
		qcom,dsi-phy-num = <0>;
		qcom,dsi-select-clocks = "src_byte_clk0", "src_pixel_clk0";

		qcom,mdss-dsi-virtual-channel-id = <0>;
		qcom,mdss-dsi-stream = <0>;
		qcom,mdss-dsi-h-left-border = <0>;
		qcom,mdss-dsi-h-right-border = <0>;
		qcom,mdss-dsi-v-top-border = <0>;
		qcom,mdss-dsi-v-bottom-border = <0>;
		qcom,mdss-dsi-bpp = <24>;
		qcom,mdss-dsi-color-order = "rgb_swap_rgb";
		qcom,mdss-dsi-underflow-color = <0xff>;
		qcom,mdss-dsi-border-color = <0>;
		qcom,mdss-dsi-h-sync-pulse = <0>;
		qcom,mdss-dsi-traffic-mode = "non_burst_sync_event";
		qcom,mdss-dsi-lane-map = "lane_map_0123";
		qcom,mdss-dsi-bllp-eof-power-mode;
		qcom,mdss-dsi-bllp-power-mode;
		qcom,mdss-dsi-tx-eot-append;
		qcom,mdss-dsi-lane-0-state;
		qcom,mdss-dsi-lane-1-state;
		qcom,mdss-dsi-lane-2-state;
		qcom,mdss-dsi-lane-3-state;
		qcom,mdss-dsi-dma-trigger = "trigger_sw";
		qcom,mdss-dsi-mdp-trigger = "none";
		qcom,mdss-dsi-lp11-init;
		qcom,mdss-dsi-bl-pmic-control-type = "bl_ctrl_wled";
		qcom,mdss-dsi-bl-min-level = <1>;
		qcom,mdss-dsi-bl-max-level = <4095>;
		qcom,mdss-dsi-reset-sequence = <1 10>, <0 10>, <1 10>;

		qcom,mdss-dsi-display-timings {
			timing@0 {
				qcom,mdss-dsi-panel-width = <1080>;
				qcom,mdss-dsi-panel-height = <2160>;
				qcom,mdss-dsi-h-front-porch = <70>;
				qcom,mdss-dsi-h-back-porch = <40>;
				qcom,mdss-dsi-h-pulse-width = <16>;
				qcom,mdss-dsi-h-sync-skew = <0>;
				qcom,mdss-dsi-v-back-porch = <10>;
				qcom,mdss-dsi-v-front-porch = <5>;
				qcom,mdss-dsi-v-pulse-width = <2>;
				qcom,mdss-dsi-panel-framerate = <60>;
				qcom,mdss-dsi-on-command = [
					29 01 00 00 00 00 02 B0 00
					29 01 00 00 00 00 04 B3 31 00 06
					29 01 00 00 00 00 02 B4 00
					29 01 00 00 00 00 06 B6 33 DB 80 12 00
					29 01 00 00 00 00 08 B8 57 3D 19 1E 0A
					   50 50
					29 01 00 00 00 00 08 B9 6F 3D 28 3C 14
					   C8 C8
					29 01 00 00 00 00 08 BA B5 33 41 64 23
					   A0 A0
					29 01 00 00 00 00 03 BB 14 14
					29 01 00 00 00 00 03 BC 37 32
					29 01 00 00 00 00 03 BD 64 32
					29 01 00 00 00 00 02 BE 04
					29 01 00 00 00 00 02 C0 00
					29 01 00 00 00 00 2E C1 04 48 00 00 26
					   15 19 0B 63 D2 D9 9A 73 EF BD E7 5C
					   6B 93 4D 22 18 8B 2A 41 00 00 00 00
					   00 00 00 00 00 40 02 22 1B 06 03 00
					   07 FF 00 01
					29 01 00 00 00 00 18 C2 01 F8 70 08 68
					   08 0C 10 00 08 30 00 00 00 00 00 00
					   20 02 43 00 00 00
					29 01 00 00 00 00 3F C3 87 D8 7D 87 D0
					   00 00 00 00 00 00 04 3A 00 00 00 04
					   44 00 00 01 01 03 28 00 01 00 01 00
					   00 19 00 0C 00 00 00 00 00 00 00 00
					   00 00 00 00 00 00 00 32 00 19 00 5A
					   02 32 00 19 00 5A 02 40 00
					29 01 00 00 00 00 15 C4 70 00 00 00 11
					   11 00 00 00 02 02 31 01 00 00 00 02
					   01 01 01
					29 01 00 00 00 00 08 C5 08 00 00 00 00
					   70 00
					29 01 00 00 00 00 40 C6 5B 2D 2D 07 54
					   07 54 01 02 01 02 07 07 00 00 07 07
					   0F 11 07 5B 00 5B 5B C2 C2 00 00 00
					   00 00 00 00 00 00 00 00 00 00 00 00
					   00 00 00 00 00 00 00 00 00 00 00 00
					   00 00 00 00 00 00 00 00 00 00
					29 01 00 00 00 00 27 C7 01 1D 2E 41 4F
					   5A 71 80 8B 95 45 4F 5C 71 7B 88 98
					   A6 BE 01 1D 2E 41 4F 5A 71 80 8B 95
					   45 4F 5C 71 7B 88 98 A6 BE
					29 01 00 00 00 00 38 C8 00 00 00 00 00
					   FC 00 00 00 00 00 FC 00 00 00 00 00
					   FC 00 00 00 00 00 FC 00 00 00 00 00
					   FC 00 00 00 00 00 FC 00 00 00 00 00
					   FC 00 00 00 00 00 FC 00 00 00 00 00
					   FC 00
					29 01 00 00 00 00 14 C9 00 00 00 00 00
					   FC 00 00 00 00 00 FC 00 00 00 00 00
					   FC 00
					29 01 00 00 00 00 2C CA 1C FC FC FC 00
					   00 00 00 00 00 00 00 00 00 00 00 00
					   00 00 00 00 00 00 00 00 00 00 00 00
					   00 00 00 00 00 00 00 00 00 00 00 00
					   00 00
					29 01 00 00 00 00 1C CB FF FF FF FF 0F
					   00 08 00 01 00 31 F0 40 08 00 00 00
					   00 00 00 00 00 00 00 00 00 00
					29 01 00 00 00 00 02 CC 02
					29 01 00 00 00 00 27 CD 10 80 37 C0 1A
					   00 5C 02 19 90 11 88 D8 6C D8 6C 01
					   00 00 00 32 00 32 00 5D 02 32 32 01
					   33 00 33 00 5E 02 32 32 AF
					29 01 00 00 00 00 1A CE 5D 40 49 53 59
					   5E 63 68 6E 74 7E 8A 98 A8 BB D0 FF
					   04 00 04 04 42 00 69 5A
					29 01 00 00 00 00 03 CF 4A 1D
					29 01 00 00 00 00 12 D0 33 57 D4 31 01
					   10 10 10 19 19 00 00 00 00 00 00 00
					29 01 00 00 00 00 02 D1 00
					29 01 00 00 00 00 20 D2 10 00 00 10 75
					   0F 03 25 20 00 00 00 00 00 00 00 00
					   04 00 00 00 00 00 00 00 00 00 00 00
					   00 00
					29 01 00 00 00 00 17 D3 1B 3B BB 77 77
					   77 BB B3 33 00 00 6D 6E DB DB 33 BB
					   F2 FD C6 0B 07
					29 01 00 00 00 00 08 D4 00 00 00 00 00
					   00 00
					29 01 00 00 00 00 08 D5 03 00 00 02 40
					   02 40
					29 01 00 00 00 00 02 D6 01
					29 01 00 00 00 00 22 D7 F6 FF 03 05 41
					   24 80 1F C7 1F 1B 00 0C 07 20 00 00
					   00 00 00 0C 00 1F 00 FC 00 00 AA 67
					   7E 5D 06 00
					29 01 00 00 00 00 03 D9 20 14
					29 01 00 00 00 00 05 DD 30 06 23 65
					29 01 00 00 00 00 05 DE 00 3F FF 90
					29 01 00 00 00 00 06 E7 00 00 00 46 61
					29 01 00 00 00 00 02 EA 1F
					29 01 00 00 00 00 04 EE 41 51 00
					29 01 00 00 00 00 03 F1 00 00
					39 01 00 00 00 00 05 2A 00 00 04 37
					39 01 00 00 00 00 05 2B 00 00 08 6F
					39 01 00 00 00 00 01 2C
					39 01 00 00 00 00 02 51 FF
					39 01 00 00 00 00 02 53 0C
					39 01 00 00 00 00 02 55 00
					05 01 00 00 96 00 01 11
					05 01 00 00 32 00 01 29];
				qcom,mdss-dsi-off-command = [
					05 01 00 00 32 00 02 28 00
					05 01 00 00 96 00 02 10 00];
				qcom,mdss-dsi-on-command-state = "dsi_lp_mode";
				qcom,mdss-dsi-off-command-state = "dsi_hs_mode";
			};
		};
	};
};
