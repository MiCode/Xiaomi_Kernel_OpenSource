/dts-v1/;
/plugin/;

#include "sa8155-adp-star.dtsi"
#include "display/sa8155-adp-star-display-shd.dtsi"

/ {
	model = "ADP-STAR";
	compatible = "qcom,sa8155p-adp-star", "qcom,sa8155p",
		"qcom,adp-star";
	qcom,board-id = <25 0>;
};
