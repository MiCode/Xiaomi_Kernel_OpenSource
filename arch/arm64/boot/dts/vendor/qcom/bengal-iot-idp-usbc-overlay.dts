/dts-v1/;
/plugin/;

#include <dt-bindings/interrupt-controller/arm-gic.h>
#include "bengal-iot-idp.dtsi"
#include "bengal-iot-idp-usbc.dtsi"

/ {
	model = "Qualcomm Technologies, Inc. BENGAL-IOT IDP USBC Audio";
	compatible = "qcom,bengal-iot-idp", "qcom,bengal-iot", "qcom,idp";
	qcom,msm-id = <469 0x10000>;
	qcom,board-id = <34 1>;
};
