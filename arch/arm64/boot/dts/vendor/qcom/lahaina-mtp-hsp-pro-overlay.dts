/dts-v1/;
/plugin/;

#include "lahaina-mtp-hsp-pro.dtsi"

/ {
	model = "Qualcomm Technologies, Inc. Lahaina MTP-HSP-PRO";
	compatible = "qcom,lahaina-mtp", "qcom,lahaina", "qcom,mtp";
	qcom,board-id = <0x2010008 0>;
};
