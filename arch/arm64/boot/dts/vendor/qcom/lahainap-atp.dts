/dts-v1/;

#include "lahainap.dtsi"
#include "lahainap-atp.dtsi"

/ {
	model = "Qualcomm Technologies, Inc. LahainaP MTP";
	compatible = "qcom,lahainap-atp", "qcom,lahainap", "qcom,atp";
	qcom,board-id = <0x10021 0>;
};
