/dts-v1/;

#include "sa8155p-v2.dtsi"
#include "sa8155-adp-star.dtsi"

/ {
	model = "Qualcomm Technologies, Inc. SA8155P V2 ADP STAR";
	compatible = "qcom,sa8155p-adp-star", "qcom,sa8155p", "qcom,adp-star";
	qcom,board-id = <25 0>;
};
