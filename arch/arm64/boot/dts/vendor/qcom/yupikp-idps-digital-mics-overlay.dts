/dts-v1/;
/plugin/;

#include "yupikp-idps-digital-mics.dtsi"

/ {
	model = "Qualcomm Technologies, Inc. YupikP IDPS + DIGITAL MICS";
	compatible = "qcom,yupikp-idp", "qcom,yupikp", "qcom,idp";
	qcom,msm-id = <499 0x10000>;
	qcom,board-id = <34 1>;
};
