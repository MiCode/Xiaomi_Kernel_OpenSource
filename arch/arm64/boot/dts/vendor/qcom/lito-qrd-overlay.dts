/dts-v1/;
/plugin/;

#include "lito-qrd.dtsi"

/ {
	model = "Qualcomm Technologies, Inc. Lito QRD";
	compatible = "qcom,lito-qrd", "qcom,lito", "qcom,qrd";
	qcom,msm-id = <400 0x10000>, <440 0x10000>;
	qcom,board-id = <11 0>;
};

&ufsphy_mem {
	vdda-phy-always-on;
};
