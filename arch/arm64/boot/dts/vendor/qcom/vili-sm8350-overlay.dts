/dts-v1/;
/plugin/;

#include "vili-sm8350.dtsi"

/ {
	model = "Vili based on Qualcomm Technologies, Inc SM8350";
	compatible = "qcom,lahaina-mtp", "qcom,lahaina", "qcom,mtp";
	qcom,board-id = <0x10008 0>;
	xiaomi,board-id = <0x8 0>;
};
