/dts-v1/;

#include "sdxlemur-v2.dtsi"
#include "sdxlemur-mtp-cpe.dtsi"
#include "sdxlemur-1024mb-cpe.dtsi"

/ {
	model = "Qualcomm Technologies, Inc. SDXLEMUR MTP CPE V2";
	compatible = "qcom,sdxlemur-mtp",
		"qcom,sdxlemur", "qcom,mtp";
	qcom,board-id = <0x6020008 0x306>;
};
