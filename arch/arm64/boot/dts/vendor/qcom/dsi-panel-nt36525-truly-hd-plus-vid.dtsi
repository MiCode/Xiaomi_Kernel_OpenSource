&mdss_mdp {
	dsi_nt36525_truly_video: qcom,mdss_dsi_nt36525_truly_video {
		qcom,mdss-dsi-panel-name =
			"nt36525 video mode dsi truly panel";
		qcom,mdss-dsi-panel-type = "dsi_video_mode";

		qcom,dsi-ctrl-num = <0>;
		qcom,dsi-phy-num = <0>;

		qcom,mdss-dsi-virtual-channel-id = <0>;
		qcom,mdss-dsi-stream = <0>;
		qcom,mdss-dsi-h-left-border = <0>;
		qcom,mdss-dsi-h-right-border = <0>;
		qcom,mdss-dsi-v-top-border = <0>;
		qcom,mdss-dsi-v-bottom-border = <0>;
		qcom,mdss-dsi-bpp = <24>;
		qcom,mdss-dsi-color-order = "rgb_swap_rgb";
		qcom,mdss-dsi-underflow-color = <0xff>;
		qcom,mdss-dsi-border-color = <0>;
		qcom,mdss-dsi-h-sync-pulse = <0>;
		qcom,mdss-dsi-traffic-mode = "non_burst_sync_event";
		qcom,mdss-dsi-lane-map = "lane_map_0123";
		qcom,mdss-dsi-bllp-eof-power-mode;
		qcom,mdss-dsi-bllp-power-mode;
		qcom,mdss-dsi-tx-eot-append;
		qcom,mdss-dsi-lane-0-state;
		qcom,mdss-dsi-lane-1-state;
		qcom,mdss-dsi-lane-2-state;
		qcom,mdss-dsi-lane-3-state;
		qcom,mdss-dsi-dma-trigger = "trigger_sw";
		qcom,mdss-dsi-mdp-trigger = "none";
		qcom,mdss-dsi-lp11-init;
		qcom,mdss-dsi-bl-pmic-control-type = "bl_ctrl_wled";
		qcom,mdss-dsi-bl-min-level = <1>;
		qcom,mdss-dsi-bl-max-level = <4095>;
		qcom,mdss-dsi-reset-sequence = <1 10>, <0 10>, <1 10>;
		qcom,mdss-pan-physical-width-dimension = <65>;
		qcom,mdss-pan-physical-height-dimension = <129>;

		qcom,mdss-dsi-display-timings {
			timing@0 {
				qcom,mdss-dsi-panel-width = <720>;
				qcom,mdss-dsi-panel-height = <1520>;
				qcom,mdss-dsi-h-front-porch = <80>;
				qcom,mdss-dsi-h-back-porch = <88>;
				qcom,mdss-dsi-h-pulse-width = <20>;
				qcom,mdss-dsi-h-sync-skew = <0>;
				qcom,mdss-dsi-v-back-porch = <4>;
				qcom,mdss-dsi-v-front-porch = <8>;
				qcom,mdss-dsi-v-pulse-width = <4>;
				qcom,mdss-dsi-panel-framerate = <60>;
				qcom,mdss-dsi-on-command = [
				15 01 00 00 00 00 02 FF 20
				15 01 00 00 00 00 02 FB 01
				15 01 00 00 00 00 02 05 A9
				15 01 00 00 00 00 02 07 73
				15 01 00 00 00 00 02 08 C1
				15 01 00 00 00 00 02 0E 87
				15 01 00 00 00 00 02 0F 55
				15 01 00 00 00 00 02 1F 00
				15 01 00 00 00 00 02 69 A9
				15 01 00 00 00 00 02 6D 33
				15 01 00 00 00 00 02 89 64
				15 01 00 00 00 00 02 8A 64
				15 01 00 00 00 00 02 8B 64
				15 01 00 00 00 00 02 8C 64
				15 01 00 00 00 00 02 95 EB
				15 01 00 00 00 00 02 96 EB
				15 01 00 00 00 00 02 FF 23
				15 01 00 00 00 00 02 FB 01
				15 01 00 00 00 00 02 12 AB
				15 01 00 00 00 00 02 15 F5
				15 01 00 00 00 00 02 16 0B
				15 01 00 00 00 00 02 FF 24
				15 01 00 00 00 00 02 FB 01
				15 01 00 00 00 00 02 02 05
				15 01 00 00 00 00 02 03 05
				15 01 00 00 00 00 02 04 9F
				15 01 00 00 00 00 02 05 9F
				15 01 00 00 00 00 02 06 9E
				15 01 00 00 00 00 02 07 9E
				15 01 00 00 00 00 02 08 0C
				15 01 00 00 00 00 02 09 03
				15 01 00 00 00 00 02 0A 0D
				15 01 00 00 00 00 02 0B 0E
				15 01 00 00 00 00 02 0C 0F
				15 01 00 00 00 00 02 0D 10
				15 01 00 00 00 00 02 0E 11
				15 01 00 00 00 00 02 0F 12
				15 01 00 00 00 00 02 10 13
				15 01 00 00 00 00 02 11 04
				15 01 00 00 00 00 02 12 04
				15 01 00 00 00 00 02 18 05
				15 01 00 00 00 00 02 19 05
				15 01 00 00 00 00 02 1A 9F
				15 01 00 00 00 00 02 1B 9F
				15 01 00 00 00 00 02 1C 9E
				15 01 00 00 00 00 02 1D 9E
				15 01 00 00 00 00 02 1E 0C
				15 01 00 00 00 00 02 1F 03
				15 01 00 00 00 00 02 20 0D
				15 01 00 00 00 00 02 21 0E
				15 01 00 00 00 00 02 22 0F
				15 01 00 00 00 00 02 23 10
				15 01 00 00 00 00 02 24 11
				15 01 00 00 00 00 02 25 12
				15 01 00 00 00 00 02 26 13
				15 01 00 00 00 00 02 27 04
				15 01 00 00 00 00 02 28 04
				15 01 00 00 00 00 02 2F 0C
				15 01 00 00 00 00 02 30 40
				15 01 00 00 00 00 02 33 40
				15 01 00 00 00 00 02 34 0C
				15 01 00 00 00 00 02 37 77
				15 01 00 00 00 00 02 3A 9A
				15 01 00 00 00 00 02 3B 95
				15 01 00 00 00 00 02 3D 92
				15 01 00 00 00 00 02 4D 15
				15 01 00 00 00 00 02 4E 26
				15 01 00 00 00 00 02 4F 37
				15 01 00 00 00 00 02 50 48
				15 01 00 00 00 00 02 51 84
				15 01 00 00 00 00 02 52 73
				15 01 00 00 00 00 02 53 62
				15 01 00 00 00 00 02 54 51
				15 01 00 00 00 00 02 55 86
				15 01 00 00 00 00 02 56 78
				15 01 00 00 00 00 02 5A 9A
				15 01 00 00 00 00 02 5B 95
				15 01 00 00 00 00 02 5C 8F
				15 01 00 00 00 00 02 5D 0A
				15 01 00 00 00 00 02 5E 10
				15 01 00 00 00 00 02 60 80
				15 01 00 00 00 00 02 61 7C
				15 01 00 00 00 00 02 64 11
				15 01 00 00 00 00 02 85 11
				15 01 00 00 00 00 02 92 AD
				15 01 00 00 00 00 02 93 08
				15 01 00 00 00 00 02 94 06
				15 01 00 00 00 00 02 AB 00
				15 01 00 00 00 00 02 AD 00
				15 01 00 00 00 00 02 B0 05
				15 01 00 00 00 00 02 B1 A9
				15 01 00 00 00 00 02 FF 25
				15 01 00 00 00 00 02 FB 01
				15 01 00 00 00 00 02 0A 82
				15 01 00 00 00 00 02 0B 9C
				15 01 00 00 00 00 02 0C 01
				15 01 00 00 00 00 02 17 82
				15 01 00 00 00 00 02 18 06
				15 01 00 00 00 00 02 19 0F
				15 01 00 00 00 00 02 1F 9A
				15 01 00 00 00 00 02 20 95
				15 01 00 00 00 00 02 23 05
				15 01 00 00 00 00 02 24 A9
				15 01 00 00 00 00 02 26 9A
				15 01 00 00 00 00 02 27 95
				15 01 00 00 00 00 02 2A 05
				15 01 00 00 00 00 02 2B A9
				15 01 00 00 00 00 02 2F 80
				15 01 00 00 00 00 02 40 10
				15 01 00 00 00 00 02 41 80
				15 01 00 00 00 00 02 42 A6
				15 01 00 00 00 00 02 43 95
				15 01 00 00 00 00 02 46 05
				15 01 00 00 00 00 02 47 A9
				15 01 00 00 00 00 02 4C 95
				15 01 00 00 00 00 02 4E 95
				15 01 00 00 00 00 02 4F A6
				15 01 00 00 00 00 02 50 95
				15 01 00 00 00 00 02 53 05
				15 01 00 00 00 00 02 54 A9
				15 01 00 00 00 00 02 55 05
				15 01 00 00 00 00 02 56 A9
				15 01 00 00 00 00 02 5A 80
				15 01 00 00 00 00 02 5B 80
				15 01 00 00 00 00 02 5D 9A
				15 01 00 00 00 00 02 5E 95
				15 01 00 00 00 00 02 5F 9A
				15 01 00 00 00 00 02 60 95
				15 01 00 00 00 00 02 61 9A
				15 01 00 00 00 00 02 62 95
				15 01 00 00 00 00 02 65 05
				15 01 00 00 00 00 02 66 A9
				15 01 00 00 00 00 02 FF 26
				15 01 00 00 00 00 02 FB 01
				15 01 00 00 00 00 02 04 42
				15 01 00 00 00 00 02 06 FF
				15 01 00 00 00 00 02 0C 0B
				15 01 00 00 00 00 02 0D 01
				15 01 00 00 00 00 02 0E 02
				15 01 00 00 00 00 02 0F 06
				15 01 00 00 00 00 02 10 07
				15 01 00 00 00 00 02 13 24
				15 01 00 00 00 00 02 14 88
				15 01 00 00 00 00 02 16 81
				15 01 00 00 00 00 02 19 15
				15 01 00 00 00 00 02 1A 0D
				15 01 00 00 00 00 02 1B 12
				15 01 00 00 00 00 02 1C 82
				15 01 00 00 00 00 02 1E AD
				15 01 00 00 00 00 02 1F AD
				15 01 00 00 00 00 02 24 00
				15 01 00 00 00 00 02 2F 04
				15 01 00 00 00 00 02 30 AD
				15 01 00 00 00 00 02 31 11
				15 01 00 00 00 00 02 32 11
				15 01 00 00 00 00 02 34 04
				15 01 00 00 00 00 02 35 AD
				15 01 00 00 00 00 02 36 81
				15 01 00 00 00 00 02 37 67
				15 01 00 00 00 00 02 38 11
				15 01 00 00 00 00 02 3F 10
				15 01 00 00 00 00 02 40 AD
				15 01 00 00 00 00 02 58 D6
				15 01 00 00 00 00 02 59 D6
				15 01 00 00 00 00 02 5A D6
				15 01 00 00 00 00 02 5B AD
				15 01 00 00 00 00 02 5C 00
				15 01 00 00 00 00 02 5D 26
				15 01 00 00 00 00 02 5E 10
				15 01 00 00 00 00 02 63 9A
				15 01 00 00 00 00 02 64 95
				15 01 00 00 00 00 02 65 9A
				15 01 00 00 00 00 02 66 95
				15 01 00 00 00 00 02 67 9A
				15 01 00 00 00 00 02 68 95
				15 01 00 00 00 00 02 6B 00
				15 01 00 00 00 00 02 6D 00
				15 01 00 00 00 00 02 70 05
				15 01 00 00 00 00 02 71 D2
				15 01 00 00 00 00 02 73 9A
				15 01 00 00 00 00 02 74 95
				15 01 00 00 00 00 02 77 05
				15 01 00 00 00 00 02 78 D2
				15 01 00 00 00 00 02 7A 9A
				15 01 00 00 00 00 02 7B 95
				15 01 00 00 00 00 02 7E 05
				15 01 00 00 00 00 02 7F D2
				15 01 00 00 00 00 02 82 9A
				15 01 00 00 00 00 02 83 95
				15 01 00 00 00 00 02 84 9A
				15 01 00 00 00 00 02 85 95
				15 01 00 00 00 00 02 86 9A
				15 01 00 00 00 00 02 87 95
				15 01 00 00 00 00 02 8A 05
				15 01 00 00 00 00 02 8B A9
				15 01 00 00 00 00 02 8F 00
				15 01 00 00 00 00 02 90 00
				15 01 00 00 00 00 02 92 05
				15 01 00 00 00 00 02 93 F0
				15 01 00 00 00 00 02 99 0D
				15 01 00 00 00 00 02 9A 36
				15 01 00 00 00 00 02 9B 0C
				15 01 00 00 00 00 02 9C 9E
				15 01 00 00 00 00 02 FF 27
				15 01 00 00 00 00 02 FB 01
				15 01 00 00 00 00 02 13 00
				15 01 00 00 00 00 02 14 55
				15 01 00 00 00 00 02 FF 27
				15 01 00 00 00 00 02 FB 01
				15 01 00 00 00 00 02 9E 00
				15 01 00 00 00 00 02 FF 20
				15 01 00 00 00 00 02 FB 01
				29 01 00 00 00 00 11 B0 00 00 00 2E 00 65 00 8C 00 AA 00 C4 00 DA 00 ED
				29 01 00 00 00 00 11 B1 00 FE 01 36 01 5C 01 99 01 C3 02 03 02 33 02 34
				29 01 00 00 00 00 11 B2 02 64 02 98 02 C0 02 F1 03 10 03 47 03 53 03 64
				29 01 00 00 00 00 0D B3 03 76 03 8C 03 A6 03 C3 03 D9 03 FF
				29 01 00 00 00 00 11 B4 00 00 00 2E 00 65 00 8C 00 AA 00 C4 00 DA 00 ED
				29 01 00 00 00 00 11 B5 00 FE 01 36 01 5C 01 99 01 C3 02 03 02 33 02 34
				29 01 00 00 00 00 11 B6 02 64 02 98 02 C0 02 F1 03 10 03 47 03 53 03 64
				29 01 00 00 00 00 0D B7 03 76 03 8C 03 A6 03 C3 03 D9 03 FF
				29 01 00 00 00 00 11 B8 00 00 00 2E 00 65 00 8C 00 AA 00 C4 00 DA 00 ED
				29 01 00 00 00 00 11 B9 00 FE 01 36 01 5C 01 99 01 C3 02 03 02 33 02 34
				29 01 00 00 00 00 11 BA 02 64 02 98 02 C0 02 F1 03 10 03 47 03 53 03 64
				29 01 00 00 00 00 0D BB 03 76 03 8C 03 A6 03 C3 03 D9 03 FF
				15 01 00 00 00 00 02 FF 21
				15 01 00 00 00 00 02 FB 01
				29 01 00 00 00 00 11 B0 00 00 00 2E 00 65 00 8C 00 AA 00 C4 00 DA 00 ED
				29 01 00 00 00 00 11 B1 00 FE 01 36 01 5C 01 99 01 C3 02 03 02 33 02 34
				29 01 00 00 00 00 11 B2 02 64 02 98 02 C0 02 F1 03 10 03 47 03 53 03 64
				29 01 00 00 00 00 0D B3 03 76 03 8C 03 A6 03 C3 03 D9 03 FF
				29 01 00 00 00 00 11 B4 00 00 00 2E 00 65 00 8C 00 AA 00 C4 00 DA 00 ED
				29 01 00 00 00 00 11 B5 00 FE 01 36 01 5C 01 99 01 C3 02 03 02 33 02 34
				29 01 00 00 00 00 11 B6 02 64 02 98 02 C0 02 F1 03 10 03 47 03 53 03 64
				29 01 00 00 00 00 0D B7 03 76 03 8C 03 A6 03 C3 03 D9 03 FF
				29 01 00 00 00 00 11 B8 00 00 00 2E 00 65 00 8C 00 AA 00 C4 00 DA 00 ED
				29 01 00 00 00 00 11 B9 00 FE 01 36 01 5C 01 99 01 C3 02 03 02 33 02 34
				29 01 00 00 00 00 11 BA 02 64 02 98 02 C0 02 F1 03 10 03 47 03 53 03 64
				29 01 00 00 00 00 0D BB 03 76 03 8C 03 A6 03 C3 03 D9 03 FF
				15 01 00 00 00 00 02 FF 10
				15 01 00 00 00 00 02 FB 01
				15 01 00 00 00 00 02 BA 03
				05 01 00 00 96 00 02 11 00
				05 01 00 00 00 00 02 29 00];
				qcom,mdss-dsi-off-command = [
					05 01 00 00 32 00 02 28 00
					05 01 00 00 78 00 02 10 00];
				qcom,mdss-dsi-on-command-state = "dsi_lp_mode";
				qcom,mdss-dsi-off-command-state = "dsi_hs_mode";
			};
		};
	};
};
