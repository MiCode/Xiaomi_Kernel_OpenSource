
/dts-v1/;
/plugin/;

#include <dt-bindings/interrupt-controller/arm-gic.h>
#include "lagoon-cdp.dtsi"

/ {
	model = "Qualcomm Technologies, Inc. Lagoon CDP";
	compatible = "qcom,lagoon-cdp", "qcom,lagoon", "qcom,cdp";
	qcom,msm-id = <434 0x10000>;
	qcom,board-id = <1 0>;
};
