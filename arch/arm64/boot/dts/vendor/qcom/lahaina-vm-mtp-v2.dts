/dts-v1/;

#include "lahaina-vm-v2.dtsi"
#include "lahaina-vm-mtp-v2.dtsi"

/ {
	model = "Qualcomm Technologies, Inc. Lahaina SVM MTP v2";
	compatible = "qcom,lahaina-mtp", "qcom,lahaina", "qcom,mtp";
	qcom,board-id = <0x20008 0>;
};
