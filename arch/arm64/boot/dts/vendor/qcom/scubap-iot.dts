/dts-v1/;

#include "scuba-iot.dtsi"

/ {
	model = "Qualcomm Technologies, Inc. Scubap IOT SoC";
	compatible = "qcom,scubap-iot";
	qcom,msm-id = <474 0x10000>;
	qcom,board-id = <0 0>;
};

&soc {
	qcom,rmnet-ipa {
	status = "disabled";
	};
};

&ipa_hw {
	status = "disabled";
};
