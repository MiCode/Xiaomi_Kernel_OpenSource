/dts-v1/;
/plugin/;

#include <dt-bindings/interrupt-controller/arm-gic.h>
#include "lagoon-rumi.dtsi"

/ {
	model = "Qualcomm Technologies, Inc. Lagoon RUMI";
	compatible = "qcom,lagoon-rumi", "qcom,lagoon", "qcom,rumi";
	qcom,msm-id = <434 0x10000>;
	qcom,board-id = <15 0>;
};
