/dts-v1/;

#include "kona-v2.1.dtsi"
#include "kona-mtp.dtsi"

/ {
	model = "Qualcomm Technologies, Inc. kona v2.1 MTP";
	compatible = "qcom,kona-mtp", "qcom,kona", "qcom,mtp";
	qcom,board-id = <0x10008 0>;
};
