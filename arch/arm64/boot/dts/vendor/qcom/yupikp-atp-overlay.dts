/dts-v1/;
/plugin/;

#include "yupikp-atp.dtsi"

/ {
	model = "Qualcomm Technologies, Inc. YupikP ATP";
	compatible = "qcom,yupikp-atp", "qcom,yupikp", "qcom,atp";
	qcom,msm-id = <499 0x10000>;
	qcom,board-id = <0x10021 0>;
};
