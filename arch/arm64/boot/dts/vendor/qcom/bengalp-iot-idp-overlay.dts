/dts-v1/;
/plugin/;

#include <dt-bindings/interrupt-controller/arm-gic.h>
#include "bengalp-iot-idp.dtsi"

/ {
	model = "Qualcomm Technologies, Inc. BENGALP-IOT IDP Overlay";
	compatible = "qcom,bengalp-iot-idp", "qcom,bengalp-iot", "qcom,idp";
	qcom,msm-id = <470 0x10000>;
	qcom,board-id = <34 0>;
};
