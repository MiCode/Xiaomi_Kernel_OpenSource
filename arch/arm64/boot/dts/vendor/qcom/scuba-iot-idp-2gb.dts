/dts-v1/;

#include "scuba-iot-low-ram.dtsi"
#include "scuba-iot-idp.dtsi"

/ {
	model = "Qualcomm Technologies, Inc. Scuba IOT IDP 2GB DDR";
	compatible = "qcom,scuba-idp", "qcom,scuba-iot", "qcom,idp";
	qcom,msm-id = <473 0x10000>;
	qcom,board-id = <34 0x400>;
};
