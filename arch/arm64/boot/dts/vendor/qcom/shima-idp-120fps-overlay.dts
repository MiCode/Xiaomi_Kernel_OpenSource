/dts-v1/;
/plugin/;

#include "shima-idp-120fps.dtsi"

/ {
	model = "Qualcomm Technologies, Inc. Shima IDP + 120fps";
	compatible = "qcom,shima-idp", "qcom,shima", "qcom,idp";
	qcom,msm-id = <450 0x10000>;
	qcom,board-id = <34 2>;
};
