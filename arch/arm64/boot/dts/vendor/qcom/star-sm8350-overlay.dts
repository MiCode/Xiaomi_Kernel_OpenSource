/dts-v1/;
/plugin/;

#include "star-sm8350.dtsi"

/ {
	model = "Star based on Qualcomm Technologies, Inc SM8350";
	compatible = "qcom,lahaina-mtp", "qcom,lahaina", "qcom,mtp";
	qcom,board-id = <0x10008 0>;
	xiaomi,board-id = <0x2 0>;
};
