/dts-v1/;
/plugin/;

#include "sa8195p-v2-adp-air.dtsi"
#include "display/sa8195p-v2-adp-air-display-lxc-shd.dtsi"

/ {
	model = "ADP-AIR";
	compatible = "qcom,sa8195p-v2-adp-air", "qcom,sa8195p",
		"qcom,adp-air";
	qcom,board-id = <0x02010019 0>;
};

&qupv3_se0_spi {
	can-controller@0 {
		status = "disabled";
	};
};
