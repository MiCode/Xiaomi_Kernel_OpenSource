/dts-v1/;
/plugin/;

#include "yupikp-idp.dtsi"

/ {
	model = "Qualcomm Technologies, Inc. YupikP IDP";
	compatible = "qcom,yupikp-idp", "qcom,yupikp", "qcom,idp";
	qcom,msm-id = <499 0x10000>;
	qcom,board-id = <34 0>;
};
