/dts-v1/;
/plugin/;

#include "renoir-sm7350.dtsi"

/ {
	model = "Renoir based on Qualcomm Technologies, Inc SM7350";
	compatible = "qcom,shima-idp", "qcom,shima", "qcom,idp";
	qcom,msm-id = <450 0x10000>;
	qcom,board-id = <34 0>;
	xiaomi,board-id = <6 0>;
};
