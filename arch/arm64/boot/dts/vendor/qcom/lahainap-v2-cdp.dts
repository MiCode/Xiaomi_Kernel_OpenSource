/dts-v1/;

#include "lahainap-v2.dtsi"
#include "lahainap-cdp.dtsi"

/ {
	model = "Qualcomm Technologies, Inc. LahainaP v2 CDP";
	compatible = "qcom,lahainap-cdp", "qcom,lahainap", "qcom,cdp";
	qcom,board-id = <0x10001 0>;
};
