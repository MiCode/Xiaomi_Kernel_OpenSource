/dts-v1/;

#include "scuba.dtsi"
#include "scuba-idp.dtsi"

/ {
	model = "Qualcomm Technologies, Inc. Scubap IDP";
	compatible = "qcom,scuba-idp", "qcom,scuba", "qcom,idp";
	qcom,msm-id = <471 0x10000>;
	qcom,board-id = <34 0>;
};

&soc {
	qcom,rmnet-ipa {
	status = "disabled";
	};
};

&ipa_hw {
	status = "disabled";
};
