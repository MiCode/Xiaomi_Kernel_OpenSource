#include "sdxlemur-pmic-overlay.dtsi"

&soc {

};

&sdhc_1 {
	reg = <0x08804000 0x1000>, <0x08805000 0x1000>;
	reg-names = "hc_mem", "cqhci_mem";

	mmc-ddr-1_8v;
	mmc-hs200-1_8v;

	bus-width = <8>;
	non-removable;
	supports-cqe;

	vdd-supply = <&vreg_sd_vdd>;
	qcom,vdd-voltage-level = <2950000 2950000>;
	qcom,vdd-current-level = <0 570000>;

	vdd-io-supply = <&L6B>;
	qcom,vdd-io-always-on;
	qcom,vdd-io-lpm-sup;
	qcom,vdd-io-voltage-level = <1800000 1800000>;
	qcom,vdd-io-current-level = <0 200000>;

	qcom,devfreq,freq-table = <50000000 192000000>;
	qcom,scaling-lower-bus-speed-mode = "DDR52";

	pinctrl-names = "default", "sleep";
	pinctrl-0 = <&sdc1_on>;
	pinctrl-1 = <&sdc1_off>;

	status = "ok";
};
