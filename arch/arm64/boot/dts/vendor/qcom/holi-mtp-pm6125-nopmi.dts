/dts-v1/;

#include "holi.dtsi"
#include "holi-mtp-pm6125-nopmi.dtsi"

/ {
	model = "Qualcomm Technologies, Inc. Holi MTP PM6125 NOPMI";
	compatible = "qcom,holi-mtp", "qcom,holi", "qcom,mtp";
	qcom,board-id = <8 0>;
	qcom,pmic-id-size = <4>;
	qcom,pmic-id = <0x2D 0x0 0x00 0x0>;
};

