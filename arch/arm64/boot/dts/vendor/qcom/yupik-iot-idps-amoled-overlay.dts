/dts-v1/;
/plugin/;

#include "yupik-iot-idps-amoled.dtsi"

/ {
	model = "Qualcomm Technologies, Inc. YUPIK-IOT IDPS + AMOLED";
	compatible = "qcom,yupik-iot-idp", "qcom,yupik-iot", "qcom,idp";
	qcom,msm-id = <497 0x10000>;
	qcom,board-id = <34 2>;
};
