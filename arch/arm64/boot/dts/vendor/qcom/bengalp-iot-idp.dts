/dts-v1/;

#include "bengalp-iot.dtsi"
#include "bengalp-iot-idp.dtsi"

/ {
	model = "Qualcomm Technologies, Inc. BENGALP-IOT IDP";
	compatible = "qcom,bengalp-iot-idp", "qcom,bengalp-iot", "qcom,idp";
	qcom,board-id = <34 0>;
};
