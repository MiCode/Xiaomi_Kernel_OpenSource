/dts-v1/;
/plugin/;

#include <dt-bindings/interrupt-controller/arm-gic.h>
#include "scuba-idp.dtsi"
#include "scuba-idp-usbc.dtsi"

/ {
	model = "Qualcomm Technologies, Inc. Scuba IDP USBC Audio";
	compatible = "qcom,scuba-idp", "qcom,scuba", "qcom,idp";
	qcom,msm-id = <441 0x10000>;
	qcom,board-id = <34 1>;
};
