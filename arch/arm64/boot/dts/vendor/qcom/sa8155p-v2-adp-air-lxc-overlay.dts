/dts-v1/;
/plugin/;

#include "sa8155-adp-star.dtsi"
#include "display/sa8155-v2-adp-air-display-lxc-shd.dtsi"

/ {
	model = "ADP-AIR";
	compatible = "qcom,sa8155p-v2-adp-air", "qcom,sa8155p",
		"qcom,adp-air";
	qcom,board-id = <0x01000019 0>;
};
