## arch/arm64/configs/mgk_64_kasan_k510_defconfig
```kconfig
CONFIG_UBSAN_SHIFT=y
CONFIG_UBSAN_DIV_ZERO=y
CONFIG_UBSAN_UNREACHABLE=y
# CONFIG_UBSAN_OBJECT_SIZE is not set
CONFIG_UBSAN_BOOL=y
CONFIG_UBSAN_ENUM=y
CONFIG_BUILD_CONFIG_FILE="build.config.mtk.aarch64"
CONFIG_ARCH_MEDIATEK=y
CONFIG_MTK_CLKBUF=m
CONFIG_MTK_CLKBUF_V1=y
CONFIG_MTK_DCM_MT6789=m
CONFIG_MTK_DCM_MT6833=m
CONFIG_MTK_DCM_MT6855=m
CONFIG_MTK_DCM_MT6879=m
CONFIG_MTK_DCM_MT6895=m
CONFIG_MTK_DCM_MT6983=m
CONFIG_MTK_SRCLKEN_RC_V1=y
CONFIG_MTK_DVFSRC_HELPER=m
CONFIG_MTK_DVFSRC_MET_MT6873=m
CONFIG_DMABUF_HEAPS_MTK_MM=m
CONFIG_DMABUF_HEAPS_SYSTEM=m
CONFIG_DMABUF_HEAPS_DEBUG=m
CONFIG_MTK_BATTERY_OC_POWER_THROTTLING=m
CONFIG_MTK_BATTERY_PERCENT_THROTTLING=m
CONFIG_MTK_DYNAMIC_LOADING_POWER_THROTTLING=m
CONFIG_MTK_LOW_BATTERY_POWER_THROTTLING=m
CONFIG_MTK_MD_POWER_THROTTLING=m
CONFIG_MTK_CPU_POWER_THROTTLING=m
CONFIG_MTK_PBM=m
CONFIG_MTK_IOMMU_MISC=m
CONFIG_MTK_IOMMU_MISC_DBG=m
CONFIG_MTK_IOMMU_MISC_TEST=m
CONFIG_MTK_IOMMU_MISC_SECURE=m
CONFIG_MTK_CMDQ_MBOX_EXT=m
CONFIG_MTK_MDP=m
CONFIG_MTK_MDP_MT6893=m
CONFIG_MTK_MDP_MT6983=m
CONFIG_MTK_MML=m
CONFIG_MMPROFILE=m
CONFIG_MTK_LENS=m
CONFIG_MTK_V4L2_LENS=m
CONFIG_HAVE_MTK_ENABLE_GENIEZONE=y
CONFIG_MTK_ENABLE_GENIEZONE=m
CONFIG_MTK_GZ_MAIN=m
CONFIG_MTK_GZ_LOG=m
CONFIG_MTK_GZ_VIRTIO=m
CONFIG_MTK_GZ_VIRTIO_IPC=m
CONFIG_MTK_GZ_IRQ=m
CONFIG_MTK_GZ_TZ_SYSTEM=m
CONFIG_HAVE_MTK_GZ_LOG=y
CONFIG_MTK_AEE_FEATURE=m
CONFIG_MTK_AEE_AED=m
CONFIG_MTK_AEE_HANGDET=m
CONFIG_MTK_AEE_IPANIC=m
CONFIG_MTK_BTM_SUPPORT=m
CONFIG_MTK_BTM_V1=m
CONFIG_MTK_DRAM_LOG_STORE=m
CONFIG_MTK_DRAM_LOG_STORE_ADDR=0x0011DF00
CONFIG_MTK_DRAM_LOG_STORE_SIZE=0x100
CONFIG_MTPROF=m
CONFIG_MTK_IRQ_MONITOR=m
CONFIG_MTK_IRQ_MONITOR_DEFAULT_ENABLED=y
CONFIG_MTK_IRQ_MONITOR_IRQ_TIMER_OVERRIDE=y
CONFIG_MTK_CCCI_DEVICES=y
CONFIG_MTK_MD1_SUPPORT=25
CONFIG_MTK_ECCCI_DRIVER=m
CONFIG_MTK_ECCCI_C2K=y
CONFIG_MTK_ECCCI_C2K_USB=m
CONFIG_MTK_BTIF=m
CONFIG_MTK_CONN_SCP=m
CONFIG_MTK_COMBO=m
CONFIG_MTK_COMBO_CHIP_CONSYS_6893=y
CONFIG_MTK_COMBO_CHIP_CONSYS_6983=y
CONFIG_MTK_COMBO_CHIP_CONSYS_6879=y
CONFIG_MTK_COMBO_CHIP_CONSYS_6895=y
CONFIG_MTK_COMBO_CHIP_CONSYS_6855=y
CONFIG_MTK_COMBO_BT=m
CONFIG_MTK_COMBO_GPS=m
CONFIG_MTK_COMBO_WIFI=m
CONFIG_MTK_DHCPV6C_WIFI=y
# CONFIG_MTK_CONN_LTE_IDC_SUPPORT is not set
CONFIG_MTK_GPS_SUPPORT=y
CONFIG_MTK_GPS_EMI=m
CONFIG_MTK_FMRADIO=m
CONFIG_MTK_FM_CHIP="MT6635_FM"
CONFIG_MTK_CONNSYS_DEDICATED_LOG_PATH=y
CONFIG_MTK_GATE_IC=y
CONFIG_RT4831A_I2C=m
CONFIG_TCPC_CLASS=m
CONFIG_USB_POWER_DELIVERY=m
CONFIG_TCPC_MT6360=m
CONFIG_MTK_TYPEC_WATER_DETECT=m
CONFIG_EXTCON_MTK_USB=m
CONFIG_SCSI_UFS_MEDIATEK=m
CONFIG_SCSI_UFS_MEDIATEK_DBG=m
CONFIG_UFSFEATURE=y
CONFIG_UFSSHPB=y
CONFIG_HPB_DEBUG=y
CONFIG_HPB_DEBUG_SYSFS=y
CONFIG_HPB_ERR_INJECTION=y
CONFIG_UFSTW=y
CONFIG_UFSTW_IGNORE_GUARANTEE_BIT=y
CONFIG_UFSTW_BOOT_ENABLED=y
CONFIG_UFSHID=y
CONFIG_UFSHID_POC=y
CONFIG_UFSHID_DEBUG=y
CONFIG_UFSRINGBUF=y
CONFIG_UFSRINGBUF_POC=y
CONFIG_RPMB=m
CONFIG_KEYBOARD_MTK_KPD=m
CONFIG_KEYBOARD_MTK_PMIC=m
CONFIG_TOUCHSCREEN_MTK_TOUCH="GT9886 GT9896S NT36672C"
CONFIG_SERIAL_8250_MT6577=m
CONFIG_I2C_MT65XX=m
CONFIG_SPI_MT65XX=m
CONFIG_SPMI_MTK_PMIF=m
# CONFIG_PINCTRL_MT2712 is not set
# CONFIG_PINCTRL_MT6797 is not set
# CONFIG_PINCTRL_MT6779 is not set
CONFIG_PINCTRL_MT6373=m
CONFIG_PINCTRL_MT6855=m
CONFIG_PINCTRL_MT6879=m
CONFIG_PINCTRL_MT6885=m
CONFIG_PINCTRL_MT6895=m
CONFIG_PINCTRL_MT6983=m
# CONFIG_PINCTRL_MT7622 is not set
# CONFIG_PINCTRL_MT8167 is not set
# CONFIG_PINCTRL_MT8173 is not set
# CONFIG_PINCTRL_MT8183 is not set
# CONFIG_PINCTRL_MT8192 is not set
# CONFIG_PINCTRL_MT8516 is not set
# CONFIG_PINCTRL_MT6397 is not set
CONFIG_HAVE_MTK_MC=y
CONFIG_MTK_DRAMC=m
CONFIG_MTK_EMI=m
CONFIG_MTK_EMI_MPU_TEST=m
CONFIG_SYSCON_REBOOT_MODE=m
CONFIG_CHARGER_MT6360=m
CONFIG_MTK_CHARGER_TYPE_DETECT=m
CONFIG_MTK_CHARGER=m
CONFIG_MTK_PERF_COMMON=m
CONFIG_MTK_PERF_TRACKER=y
CONFIG_MTK_GPU_SWPM_SUPPORT=y
CONFIG_MTK_PUMP_EXPRESS_PLUS_SUPPORT=m
CONFIG_MTK_PUMP_EXPRESS_PLUS_20_SUPPORT=m
CONFIG_MTK_PUMP_EXPRESS_40_SUPPORT=m
CONFIG_MTK_PUMP_EXPRESS_50_SUPPORT=m
CONFIG_CHARGER_RT9759=m
CONFIG_MTK_TASK_TURBO=m
CONFIG_MTK_THERMAL=y
CONFIG_MTK_TINYSYS_MBOX=m
CONFIG_MTK_TINYSYS_SCMI=m
CONFIG_MTK_SOC_THERMAL_LVTS=m
CONFIG_MTK_PMIC_THERMAL=m
CONFIG_MTK_MD_THERMAL=m
CONFIG_MTK_THERMAL_TRACE=m
CONFIG_MTK_THERMAL_INTERFACE=m
CONFIG_MTK_THERMAL_JATM=m
CONFIG_MTK_CHARGER_THERMAL=m
CONFIG_MTK_BACKLIGHT_THERMAL=m
CONFIG_MTK_BOARD_THERMAL=m
CONFIG_GENERIC_ADC_THERMAL=m
CONFIG_MEDIATEK_WATCHDOG=m
CONFIG_MFD_MT6338=m
CONFIG_MFD_MT6360=m
CONFIG_MFD_MT6397=m
CONFIG_MFD_MT6685=m
CONFIG_MFD_MTK_SPMI_PMIC=m
CONFIG_REGULATOR_MT6315=m
CONFIG_REGULATOR_MT6359P=m
CONFIG_REGULATOR_MT6360=m
CONFIG_REGULATOR_MT6363=m
CONFIG_REGULATOR_MT6368=m
CONFIG_REGULATOR_MT6369=m
CONFIG_REGULATOR_MT6373=m
CONFIG_REGULATOR_MTK_DVFSRC=m
CONFIG_REGULATOR_MTK_VMM=m
CONFIG_REGULATOR_RT5133=m
CONFIG_REGULATOR_RT6160=m
CONFIG_MTK_VMM_SPM=m
CONFIG_MTK_VMM_DBG=m
CONFIG_MTK_PMIC_PROTECT=m
CONFIG_DRM_PANEL_TRULY_TD4330_VDO=m
CONFIG_DRM_PANEL_TRULY_TD4330_CMD=m
CONFIG_DRM_PANEL_TRULY_FT8756_VDO=m
CONFIG_DRM_PANEL_ALPHA_JDI_NT36672C_CPHY_VDO=m
CONFIG_DRM_PANEL_SC_NT36672C_VDO_120HZ=m
CONFIG_DRM_PANEL_TIANMA_R66451_CMD_120HZ=m
CONFIG_DRM_PANEL_TIANMA_R66451_CMD_120HZ_WA=m
CONFIG_DRM_PANEL_TIANMA_NT36672E_VDO_120HZ_HFP=m
CONFIG_DRM_PANEL_ALPHA_JDI_NT36672E_CPHY_VDO=m
CONFIG_DRM_PANEL_ALPHA_JDI_NT36672E_VDO_120HZ=m
CONFIG_DRM_PANEL_ALPHA_JDI_NT36672E_VDO_144HZ=m
CONFIG_DRM_PANEL_ALPHA_JDI_NT36672E_VDO_60HZ=m
CONFIG_DRM_PANEL_SAMSUNG_S68FC01_VDO_AOD=m
CONFIG_DRM_PANEL_ALPHA_JDI_NT36672E_VDO_120HZ_HFP=m
CONFIG_DRM_PANEL_ALPHA_JDI_NT36672E_VDO_144HZ_HFP=m
CONFIG_DRM_PANEL_HX_NT37701_DPHY_CMD=m
CONFIG_DRM_PANEL_HX_NT37701_DPHY_CMD_120HZ=m
CONFIG_DRM_PANEL_ALPHA_SAMSUNG_S6E3HAE_CMD_120HZ=m
CONFIG_DRM_PANEL_TRULY_NT35595_CMD=m
CONFIG_DRM_PANEL_SAMSUNG_ANA6705_CMD=m
CONFIG_DRM_PANEL_K6895V1_64_95T_ALPHA_CMD=m
CONFIG_DRM_MEDIATEK_PANEL=m
CONFIG_DRM_MEDIATEK=m
CONFIG_DRM_MEDIATEK_V2=y
CONFIG_MTK_GPU_SUPPORT=m
CONFIG_MTK_GPU_MT6855_SUPPORT=m
CONFIG_MTK_GPU_MT6879_SUPPORT=m
CONFIG_MTK_GPU_MT6893_SUPPORT=m
CONFIG_MTK_GPU_MT6895_SUPPORT=m
CONFIG_MTK_GPU_MT6983_SUPPORT=m
CONFIG_MTK_GPUFREQ_V2=y
CONFIG_MTK_GPU_COMMON_DVFS_SUPPORT=y
CONFIG_CUSTOM_KERNEL_IMGSENSOR="s5kjd1_mipi_raw imx519_mipi_raw imx586_mipi_raw imx576_mipi_raw imx481_mipi_raw s5k3m5sx_mipi_raw ov48b_mipi_raw imx766_mipi_raw s5k3p9sp_mipi_raw imx766dual_mipi_raw"
CONFIG_MTK_IMGSENSOR=m
CONFIG_MTK_IMGSENSOR_PLATFORM_SUPPORT=y
CONFIG_MTK_IMGSENSOR_MT6853=m
CONFIG_MTK_IMGSENSOR_MT6893=m
CONFIG_MTK_SECURITY_SW_SUPPORT=m
CONFIG_SND_SOC_MT6338_ACCDET=m
CONFIG_SND_SOC_MT6368_ACCDET=m
CONFIG_SND_SOC_MT6369_ACCDET=m
CONFIG_SND_SOC_MT6359P_ACCDET=m
CONFIG_SND_SOC_MT6885=m
CONFIG_SND_SOC_MT6885_MT6359P=m
CONFIG_SND_SOC_MT6983=m
CONFIG_SND_SOC_MT6983_MT6338=m
CONFIG_SND_SOC_MT6879=m
CONFIG_SND_SOC_MT6879_MT6368=m
CONFIG_SND_SOC_MT6895=m
CONFIG_SND_SOC_MT6895_MT6368=m
CONFIG_SND_SOC_MTK_BTCVSD=m
CONFIG_SND_SOC_RT5512=m
CONFIG_SND_SOC_TFA9874=m
CONFIG_USB_MTU3=m
CONFIG_USB_MTK_HDRC=m
CONFIG_MTK_MUSB_QMU_SUPPORT=y
CONFIG_MTK_MUSB_QMU_PURE_ZLP_SUPPORT=y
CONFIG_MTK_MUSB_DRV_36BIT=y
CONFIG_USB_MTK_OTG=y
CONFIG_MTK_MUSB_DUAL_ROLE=y
CONFIG_MTK_USB_BOOST=m
CONFIG_MTK_USB_CONFIGFS_RNDIS=m
CONFIG_MTK_USB_META=m
CONFIG_NOP_USB_XCEIV=m
CONFIG_USB_NET_AX8817X=m
CONFIG_USB_NET_AX88179_178A=m
CONFIG_LEDS_MT_BRIGHTNESS_HW_CHANGED=y
CONFIG_LEDS_MTK=m
CONFIG_LEDS_MTK_DISP=m
CONFIG_LEDS_MTK_PWM=m
CONFIG_LEDS_PWM=m
CONFIG_LEDS_REGULATOR_VIBRATOR=m
CONFIG_LEDS_MT6360=m
CONFIG_MTK_VIDEO_LM3644=m
CONFIG_MTK_FLASHLIGHT=m
CONFIG_MTK_FLASHLIGHT_PT=y
CONFIG_MTK_FLASHLIGHT_PT_STRICT=y
CONFIG_MTK_FLASHLIGHT_DLPT=y
CONFIG_MTK_V4L2_FLASHLIGHT=m
CONFIG_V4L2_FLASH_LED_CLASS=m
CONFIG_RTC_DRV_MT6397=m
CONFIG_RTC_DRV_MT6685=m
CONFIG_MTK_UART_APDMA=m
CONFIG_COMMON_CLK_MT6833=m
CONFIG_COMMON_CLK_MT6833_AUDIOSYS=m
CONFIG_COMMON_CLK_MT6833_CAM=m
CONFIG_COMMON_CLK_MT6833_MMSYS=m
CONFIG_COMMON_CLK_MT6833_IMG=m
CONFIG_COMMON_CLK_MT6833_I2C=m
CONFIG_COMMON_CLK_MT6833_BUS=m
CONFIG_COMMON_CLK_MT6833_MFG=m
CONFIG_COMMON_CLK_MT6833_VCODEC=m
CONFIG_COMMON_CLK_MT6855=m
CONFIG_COMMON_CLK_MT6855_ADSP=m
CONFIG_COMMON_CLK_MT6855_CAMSYS_MAIN=m
CONFIG_COMMON_CLK_MT6855_CAM=m
CONFIG_COMMON_CLK_MT6855_MMSYS=m
CONFIG_COMMON_CLK_MT6855_IMGSYS1=m
CONFIG_COMMON_CLK_MT6855_IMGSYS2=m
CONFIG_COMMON_CLK_MT6855_PERI=m
CONFIG_COMMON_CLK_MT6855_BUS=m
CONFIG_COMMON_CLK_MT6855_IMG=m
CONFIG_COMMON_CLK_MT6855_MDPSYS1_CONFIG=m
CONFIG_COMMON_CLK_MT6855_MDPSYS=m
CONFIG_COMMON_CLK_MT6855_VCODEC=m
CONFIG_COMMON_CLK_MT6879=m
CONFIG_COMMON_CLK_MT6879_ADSP=m
CONFIG_COMMON_CLK_MT6879_CAM=m
CONFIG_COMMON_CLK_MT6879_CCU=m
CONFIG_COMMON_CLK_MT6879_IMG=m
CONFIG_COMMON_CLK_MT6879_MMSYS=m
CONFIG_COMMON_CLK_MT6879_PERI=m
CONFIG_COMMON_CLK_MT6879_BUS=m
CONFIG_COMMON_CLK_MT6879_MDPSYS=m
CONFIG_COMMON_CLK_MT6879_MFG=m
CONFIG_COMMON_CLK_MT6879_VCODEC=m
CONFIG_COMMON_CLK_MT6893=m
CONFIG_COMMON_CLK_MT6893_APU0=m
CONFIG_COMMON_CLK_MT6893_APU1=m
CONFIG_COMMON_CLK_MT6893_APU2=m
CONFIG_COMMON_CLK_MT6893_APU_VCORE=m
CONFIG_COMMON_CLK_MT6893_APU_CONN=m
CONFIG_COMMON_CLK_MT6893_APU_MDLA0=m
CONFIG_COMMON_CLK_MT6893_APU_MDLA1=m
CONFIG_COMMON_CLK_MT6893_AUDIOSYS=m
CONFIG_COMMON_CLK_MT6893_CAMSYS_MAIN=m
CONFIG_COMMON_CLK_MT6893_CAMSYS_RAWA=m
CONFIG_COMMON_CLK_MT6893_CAMSYS_RAWB=m
CONFIG_COMMON_CLK_MT6893_CAMSYS_RAWC=m
CONFIG_COMMON_CLK_MT6893_IMGSYS1=m
CONFIG_COMMON_CLK_MT6893_IMGSYS2=m
CONFIG_COMMON_CLK_MT6893_IMP_IIC_WRAP_C=m
CONFIG_COMMON_CLK_MT6893_IMP_IIC_WRAP_E=m
CONFIG_COMMON_CLK_MT6893_IMP_IIC_WRAP_N=m
CONFIG_COMMON_CLK_MT6893_IMP_IIC_WRAP_S=m
CONFIG_COMMON_CLK_MT6893_IPESYS=m
CONFIG_COMMON_CLK_MT6893_MDPSYS=m
CONFIG_COMMON_CLK_MT6893_MFGCFG=m
CONFIG_COMMON_CLK_MT6893_MMSYS=m
CONFIG_COMMON_CLK_MT6893_SCP_ADSP=m
CONFIG_COMMON_CLK_MT6893_VDECSYS=m
CONFIG_COMMON_CLK_MT6893_VDECSYS_SOC=m
CONFIG_COMMON_CLK_MT6893_VENCSYS_C1=m
CONFIG_COMMON_CLK_MT6893_VENCSYS=m
CONFIG_COMMON_CLK_MT6895=m
CONFIG_COMMON_CLK_MT6895_ADSP=m
CONFIG_COMMON_CLK_MT6895_CAM=m
CONFIG_COMMON_CLK_MT6895_CCU=m
CONFIG_COMMON_CLK_MT6895_IMG=m
CONFIG_COMMON_CLK_MT6895_MMSYS=m
CONFIG_COMMON_CLK_MT6895_PERI=m
CONFIG_COMMON_CLK_MT6895_BUS=m
CONFIG_COMMON_CLK_MT6895_MDPSYS=m
CONFIG_COMMON_CLK_MT6895_MFG=m
CONFIG_COMMON_CLK_MT6895_VCODEC=m
CONFIG_COMMON_CLK_MT6983=m
CONFIG_COMMON_CLK_MT6983_ADSP=m
CONFIG_COMMON_CLK_MT6983_CCU=m
CONFIG_COMMON_CLK_MT6983_IMG=m
CONFIG_COMMON_CLK_MT6983_IMP_IIC_WRAP=m
CONFIG_COMMON_CLK_MT6983_VCODEC=m
CONFIG_COMMON_CLK_MT6983_MDPSYS=m
CONFIG_COMMON_CLK_MT6983_MFG=m
CONFIG_COMMON_CLK_MT6983_MMSYS=m
CONFIG_COMMON_CLK_MT6983_CAM=m
CONFIG_COMMON_CLK_MTK_FREQ_HOPPING=m
CONFIG_COMMON_CLK_MTK_FREQ_HOPPING_MCUPM=y
CONFIG_COMMON_CLK_MTK_FREQ_HOPPING_GPUEB=y
CONFIG_MTK_APUSYS_SUPPORT=m
CONFIG_MTK_APUSYS_DEBUG=y
CONFIG_MTK_APUSYS_RT_SUPPORT=y
CONFIG_MTK_APUSYS_MDLA_SUPPORT=y
CONFIG_MTK_APUSYS_VPU=y
CONFIG_MTK_APUSYS_VPU_DEBUG=y
CONFIG_MTK_VPU_SUPPORT=y
CONFIG_MTK_VOW_SUPPORT=m
CONFIG_MTK_VOW_DSP_VERSION="ver02"
CONFIG_MTK_VOW_DUAL_MIC_SUPPORT=y
CONFIG_MTK_VOW_MAX_PDK_NUMBER=2
CONFIG_MTK_APUSYS_EDMA_SUPPORT=y
CONFIG_MTK_IOMMU=m
CONFIG_MTK_DVFSRC=m
CONFIG_MTK_PMIC_WRAP=m
CONFIG_MTK_SCHEDULER=m
CONFIG_MTK_OPP_CAP_INFO=y
CONFIG_NONLINEAR_FREQ_CTL=y
CONFIG_MTK_EAS=y
CONFIG_MTK_THERMAL_AWARE_SCHEDULING=y
CONFIG_MTK_LEAKAGE_AWARE_TEMP=y
CONFIG_MTK_NEWIDLE_BALANCE=y
CONFIG_MTK_CORE_PAUSE=y
CONFIG_MTK_CORE_CTL=m
CONFIG_MTK_SCHED_BIG_TASK_ROTATE=y
CONFIG_MTK_CPUFREQ_SUGOV_EXT=m
CONFIG_MTK_OPP_MIN=y
CONFIG_MTK_CPUQOS_V3=m
CONFIG_MTK_SCPSYS=m
CONFIG_MTK_IPI=m
CONFIG_MTK_MBOX=m
CONFIG_RPMSG_MTK=m
CONFIG_MTK_TINYSYS_SCP_SUPPORT=m
CONFIG_MTK_TINYSYS_SCP_LOGGER_SUPPORT=y
CONFIG_MTK_TINYSYS_SSPM_SUPPORT=m
CONFIG_MTK_TINYSYS_SSPM_V3=y
CONFIG_MTK_TINYSYS_VCP_SUPPORT=m
CONFIG_SND_SOC_MTK_AUDIO_DSP=m
CONFIG_MTK_AUDIODSP_SUPPORT=m
CONFIG_SND_SOC_MTK_OFFLOAD=m
CONFIG_MTK_ADSP_V1=m
CONFIG_MTK_ADSP_V2=m
CONFIG_MTK_TINYSYS_MCUPM_SUPPORT=m
CONFIG_DEVAPC_MT6855=m
CONFIG_DEVAPC_MT6879=m
CONFIG_DEVAPC_MT6893=m
CONFIG_DEVAPC_MT6895=m
CONFIG_DEVAPC_MT6983=m
CONFIG_HW_RANDOM_SECURE=m
# CONFIG_HW_RANDOM_MTK is not set
# CONFIG_MST_IRQ is not set
CONFIG_MTK_DVFSRC_DEVFREQ=m
CONFIG_MEDIATEK_MT6338_AUXADC=m
CONFIG_MEDIATEK_MT635X_AUXADC=m
CONFIG_MEDIATEK_MT6360_AUXADC=m
CONFIG_MEDIATEK_MT6577_AUXADC=m
CONFIG_MEDIATEK_SPMI_PMIC_ADC=m
CONFIG_PWM_MTK_DISP=m
CONFIG_RESET_TI_SYSCON=m
CONFIG_PHY_MTK_TPHY=m
CONFIG_PHY_MTK_XSPHY=m
CONFIG_PHY_MTK_FPGAPHY=m
CONFIG_MTK_DEVINFO=m
CONFIG_TEE=m
CONFIG_TEE_PERF_SUPPORT=m
CONFIG_TRUSTONIC_TEE_SUPPORT=m
CONFIG_TRUSTONIC_TRUSTED_UI=m
CONFIG_MICROTRUST_TEE_SUPPORT=m
CONFIG_MTK_TEE_GP_SUPPORT=y
CONFIG_MT6685_AUDCLK=m
CONFIG_MT6338_EFUSE=m
CONFIG_MT635X_EFUSE=m
CONFIG_INTERCONNECT_MTK=y
CONFIG_INTERCONNECT_MTK_EMI=m
CONFIG_MTK_MDDP_SUPPORT=m
CONFIG_KASAN=y
# CONFIG_KASAN_HW_TAGS is not set
CONFIG_KASAN_INLINE=y
CONFIG_KASAN_STACK=y
CONFIG_FRAME_WARN=0
CONFIG_DEBUG_SECTION_MISMATCH=y
CONFIG_MTK_PRINTK_UART_CONSOLE=y
CONFIG_MTK_PRINTK=m
CONFIG_MTK_LOW_POWER_MODULE=m
CONFIG_MTK_LPM_MT6983=m
CONFIG_MTK_LPM_MT6895=m
CONFIG_MTK_LPM_MT6893=m
CONFIG_MTK_LPM_MT6879=m
CONFIG_MTK_LPM_MT6855=m
CONFIG_MTK_LPM_GS_DUMP_SUPPORT=y
CONFIG_MTK_PMSR=m
CONFIG_MTK_SWPM_PERF_ARMV8_PMU=m
CONFIG_MTK_SWPM_MODULE=m
CONFIG_MTK_SWPM_MT6983=m
CONFIG_MTK_SWPM_MT6893=m
CONFIG_MTK_SWPM_MT6879=m
CONFIG_MTK_SWPM_MT6895=m
CONFIG_MTK_SLBC=m
CONFIG_MTK_SLBC_MT6893=m
CONFIG_MTK_SLBC_MT6983=m
CONFIG_MTK_SLBC_MT6895=m
CONFIG_MTK_SLBC_IPI=m
CONFIG_MTK_SLBC_MMSRAM=m
CONFIG_INTERCONNECT_MTK_MMQOS_MT6893=m
CONFIG_MTK_MMDVFS=m
CONFIG_MTK_MMINFRA=m
CONFIG_MTK_CAM_TIMESYNC=m
CONFIG_MTK_CAMERA_MEM_SUPPORT=m
CONFIG_MTK_CAMERA_ISP_RAW_SUPPORT=m
CONFIG_MTK_CAMERA_ISP_SUPPORT=m
CONFIG_MTK_CAMERA_MFB_ISP6S=m
CONFIG_MTK_CAMERA_WPE_ISP6S=m
CONFIG_MTK_CAMERA_DPE_ISP6S=m
CONFIG_MTK_CAMERA_ISP_PDA_SUPPORT=m
CONFIG_MTK_CAMERA_RSC_ISP6S=m
CONFIG_MTK_CAMERA_FD_ISP6S=m
CONFIG_MTK_CAMERA_DIP_ISP6S=m
CONFIG_MTK_CAMERA_DUAL_DIP_ISP6S=m
CONFIG_MTK_CAMERA_FD_ISP7=m
CONFIG_MTK_CAMERA_DPE_ISP7=m
CONFIG_MTK_CCU=m
CONFIG_MTK_CCU_RPROC=m
CONFIG_VIDEO_MEDIATEK_VCODEC=m
CONFIG_VIDEO_MEDIATEK_VCODEC_V1=y
CONFIG_VIDEO_MEDIATEK_VCODEC_V2=y
CONFIG_VIDEO_MEDIATEK_VCU=m
CONFIG_VIDEO_MEDIATEK_JPEG=m
CONFIG_VB2_MEDIATEK_DMA_CONTIG=m
CONFIG_MTK_LPM_MT6893=m
CONFIG_MTK_MMSYS=m
CONFIG_MTK_SENSOR_SUPPORT=m
CONFIG_MTK_SENSORHUB=m
CONFIG_MTK_MET=m
CONFIG_ZSMALLOC=m
CONFIG_ZRAM=m
CONFIG_MTK_USB_TYPEC_MUX=m
CONFIG_TYPEC_MUX_FUSB304=m
CONFIG_TYPEC_MUX_PTN36241G=m
CONFIG_TYPEC_MUX_PS5169=m
CONFIG_TYPEC_MUX_PS5170=m
CONFIG_TYPEC_MUX_DP_SELECTOR=m
CONFIG_MMSTAT_TRACER=m
CONFIG_MTK_CM_MGR=m
CONFIG_MTK_CM_IPI=m
CONFIG_MTK_CM_MGR_MT6855=m
CONFIG_MTK_CM_MGR_MT6893=m
CONFIG_MTK_CM_MGR_MT6983=m
CONFIG_MTK_CM_MGR_MT6879=m
CONFIG_MTK_CM_MGR_MT6895=m
CONFIG_MTK_QOS_FRAMEWORK=m
CONFIG_MTK_QOS_MT6893=y
CONFIG_MMC_MTK=m
CONFIG_MMC_MTK_PRO=m
CONFIG_MMC_CQHCI=m
CONFIG_MMC_AUTOK=m
CONFIG_MMC_DEBUG=m
CONFIG_MTK_FPSGO_V3=m
CONFIG_MTK_PERFORMANCE_MODULE=m
CONFIG_MTK_FRS=m
CONFIG_MTK_BLOCK_IO_TRACER=m
CONFIG_MTK_PWM=m
CONFIG_MTK_IRTX_PWM_SUPPORT=m
CONFIG_MTK_PID_MAP=m
CONFIG_MTK_ATF_LOGGER=m
CONFIG_MTK_NEWIDLE_BALANCE=y
CONFIG_MTK_PRINTK_UART_CONSOLE=y
CONFIG_MTK_PRINTK=m
CONFIG_MTK_SOCINFO=m
CONFIG_ARM_DSU_PMU=m
CONFIG_MTK_CAM_CAL=m
CONFIG_MTK_DBGTOP=m
CONFIG_MTK_HANG_DETECT=m
CONFIG_MTK_HANG_DETECT_DB=y
CONFIG_MFD_MT6375=m
CONFIG_CHARGER_MT6375=m
CONFIG_GAUGE_MT6375=m
CONFIG_MEDIATEK_MT6375_ADC=m
CONFIG_MEDIATEK_MT6375_AUXADC=m
CONFIG_TCPC_MT6375=m
CONFIG_MTK_SUBPMIC_MISC=m
CONFIG_MT6375_DBG=m
CONFIG_MT6360_DBG=m
CONFIG_IIO_TRIGGERED_BUFFER=m
CONFIG_MTK_JPEG=m
CONFIG_MTK_MKP=m
CONFIG_MTK_SDA=y
CONFIG_MTK_IRQ_DBG=m
CONFIG_MEDIATEK_CPUFREQ_DEBUG_LITE=m
CONFIG_MTK_CQDMA=m
CONFIG_CFG80211=m
CONFIG_NL80211_TESTMODE=y
CONFIG_MAC80211=m
CONFIG_MTK_V4L2_IMGSENSOR=m
CONFIG_MTK_CCD_REMOTEPROC=m
CONFIG_VIDEO_MTK_ISP_CAMSYS=m
CONFIG_VIDEO_MTK_ISP_HCP=m
CONFIG_VIDEO_MTK_ISP_IMGSYS=m
CONFIG_VIDEO_MTK_ISP_IPESYS=m
CONFIG_V4L2_FWNODE=m
CONFIG_RPMSG_MTK_CCD=m
CONFIG_MTK_SSC_MODULE=m
CONFIG_MTK_SSC_DBG_V1=m
CONFIG_MTK_SSC_DBG_V2=m
CONFIG_MTK_WIDEVINE_DRM=m
CONFIG_MTK_LOAD_TRACKER=m
CONFIG_MTK_ULTRASND_PROXIMITY=m
CONFIG_MTK_VDEC_FMT=m
CONFIG_INTERCONNECT_MTK_MMQOS_MT6983=m
CONFIG_INTERCONNECT_MTK_MMQOS_MT6879=m
CONFIG_INTERCONNECT_MTK_MMQOS_MT6895=m
CONFIG_INTERCONNECT_MTK_MMQOS_MT6855=m
CONFIG_MTK_BUS_PARITY_CHECK=m
CONFIG_MTK_CACHE_PARITY_CHECK=m
CONFIG_PAGE_POISONING=y
CONFIG_EXT_MODULES="../vendor/mediatek/kernel_modules/connectivity/common ../vendor/mediatek/kernel_modules/connectivity/conninfra ../vendor/mediatek/kernel_modules/connectivity/connfem ../vendor/mediatek/kernel_modules/connectivity/gps/gps_stp ../vendor/mediatek/kernel_modules/connectivity/gps/data_link/plat/v010 ../vendor/mediatek/kernel_modules/connectivity/gps/data_link/plat/v030 ../vendor/mediatek/kernel_modules/connectivity/gps/data_link/plat/v050 ../vendor/mediatek/kernel_modules/connectivity/gps/gps_pwr ../vendor/mediatek/kernel_modules/connectivity/gps/gps_scp ../vendor/mediatek/kernel_modules/gpu ../vendor/mediatek/kernel_modules/connectivity/fmradio"
```
