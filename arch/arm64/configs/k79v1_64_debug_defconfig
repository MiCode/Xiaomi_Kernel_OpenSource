## arch/arm64/configs/moon_defconfig
```kconfig
CONFIG_LOCALVERSION_AUTO=n
CONFIG_LOCALVERSION="-android12-9"
CONFIG_BUILD_CONFIG_FILE="build.config.mtk.aarch64"
CONFIG_ABI_MONITOR=y
CONFIG_ARCH_MEDIATEK=y
CONFIG_MTK_AEE_FEATURE=m
CONFIG_MTK_AEE_AED=m
CONFIG_MTK_AEE_HANGDET=m
CONFIG_MTK_AEE_IPANIC=m
CONFIG_MTK_DRAM_LOG_STORE=m
CONFIG_MTK_DRAM_LOG_STORE_ADDR=0x10E700
CONFIG_MTK_DRAM_LOG_STORE_SIZE=0x100
CONFIG_MTK_ATF_LOGGER=m
CONFIG_MTK_HANG_DETECT=m
CONFIG_MTK_HANG_DETECT_DB=y
CONFIG_BATTERY_MT6358=m
CONFIG_MFD_MT6370=m
CONFIG_MT6370_DBG=m
CONFIG_BACKLIGHT_MT6370=m
CONFIG_MTK_SUBPMIC_MISC=m
CONFIG_MTK_SPM=m
CONFIG_MTK_POWER_GS_LEGACY=m
CONFIG_MTK_UNIFIED_POWER_COMMON=m
CONFIG_MTK_PLAT_POWER_MT6768=m
CONFIG_MFD_MT6397=m
CONFIG_MTK_PMIC_WRAP=m
CONFIG_REGULATOR_MT6358=m
CONFIG_MEDIATEK_MT635X_AUXADC=m
CONFIG_MEDIATEK_CPU_DVFS=m
CONFIG_MEMORY=y
CONFIG_HAVE_MTK_MC=y
CONFIG_MTK_EMI_LEGACY=m
CONFIG_MTK_DRAMC=m
CONFIG_MMSTAT_TRACER=m
CONFIG_REGULATOR_MT6370=m
CONFIG_COMMON_CLK_MT6768=m
CONFIG_COMMON_CLK_PG_LEGACY=m
CONFIG_MTK_SCPSYS=m
CONFIG_MTK_IPI=m
CONFIG_MTK_MBOX=m
CONFIG_RPMSG_MTK=m
CONFIG_MTK_TINYSYS_SSPM_SUPPORT=m
CONFIG_MTK_TINYSYS_SSPM_V1=y
CONFIG_MTK_CLKBUF=m
CONFIG_MTK_CLKBUF_V1=y
CONFIG_MEDIATEK_DCM_COMMON=y
CONFIG_MEDIATEK_DCM_MT6768=m
CONFIG_MTK_UNIFIED_POWER=m
CONFIG_MTK_STATIC_POWER_LEGACY=m
CONFIG_MTK_PTPOD_LEGACY=m
CONFIG_MEDIATEK_CPUIDLE=m
CONFIG_MTK_CPUHOTPLUG=m
CONFIG_MEDIATEK_MCDI=m
CONFIG_INTERCONNECT_MTK=y
CONFIG_INTERCONNECT_MTK_MMQOS_MT6768=m
CONFIG_MTK_IOMMU=m
CONFIG_DMABUF_HEAPS_MTK_MM=m
CONFIG_DMABUF_HEAPS_SYSTEM=m
CONFIG_DMABUF_HEAPS_DEBUG=m
# CONFIG_CHARGER_MT6370 is not set
# CONFIG_MTK_CHARGER is not set
CONFIG_MTK_PUMP_EXPRESS_PLUS_20_SUPPORT=m
CONFIG_MTK_PUMP_EXPRESS_40_SUPPORT=m
CONFIG_MTK_PUMP_EXPRESS_50_SUPPORT=m
CONFIG_MTK_PUMP_EXPRESS_PLUS_SUPPORT=m
CONFIG_MTK_BATTERY_OC_POWER_THROTTLING=m
CONFIG_MTK_BATTERY_PERCENT_THROTTLING=m
CONFIG_MTK_DYNAMIC_LOADING_POWER_THROTTLING=m
CONFIG_MTK_LOW_BATTERY_POWER_THROTTLING=m
CONFIG_MTK_CPU_POWER_THROTTLING=m
CONFIG_PMIC_LBAT_SERVICE=m
CONFIG_MTK_IOMMU_MISC=m
CONFIG_MTK_IOMMU_MISC_DBG=m
CONFIG_MTK_IOMMU_MISC_TEST=m
CONFIG_MTK_IOMMU_MISC_SECURE=m
CONFIG_DRM_MEDIATEK=m
CONFIG_DRM_MEDIATEK_V2=y
CONFIG_SND_SOC_MT6660=m
CONFIG_SND_SOC_MT6768=m
CONFIG_SND_SOC_MT6768_MT6358=m
CONFIG_SND_SOC_MTK_BTCVSD=m
CONFIG_SERIAL_8250_MT6577=m
CONFIG_PWM_MTK_DISP=m
CONFIG_LEDS_MTK=m
CONFIG_LEDS_MTK_DISP=m
CONFIG_LEDS_MTK_PWM=m
CONFIG_LEDS_MT6370_FLASH=m
CONFIG_MTK_UART_APDMA=m
CONFIG_MTK_CQDMA=m
CONFIG_TOUCHSCREEN_MTK_TOUCH="GT9886 GT1151"
CONFIG_MTPROF=m
CONFIG_USB_POWER_DELIVERY=m
CONFIG_TCPC_CLASS=m
CONFIG_MTK_CHARGER_TYPE_DETECT=m
CONFIG_LEDS_REGULATOR_VIBRATOR=m
CONFIG_MTK_SDA=y
CONFIG_MTK_CACHE_PARITY_CHECK=m
CONFIG_MTK_IRQ_DBG_LEGACY=m
CONFIG_MEDIATEK_WATCHDOG=m
CONFIG_RTC_DRV_MT6397=m
CONFIG_MTK_SECURITY_SW_SUPPORT=m
CONFIG_HW_RANDOM_SECURE=m
CONFIG_MMSTAT_TRACER=m
CONFIG_MTK_CM_MGR=m
CONFIG_MTK_CM_MGR_MT6768=m
CONFIG_MT635X_EFUSE=m
CONFIG_MTK_BTIF=m
CONFIG_MTK_COMBO=m
CONFIG_MTK_COMBO_CHIP_CONSYS_6768=y
CONFIG_MTK_COMBO_GPS=m
CONFIG_MTK_GPS_SUPPORT=y
CONFIG_MTK_GPS_EMI=m
CONFIG_MTK_FMRADIO=m
CONFIG_MTK_FM_CHIP="MT6631_FM"
CONFIG_MTK_CONNSYS_DEDICATED_LOG_PATH=y
# CONFIG_MTK_CONN_LTE_IDC_SUPPORT is not set
# CONFIG_HW_RANDOM_MTK is not set
# CONFIG_MST_IRQ is not set
# CONFIG_PINCTRL_MT2712 is not set
# CONFIG_PINCTRL_MT6797 is not set
# CONFIG_PINCTRL_MT6779 is not set
# CONFIG_PINCTRL_MT7622 is not set
# CONFIG_PINCTRL_MT8167 is not set
# CONFIG_PINCTRL_MT8173 is not set
# CONFIG_PINCTRL_MT8183 is not set
# CONFIG_PINCTRL_MT8192 is not set
# CONFIG_PINCTRL_MT8516 is not set
# CONFIG_PINCTRL_MT6397 is not set
CONFIG_PINCTRL_MT6768=m
CONFIG_I2C_MT65XX=m
CONFIG_EINT_MTK=m
CONFIG_MTK_MMSYS=m
CONFIG_MMC_MTK=m
CONFIG_MMC_MTK_PRO=m
CONFIG_MMC_CQHCI=m
CONFIG_MMC_AUTOK=m
CONFIG_MMC_DEBUG=m
CONFIG_MTK_BLOCK_IO_TRACER=m
CONFIG_MTK_DVFSRC_HELPER=m
CONFIG_MTK_DVFSRC_MET_MT6768=m
CONFIG_INTERCONNECT_MTK_EMI=m
CONFIG_REGULATOR_MTK_DVFSRC=m
CONFIG_MTK_DVFSRC=m
CONFIG_MTK_DVFSRC_DEVFREQ=m
CONFIG_MTK_CMDQ_MBOX_EXT=m
CONFIG_MTK_MDP=m
CONFIG_MTK_MDP_MTEE_SUPPORT=m
CONFIG_MTK_MDPM_LEGACY_V1=m
CONFIG_MTK_PBM_LEGACY=m
CONFIG_MMPROFILE=m
CONFIG_TEE=m
CONFIG_TEE_PERF_SUPPORT=m
CONFIG_TRUSTONIC_TEE_SUPPORT=m
CONFIG_MICROTRUST_TEE_SUPPORT=m
CONFIG_MTK_TEE_GP_SUPPORT=y
CONFIG_TRUSTONIC_TEE_VERSION="500"
CONFIG_HAVE_MTK_ENABLE_GENIEZONE=y
CONFIG_MTK_ENABLE_GENIEZONE=m
CONFIG_MTK_GZ_MAIN=m
CONFIG_MTK_GZ_LOG=m
CONFIG_MTK_GZ_VIRTIO=m
CONFIG_MTK_GZ_VIRTIO_IPC=m
CONFIG_MTK_GZ_IRQ=m
CONFIG_MTK_GZ_TZ_SYSTEM=m
CONFIG_HAVE_MTK_GZ_LOG=y
CONFIG_MTK_MML_LEGACY=m
CONFIG_VIDEO_MEDIATEK_VCODEC=m
CONFIG_VIDEO_MEDIATEK_VCODEC_V1=y
CONFIG_VIDEO_MEDIATEK_VCU=m
CONFIG_VB2_MEDIATEK_DMA_CONTIG=m
CONFIG_VIDEO_MEDIATEK_VPU=m
CONFIG_MTK_MMDVFS=m
CONFIG_DRM_PANEL_N19A_36_02_0A_DSC_VDO=m
CONFIG_DRM_PANEL_N19A_42_03_0B_DSC_VDO=m
CONFIG_DRM_PANEL_N19A_43_02_0C_DSC_VDO=m
CONFIG_MTK_MT6382_BDG=m
CONFIG_SPI_MT65XX=m
CONFIG_MTK_PWM=m
CONFIG_MTK_SCHEDULER=m
CONFIG_MTK_OPP_CAP_INFO=y
CONFIG_NONLINEAR_FREQ_CTL=y
CONFIG_MTK_EAS=y
CONFIG_MTK_NEWIDLE_BALANCE=y
CONFIG_MTK_CORE_PAUSE=y
CONFIG_MTK_CORE_CTL=m
CONFIG_MTK_SCHED_BIG_TASK_ROTATE=y
CONFIG_MTK_CPUFREQ_SUGOV_EXT=m
CONFIG_MTK_IRTX_PWM_SUPPORT=m
CONFIG_KEYBOARD_MTK_KPD=m
CONFIG_KEYBOARD_MTK_PMIC=m
CONFIG_EXTCON_MTK_USB=m
CONFIG_MTK_MUSB_DRV_36BIT=y
CONFIG_MTK_MUSB_DUAL_ROLE=y
CONFIG_MTK_MUSB_QMU_SUPPORT=y
CONFIG_MTK_MUSB_QMU_PURE_ZLP_SUPPORT=y
CONFIG_MTK_USB_BOOST=m
CONFIG_MTK_USB_META=m
CONFIG_NOP_USB_XCEIV=m
CONFIG_PHY_MTK_TPHY=m
CONFIG_USB_MTK_HDRC=m
CONFIG_USB_MTK_OTG=y
CONFIG_TCPC_MT6370=m
CONFIG_TOUCHSCREEN_NT36XXX_HOSTDL_SPI=m
# N19A code for HQ-353617 by p-huangyunbiao at 2024/02/19 start
CONFIG_XIAOMI_USB_TOUCH_NOTIFIER=m
CONFIG_XIAOMI_HEADSET_TOUCH_NOTIFIER=m
# N19A code for HQ-353617 by p-huangyunbiao at 2024/02/19 end
# N19A code for HQ-359934 by p-huangyunbiao at 2023/12/19 start
CONFIG_TOUCHSCREEN_FTS_SPI=m
CONFIG_TOUCHSCREEN_XIAOMI_TOUCHFEATURE=m
CONFIG_TOUCHSCREEN_TPD_NOTIFY=m
# N19A code for HQ-359934 by p-huangyunbiao at 2023/12/19 end
CONFIG_NVMEM=y
CONFIG_HQ_SYSFS_SUPPORT=m
CONFIG_MTK_DEVINFO=m
CONFIG_MEDIATEK_MT6577_AUXADC=m
CONFIG_MEDIATEK_MT6370_ADC=m
CONFIG_MTK_SOCINFO=m
CONFIG_MTK_GPU_SUPPORT=m
CONFIG_MTK_GPU_MT6768_SUPPORT=m
CONFIG_MTK_GPUFREQ_V2=y
CONFIG_MTK_GPU_COMMON_DVFS_SUPPORT=y
CONFIG_EXT_MODULES="../vendor/mediatek/kernel_modules/gpu/platform/mt6768 ../vendor/mediatek/kernel_modules/connectivity/common ../vendor/mediatek/kernel_modules/connectivity/fmradio ../vendor/mediatek/kernel_modules/connectivity/common  ../vendor/mediatek/kernel_modules/connectivity/gps/gps_stp"
CONFIG_MTK_TINYSYS_SCP_SUPPORT=m
CONFIG_MTK_TINYSYS_SCP_CM4_SUPPORT=y
CONFIG_MTK_AMMS=m
CONFIG_SYSCON_REBOOT_MODE=m
CONFIG_RESET_TI_SYSCON=m
# N19A code for HQ-360492 by p-xuyechen at 2023/12/20
CONFIG_CUSTOM_KERNEL_IMGSENSOR="s5khm6_sunny_main_mipi_raw s5khm6_aac_main_mipi_raw s5khm6_truly_main_mipi_raw ov13b10_sunny_front_mipi_raw ov13b10_ofilm_front_mipi_raw s5k3l6_aac_front_mipi_raw gc02m1_sunny_macro_mipi_raw gc02m1_truly_macro_mipi_raw gc02m1_aac_macro_mipi_raw"
CONFIG_MTK_IMGSENSOR_ISP4=m
CONFIG_MTK_SENSOR_SUPPORT=m
CONFIG_MTK_SENSOR_ARCHITECTURE="1.0"
CONFIG_CUSTOM_KERNEL_ACCELEROMETER=y
CONFIG_MTK_ACCELHUB=y
CONFIG_CUSTOM_KERNEL_ALSPS=y
CONFIG_MTK_ALSPSHUB=y
CONFIG_CUSTOM_KERNEL_GYROSCOPE=y
CONFIG_MTK_GYROHUB=y
CONFIG_CUSTOM_KERNEL_MAGNETOMETER=y
CONFIG_CUSTOM_KERNEL_SAR=y
CONFIG_MTK_SAR_HUB=y
CONFIG_MTK_MAGHUB=y
CONFIG_MTK_HWMON=y
CONFIG_CUSTOM_KERNEL_BAROMETER=y
CONFIG_MTK_BAROHUB=y
CONFIG_CUSTOM_KERNEL_STEP_COUNTER=y
CONFIG_MTK_STEPSIGNHUB=y
CONFIG_CUSTOM_KERNEL_SITUATION=y
CONFIG_MTK_STATHUB=y
CONFIG_MTK_WAKEHUB=y
CONFIG_MTK_GLGHUB=y
CONFIG_MTK_PICKUPHUB=y
CONFIG_MTK_DEVICE_ORIENTATION_HUB=y
CONFIG_MTK_MOTION_DETECT_HUB=y
CONFIG_MTK_TILTDETECTHUB=y
CONFIG_CUSTOM_KERNEL_SENSORHUB=y
CONFIG_NANOHUB=y
CONFIG_NANOHUB_MTK_IPI=y
CONFIG_CUSTOM_KERNEL_SENSOR_FUSION=y
CONFIG_MTK_ROTATVECHUB=y
CONFIG_MTK_GAMEROTVECHUB=y
CONFIG_MTK_GMAGROTVECHUB=y
CONFIG_MTK_GRAVITYHUB=y
CONFIG_MTK_LINEARACCHUB=y
CONFIG_MTK_ORIENTHUB=y
CONFIG_MTK_UNCALI_ACCHUB=y
# N19A code for HQ-366241 by chenyushuai at 2024/01/15 start
# CONFIG_MTK_UNCALI_GYROHUB is not set
# N19A code for HQ-366241 by chenyushuai at 2024/01/15 start
CONFIG_MTK_UNCALI_MAGHUB=y
CONFIG_MTK_MET=m
CONFIG_MTK_PPM_V3=m
CONFIG_MTK_QOS_LEGACY=y
CONFIG_MTK_QOS_FRAMEWORK=m
#CONFIG_MTK_THERMAL=y
#CONFIG_MTK_SOC_THERMAL=m
#CONFIG_GENERIC_ADC_THERMAL=m
#CONFIG_MTK_PMIC_THERMAL=m
# CONFIG_MTK_MD_THERMAL=m
#CONFIG_MTK_CHARGER_THERMAL=m
#CONFIG_MTK_BACKLIGHT_THERMAL=m
CONFIG_MTK_LEGACY_THERMAL=m
CONFIG_MTK_LEGACY_PLATFORM="mt6768"
CONFIG_MTK_THERMAL_PA_VIA_ATCMD=y
CONFIG_SND_SOC_MT6358_ACCDET=m
CONFIG_MTK_TRUSTED_MEMORY_SUBSYSTEM=m
CONFIG_CFG80211=m
CONFIG_NL80211_TESTMODE=y
CONFIG_MAC80211=m
CONFIG_MTK_PERFORMANCE_MODULE=m
CONFIG_MTK_PERF_COMMON=m
CONFIG_MTK_PERF_TRACKER=y
CONFIG_MTK_TASK_TURBO=m
CONFIG_MTK_LOAD_TRACKER=m
CONFIG_MTK_FPSGO_V3=m
CONFIG_ZSMALLOC=m
CONFIG_ZRAM=m
CONFIG_MTK_TINYSYS_SCP_LOGGER_SUPPORT=y
CONFIG_KRETPROBES=y
CONFIG_KALLSYMS_ALL=y
CONFIG_KALLSYMS=y
CONFIG_KPROBES=y
CONFIG_MTK_PRINTK_UART_CONSOLE=y
CONFIG_MTK_PRINTK=m
CONFIG_DEVAPC_MT6768=m
CONFIG_COMMON_CLK_MTK_FREQ_HOPPING=m
CONFIG_COMMON_CLK_MTK_FREQ_HOPPING_SSPM=y
CONFIG_MTK_WIDEVINE_DRM=m
CONFIG_MTK_FB_MMDVFS_SUPPORT=y
CONFIG_MTK_CAM_TIMESYNC=m
CONFIG_MTK_CAMERA_MEM_SUPPORT=m
CONFIG_MTK_CAMERA_ISP_RAW_SUPPORT=m
CONFIG_MTK_CAMERA_ISP_RAW_SUPPORT_ISP4_T=m
CONFIG_MTK_CAMERA_ISP_SUPPORT=m
CONFIG_MTK_CAMERA_FD_VERSION40=m
CONFIG_MTK_CAMERA_DPE_ISP40=m
CONFIG_MTK_CAM_CAL=m
CONFIG_MTK_LENS=m
CONFIG_MTK_V4L2_LENS=m
CONFIG_MTK_CCCI_DEVICES=y
CONFIG_MTK_MD1_SUPPORT=25
CONFIG_MTK_ECCCI_DRIVER=m
CONFIG_MTK_ECCCI_C2K_USB=m
CONFIG_MTK_CCU=m
CONFIG_MTK_FLASHLIGHT=m
CONFIG_MTK_V4L2_FLASHLIGHT=m
CONFIG_V4L2_FLASH_LED_CLASS=m
CONFIG_USB_NET_AX8817X=m
CONFIG_ARM_DSU_PMU=m
CONFIG_MTK_USB_CONFIGFS_RNDIS=m
CONFIG_USB_NET_AX88179_178A=m
CONFIG_MTK_SMI_BWC=m
# Audio bringup pa codec dai config liutongren 20231212 start
CONFIG_SND_SOC_SIA8150=m
CONFIG_SND_SOC_FS1599=m
CONFIG_SND_SOC_AW87XXX=m
# Audio bringup pa codec dai config liutongren 20231212 end
CONFIG_SUBPMIC_DRIVER=m
CONFIG_SUBPMIC_6601=m
CONFIG_SC_CHARGER=m
CONFIG_NU_CHARGER=m
CONFIG_NU_SUBPMIC_DRIVER=m
CONFIG_NU_SUBPMIC_NU6601=m
CONFIG_NU_CHARGERPUMP_DRIVER=m
CONFIG_NU_CHARGERPUMP_NU2115=m
CONFIG_BQ_CHARGERPUMP_BQ25960=m
CONFIG_HUAQIN_ADAPTER_CLASS=m
CONFIG_HUAQIN_CHARGER_CLASS=m
CONFIG_HUAQIN_CP_CLASS=m
CONFIG_HUAQIN_LED_CLASS=m
CONFIG_HUAQIN_CHARGER_MANAGER=m
CONFIG_HUAQIN_CP_POLICY=m
CONFIG_PROTOCOL=m
CONFIG_BC12=m
CONFIG_TCPC_RT1711H=m
CONFIG_PD_DBG_INFO=m
# CONFIG_BQ_FUELGAUGE is not set
CONFIG_PD_BATTERY_SECRET=m
CONFIG_XM_CHG_ANIMATION=m
# CONFIG_XM_FG_I2C_ERR is not set
CONFIG_HUAQIN_QC_POLICY=m
CONFIG_XIAOMI_SMART_CHG=m
# N19A code for HQ-360184 by p-wumingzhu1 at 20240103 start
CONFIG_ONEWIRE_GPIO=m
CONFIG_BATT_VERIFY=m
CONFIG_BATT_VERIFY_BY_DS28E30=m
CONFIG_BATT_VERIFY_BY_SLG=m
CONFIG_BATT_VERIFY_BY_ST=m
# N19A code for HQ-360184 by p-wumingzhu1 at 20240103 end
CONFIG_MIUI_ZRAM_MEMORY_TRACKING=y
# N19A code for HQ-348137 by p-xuzhirong at 20231210 start
CONFIG_NFC_PN553_DEVICES=m
CONFIG_MTK_NFC_CLKBUF_ENABLE=y
# N19A code for HQ-348137 by p-xuzhirong at 20231210 end
# N19A code for HQ-360358 by p-xuzhirong at 20240101 start
CONFIG_TMS_DEVICE=m
CONFIG_TMS_NFC_DEVICE=m
CONFIG_TMS_ESE_DEVICE=n
CONFIG_TMS_GUIDE_DEVICE=m
# N19A code for HQ-360358 by p-xuzhirong at 20240101 end
CONFIG_ZRAM_WRITEBACK=y
CONFIG_WATER_DETECTION=y
####*******N19A code for charger module end *******####
# N19A code for HQ-353543 by lizhilong at 20231207 start
CONFIG_MTK_TEE_GP_COORDINATOR=m
# N19A code for HQ-353543 by lizhilong at 20231207 end
# N19A code for HQ-354070 by gaobowei at 2023/12/07 start
CONFIG_SIMTRAY_STATUS=m
# N19A code for HQ-354070 by gaobowei at 2023/12/07 end
# N19A code for HQ-353952 by tianjuanhe at 20231211 start
CONFIG_SWITCH=m
# N19A code for HQ-353952 by tianjuanhe at 20231211 end
# N19A code for HQ-348485 by gaobowei at  2023/12/13 start
CONFIG_MI_CPU_MAX_FREQ=m
# N19A code for HQ-348485 by gaobowei at  2023/12/13 end
# N19A code for HQ-354305 by sunyuting at 2023/12/13 start
CONFIG_INPUT_FINGERPRINT=m
CONFIG_SILEAD_FP=m
CONFIG_FINGERPRINT_GOODIX=m
# N19A code for HQ-354305 by sunyuting at 2023/12/13 end

# N19a code for HQ-353506 by huweifeng at 2023/12/16 start
CONFIG_MTK_SAR_ALGO_HUB=m
# N19a code for HQ-353506 by huweifeng at 2023/12/16 end

# N19A code for HQHW-6120 by yaochuxue at 2024/02/20 start
CONFIG_BC12_RETRY_FOR_MI_PD=m
# N19A code for HQHW-6120 by yaochuxue at 2024/02/20 end
# N19A code for HQ-375085 by xushuo at 2024/02/28 start
CONFIG_RPMB=m
# N19A code for HQ-375085 by xushuo at 2024/02/28 end

# N19A code for HQ-380111 by p-yanzelin at 20240423 start
CONFIG_PR_SWAP_FOR_NU6601=y
# N19A code for HQ-380111 by p-yanzelin at 20240423 end
```
