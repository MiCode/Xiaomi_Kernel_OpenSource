## arch/arm64/configs/k61v1_64_bsp_k510_defconfig
```kconfig
CONFIG_BUILD_CONFIG_FILE="build.config.mtk.aarch64"
CONFIG_MEDIATEK_MCDI=m
CONFIG_MEDIATEK_CPUIDLE=m
CONFIG_ABI_MONITOR=y
CONFIG_ARCH_MEDIATEK=y
CONFIG_MTK_DCM_MT6761=m
CONFIG_MTK_AEE_FEATURE=m
CONFIG_MTK_AEE_AED=m
CONFIG_MTK_AEE_HANGDET=m
CONFIG_MTK_AEE_IPANIC=m
CONFIG_MTK_ATF_LOGGER=m
CONFIG_MTK_HANG_DETECT=m
CONFIG_MTK_HANG_DETECT_DB=y
CONFIG_MTPROF=m
CONFIG_TEE=m
CONFIG_MTK_TEE_GP_SUPPORT=y
CONFIG_TEE_PERF_SUPPORT=m
CONFIG_TRUSTONIC_TEE_SUPPORT=m
CONFIG_TRUSTONIC_TEE_VERSION="500"
CONFIG_TRUSTONIC_TEE_DEBUG=y
CONFIG_MICROTRUST_TEE_SUPPORT=m
CONFIG_MTK_CM_MGR_LEGACY=m
# CONFIG_HAVE_MTK_ENABLE_GENIEZONE is not set
# CONFIG_MTK_ENABLE_GENIEZONE is not set
# CONFIG_MTK_GZ_MAIN is not set
# CONFIG_MTK_GZ_LOG is not set
# CONFIG_MTK_GZ_VIRTIO is not set
# CONFIG_MTK_GZ_VIRTIO_IPC is not set
# CONFIG_MTK_GZ_IRQ is not set
# CONFIG_MTK_GZ_TZ_SYSTEM is not set
# CONFIG_HAVE_MTK_GZ_LOG is not set
# CONFIG_MTK_TRUSTED_MEMORY_SUBSYSTEM is not set
# CONFIG_MTK_SECURE_MEM_SUPPORT is not set
CONFIG_MTK_PPM_V3=m
CONFIG_COMMON_CLK_MT6761=m
CONFIG_COMMON_CLK_MT6761_AUDIOSYS=m
CONFIG_COMMON_CLK_MT6761_CAMSYS=m
CONFIG_COMMON_CLK_MT6761_MMSYS=m
CONFIG_COMMON_CLK_MT6761_VCODECSYS=m
CONFIG_COMMON_CLK_MT6761_MIPI0ASYS=m
CONFIG_COMMON_CLK_PG_LEGACY=m
CONFIG_MTK_SCPSYS=m
CONFIG_COMMON_CLK_MTK_FREQ_HOPPING=m
CONFIG_COMMON_CLK_MTK_FREQ_HOPPING_SSPM=y
CONFIG_MTK_LEGACY_THERMAL=m
CONFIG_MTK_THERMAL_PA_VIA_ATCMD=y
CONFIG_MFD_MT6370=m
CONFIG_REGULATOR_MT6370=m
CONFIG_MEDIATEK_MT6370_ADC=m
CONFIG_LEDS_MT6370_FLASH=m
CONFIG_PWM_MTK_DISP=m
CONFIG_MT6370_DBG=m
CONFIG_BACKLIGHT_MT6370=m
CONFIG_MTK_SUBPMIC_MISC=m
CONFIG_CHARGER_MT6370=m
CONFIG_CHARGER_TYPE_MT6357=m
CONFIG_MTK_CHARGER=m
CONFIG_MTK_PUMP_EXPRESS_PLUS_20_SUPPORT=m
CONFIG_MTK_PUMP_EXPRESS_40_SUPPORT=m
CONFIG_MTK_PUMP_EXPRESS_50_SUPPORT=m
CONFIG_MTK_PUMP_EXPRESS_PLUS_SUPPORT=m
CONFIG_CHARGER_RT9465=m
CONFIG_MTK_CHARGER_TYPE_DETECT=m
CONFIG_MT6357_DO_CTD=y
CONFIG_MEDIATEK_CPU_DVFS_MT6761=m
CONFIG_MEDIATEK_CPU_DVFS=m
# CONFIG_MTK_MMSYS is not set
# CONFIG_HW_RANDOM_MTK is not set
CONFIG_SERIAL_8250_MT6577=m
CONFIG_MTK_UART_APDMA=m
CONFIG_MTK_CQDMA=m
CONFIG_MTK_IOMMU=m
CONFIG_DMABUF_HEAPS_MTK_MM=m
CONFIG_DMABUF_HEAPS_SYSTEM=m
CONFIG_DMABUF_HEAPS_DEBUG=m
CONFIG_MTK_IOMMU_MISC=m
CONFIG_MTK_IOMMU_MISC_DBG=m
CONFIG_MTK_IOMMU_MISC_TEST=m
# CONFIG_MTK_IOMMU_MISC_SECURE is not set
# CONFIG_MST_IRQ is not set
# CONFIG_PINCTRL_MT2712 is not set
# CONFIG_PINCTRL_MT6797 is not set
# CONFIG_PINCTRL_MT6779 is not set
# CONFIG_PINCTRL_MT7622 is not set
# CONFIG_PINCTRL_MT8167 is not set
# CONFIG_PINCTRL_MT8173 is not set
# CONFIG_PINCTRL_MT8183 is not set
# CONFIG_PINCTRL_MT8192 is not set
# CONFIG_PINCTRL_MT8516 is not set
# CONFIG_PINCTRL_MT6397 is not set
CONFIG_MEMORY=y
CONFIG_HAVE_MTK_MC=y
CONFIG_MTK_DRAMC=m
CONFIG_MTK_EMI_LEGACY=m
CONFIG_MTK_EMI_BWL_VERSION=1
CONFIG_ZSMALLOC=m
CONFIG_ZRAM=m
CONFIG_PINCTRL_MT6761=m
CONFIG_EINT_MTK=m
CONFIG_SYSCON_REBOOT_MODE=m
CONFIG_RESET_TI_SYSCON=m
CONFIG_MMSTAT_TRACER=m
CONFIG_MMC_MTK_PRO=m
CONFIG_MMC_MTK_SW_CQHCI=m
CONFIG_MMC_CQHCI=m
CONFIG_MMC_AUTOK=m
CONFIG_MMC_DEBUG=m
CONFIG_MMPROFILE=m
CONFIG_MTK_BATTERY_OC_POWER_THROTTLING=m
CONFIG_MTK_BATTERY_PERCENT_THROTTLING=m
CONFIG_MTK_DYNAMIC_LOADING_POWER_THROTTLING=m
CONFIG_MTK_LOW_BATTERY_POWER_THROTTLING=m
CONFIG_MTK_CPU_POWER_THROTTLING=m
CONFIG_MTK_MD_POWER_THROTTLING=m
CONFIG_PMIC_LBAT_SERVICE=m
CONFIG_MTK_MDPM_LEGACY_V1=m
CONFIG_MTK_PBM_LEGACY=m
CONFIG_MTK_CLKBUF=m
CONFIG_MTK_CLKBUF_V1=y
CONFIG_MTK_PLAT_POWER_MT6761=m
CONFIG_MTK_PTPOD_LEGACY=m
CONFIG_MTK_SPM_V0=m
CONFIG_MTK_MDP=m
CONFIG_MTK_DVFSRC_DEVFREQ=m
CONFIG_MTK_QOS_LEGACY=y
CONFIG_MTK_QOS_FRAMEWORK=m
CONFIG_MTK_MDP_MT6761=m
CONFIG_MTK_BLOCK_IO_TRACER=m
CONFIG_NVMEM=y
CONFIG_MTK_DEVINFO=m
CONFIG_MEDIATEK_MT6577_AUXADC=m
CONFIG_MTK_SOCINFO=m
CONFIG_MEDIATEK_WATCHDOG=m
CONFIG_MTK_PMIC_WRAP=m
CONFIG_MFD_MT6397=m
CONFIG_REGULATOR_MT6357=m
CONFIG_MEDIATEK_MT635X_AUXADC=m
CONFIG_MT635X_EFUSE=m
CONFIG_BATTERY_MT6357=m
CONFIG_I2C_MT65XX=m
CONFIG_SPI_MT65XX=m
CONFIG_MTK_IPI=m
CONFIG_MTK_MBOX=m
CONFIG_MTK_CMDQ_MBOX_EXT=m
CONFIG_RPMSG_MTK=m
CONFIG_MTK_TINYSYS_SSPM_SUPPORT=m
CONFIG_MTK_TINYSYS_SSPM_V0=y
CONFIG_LEDS_MTK=m
CONFIG_LEDS_MTK_DISP=m
CONFIG_LEDS_MTK_PWM=m
CONFIG_EXTCON_MTK_USB=m
CONFIG_MTK_MUSB_DRV_36BIT=y
CONFIG_MTK_MUSB_DUAL_ROLE=y
CONFIG_MTK_MUSB_QMU_SUPPORT=y
CONFIG_MTK_MUSB_QMU_PURE_ZLP_SUPPORT=y
CONFIG_MTK_USB_BOOST=m
CONFIG_MTK_USB_META=m
CONFIG_NOP_USB_XCEIV=m
CONFIG_PHY_MTK_TPHY=m
CONFIG_USB_MTK_HDRC=m
CONFIG_USB_MTK_OTG=y
CONFIG_USB_NET_AX8817X=m
CONFIG_USB_NET_AX88179_178A=m
CONFIG_TCPC_CLASS=m
CONFIG_TCPC_MT6370=m
CONFIG_MTK_USB_CONFIGFS_RNDIS=m
CONFIG_MTK_ECCCI_C2K_USB=m
CONFIG_USB_POWER_DELIVERY=m
CONFIG_MTK_DVFSRC=m
CONFIG_MTK_POWER_GS_LEGACY=m
CONFIG_MTK_DVFSRC_HELPER=m
CONFIG_MTK_DVFSRC_MET_MT6761=m
CONFIG_INTERCONNECT_MTK_EMI=m
CONFIG_REGULATOR_MTK_DVFSRC=m
CONFIG_MTK_GPU_SUPPORT=m
CONFIG_MTK_GPU_MT6761_SUPPORT=m
CONFIG_MTK_GPUFREQ_V2=y
CONFIG_MTK_GPU_COMMON_DVFS_SUPPORT=y
CONFIG_MTK_BTIF=m
CONFIG_MTK_COMBO=m
CONFIG_MTK_COMBO_CHIP_CONSYS_6761=y
CONFIG_MTK_COMBO_GPS=m
CONFIG_MTK_GPS_SUPPORT=y
CONFIG_MTK_GPS_EMI=m
CONFIG_MTK_FMRADIO=m
CONFIG_MTK_FM_CHIP="MT6631_FM"
CONFIG_MTK_CONNSYS_DEDICATED_LOG_PATH=y
CONFIG_EXT_MODULES="../vendor/mediatek/kernel_modules/gpu/platform/mt6761/ ../vendor/mediatek/kernel_modules/connectivity/common ../vendor/mediatek/kernel_modules/connectivity/gps/gps_stp ../vendor/mediatek/kernel_modules/gpu/platform/mt6761/ ../vendor/mediatek/kernel_modules/connectivity/fmradio"
CONFIG_MTK_MMDVFS=m
CONFIG_INTERCONNECT_MTK=y
CONFIG_INTERCONNECT_MTK_MMQOS_MT6761=m
CONFIG_MTK_FLASHLIGHT=m
CONFIG_MTK_FLASHLIGHT_PT=y
CONFIG_MTK_FLASHLIGHT_PT_STRICT=y
CONFIG_MTK_FLASHLIGHT_DLPT=y
CONFIG_MTK_V4L2_FLASHLIGHT=m
CONFIG_V4L2_FLASH_LED_CLASS=m
CONFIG_MTK_LENS=m
CONFIG_MTK_V4L2_LENS=m
CONFIG_MTK_VIDEOCODEC_DRIVER=m
CONFIG_MTK_VIDEOCODEC_IPM_V1=y
CONFIG_VIDEO_MEDIATEK_JPEG=m
CONFIG_MMPROFILE=m
CONFIG_DRM_PANEL_NT35521_HD_VDO_TRULY_RT5081=m
CONFIG_MTK_MML_LEGACY=m
CONFIG_MTK_MMSYS=m
CONFIG_DEVAPC_MT6761=m
CONFIG_DRM_MEDIATEK=m
CONFIG_DRM_MEDIATEK_V2=y
CONFIG_KEYBOARD_MTK_KPD=m
CONFIG_KEYBOARD_MTK_PMIC=m
CONFIG_TOUCHSCREEN_MTK_TOUCH="GT1151"
CONFIG_CFG80211=m
CONFIG_NL80211_TESTMODE=y
CONFIG_MAC80211=m
CONFIG_MTK_HPS_V3=m
CONFIG_MTK_STATIC_POWER_LEGACY=m
CONFIG_MTK_UNIFIED_POWER=m
CONFIG_MTK_CAMERA_ISP_RAW_SUPPORT_ISP3_M=m
CONFIG_MTK_CAMERA_ISP_RAW_SUPPORT=m
CONFIG_MTK_CAMERA_ISP_SUPPORT=m
CONFIG_MTK_CAMERA_FD_VERSION35=m
CONFIG_MTK_CAM_TIMESYNC=m
CONFIG_MTK_CAMERA_MEM_SUPPORT=m
CONFIG_SND_SOC_RT5509=m
CONFIG_SND_SOC_MTK_BTCVSD=m
CONFIG_MTK_SND_SOC_NEW_ARCH=y
CONFIG_MTK_SND_SOC_NEW_ARCH_COMMON=m
CONFIG_SND_SOC_CODEC_MT6357=m
CONFIG_RTC_DRV_MT6397=m
CONFIG_LEDS_REGULATOR_VIBRATOR=m
CONFIG_SND_SOC_MT6357_ACCDET=m
CONFIG_MTK_CCCI_DEVICES=y
CONFIG_MTK_MD1_SUPPORT=25
CONFIG_MTK_ECCCI_DRIVER=m
CONFIG_CUSTOM_KERNEL_IMGSENSOR="imx499_mipi_raw s5k2t7sp_mipi_raw s5k3l8_mipi_raw s5k5e8yx_mipi_raw ov8856_mipi_raw imx318_mipi_raw imx386_mipi_raw"
CONFIG_MTK_IMGSENSOR_ISP3_M=m
CONFIG_MTK_PWM=m
CONFIG_MTK_PERFORMANCE_MODULE=m
CONFIG_MTK_FPSGO_V3=m
CONFIG_MTK_PERF_TRACKER=y
CONFIG_MTK_LOAD_TRACKER=m
CONFIG_MTK_PERF_COMMON=m
CONFIG_MTK_PRINTK=m
CONFIG_MTK_PRINTK_UART_CONSOLE=y
CONFIG_MTK_TINYSYS_SCP_SUPPORT=m
CONFIG_MTK_TINYSYS_SCP_CM4_SUPPORT=y
CONFIG_MTK_TINYSYS_SCP_LOGGER_SUPPORT=y
CONFIG_MTK_SENSOR_SUPPORT=m
CONFIG_MTK_SENSOR_ARCHITECTURE="1.0"
CONFIG_CUSTOM_KERNEL_ACCELEROMETER=y
CONFIG_MTK_ACCELHUB=y
CONFIG_CUSTOM_KERNEL_ALSPS=y
CONFIG_MTK_ALSPSHUB=y
CONFIG_CUSTOM_KERNEL_MAGNETOMETER=y
CONFIG_MTK_MAGHUB=y
CONFIG_MTK_HWMON=y
CONFIG_CUSTOM_KERNEL_BAROMETER=y
CONFIG_MTK_BAROHUB=y
CONFIG_CUSTOM_KERNEL_STEP_COUNTER=y
CONFIG_MTK_STEPSIGNHUB=y
CONFIG_CUSTOM_KERNEL_SITUATION=y
CONFIG_MTK_STATHUB=y
CONFIG_MTK_WAKEHUB=y
CONFIG_MTK_GLGHUB=y
CONFIG_MTK_PICKUPHUB=y
CONFIG_MTK_DEVICE_ORIENTATION_HUB=y
CONFIG_MTK_MOTION_DETECT_HUB=y
CONFIG_MTK_TILTDETECTHUB=y
CONFIG_CUSTOM_KERNEL_SENSORHUB=y
CONFIG_NANOHUB=y
CONFIG_NANOHUB_MTK_IPI=y
CONFIG_CUSTOM_KERNEL_SENSOR_FUSION=y
CONFIG_MTK_ROTATVECHUB=y
CONFIG_MTK_GAMEROTVECHUB=y
CONFIG_MTK_GMAGROTVECHUB=y
CONFIG_MTK_GRAVITYHUB=y
CONFIG_MTK_LINEARACCHUB=y
CONFIG_MTK_ORIENTHUB=y
CONFIG_MTK_UNCALI_ACCHUB=y
CONFIG_MTK_UNCALI_GYROHUB=y
CONFIG_MTK_UNCALI_MAGHUB=y
CONFIG_MTK_RECU_FENCE_LOCK=y
CONFIG_SCHED_MC=y
CONFIG_SMP=y
CONFIG_MTK_EAS=y
CONFIG_MTK_NEWIDLE_BALANCE=y
CONFIG_ENERGY_MODEL=y
CONFIG_CPU_FREQ=y
CONFIG_CPU_FREQ_GOV_SCHEDUTIL=y
CONFIG_CPU_FREQ_DEFAULT_GOV_SCHEDUTIL=y
CONFIG_MTK_CPUFREQ_SUGOV_EXT=m
CONFIG_CGROUPS=y
CONFIG_CGROUP_SCHED=y
CONFIG_FAIR_GROUP_SCHED=y
# CONFIG_RT_GROUP_SCHED is not set
# CONFIG_CFS_BANDWIDTH is not set
CONFIG_CGROUP_FREEZER=y
# CONFIG_CGROUP_DEBUG is not set
CONFIG_CPUSETS=y
CONFIG_UCLAMP_TASK=y
CONFIG_UCLAMP_BUCKETS_COUNT=20
CONFIG_UCLAMP_TASK_GROUP=y
CONFIG_MTK_SCHEDULER=m
CONFIG_MTK_OPP_CAP_INFO=y
CONFIG_MTK_CORE_PAUSE=y
CONFIG_MTK_SCHED_BIG_TASK_ROTATE=y
CONFIG_RPMB=m
CONFIG_MTK_OPP_MIN=y
CONFIG_MTK_CAM_CAL_ISP3_M=m
CONFIG_MTK_AMMS=m
CONFIG_MTK_MET=m
CONFIG_MTK_FB_MMDVFS_SUPPORT=y
CONFIG_MTK_SMI_BWC=m
CONFIG_MTK_SMI_BWC_MT6761=m
CONFIG_NONLINEAR_FREQ_CTL=y
```
