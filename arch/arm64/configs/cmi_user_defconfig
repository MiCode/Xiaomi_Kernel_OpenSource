## arch/arm64/configs/k6873v1_64_gki_kmainline_defconfig
```kconfig
CONFIG_BUILD_CONFIG_FILE="build.config.mtk.aarch64"
CONFIG_EXT_MODULES=""
CONFIG_ARCH_MEDIATEK=y
CONFIG_COMMON_CLK_MEDIATEK=m
CONFIG_MTK_ATF_LOGGER=m
CONFIG_MTK_CCCI_DEVICES=y
CONFIG_MTK_MD1_SUPPORT=24
CONFIG_MTK_ECCCI_DRIVER=m
CONFIG_MTK_ECCCI_C2K=y
CONFIG_SCSI_UFS_MEDIATEK=m
CONFIG_SCSI_UFS_MEDIATEK_DBG=m
CONFIG_KEYBOARD_MTK_KPD=m
CONFIG_KEYBOARD_MTK_PMIC=m
CONFIG_MTK_SCHEDULER=m
CONFIG_MTK_OPP_CAP_INFO=y
CONFIG_SERIAL_8250_NR_UARTS=2
CONFIG_SERIAL_8250_RUNTIME_UARTS=2
CONFIG_SERIAL_8250_MT6577=m
CONFIG_I2C_MT65XX=m
CONFIG_SPI_MT65XX=m
CONFIG_SPMI_MTK_PMIF=m
# CONFIG_PINCTRL_MT2712 is not set
# CONFIG_PINCTRL_MT6797 is not set
CONFIG_PINCTRL_MT6873=m
# CONFIG_PINCTRL_MT7622 is not set
# CONFIG_PINCTRL_MT8173 is not set
# CONFIG_PINCTRL_MT8183 is not set
# CONFIG_PINCTRL_MT8516 is not set
# CONFIG_PINCTRL_MT6397 is not set
CONFIG_CHARGER_MT6360=m
CONFIG_MTK_CHARGER=m
CONFIG_MTK_BLOCK_IO_TRACER=m
CONFIG_MTK_PID_MAP=m
CONFIG_MTK_PUMP_EXPRESS_PLUS_SUPPORT=m
CONFIG_MTK_PUMP_EXPRESS_PLUS_20_SUPPORT=m
CONFIG_MTK_PUMP_EXPRESS_40_SUPPORT=m
CONFIG_THERMAL_EMERGENCY_POWEROFF_DELAY_MS=100
CONFIG_THERMAL_WRITABLE_TRIPS=y
CONFIG_THERMAL_EMULATION=y
CONFIG_GENERIC_ADC_THERMAL=m
CONFIG_MEDIATEK_WATCHDOG=m
CONFIG_MFD_MT6360=m
CONFIG_MFD_MT6397=m
CONFIG_MFD_MTK_SPMI_PMIC=m
CONFIG_REGULATOR_MT6315=m
CONFIG_REGULATOR_MT6359P=m
CONFIG_REGULATOR_MT6360=m
CONFIG_MTK_GPU_SUPPORT=m
CONFIG_MTK_GPU_SWPM_SUPPORT=y
CONFIG_MTK_GPU_COMMON_DVFS_SUPPORT=y
CONFIG_MTK_GPU_VERSION="mali valhall r25p0 mt6873"
CONFIG_LCD_CLASS_DEVICE=m
CONFIG_RTC_DRV_MT6397=m
CONFIG_PWM_MTK_DISP=m
CONFIG_LEDS_PWM=m
CONFIG_LEDS_REGULATOR_VIBRATOR=m
CONFIG_LEDS_CLASS_FLASH=m
CONFIG_LEDS_MT6360=m
CONFIG_MTK_SUBPMIC_MISC=m
CONFIG_MTK_SUBPMIC_DEBUGFS=m
CONFIG_MT6360_DBG=m
CONFIG_MTK_HSDMA=m
CONFIG_MTK_UART_APDMA=m
CONFIG_MTK_CLK_BUFFER=m
CONFIG_MTK_CLKBUF_BBLPM=y
CONFIG_MTK_CLKBUF_NFC=y
CONFIG_MTK_SRCLKEN_RC=m
CONFIG_MTK_CQDMA=m
CONFIG_MTK_DCM_MT6873=m
CONFIG_MTK_QOS_FRAMEWORK=m
CONFIG_MTK_BATTERY_OC_POWER_THROTTLING=m
CONFIG_MTK_BATTERY_PERCENT_THROTTLING=m
CONFIG_MTK_BATTERY_PERCENT_THROTTLING_DEBUG=m
CONFIG_MTK_DYNAMIC_LOADING_POWER_THROTTLING=m
CONFIG_MTK_LOW_BATTERY_POWER_THROTTLING=m
CONFIG_MTK_MD_POWER_THROTTLING=m
CONFIG_MTK_CPU_POWER_THROTTLING=m
CONFIG_MEDIATEK_CPUFREQ_DEBUG=m
CONFIG_MTK_PTPOD_GPU=m
CONFIG_MTK_STATIC_POWER=m
CONFIG_MTK_PBM=m
CONFIG_COMMON_CLK_MT8167=n
CONFIG_COMMON_CLK_MT8192=m
CONFIG_COMMON_CLK_MT8192_APU0=m
CONFIG_COMMON_CLK_MT8192_APU1=m
CONFIG_COMMON_CLK_MT8192_APU_VCORE=m
CONFIG_COMMON_CLK_MT8192_APU_CONN=m
CONFIG_COMMON_CLK_MT8192_APU_MDLA0=m
CONFIG_COMMON_CLK_MT8192_AUDSYS=m
CONFIG_COMMON_CLK_MT8192_CAMSYS=m
CONFIG_COMMON_CLK_MT8192_CAMSYS_RAWA=m
CONFIG_COMMON_CLK_MT8192_CAMSYS_RAWB=m
CONFIG_COMMON_CLK_MT8192_CAMSYS_RAWC=m
CONFIG_COMMON_CLK_MT8192_IMGSYS=m
CONFIG_COMMON_CLK_MT8192_IMGSYS2=m
CONFIG_COMMON_CLK_MT8192_IMP_IIC_WRAP=m
CONFIG_COMMON_CLK_MT8192_IPESYS=m
CONFIG_COMMON_CLK_MT8192_MDPSYS=m
CONFIG_COMMON_CLK_MT8192_MFGCFG=m
CONFIG_COMMON_CLK_MT8192_MMSYS=m
CONFIG_COMMON_CLK_MT8192_MSDC=m
CONFIG_COMMON_CLK_MT8192_SCP_ADSP=m
CONFIG_COMMON_CLK_MT8192_VDECSYS=m
CONFIG_COMMON_CLK_MT8192_VENCSYS=m
CONFIG_COMMON_CLK_MTK_FREQ_HOPPING=m
CONFIG_COMMON_CLK_MTK_FREQ_HOPPING_MCUPM=y
CONFIG_MT635X_EFUSE=m
CONFIG_MTK_DEVINFO=m
CONFIG_MTK_CMDQ_MBOX_EXT=m
CONFIG_MTK_MDP=m
CONFIG_MTK_MDP_MT6873=m
CONFIG_MTK_PMIC_WRAP=m
CONFIG_MTK_SCPSYS=m
CONFIG_IIO_KFIFO_BUF=m
CONFIG_IIO_TRIGGERED_BUFFER=m
CONFIG_MEDIATEK_MT6360_AUXADC=m
CONFIG_MEDIATEK_MT6360_ADC=m
CONFIG_DEVAPC_MT6873=m
CONFIG_MTK_DEVINFO=m
CONFIG_MTK_DEVMPU=m
CONFIG_MTK_SLBC=m
CONFIG_MTK_CM_MGR=m
CONFIG_MTK_CM_MGR_MT6873=y
CONFIG_ION=y
CONFIG_ION_SYSTEM_HEAP=y
CONFIG_MTK_ION_MM_HEAP=m
CONFIG_MTK_IOMMU=m
CONFIG_MTK_IOMMU_MISC=m
CONFIG_MTK_IOMMU_MISC_DBG=m
CONFIG_DRM_MEDIATEK=m
CONFIG_DRM_MEDIATEK_V2=y
CONFIG_MMPROFILE=m
CONFIG_MTK_MBOX=m
CONFIG_RPMSG_MTK=m
CONFIG_MTK_IPI=m
CONFIG_MTK_TINYSYS_SSPM_SUPPORT=m
CONFIG_MTK_TINYSYS_SSPM_V2=y
CONFIG_DRM_PANEL_TRULY_TD4330_VDO=m
CONFIG_USB_MTU3=m
CONFIG_PHY_MTK_TPHY=m
CONFIG_MTK_TINYSYS_MCUPM_SUPPORT=m
CONFIG_MTK_APUSYS_SUPPORT=m
CONFIG_MTK_APUSYS_MDLA_SUPPORT=y
CONFIG_MTK_VPU_SUPPORT=y
CONFIG_MTK_VPU_SUPPORT_DEBUG=y
CONFIG_MTK_DRAM_LOG_STORE=m
CONFIG_MTK_DRAM_LOG_STORE_ADDR=0x0011DF00
CONFIG_MTK_DRAM_LOG_STORE_SIZE=0x100
CONFIG_MTK_APUSYS_RT_SUPPORT=y
CONFIG_MTK_APUSYS_DEBUG=y
CONFIG_MTK_APUSYS_POWER_MT6873=y
CONFIG_MEDIATEK_MT635X_AUXADC=m
CONFIG_MEDIATEK_MT6577_AUXADC=m
CONFIG_MTPROF=m
CONFIG_MMSTAT_TRACER=m
CONFIG_MTK_DVFSRC=m
CONFIG_REGULATOR_MTK_DVFSRC=m
CONFIG_INTERCONNECT_MTK=y
CONFIG_INTERCONNECT_MTK_EMI=m
CONFIG_MTK_DVFSRC_DEVFREQ=m
CONFIG_MTK_CAMERA_ISP_SUPPORT=y
CONFIG_MTK_CAMERA_ISP_VER="isp6s"
CONFIG_MTK_CAMERA_ISP_PLATFORM="mt6873"
CONFIG_MTK_CAM_TIMESYNC=m
CONFIG_MTK_CAMERA_MEM_SUPPORT=m
CONFIG_MTK_CAMERA_ISP_RAW_SUPPORT=m
CONFIG_MTK_CAMERA_ISP_DPE_SUPPORT=m
CONFIG_MTK_CAMERA_ISP_DIP_SUPPORT=m
CONFIG_EINT_MTK=m
CONFIG_PINCTRL_MT6779=m
CONFIG_MTK_CAMERA_ISP_MFB_SUPPORT=m
CONFIG_MTK_CAMERA_ISP_RSC_SUPPORT=m
CONFIG_MTK_CAMERA_ISP_FD_SUPPORT=m
CONFIG_MTK_CAMERA_ISP_WPE_SUPPORT=m
CONFIG_HAVE_MTK_MC=y
CONFIG_MTK_EMI=m
CONFIG_MTK_EMI_MPU_TEST=m
CONFIG_MTK_DRAMC=m
CONFIG_MTK_MMDVFS=m
CONFIG_HAVE_MTK_ENABLE_GENIEZONE=y
CONFIG_MTK_ENABLE_GENIEZONE=m
CONFIG_MTK_GZ_MAIN=m
CONFIG_MTK_GZ_LOG=m
CONFIG_MTK_GZ_VIRTIO=m
CONFIG_MTK_GZ_VIRTIO_IPC=m
CONFIG_MTK_GZ_IRQ=m
CONFIG_HAVE_MTK_GZ_LOG=y
CONFIG_MTK_GZ_TZ_SYSTEM=m
CONFIG_MTK_DVFSRC_HELPER=m
CONFIG_MTK_DVFSRC_MET_MT6873=m
CONFIG_SND_SOC_TFA9874=m
CONFIG_SND_SOC_MT6873=m
CONFIG_SND_SOC_MT6873_MT6359P=m
CONFIG_SND_SOC_MTK_BTCVSD=m
CONFIG_SND_SOC_MTK_AUDIO_DSP=m
CONFIG_MTK_AUDIODSP_SUPPORT=m
CONFIG_MTK_AUDIO_IPI=m
CONFIG_MTK_LENS=m
CONFIG_MTK_FLASHLIGHT=m
CONFIG_MTK_FLASHLIGHT_PT=y
CONFIG_MTK_FLASHLIGHT_PT_STRICT=y
CONFIG_MTK_FLASHLIGHT_DLPT=y
CONFIG_MTK_V4L2_FLASHLIGHT=m
CONFIG_V4L2_FLASH_LED_CLASS=m
CONFIG_MTK_LOW_POWER_MODULE=m
CONFIG_MTK_LPM_GS_DUMP_SUPPORT=y
CONFIG_MTK_LPM_MODULE_NAME="mt6873"
CONFIG_CPU_IDLE_GOV_MENU=""
CONFIG_CPU_IDLE_GOV_TEO=y
CONFIG_SUSPEND_SKIP_SYNC=y
CONFIG_MTK_PERF_COMMON=m
CONFIG_MTK_PERF_TRACKER=y
CONFIG_CUSTOM_KERNEL_IMGSENSOR="imx586_mipi_raw imx576_mipi_raw imx519_mipi_raw s5k3m5sx_mipi_raw imx481_mipi_raw"
CONFIG_MTK_IMGSENSOR=m
CONFIG_MTK_IMGSENSOR_PLATFORM="mt6873"
CONFIG_MTK_BTIF=m
CONFIG_MTK_COMBO=m
CONFIG_MTK_COMBO_CHIP_CONSYS_6873=y
CONFIG_MTK_COMBO_GPS=m
CONFIG_MTK_GPS_SUPPORT=y
CONFIG_MTK_GPS_EMI=m
CONFIG_MTK_FMRADIO=m
CONFIG_MTK_FM_CHIP="MT6635_FM"
CONFIG_MTK_CONNSYS_DEDICATED_LOG_PATH=y
CONFIG_MTK_CONN_MD=m
CONFIG_INTERCONNECT_MTK_MMQOS_MT6873=m
CONFIG_MTK_CAM_CAL=m
CONFIG_USB_CONFIGFS_ACM=y
CONFIG_RESET_TI_SYSCON=m
CONFIG_MTK_THERMAL=y
CONFIG_MTK_SOC_THERMAL_LVTS=m
CONFIG_MTK_TRUSTED_MEMORY_SUBSYSTEM=m
CONFIG_MTK_PMIC_THERMAL=m
CONFIG_MTK_MD_THERMAL=m
CONFIG_MTK_CHARGER_THERMAL=m
CONFIG_MTK_THERMAL_TRACE=m
CONFIG_MTK_THERMAL_IPI=m
CONFIG_MTK_DBGTOP=m
CONFIG_MTK_AEE_FEATURE=m
CONFIG_MTK_AEE_AED=m
CONFIG_MTK_AEE_HANGDET=m
CONFIG_MTK_AEE_IPANIC=m
CONFIG_STATIC_USERMODEHELPER_PATH="/system_ext/bin/aee_core_forwarder"
CONFIG_SYSCON_REBOOT_MODE=m
CONFIG_TCPC_CLASS=m
CONFIG_TCPC_MT6360=m
CONFIG_MTK_VOW_SUPPORT=m
CONFIG_MTK_VOW_DUAL_MIC_SUPPORT=y
CONFIG_MTK_VOW_MAX_PDK_NUMBER=2
CONFIG_MTK_VOW_BARGE_IN_SUPPORT=y
CONFIG_MTK_VOW_DSP_VERSION="ver02"
CONFIG_USB_POWER_DELIVERY=m
CONFIG_EXTCON_MTK_USB=m
CONFIG_MTK_CCU=m
CONFIG_USB_XHCI_HCD=m
CONFIG_MTK_HANG_DETECT=m
CONFIG_MTK_HANG_DETECT_DB=y
CONFIG_MTK_V4L2_LENS=m
CONFIG_USB_CONFIGFS_F_MTP=m
CONFIG_MTK_AAL_SUPPORT=y
CONFIG_V4L_MEM2MEM_DRIVERS=y
CONFIG_VIDEO_MEDIATEK_JPEG=m
CONFIG_MEDIA_SUPPORT=y
CONFIG_MEDIA_CAMERA_SUPPORT=y
CONFIG_VIDEO_MEDIATEK_VCU=m
CONFIG_VIDEO_MEDIATEK_VCODEC=m
CONFIG_VB2_MEDIATEK_DMA_CONTIG=m
CONFIG_VIDEO_MEDIATEK_VCU_WO_FUSE=y
CONFIG_MTK_CHARGER_TYPE_DETECT=m
CONFIG_MTK_TYPEC_WATER_DETECT=m
CONFIG_MTK_SDA=y
CONFIG_MTK_CACHE_PARITY_CHECK=m
CONFIG_MTK_AMMS=m
CONFIG_BOOTPARAM_SOFTLOCKUP_PANIC=y
CONFIG_MTK_TINYSYS_SCP_SUPPORT=m
CONFIG_MTK_SENSOR_SUPPORT=m
CONFIG_MTK_SENSOR_ARCHITECTURE="2.0"
CONFIG_CUSTOM_KERNEL_SENSORHUB=m
CONFIG_NANOHUB=y
CONFIG_NANOHUB_MTK_IPI=y
CONFIG_MTK_TINYSYS_SCP_VERSION="rv33"
CONFIG_MTK_TINYSYS_SCP_LOGGER_SUPPORT=y
CONFIG_MTK_USB_TYPEC_MUX=m
CONFIG_TYPEC_MUX_FUSB304=m
CONFIG_TYPEC_MUX_PTN36241G=m
CONFIG_MTK_MDDP_SUPPORT=m
CONFIG_MTK_MCIF_WIFI_SUPPORT=y
CONFIG_INCREMENTAL_FS=m
CONFIG_TOUCHSCREEN_MTK_TOUCH="GT9886 GT9896S"
# CONFIG_PINCTRL_MT8167 is not set
# CONFIG_PINCTRL_MT8192 is not set
# CONFIG_PINCTRL_MT8365 is not set
CONFIG_MMC_CQHCI=m
CONFIG_MTK_MET=m
CONFIG_MTK_MET_PLF="mt6873"
CONFIG_MMC_MTK_PRO=m
CONFIG_MMC_AUTOK=m
CONFIG_MMC_DEBUG=m
# CONFIG_ARM64_BTI_KERNEL is not set
```

## arch/arm64/configs/k6893v1_64_defconfig
```kconfig
CONFIG_ARCH_MEDIATEK=y
CONFIG_MTK_CLKBUF=y
CONFIG_MTK_CLKBUF_V1=y
CONFIG_MT6359P_CLKBUF=y
CONFIG_MTK_SRCLKEN_RC_V1=y
CONFIG_MTK_DVFSRC_HELPER=y
CONFIG_MTK_DVFSRC_MET_MT6873=y
CONFIG_MTK_IOMMU_MISC=y
CONFIG_MTK_IOMMU_MISC_DBG=y
CONFIG_MTK_CMDQ_MBOX_EXT=y
CONFIG_MMPROFILE=y
CONFIG_MTK_AEE_FEATURE=y
CONFIG_MTK_AEE_AED=y
CONFIG_MTK_AEE_IPANIC=y
CONFIG_MTK_CCCI_DEVICES=y
CONFIG_MTK_MD1_SUPPORT=25
CONFIG_MTK_ECCCI_DRIVER=y
CONFIG_MTK_ECCCI_C2K=y
CONFIG_MTK_BTIF=y
CONFIG_MTK_COMBO=y
CONFIG_MTK_COMBO_CHIP_CONSYS_6893=y
CONFIG_MTK_COMBO_BT=y
CONFIG_MTK_COMBO_GPS=y
CONFIG_MTK_COMBO_WIFI=y
CONFIG_MTK_DHCPV6C_WIFI=y
CONFIG_MTK_GPS_SUPPORT=y
CONFIG_MTK_GPS_EMI=y
CONFIG_MTK_FMRADIO=y
CONFIG_MTK_FM_CHIP="MT6635_FM"
CONFIG_MTK_CONNSYS_DEDICATED_LOG_PATH=y
CONFIG_TCPC_CLASS=y
CONFIG_USB_POWER_DELIVERY=y
CONFIG_TCPC_MT6360=y
CONFIG_EXTCON_MTK_USB=y
CONFIG_KEYBOARD_MTK_KPD=y
CONFIG_KEYBOARD_MTK_PMIC=y
# CONFIG_PINCTRL_MT2712 is not set
# CONFIG_PINCTRL_MT6797 is not set
CONFIG_PINCTRL_MT6885=y
# CONFIG_PINCTRL_MT7622 is not set
# CONFIG_PINCTRL_MT8173 is not set
# CONFIG_PINCTRL_MT8183 is not set
# CONFIG_PINCTRL_MT8516 is not set
# CONFIG_PINCTRL_MT6397 is not set
CONFIG_SYSCON_REBOOT_MODE=y
CONFIG_MTK_CHARGER_TYPE_DETECT=y
CONFIG_MTK_CHARGER=y
CONFIG_MTK_PUMP_EXPRESS_PLUS_SUPPORT=y
CONFIG_MTK_PUMP_EXPRESS_PLUS_20_SUPPORT=y
CONFIG_MTK_PUMP_EXPRESS_40_SUPPORT=y
CONFIG_MFD_MT6397=y
CONFIG_DRM_MEDIATEK_V2=y
CONFIG_MTK_GPU_SUPPORT=y
CONFIG_MTK_GPU_VERSION="mali valhall r25p0 mt6893"
CONFIG_COMMON_CLK_MT6893=y
CONFIG_COMMON_CLK_MT6893_APU0=y
CONFIG_COMMON_CLK_MT6893_APU1=y
CONFIG_COMMON_CLK_MT6893_APU2=y
CONFIG_COMMON_CLK_MT6893_APU_VCORE=y
CONFIG_COMMON_CLK_MT6893_APU_CONN=y
CONFIG_COMMON_CLK_MT6893_APU_MDLA0=y
CONFIG_COMMON_CLK_MT6893_APU_MDLA1=y
CONFIG_COMMON_CLK_MT6893_AUDIOSYS=y
CONFIG_COMMON_CLK_MT6893_CAMSYS_MAIN=y
CONFIG_COMMON_CLK_MT6893_CAMSYS_RAWA=y
CONFIG_COMMON_CLK_MT6893_CAMSYS_RAWB=y
CONFIG_COMMON_CLK_MT6893_CAMSYS_RAWC=y
CONFIG_COMMON_CLK_MT6893_IMGSYS1=y
CONFIG_COMMON_CLK_MT6893_IMGSYS2=y
CONFIG_COMMON_CLK_MT6893_IMP_IIC_WRAP_C=y
CONFIG_COMMON_CLK_MT6893_IMP_IIC_WRAP_E=y
CONFIG_COMMON_CLK_MT6893_IMP_IIC_WRAP_N=y
CONFIG_COMMON_CLK_MT6893_IMP_IIC_WRAP_S=y
CONFIG_COMMON_CLK_MT6893_IPESYS=y
CONFIG_COMMON_CLK_MT6893_MDPSYS=y
CONFIG_COMMON_CLK_MT6893_MFGCFG=y
CONFIG_COMMON_CLK_MT6893_MMSYS=y
CONFIG_COMMON_CLK_MT6893_SCP_ADSP=y
CONFIG_COMMON_CLK_MT6893_VDECSYS=y
CONFIG_COMMON_CLK_MT6893_VDECSYS_SOC=y
CONFIG_COMMON_CLK_MT6893_VENCSYS_C1=y
CONFIG_COMMON_CLK_MT6893_VENCSYS=y
CONFIG_MTK_IOMMU=y
CONFIG_MTK_CMDQ=y
CONFIG_MTK_DVFSRC=y
CONFIG_MTK_PMIC_WRAP=y
CONFIG_DEVAPC_MT6885=y
CONFIG_RESET_TI_SYSCON=y
CONFIG_PHY_MTK_TPHY=y
```
