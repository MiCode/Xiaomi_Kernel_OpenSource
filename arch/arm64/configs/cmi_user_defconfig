## arch/arm64/configs/k6893v1_64_k510_defconfig
```kconfig
CONFIG_BUILD_CONFIG_FILE="build.config.mtk.aarch64"
CONFIG_ARCH_MEDIATEK=y
CONFIG_MTK_CLKBUF=m
CONFIG_MTK_CLKBUF_V1=y
CONFIG_MTK_SRCLKEN_RC_V1=y
CONFIG_MTK_DVFSRC_HELPER=m
CONFIG_MTK_DVFSRC_MET_MT6873=m
CONFIG_DMABUF_HEAPS_MTK_MM=m
CONFIG_DMABUF_HEAPS_SYSTEM=m
CONFIG_DMABUF_HEAPS_DEBUG=m
CONFIG_MTK_BATTERY_OC_POWER_THROTTLING=m
CONFIG_MTK_LOW_BATTERY_POWER_THROTTLING=m
CONFIG_MTK_IOMMU_MISC=m
CONFIG_MTK_IOMMU_MISC_DBG=m
CONFIG_MTK_IOMMU_MISC_TEST=m
CONFIG_MTK_IOMMU_MISC_SECURE=m
CONFIG_MTK_CMDQ_MBOX_EXT=m
CONFIG_MTK_MDP=m
CONFIG_MTK_MDP_MT6893=m
CONFIG_MMPROFILE=m
CONFIG_MTK_TRUSTED_MEMORY_SUBSYSTEM=m
CONFIG_HAVE_MTK_ENABLE_GENIEZONE=y
CONFIG_MTK_ENABLE_GENIEZONE=m
CONFIG_MTK_GZ_MAIN=m
CONFIG_MTK_GZ_LOG=m
CONFIG_MTK_GZ_VIRTIO=m
CONFIG_MTK_GZ_VIRTIO_IPC=m
CONFIG_MTK_GZ_IRQ=m
CONFIG_MTK_GZ_TZ_SYSTEM=m
CONFIG_HAVE_MTK_GZ_LOG=y
CONFIG_MTK_APUSYS_SUPPORT=m
CONFIG_MTK_APUSYS_DEBUG=y
CONFIG_MTK_APUSYS_RT_SUPPORT=y
CONFIG_MTK_APUSYS_MDLA_SUPPORT=y
CONFIG_MTK_VPU_SUPPORT=y
CONFIG_MTK_APUSYS_VPU_DEBUG=y
CONFIG_MTK_APUSYS_EDMA_SUPPORT=y
CONFIG_MTK_AEE_FEATURE=m
CONFIG_MTK_AEE_AED=m
CONFIG_MTK_AEE_IPANIC=m
CONFIG_MTK_DRAM_LOG_STORE=m
CONFIG_MTK_DRAM_LOG_STORE_ADDR=0x0011DF00
CONFIG_MTK_DRAM_LOG_STORE_SIZE=0x100
CONFIG_MTPROF=m
CONFIG_MTK_CCCI_DEVICES=y
CONFIG_MTK_MD1_SUPPORT=25
CONFIG_MTK_ECCCI_DRIVER=m
CONFIG_MTK_ECCCI_C2K=y
CONFIG_MTK_ECCCI_C2K_USB=m
CONFIG_MTK_BTIF=m
CONFIG_MTK_COMBO=m
CONFIG_MTK_COMBO_CHIP_CONSYS_6893=y
CONFIG_MTK_COMBO_BT=m
CONFIG_MTK_COMBO_GPS=m
CONFIG_MTK_COMBO_WIFI=m
CONFIG_MTK_DHCPV6C_WIFI=y
# CONFIG_MTK_CONN_LTE_IDC_SUPPORT is not set
CONFIG_MTK_GPS_SUPPORT=y
CONFIG_MTK_GPS_EMI=m
CONFIG_MTK_FMRADIO=m
CONFIG_MTK_FM_CHIP="MT6635_FM"
CONFIG_MTK_CONNSYS_DEDICATED_LOG_PATH=y
CONFIG_TCPC_CLASS=m
CONFIG_USB_POWER_DELIVERY=m
CONFIG_TCPC_MT6360=m
CONFIG_EXTCON_MTK_USB=m
CONFIG_SCSI_UFS_MEDIATEK=m
CONFIG_SCSI_UFS_MEDIATEK_DBG=m
CONFIG_KEYBOARD_MTK_KPD=m
CONFIG_KEYBOARD_MTK_PMIC=m
CONFIG_TOUCHSCREEN_MTK_TOUCH="GT9896S"
CONFIG_SERIAL_8250_MT6577=m
CONFIG_I2C_MT65XX=m
CONFIG_SPI_MT65XX=m
CONFIG_SPMI_MTK_PMIF=m
# CONFIG_PINCTRL_MT2712 is not set
# CONFIG_PINCTRL_MT6797 is not set
# CONFIG_PINCTRL_MT6779 is not set
CONFIG_PINCTRL_MT6885=m
# CONFIG_PINCTRL_MT6983 is not set
# CONFIG_PINCTRL_MT7622 is not set
# CONFIG_PINCTRL_MT8167 is not set
# CONFIG_PINCTRL_MT8173 is not set
# CONFIG_PINCTRL_MT8183 is not set
# CONFIG_PINCTRL_MT8192 is not set
# CONFIG_PINCTRL_MT8516 is not set
# CONFIG_PINCTRL_MT6397 is not set
CONFIG_HAVE_MTK_MC=y
CONFIG_MTK_DRAMC=m
CONFIG_MTK_EMI=m
CONFIG_SYSCON_REBOOT_MODE=m
CONFIG_CHARGER_MT6360=m
CONFIG_MTK_CHARGER_TYPE_DETECT=m
CONFIG_MTK_CHARGER=m
CONFIG_MTK_PERF_COMMON=m
CONFIG_MTK_PERF_TRACKER=y
CONFIG_MTK_GPU_SWPM_SUPPORT=y
CONFIG_MTK_PUMP_EXPRESS_PLUS_SUPPORT=m
CONFIG_MTK_PUMP_EXPRESS_PLUS_20_SUPPORT=m
CONFIG_MTK_PUMP_EXPRESS_40_SUPPORT=m
CONFIG_MTK_TASK_TURBO=m
CONFIG_MTK_THERMAL=y
CONFIG_MTK_SOC_THERMAL_LVTS=m
CONFIG_MTK_PMIC_THERMAL=m
CONFIG_MTK_MD_THERMAL=m
CONFIG_MTK_THERMAL_TRACE=m
CONFIG_GENERIC_ADC_THERMAL=m
CONFIG_MEDIATEK_WATCHDOG=m
CONFIG_MFD_MT6360=m
CONFIG_MFD_MT6397=m
CONFIG_MFD_MTK_SPMI_PMIC=m
CONFIG_REGULATOR_MT6315=m
CONFIG_REGULATOR_MT6359P=m
CONFIG_REGULATOR_MT6360=m
CONFIG_REGULATOR_MTK_DVFSRC=m
CONFIG_DRM_PANEL_TRULY_TD4330_VDO=m
CONFIG_DRM_PANEL_TRULY_FT8756_VDO=m
CONFIG_DRM_MEDIATEK=m
CONFIG_DRM_MEDIATEK_V2=y
CONFIG_MTK_GPU_SUPPORT=m
CONFIG_MTK_GPU_MT6893_SUPPORT=m
CONFIG_MTK_GPUFREQ_V2=y
CONFIG_MTK_GPU_COMMON_DVFS_SUPPORT=y
CONFIG_MTK_GPU_VERSION="mali valhall r30p0 mt6893"
CONFIG_MTK_TINYSYS_GPUEB_SUPPORT=m
CONFIG_CUSTOM_KERNEL_IMGSENSOR="s5kjd1_mipi_raw imx519_mipi_raw imx586_mipi_raw imx576_mipi_raw imx481_mipi_raw s5k3m5sx_mipi_raw"
CONFIG_MTK_IMGSENSOR=m
CONFIG_MTK_IMGSENSOR_PLATFORM="mt6893"
CONFIG_MTK_SECURITY_SW_SUPPORT=m
CONFIG_SND_SOC_MT6885=m
CONFIG_SND_SOC_MT6885_MT6359P=m
CONFIG_SND_SOC_MTK_BTCVSD=m
CONFIG_SND_SOC_TFA9874=m
CONFIG_USB_MTU3=m
CONFIG_MTK_AAL_SUPPORT=y
CONFIG_LEDS_MTK_PWM=m
CONFIG_LEDS_PWM=m
CONFIG_LEDS_REGULATOR_VIBRATOR=m
CONFIG_LEDS_MT6360=m
CONFIG_MTK_FLASHLIGHT=m
CONFIG_MTK_V4L2_FLASHLIGHT=m
CONFIG_V4L2_FLASH_LED_CLASS=m
CONFIG_RTC_DRV_MT6397=m
CONFIG_MTK_UART_APDMA=m
CONFIG_COMMON_CLK_MT6893=m
CONFIG_COMMON_CLK_MT6893_APU0=m
CONFIG_COMMON_CLK_MT6893_APU1=m
CONFIG_COMMON_CLK_MT6893_APU2=m
CONFIG_COMMON_CLK_MT6893_APU_VCORE=m
CONFIG_COMMON_CLK_MT6893_APU_CONN=m
CONFIG_COMMON_CLK_MT6893_APU_MDLA0=m
CONFIG_COMMON_CLK_MT6893_APU_MDLA1=m
CONFIG_COMMON_CLK_MT6893_AUDIOSYS=m
CONFIG_COMMON_CLK_MT6893_CAMSYS_MAIN=m
CONFIG_COMMON_CLK_MT6893_CAMSYS_RAWA=m
CONFIG_COMMON_CLK_MT6893_CAMSYS_RAWB=m
CONFIG_COMMON_CLK_MT6893_CAMSYS_RAWC=m
CONFIG_COMMON_CLK_MT6893_IMGSYS1=m
CONFIG_COMMON_CLK_MT6893_IMGSYS2=m
CONFIG_COMMON_CLK_MT6893_IMP_IIC_WRAP_C=m
CONFIG_COMMON_CLK_MT6893_IMP_IIC_WRAP_E=m
CONFIG_COMMON_CLK_MT6893_IMP_IIC_WRAP_N=m
CONFIG_COMMON_CLK_MT6893_IMP_IIC_WRAP_S=m
CONFIG_COMMON_CLK_MT6893_IPESYS=m
CONFIG_COMMON_CLK_MT6893_MDPSYS=m
CONFIG_COMMON_CLK_MT6893_MFGCFG=m
CONFIG_COMMON_CLK_MT6893_MMSYS=m
CONFIG_COMMON_CLK_MT6893_SCP_ADSP=m
CONFIG_COMMON_CLK_MT6893_VDECSYS=m
CONFIG_COMMON_CLK_MT6893_VDECSYS_SOC=m
CONFIG_COMMON_CLK_MT6893_VENCSYS_C1=m
CONFIG_COMMON_CLK_MT6893_VENCSYS=m
CONFIG_MTK_IOMMU=m
CONFIG_MTK_DVFSRC=m
CONFIG_MTK_PMIC_WRAP=m
CONFIG_MTK_SCHEDULER=m
CONFIG_MTK_OPP_CAP_INFO=y
CONFIG_NONLINEAR_FREQ_CTL=y
CONFIG_MTK_EAS=y
CONFIG_MTK_THERMAL_AWARE_SCHEDULING=y
CONFIG_MTK_LEAKAGE_AWARE_TEMP=y
CONFIG_MTK_NEWIDLE_BALANCE=y
CONFIG_MTK_CORE_PAUSE=y
CONFIG_MTK_CORE_CTL=m
CONFIG_MTK_SCHED_BIG_TASK_ROTATE=y
CONFIG_MTK_CPUFREQ_SUGOV_EXT=m
CONFIG_MTK_OPP_MIN=y
CONFIG_MTK_SCPSYS=m
CONFIG_MTK_IPI=m
CONFIG_MTK_MBOX=m
CONFIG_RPMSG_MTK=m
CONFIG_MTK_TINYSYS_SCP_SUPPORT=m
CONFIG_MTK_TINYSYS_SCP_LOGGER_SUPPORT=y
CONFIG_MTK_TINYSYS_VCP_SUPPORT=m
CONFIG_DEVAPC_MT6893=m
CONFIG_HW_RANDOM_SECURE=m
CONFIG_MTK_DVFSRC_DEVFREQ=m
CONFIG_MEDIATEK_MT635X_AUXADC=m
CONFIG_MEDIATEK_MT6360_AUXADC=m
CONFIG_MEDIATEK_MT6577_AUXADC=m
CONFIG_PWM_MTK_DISP=m
CONFIG_RESET_TI_SYSCON=m
CONFIG_PHY_MTK_TPHY=m
CONFIG_MTK_DEVINFO=m
CONFIG_MT635X_EFUSE=m
CONFIG_INTERCONNECT_MTK=y
CONFIG_INTERCONNECT_MTK_EMI=m
CONFIG_MTK_MDDP_SUPPORT=m
CONFIG_MTK_PRINTK_UART_CONSOLE=y
CONFIG_MTK_PRINTK=m
CONFIG_MTK_CAMERA_ISP_PLATFORM="mt6893"
CONFIG_MTK_CAM_TIMESYNC=m
CONFIG_MTK_CAMERA_MEM_SUPPORT=m
CONFIG_MTK_CAMERA_ISP_RAW_SUPPORT=m
CONFIG_MTK_CAMERA_ISP_SUPPORT=m
CONFIG_MTK_CAMERA_MFB_ISP6S=m
CONFIG_MTK_CAMERA_WPE_ISP6S=m
CONFIG_MTK_CAMERA_DPE_ISP6S=m
CONFIG_MTK_CAMERA_RSC_ISP6S=m
CONFIG_MTK_CAMERA_FD_ISP6S=m
CONFIG_MTK_CAMERA_DIP_ISP6S=m
CONFIG_MTK_CAMERA_DUAL_DIP_ISP6S=m
CONFIG_MTK_CCU=m
CONFIG_MTK_LENS=m
CONFIG_MTK_LOW_POWER_MODULE=m
CONFIG_MTK_LPM_MT6893=m
CONFIG_MTK_PMSR=m
CONFIG_MTK_SWPM_PERF_ARMV8_PMU=m
CONFIG_MTK_SWPM_MODULE=m
CONFIG_MTK_SWPM_MT6893=m
CONFIG_MTK_SLBC=m
CONFIG_MTK_SLBC_MT6893=m
CONFIG_MTK_SLBC_IPI=m
CONFIG_MTK_SLBC_MMSRAM=m
CONFIG_INTERCONNECT_MTK_MMQOS_MT6893=m
CONFIG_MTK_MMDVFS=m
CONFIG_MTK_MMSYS=m
CONFIG_ZSMALLOC=m
CONFIG_ZRAM=m
CONFIG_MTK_TINYSYS_MCUPM_SUPPORT=m
CONFIG_MTK_SENSOR_SUPPORT=m
CONFIG_MTK_SENSORHUB=m
CONFIG_MTK_CM_MGR=m
CONFIG_MTK_CM_IPI=m
CONFIG_MTK_CM_MGR_MT6893=m
CONFIG_MTK_QOS_FRAMEWORK=m
CONFIG_MTK_QOS_MT6893=y
CONFIG_MMC_MTK=m
CONFIG_MMC_MTK_PRO=m
CONFIG_MMC_CQHCI=m
CONFIG_MMC_AUTOK=m
CONFIG_MMC_DEBUG=m
CONFIG_MTK_FPSGO_V3=m
CONFIG_MTK_PERFORMANCE_MODULE=m
CONFIG_MTK_ATF_LOGGER=m
CONFIG_VIDEO_MEDIATEK_VCODEC=m
CONFIG_VIDEO_MEDIATEK_VCODEC_V2=y
CONFIG_VIDEO_MEDIATEK_VCU=m
CONFIG_VB2_MEDIATEK_CONTING=m
CONFIG_MTK_SOCINFO=m
CONFIG_ARM_DSU_PMU=m
CONFIG_MTK_CAM_CAL=m
CONFIG_MTK_DBGTOP=m
CONFIG_MTK_HANG_DETECT=m
CONFIG_MTK_HANG_DETECT_DB=y
CONFIG_MTK_JPEG=m
CONFIG_MTK_SDA=y
CONFIG_MTK_IRQ_DBG=m
CONFIG_MTK_CQDMA=m
```
