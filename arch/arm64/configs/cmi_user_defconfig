## arch/arm64/configs/k62v1_64_bsp_k510_defconfig
```kconfig
CONFIG_BUILD_CONFIG_FILE="build.config.mtk.aarch64"
CONFIG_ABI_MONITOR=y
CONFIG_ARCH_MEDIATEK=y
CONFIG_MTK_AEE_FEATURE=m
CONFIG_MTK_AEE_AED=m
CONFIG_MTK_AEE_HANGDET=m
CONFIG_MTK_AEE_IPANIC=m
CONFIG_MTK_ATF_LOGGER=m
CONFIG_MTK_HANG_DETECT=m
CONFIG_MTK_HANG_DETECT_DB=y
CONFIG_MTK_IOMMU=m
CONFIG_DMABUF_HEAPS_MTK_MM=m
CONFIG_DMABUF_HEAPS_SYSTEM=m
CONFIG_DMABUF_HEAPS_DEBUG=m
CONFIG_MTK_IOMMU_MISC=m
CONFIG_MTK_IOMMU_MISC_DBG=m
CONFIG_MTK_IOMMU_MISC_TEST=m
CONFIG_MTK_IOMMU_MISC_SECURE=m
CONFIG_PWM_MTK_DISP=m
CONFIG_LEDS_MTK=m
CONFIG_LEDS_MTK_DISP=m
CONFIG_LEDS_MTK_PWM=m
CONFIG_LEDS_MT6370_FLASH=m
CONFIG_LEDS_REGULATOR_VIBRATOR=m
CONFIG_MEDIATEK_WATCHDOG=m
CONFIG_RTC_DRV_MT6397=m
CONFIG_SERIAL_8250_MT6577=m
CONFIG_SND_SOC_RT5509=m
CONFIG_MTK_UART_APDMA=m
CONFIG_MTK_PLAT_POWER_MT6765=m
CONFIG_MTK_HPS_V3=m
CONFIG_MEDIATEK_CPUIDLE=m
CONFIG_MEDIATEK_MCDI=m
CONFIG_MTK_PTPOD_LEGACY=m
CONFIG_MTK_BATTERY_OC_POWER_THROTTLING=m
CONFIG_MTK_BATTERY_PERCENT_THROTTLING=m
CONFIG_MTK_DYNAMIC_LOADING_POWER_THROTTLING=m
CONFIG_MTK_LOW_BATTERY_POWER_THROTTLING=m
CONFIG_MTK_MD_POWER_THROTTLING=m
CONFIG_MTK_CPU_POWER_THROTTLING=m
CONFIG_PMIC_LBAT_SERVICE=m
CONFIG_MTK_MDPM_LEGACY=m
CONFIG_MTK_PBM=m
CONFIG_MTK_STATIC_POWER_LEGACY=m
CONFIG_MTK_UNIFIED_POWER=m
CONFIG_MTK_PPM_V3=m
CONFIG_MTPROF=m
CONFIG_THERMAL=y
CONFIG_THERMAL_DEFAULT_GOV_BACKWARD_COMPATIBLE=y
CONFIG_MTK_LEGACY_THERMAL=m
CONFIG_MTK_THERMAL_PA_VIA_ATCMD=y
CONFIG_MTK_LEGACY_THERMAL_PLATFORM="mt6765"
CONFIG_MTK_SDA=y
CONFIG_MTK_IRQ_DBG_LEGACY=m
CONFIG_MTK_BTIF=m
CONFIG_MTK_COMBO=m
CONFIG_MTK_COMBO_CHIP_CONSYS_6765=y
CONFIG_MTK_COMBO_GPS=m
CONFIG_MTK_GPS_SUPPORT=y
CONFIG_MTK_GPS_EMI=m
CONFIG_MTK_FMRADIO=m
CONFIG_MTK_FM_CHIP="MT6631_FM"
CONFIG_MTK_CONNSYS_DEDICATED_LOG_PATH=y
CONFIG_TOUCHSCREEN_MTK_TOUCH="GT1151"
CONFIG_HW_RANDOM_SECURE=m
# CONFIG_MTK_CONN_LTE_IDC_SUPPORT is not set
# CONFIG_HW_RANDOM_MTK is not set
# CONFIG_MST_IRQ is not set
# CONFIG_PINCTRL_MT2712 is not set
# CONFIG_PINCTRL_MT6797 is not set
# CONFIG_PINCTRL_MT6779 is not set
# CONFIG_PINCTRL_MT7622 is not set
# CONFIG_PINCTRL_MT8167 is not set
# CONFIG_PINCTRL_MT8173 is not set
# CONFIG_PINCTRL_MT8183 is not set
# CONFIG_PINCTRL_MT8192 is not set
# CONFIG_PINCTRL_MT8516 is not set
# CONFIG_PINCTRL_MT6397 is not set
CONFIG_INTERCONNECT_MTK=y
CONFIG_INTERCONNECT_MTK_MMQOS_MT6765=m
CONFIG_PINCTRL_MT6765=m
CONFIG_I2C_MT65XX=m
CONFIG_EINT_MTK=m
CONFIG_MTK_PMIC_WRAP=m
CONFIG_MEDIATEK_CPU_DVFS=m
CONFIG_MEDIATEK_CPU_DVFS_MT6765=m
CONFIG_MFD_MT6370=m
CONFIG_MT6370_DBG=m
CONFIG_BACKLIGHT_MT6370=m
CONFIG_MTK_SUBPMIC_MISC=m
CONFIG_MFD_MT6397=m
CONFIG_MTK_SPM_V0=m
CONFIG_MTK_POWER_GS_LEGACY_V2=m
CONFIG_BATTERY_MT6357=m
CONFIG_REGULATOR_MT6357=m
CONFIG_MEDIATEK_MT635X_AUXADC=m
CONFIG_MEDIATEK_MT6370_ADC=m
CONFIG_MEMORY=y
CONFIG_HAVE_MTK_MC=y
CONFIG_MTK_EMI_LEGACY=m
CONFIG_MTK_EMI_BWL_VERSION=1
CONFIG_MTK_CM_MGR=m
CONFIG_MTK_CM_MGR_MT6765=m
CONFIG_MTK_DRAMC=m
CONFIG_MMSTAT_TRACER=m
CONFIG_REGULATOR_MT6370=m
CONFIG_COMMON_CLK_MT6765=m
CONFIG_COMMON_CLK_PG_LEGACY_V1=m
CONFIG_CHARGER_TYPE_MT6357=m
CONFIG_CHARGER_MT6370=m
CONFIG_CHARGER_RT9465=m
CONFIG_MTK_CHARGER=m
CONFIG_MTK_PUMP_EXPRESS_PLUS_20_SUPPORT=m
CONFIG_MTK_PUMP_EXPRESS_40_SUPPORT=m
CONFIG_MTK_PUMP_EXPRESS_50_SUPPORT=m
CONFIG_MTK_PUMP_EXPRESS_PLUS_SUPPORT=m
CONFIG_USB_POWER_DELIVERY=m
CONFIG_TCPC_CLASS=m
CONFIG_MTK_CHARGER_TYPE_DETECT=m
CONFIG_MT6357_DO_CTD=y
CONFIG_MT635X_EFUSE=m
CONFIG_MTK_SCPSYS=m
CONFIG_MTK_IPI=m
CONFIG_MTK_MBOX=m
CONFIG_RPMSG_MTK=m
CONFIG_MTK_TINYSYS_SSPM_SUPPORT=m
CONFIG_MTK_TINYSYS_SSPM_V0=y
CONFIG_MTK_CLKBUF=m
CONFIG_MTK_CLKBUF_V1=y
CONFIG_MEDIATEK_DCM_COMMON=y
CONFIG_MEDIATEK_DCM_V1=m
CONFIG_MMC_MTK_PRO=m
CONFIG_MMC_MTK_SW_CQHCI=m
CONFIG_MMC_CQHCI=m
CONFIG_MMC_AUTOK=m
CONFIG_MMC_DEBUG=m
CONFIG_MTK_BLOCK_IO_TRACER=m
CONFIG_MTK_CMDQ_MBOX_EXT=m
CONFIG_MMPROFILE=m
CONFIG_TEE=m
CONFIG_TEE_PERF_SUPPORT=m
CONFIG_TRUSTONIC_TEE_SUPPORT=m
CONFIG_MICROTRUST_TEE_SUPPORT=m
CONFIG_MICROTRUST_TEE_K_IOCTL=y
CONFIG_MTK_TEE_GP_SUPPORT=y
CONFIG_MTK_TEE_GP_COORDINATOR=m
CONFIG_MTK_TEE_GP_TESTS=m
CONFIG_TRUSTONIC_TEE_VERSION="500"
CONFIG_HAVE_MTK_ENABLE_GENIEZONE=y
CONFIG_MTK_ENABLE_GENIEZONE=m
CONFIG_MTK_GZ_MAIN=m
CONFIG_MTK_GZ_LOG=m
CONFIG_MTK_GZ_VIRTIO=m
CONFIG_MTK_GZ_VIRTIO_IPC=m
CONFIG_MTK_GZ_IRQ=m
CONFIG_MTK_GZ_TZ_SYSTEM=m
CONFIG_HAVE_MTK_GZ_LOG=y
CONFIG_MTK_TRUSTED_MEMORY_SUBSYSTEM=m
CONFIG_MTK_MDP=m
CONFIG_MTK_MDP_MTEE_SUPPORT=m
CONFIG_MTK_RECU_FENCE_LOCK=y
CONFIG_NVMEM=y
CONFIG_MTK_SCHEDULER=m
CONFIG_COMMON_CLK_MTK_FREQ_HOPPING=m
CONFIG_COMMON_CLK_MTK_FREQ_HOPPING_SSPM=y
CONFIG_MTK_OPP_CAP_INFO=y
CONFIG_NONLINEAR_FREQ_CTL=y
CONFIG_MTK_EAS=y
CONFIG_MTK_NEWIDLE_BALANCE=y
CONFIG_MTK_CORE_PAUSE=y
CONFIG_MTK_CORE_CTL=m
CONFIG_MTK_SCHED_BIG_TASK_ROTATE=y
CONFIG_RPMB=m
CONFIG_MTK_CPUFREQ_SUGOV_EXT=m
CONFIG_MTK_DEVINFO=m
CONFIG_MEDIATEK_MT6577_AUXADC=m
CONFIG_MTK_SOCINFO=m
CONFIG_MTK_MMDVFS=m
CONFIG_MTK_VIDEOCODEC_DRIVER=m
CONFIG_MTK_VIDEOCODEC_IPM_V1=y
CONFIG_VIDEO_MEDIATEK_JPEG=m
CONFIG_MTK_MMSYS=m
CONFIG_MTK_AMMS=m
CONFIG_REBOOT_MODE=m
CONFIG_SYSCON_REBOOT_MODE=m
CONFIG_RESET_TI_SYSCON=m
CONFIG_SPI_MT65XX=m
CONFIG_MTK_PWM=m
CONFIG_KEYBOARD_MTK_KPD=m
CONFIG_KEYBOARD_MTK_PMIC=m
CONFIG_EXTCON_MTK_USB=m
CONFIG_MTK_MUSB_DRV_36BIT=y
CONFIG_MTK_MUSB_DUAL_ROLE=y
CONFIG_MTK_MUSB_QMU_SUPPORT=y
CONFIG_MTK_MUSB_QMU_PURE_ZLP_SUPPORT=y
CONFIG_MTK_USB_BOOST=m
CONFIG_MTK_USB_META=m
CONFIG_NOP_USB_XCEIV=m
CONFIG_PHY_MTK_TPHY=m
CONFIG_USB_MTK_HDRC=m
CONFIG_USB_MTK_OTG=y
CONFIG_TCPC_MT6370=m
CONFIG_MTK_GPU_SUPPORT=m
CONFIG_MTK_GPU_MT6765_SUPPORT=m
CONFIG_MTK_GPUFREQ_V2=y
CONFIG_MTK_GPU_COMMON_DVFS_SUPPORT=y
CONFIG_MTK_SECURITY_SW_SUPPORT=m
CONFIG_MTK_TINYSYS_SCP_SUPPORT=m
CONFIG_MTK_TINYSYS_SCP_CM4_SUPPORT=y
CONFIG_MTK_TINYSYS_SCP_LOGGER_SUPPORT=y
CONFIG_DRM_MEDIATEK=m
CONFIG_DRM_MEDIATEK_V2=y
CONFIG_MTK_MML_LEGACY=m
CONFIG_DRM_PANEL_NOVATEK_NT35695B_VDO=m
CONFIG_MTK_DVFSRC_HELPER=m
CONFIG_MTK_DVFSRC_MET_MT6765=m
CONFIG_INTERCONNECT_MTK_EMI=m
CONFIG_REGULATOR_MTK_DVFSRC=m
CONFIG_MTK_DVFSRC=m
CONFIG_MTK_DVFSRC_DEVFREQ=m
CONFIG_MTK_QOS_LEGACY=y
CONFIG_MTK_QOS_FRAMEWORK=m
CONFIG_MTK_PERFORMANCE_MODULE=m
CONFIG_MTK_PERF_COMMON=m
CONFIG_MTK_PERF_TRACKER=y
CONFIG_MTK_LOAD_TRACKER=m
CONFIG_MTK_FPSGO_V3=m


CONFIG_CFG80211=m
CONFIG_NL80211_TESTMODE=y
CONFIG_MAC80211=m

CONFIG_EXT_MODULES="../vendor/mediatek/kernel_modules/connectivity/common ../vendor/mediatek/kernel_modules/connectivity/gps/gps_stp ../vendor/mediatek/kernel_modules/gpu/platform/mt6765/ ../vendor/mediatek/kernel_modules/connectivity/fmradio"
CONFIG_SND_SOC_MTK_BTCVSD=m
CONFIG_MTK_SND_SOC_NEW_ARCH=y
CONFIG_MTK_SND_SOC_NEW_ARCH_COMMON=m
CONFIG_SND_SOC_CODEC_MT6357=m
CONFIG_SND_SOC_MT6765=m
CONFIG_ZSMALLOC=m
CONFIG_ZRAM=m
CONFIG_SND_SOC_MT6357_ACCDET=m
CONFIG_CUSTOM_KERNEL_IMGSENSOR="imx230_mipi_raw s5k2t7sp_mipi_raw s5k2p7_mipi_raw ov8856_mipi_raw imx386_mipi_raw s5k3m3_mipi_raw imx398_mipi_raw imx338_mipi_raw s5k2l7_mipi_raw"
CONFIG_MTK_IMGSENSOR_ISP4_C=m
CONFIG_MTK_CAM_CAL_ISP4_C=m
CONFIG_MTK_SENSOR_SUPPORT=m
CONFIG_MTK_SENSOR_ARCHITECTURE="1.0"
CONFIG_CUSTOM_KERNEL_ACCELEROMETER=y
CONFIG_MTK_ACCELHUB=y
CONFIG_CUSTOM_KERNEL_ALSPS=y
CONFIG_MTK_ALSPSHUB=y
CONFIG_CUSTOM_KERNEL_MAGNETOMETER=y
CONFIG_MTK_MAGHUB=y
CONFIG_MTK_HWMON=y
CONFIG_CUSTOM_KERNEL_BAROMETER=y
CONFIG_MTK_BAROHUB=y
CONFIG_CUSTOM_KERNEL_STEP_COUNTER=y
CONFIG_MTK_STEPSIGNHUB=y
CONFIG_CUSTOM_KERNEL_SITUATION=y
CONFIG_MTK_STATHUB=y
CONFIG_MTK_WAKEHUB=y
CONFIG_MTK_GLGHUB=y
CONFIG_MTK_PICKUPHUB=y
CONFIG_MTK_DEVICE_ORIENTATION_HUB=y
CONFIG_MTK_TILTDETECTHUB=y
CONFIG_CUSTOM_KERNEL_SENSORHUB=y
CONFIG_NANOHUB=y
CONFIG_NANOHUB_MTK_IPI=y
CONFIG_DEVAPC_MT6765=m
CONFIG_MTK_WIDEVINE_DRM=m
CONFIG_MTK_CCU=m
CONFIG_MTK_FLASHLIGHT=m
CONFIG_MTK_FLASHLIGHT_PT=y
CONFIG_MTK_FLASHLIGHT_PT_STRICT=y
CONFIG_MTK_FLASHLIGHT_DLPT=y
CONFIG_MTK_V4L2_FLASHLIGHT=m
CONFIG_V4L2_FLASH_LED_CLASS=m
CONFIG_MTK_LENS=m
CONFIG_MTK_V4L2_LENS=m
CONFIG_MTK_CAM_TIMESYNC=m
CONFIG_MTK_CAMERA_MEM_SUPPORT=m
CONFIG_MTK_CAMERA_ISP_RAW_SUPPORT=m
CONFIG_MTK_CAMERA_ISP_RAW_SUPPORT_ISP4_C=m
CONFIG_MTK_CAMERA_ISP_SUPPORT=m
CONFIG_MTK_CAMERA_FD_VERSION40=m
CONFIG_MTK_CCCI_DEVICES=y
CONFIG_MTK_MD1_SUPPORT=25
CONFIG_MTK_ECCCI_DRIVER=m
CONFIG_MTK_ECCCI_C2K_USB=m
CONFIG_MTK_CAMERA_DPE_ISP40=m
CONFIG_KRETPROBES=y
CONFIG_KALLSYMS_ALL=y
CONFIG_KALLSYMS=y
CONFIG_KPROBES=y
CONFIG_MTK_MET=m
CONFIG_MTK_USB_CONFIGFS_RNDIS=m
CONFIG_USB_NET_AX88179_178A=m
CONFIG_USB_NET_AX8817X=m
CONFIG_MTK_ECCCI_C2K=y
CONFIG_MTK_FB_MMDVFS_SUPPORT=y
CONFIG_MTK_SMI_BWC=m
CONFIG_MTK_SMI_BWC_MT6765=m
CONFIG_MTK_ORIENTHUB=y
CONFIG_MTK_ROTATVECHUB=y
CONFIG_CUSTOM_KERNEL_SENSOR_FUSION=y
CONFIG_MTK_GMAGROTVECHUB=y
CONFIG_MTK_GRAVITYHUB=y
CONFIG_MTK_GAMEROTVECHUB=y
CONFIG_MTK_UNCALI_ACCHUB=y
CONFIG_MTK_MOTION_DETECT_HUB=y
CONFIG_MTK_UNCALI_GYROHUB=y
CONFIG_MTK_UNCALI_MAGHUB=y
CONFIG_MTK_LINEARACCHUB=y
```
