## arch/arm/mach-msm/Kconfig
```kconfig
if ARCH_MSM
menu "MSM SoC Type"
config ARCH_MDM9640
	bool "MDM9640"
	select ARM_GIC
	select CPU_V7
	select REGULATOR
	select REGULATOR_RPM_SMD
	select HAVE_ARM_ARCH_TIMER
	select MSM_RPM_SMD
	select MSM_SPM
	select MSM_PM if PM
	select MEMORY_HOLE_CARVEOUT
	select QMI_ENCDEC
	select MSM_CORTEX_A7
	select PINCTRL
	select PINCTRL_MSM_TLMM
	select USE_PINCTRL_IRQ
	select PCI
	select MSM_IRQ
	select MSM_JTAG_MM if CORESIGHT_ETM
	select MSM_CLK_CONTROLLER_V2
	select PM_DEVFREQ
	select MSM_DEVFREQ_DEVBW
	select MSM_RPM_LOG
	select MSM_RPM_STATS_LOG

config ARCH_MDM9607
       bool "MDM9607"
       select ARM_GIC
       select CPU_V7
       select REGULATOR
       select REGULATOR_RPM_SMD
       select HAVE_ARM_ARCH_TIMER
       select MSM_RPM_SMD
       select MEMORY_HOLE_CARVEOUT
       select MSM_CORTEX_A7
       select PINCTRL
       select PINCTRL_MSM_TLMM
       select USE_PINCTRL_IRQ
       select MSM_IRQ
       select MSM_PM if PM
       select PM_DEVFREQ
       select MSM_DEVFREQ_DEVBW
       select MSM_BIMC_BWMON
       select DEVFREQ_GOV_MSM_BW_HWMON

config ARCH_MDMCALIFORNIUM
	bool "MDMCALIFORNIUM"
	select ARM_GIC
	select CPU_V7
	select REGULATOR
	select REGULATOR_RPM_SMD
	select HAVE_ARM_ARCH_TIMER
	select MSM_RPM_SMD
	select MSM_SPM
	select MSM_PM if PM
	select QMI_ENCDEC
	select MSM_CORTEX_A7
	select PINCTRL
	select PINCTRL_MSM_TLMM
	select USE_PINCTRL_IRQ
	select PCI
	select MSM_IRQ
	select MSM_JTAG_MM if CORESIGHT_ETM
	select MSM_CLK_CONTROLLER_V2
	select PM_DEVFREQ
	select MSM_DEVFREQ_DEVBW
	select DEVFREQ_SIMPLE_DEV
	select MSM_RPM_LOG
	select MSM_RPM_STATS_LOG

config ARCH_MSM8916
	bool "MSM8916"
	select MSM_CORTEX_A53
	select ARCH_MSM_CORTEXMP
	select CPU_V7
	select HAVE_SMP
	select ARM_GIC
	select MSM_IRQ
	select SPARSE_IRQ
	select MULTI_IRQ_HANDLER
	select HAVE_ARM_ARCH_TIMER
	select MAY_HAVE_SPARSE_IRQ
	select PINCTRL
	select PINCTRL_MSM_TLMM
	select USE_PINCTRL_IRQ
	select MSM_PM if PM
	select QMI_ENCDEC
	select CPU_FREQ
	select CPU_FREQ_MSM
	select PM_DEVFREQ
	select MSM_DEVFREQ_DEVBW
	select DEVFREQ_SIMPLE_DEV
	select DEVFREQ_GOV_MSM_BW_HWMON
	select MSM_BIMC_BWMON
	select MSM_QDSP6V2_CODECS
	select MSM_AUDIO_QDSP6V2 if SND_SOC
	select ARM_HAS_SG_CHAIN
	select MSM_RPM_SMD
	select MSM_JTAGV8 if CORESIGHT_ETMV4
	select ARCH_WANT_KMAP_ATOMIC_FLUSH

config ARCH_MSM8937
	bool "MSM8937"
	select MSM_CORTEX_A53
	select ARCH_MSM_CORTEXMP
	select CPU_V7
	select HAVE_SMP
	select ARM_GIC
	select MSM_IRQ
	select SPARSE_IRQ
	select MULTI_IRQ_HANDLER
	select HAVE_ARM_ARCH_TIMER
	select MAY_HAVE_SPARSE_IRQ
	select PINCTRL
	select PINCTRL_MSM_TLMM
	select USE_PINCTRL_IRQ
	select MSM_PM if PM
	select QMI_ENCDEC
	select CPU_FREQ
	select CPU_FREQ_MSM
	select PM_DEVFREQ
	select MSM_DEVFREQ_DEVBW
	select DEVFREQ_SIMPLE_DEV
	select DEVFREQ_GOV_MSM_BW_HWMON
	select MSM_BIMC_BWMON
	select MSM_QDSP6V2_CODECS
	select MSM_AUDIO_QDSP6V2 if SND_SOC
	select ARM_HAS_SG_CHAIN
	select MSM_JTAGV8 if CORESIGHT_ETMV4
	select ARCH_WANT_KMAP_ATOMIC_FLUSH

config ARCH_MSM8917
	bool "MSM8917"
	select MSM_CORTEX_A53
	select ARCH_MSM_CORTEXMP
	select CPU_V7
	select HAVE_SMP
	select ARM_GIC
	select MSM_IRQ
	select SPARSE_IRQ
	select MULTI_IRQ_HANDLER
	select HAVE_ARM_ARCH_TIMER
	select MAY_HAVE_SPARSE_IRQ
	select PINCTRL
	select PINCTRL_MSM_TLMM
	select USE_PINCTRL_IRQ
	select MSM_PM if PM
	select QMI_ENCDEC
	select CPU_FREQ
	select CPU_FREQ_MSM
	select PM_DEVFREQ
	select MSM_DEVFREQ_DEVBW
	select DEVFREQ_SIMPLE_DEV
	select DEVFREQ_GOV_MSM_BW_HWMON
	select MSM_BIMC_BWMON
	select MSM_QDSP6V2_CODECS
	select MSM_AUDIO_QDSP6V2 if SND_SOC
	select ARM_HAS_SG_CHAIN
	select MSM_RPM_SMD
	select MSM_JTAGV8 if CORESIGHT_ETMV4
	select ARCH_WANT_KMAP_ATOMIC_FLUSH

config ARCH_MSM8920
	bool "MSM8920"
	select MSM_CORTEX_A53
	select ARCH_MSM_CORTEXMP
	select CPU_V7
	select HAVE_SMP
	select ARM_GIC
	select MSM_IRQ
	select SPARSE_IRQ
	select MULTI_IRQ_HANDLER
	select HAVE_ARM_ARCH_TIMER
	select MAY_HAVE_SPARSE_IRQ
	select PINCTRL
	select PINCTRL_MSM_TLMM
	select USE_PINCTRL_IRQ
	select MSM_PM if PM
	select QMI_ENCDEC
	select CPU_FREQ
	select CPU_FREQ_MSM
	select PM_DEVFREQ
	select MSM_DEVFREQ_DEVBW
	select DEVFREQ_SIMPLE_DEV
	select DEVFREQ_GOV_MSM_BW_HWMON
	select MSM_BIMC_BWMON
	select MSM_QDSP6V2_CODECS
	select MSM_AUDIO_QDSP6V2 if SND_SOC
	select ARM_HAS_SG_CHAIN
	select MSM_RPM_SMD
	select MSM_JTAGV8 if CORESIGHT_ETMV4
	select ARCH_WANT_KMAP_ATOMIC_FLUSH

config ARCH_MSM8940
	bool "MSM8940"
	select MSM_CORTEX_A53
	select ARCH_MSM_CORTEXMP
	select CPU_V7
	select HAVE_SMP
	select ARM_GIC
	select MSM_IRQ
	select SPARSE_IRQ
	select MULTI_IRQ_HANDLER
	select HAVE_ARM_ARCH_TIMER
	select MAY_HAVE_SPARSE_IRQ
	select PINCTRL
	select PINCTRL_MSM_TLMM
	select USE_PINCTRL_IRQ
	select MSM_PM if PM
	select QMI_ENCDEC
	select CPU_FREQ
	select CPU_FREQ_MSM
	select PM_DEVFREQ
	select MSM_DEVFREQ_DEVBW
	select DEVFREQ_SIMPLE_DEV
	select DEVFREQ_GOV_MSM_BW_HWMON
	select MSM_BIMC_BWMON
	select MSM_QDSP6V2_CODECS
	select MSM_AUDIO_QDSP6V2 if SND_SOC
	select ARM_HAS_SG_CHAIN
	select MSM_JTAGV8 if CORESIGHT_ETMV4

config ARCH_MSM8953
	bool "MSM8953"
	select MSM_CORTEX_A53
	select ARCH_MSM_CORTEXMP
	select CPU_V7
	select HAVE_SMP
	select ARM_GIC
	select MSM_IRQ
	select SPARSE_IRQ
	select MULTI_IRQ_HANDLER
	select HAVE_ARM_ARCH_TIMER
	select MAY_HAVE_SPARSE_IRQ
	select PINCTRL
	select PINCTRL_MSM_TLMM
	select USE_PINCTRL_IRQ
	select MSM_PM if PM
	select QMI_ENCDEC
	select CPU_FREQ
	select CPU_FREQ_MSM
	select PM_DEVFREQ
	select MSM_DEVFREQ_DEVBW
	select DEVFREQ_SIMPLE_DEV
	select DEVFREQ_GOV_MSM_BW_HWMON
	select MSM_BIMC_BWMON
	select MSM_QDSP6V2_CODECS
	select MSM_AUDIO_QDSP6V2 if SND_SOC
	select ARM_HAS_SG_CHAIN
	select MSM_RPM_SMD
	select MSM_JTAGV8 if CORESIGHT_ETMV4
	select ARCH_WANT_KMAP_ATOMIC_FLUSH
	select ARCH_MSM8953_SOC_SETTINGS

config ARCH_SDM450
	bool "SDM450"
	select MSM_CORTEX_A53
	select ARCH_MSM_CORTEXMP
	select CPU_V7
	select HAVE_SMP
	select ARM_GIC
	select MSM_IRQ
	select SPARSE_IRQ
	select MULTI_IRQ_HANDLER
	select HAVE_ARM_ARCH_TIMER
	select MAY_HAVE_SPARSE_IRQ
	select PINCTRL
	select PINCTRL_MSM_TLMM
	select USE_PINCTRL_IRQ
	select MSM_PM if PM
	select QMI_ENCDEC
	select CPU_FREQ
	select CPU_FREQ_MSM
	select PM_DEVFREQ
	select MSM_DEVFREQ_DEVBW
	select DEVFREQ_SIMPLE_DEV
	select DEVFREQ_GOV_MSM_BW_HWMON
	select MSM_BIMC_BWMON
	select MSM_QDSP6V2_CODECS
	select MSM_AUDIO_QDSP6V2 if SND_SOC
	select ARM_HAS_SG_CHAIN
	select MSM_RPM_SMD
	select MSM_JTAGV8 if CORESIGHT_ETMV4
	select ARCH_WANT_KMAP_ATOMIC_FLUSH
	select ARCH_MSM8953_SOC_SETTINGS

config ARCH_MSM8909
	bool "MSM8909"
	select ARCH_MSM_CORTEXMP
	select ARM_GIC
	select MULTI_IRQ_HANDLER
	select HAVE_SMP
	select CPU_V7
	select HAVE_ARM_ARCH_TIMER
	select MAY_HAVE_SPARSE_IRQ
	select SPARSE_IRQ
	select PINCTRL
	select PINCTRL_MSM_TLMM
	select USE_PINCTRL_IRQ
	select MSM_PM if PM
	select MSM_RPM_SMD
	select MSM_RPM_STATS_LOG
	select MSM_RPM_LOG
	select MSM_CORTEX_A7
	select MSM_IRQ
	select ARM_TICKET_LOCKS
	select ARM_HAS_SG_CHAIN
	select CPU_FREQ
	select CPU_FREQ_MSM
	select PM_DEVFREQ
	select PM_OPP
	select MSM_DEVFREQ_DEVBW
	select DEVFREQ_SIMPLE_DEV
	select DEVFREQ_GOV_MSM_BW_HWMON
	select MSM_BIMC_BWMON
	select ARCH_WANT_KMAP_ATOMIC_FLUSH

endmenu
endif
```

## arch/arm/mach-qcom/Kconfig
```kconfig
if ARCH_QCOM
menu "QCOM SoC Type"

config ARCH_MSM8X60
	bool "Enable support for MSM8X60"
	select ARCH_SUPPORTS_BIG_ENDIAN
	select ARM_GIC
	select ARM_AMBA
	select QCOM_SCM if SMP
	select CLKSRC_QCOM
	select CLKSRC_OF
	select COMMON_CLK

config ARCH_MSM8960
	bool "Enable support for MSM8960"
	select CLKSRC_QCOM
	select ARCH_SUPPORTS_BIG_ENDIAN
	select ARM_GIC
	select ARM_AMBA
	select QCOM_SCM if SMP
	select CLKSRC_OF
	select COMMON_CLK


config ARCH_MSM8974
	bool "Enable support for MSM8974"
	select HAVE_ARM_ARCH_TIMER
	select ARCH_SUPPORTS_BIG_ENDIAN
	select ARM_GIC
	select ARM_AMBA
	select QCOM_SCM if SMP
	select CLKSRC_OF
	select COMMON_CLK

config ARCH_MDM9615
	bool "Enable support for MDM9615"
	select CLKSRC_QCOM
	select ARCH_SUPPORTS_BIG_ENDIAN
	select ARM_GIC
	select ARM_AMBA
	select QCOM_SCM if SMP
	select CLKSRC_OF
	select COMMON_CLK

config ARCH_QM215
	bool "Enable support for QM215"
	select CPU_V7
	select HAVE_ARM_ARCH_TIMER
	select PINCTRL
	select QCOM_SCM if SMP
	select PM_DEVFREQ
	select CLKDEV_LOOKUP
	select HAVE_CLK
	select HAVE_CLK_PREPARE
	select COMMON_CLK
	select COMMON_CLK_QCOM
	select ARM_GIC

config ARCH_SDM660
	bool "Enable Support for Qualcomm Technologies, Inc. SDM660"
	select CLKDEV_LOOKUP
	select HAVE_CLK
	select HAVE_CLK_PREPARE
	select PM_OPP
	select SOC_BUS
	select MSM_IRQ
	select THERMAL_WRITABLE_TRIPS
	select ARM_GIC_V3
	select ARM_AMBA
	select SPARSE_IRQ
	select MULTI_IRQ_HANDLER
	select HAVE_ARM_ARCH_TIMER
	select MAY_HAVE_SPARSE_IRQ
	select COMMON_CLK
	select COMMON_CLK_QCOM
	select QCOM_GDSC
	select PINCTRL_MSM_TLMM
	select USE_PINCTRL_IRQ
	select MSM_PM if PM
	select QMI_ENCDEC
	select CPU_FREQ
	select CPU_FREQ_MSM
	select PM_DEVFREQ
	select MSM_DEVFREQ_DEVBW
	select DEVFREQ_SIMPLE_DEV
	select DEVFREQ_GOV_MSM_BW_HWMON
	select MSM_BIMC_BWMON
	select MSM_QDSP6V2_CODECS
	select MSM_AUDIO_QDSP6V2 if SND_SOC
	select MSM_RPM_SMD
	select GENERIC_IRQ_MIGRATION
	select MSM_JTAGV8 if CORESIGHT_ETMV4
	help
	This enables support for the SDM660 chipset. If you do not
	wish to build a kernel that runs on this chipset, say 'N' here.

config ARCH_BENGAL
	bool "Enable Support for Qualcomm Technologies, Inc. BENGAL"
	select COMMON_CLK_QCOM
	select ARCH_SUPPORT_BIG_ENDIAN
	select ARM_GIC
	select ARM_AMBA
	select QCOM_SCM if SMP
	select CLKSRC_OF
	select COMMON_CLK
	select HAVE_CLK
	select HAVE_CLK_PREPARE
	select THERMAL_WRITABLE_TRIPS
	select ARM_GIC_V3
	select HAVE_ARM_ARCH_TIMER
	select PINCTRL_MSM
	select MSM_PM if PM
	select CPU_FREQ
	select PM_DEVFREQ
	select PCI
	help
	  This enables support for the BENGAL chipset. If you do not
	  wish to build a kernel that runs on this chipset, say 'N' here.

config ARCH_MSM8917
	bool "Enable support for MSM8917"
	select CPU_V7
	select HAVE_ARM_ARCH_TIMER
	select PINCTRL
	select QCOM_SCM if SMP
	select PM_DEVFREQ
	select CLKDEV_LOOKUP
	select HAVE_CLK
	select HAVE_CLK_PREPARE
	select COMMON_CLK
	select COMMON_CLK_QCOM

config ARCH_SCUBA
	bool "Enable Support for Qualcomm Technologies, Inc. SCUBA"
	select COMMON_CLK_QCOM
	select ARCH_SUPPORT_BIG_ENDIAN
	select ARM_GIC
	select ARM_AMBA
	select QCOM_SCM if SMP
	select CLKSRC_OF
	select COMMON_CLK
	select HAVE_CLK
	select HAVE_CLK_PREPARE
	select THERMAL_WRITABLE_TRIPS
	select ARM_GIC_V3
	select HAVE_ARM_ARCH_TIMER
	select PINCTRL_MSM
	select MSM_PM if PM
	select CPU_FREQ
	select PM_DEVFREQ
	select PCI
	help
	  This enables support for the SCUBA chipset. If you do not
	  wish to build a kernel that runs on this chipset, say 'N' here.

endmenu
endif
```

## arch/arm/mach-sprd/Kconfig
```kconfig
config ARCH_SPRD
	bool "Spreadtrum SoC Familes"
	select CPU_V7
	select HAVE_SMP
	select ARM_GIC
	select HAVE_SCHED_CLOCK
	select LOCAL_TIMERS if SMP
	select VFP
	select VFPv3
	select NEON
	select GENERIC_TIME
	select USE_OF
	select CLKSRC_MMIO
	select CLKSRC_OF
	select COMMON_CLK
	select SPRD_TIMER
	select ARCH_HAS_CPUFREQ
	select ARM_HAS_SG_CHAIN
	select HAVE_FUTEX_CMPXCHG if MMU && FUTEX
	select REGMAP
	select MFD_SYSCON
	select CLKSRC_SPRD
	select PINCTRL
	help
	  Support Spreadtrum's arm based systems.
```
