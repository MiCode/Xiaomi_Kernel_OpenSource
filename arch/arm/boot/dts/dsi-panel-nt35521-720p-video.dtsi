/* Copyright (c) 2013, The Linux Foundation. All rights reserved.
 *
 * This program is free software; you can redistribute it and/or modify
 * it under the terms of the GNU General Public License version 2 and
 * only version 2 as published by the Free Software Foundation.
 *
 * This program is distributed in the hope that it will be useful,
 * but WITHOUT ANY WARRANTY; without even the implied warranty of
 * MERCHANTABILITY or FITNESS FOR A PARTICULAR PURPOSE.  See the
 * GNU General Public License for more details.
 */

/*---------------------------------------------------------------------------
 * This file is autogenerated file using gcdb parser. Please do not edit it.
 * Update input XML file to add a new entry or update variable in this file
 * VERSION = "1.0"
 *---------------------------------------------------------------------------*/
&mdss_mdp {
	dsi_nt35521_720_vid: qcom,mdss_dsi_auo_nt35521_720p_video {
		qcom,mdss-dsi-panel-name = "auo nt35521 720p video mode dsi panel";
		qcom,mdss-dsi-panel-controller = <&mdss_dsi0>;
		qcom,mdss-dsi-panel-type = "dsi_video_mode";
		qcom,mdss-dsi-panel-destination = "display_1";
		qcom,mdss-dsi-panel-framerate = <60>;
		qcom,mdss-dsi-virtual-channel-id = <0>;
		qcom,mdss-dsi-stream = <0>;
		qcom,mdss-dsi-panel-width = <720>;
		qcom,mdss-dsi-panel-height = <1280>;
		qcom,mdss-dsi-h-front-porch = <80>;
		qcom,mdss-dsi-h-back-porch = <80>;
		qcom,mdss-dsi-h-pulse-width = <8>;
		qcom,mdss-dsi-h-sync-skew = <0>;
		qcom,mdss-dsi-v-back-porch = <20>;
		qcom,mdss-dsi-v-front-porch = <20>;
		qcom,mdss-dsi-v-pulse-width = <2>;
		qcom,mdss-dsi-h-left-border = <0>;
		qcom,mdss-dsi-h-right-border = <0>;
		qcom,mdss-dsi-v-top-border = <0>;
		qcom,mdss-dsi-v-bottom-border = <0>;
		qcom,mdss-dsi-bpp = <24>;
		qcom,mdss-dsi-underflow-color = <0xff>;
		qcom,mdss-dsi-border-color = <0>;
		qcom,mdss-dsi-pixel-packing = "tight";
		qcom,mdss-dsi-on-command = [29 01 00 00 00 00 06 F0 55 AA 52 08 00
				29 01 00 00 00 00 05 FF AA 55 A5 80
				29 01 00 00 00 00 03 B1 68 21
				29 01 00 00 00 00 06 BD 01 A3 20 10 01
				23 01 00 00 00 00 02 6F 02
				23 01 00 00 00 00 02 B8 08
				29 01 00 00 00 00 03 BB 11 11
				29 01 00 00 00 00 03 BC 05 05
				29 01 00 00 00 00 02 B6 01
				23 01 00 00 00 00 02 C8 83
				29 01 00 00 00 00 06 F0 55 AA 52 08 01
				29 01 00 00 00 00 03 B0 0F 0F
				29 01 00 00 00 00 03 B1 0F 0F
				23 01 00 00 00 00 02 CE 66
				23 01 00 00 00 00 02 C0 04
				29 01 00 00 00 00 03 B5 05 05
				23 01 00 00 00 00 02 BE 45
				29 01 00 00 00 00 03 B3 2B 2B
				29 01 00 00 00 00 03 B4 18 18
				29 01 00 00 00 00 03 B9 44 44
				29 01 00 00 00 00 03 BA 24 24
				29 01 00 00 00 00 03 BC A0 03
				29 01 00 00 00 00 03 BD A0 03
				23 01 00 00 00 00 02 CA 00
				29 01 00 00 00 00 06 F0 55 AA 52 08 02
				23 01 00 00 00 00 02 EE 01
				29 01 00 00 00 00 11 B0 00 00 00 0A 00 28 00 41 00 58 00 7E 00 A1 00 D8
				29 01 00 00 00 00 11 B1 01 07 01 51 01 8A 01 E6 02 31 02 33 02 78 02 C5
				29 01 00 00 00 00 11 B2 02 F5 03 32 03 58 03 88 03 A5 03 C6 03 D9 03 EB
				29 01 00 00 00 00 05 B3 03 FE 03 FF
				23 01 00 00 00 00 02 6F 02
				23 01 00 00 00 00 02 F8 44
				23 01 00 00 00 00 02 6F 0F
				23 01 00 00 00 00 02 FA 14
				23 01 00 00 00 00 02 6F 02
				23 01 00 00 00 00 02 F7 EF
				23 01 00 00 00 00 02 6F 0A
				23 01 00 00 00 00 02 F7 02
				23 01 00 00 00 00 02 6F 0C
				23 01 00 00 00 00 02 F4 D8
				23 01 00 00 00 00 02 6F 0E
				23 01 00 00 00 00 02 F4 44
				23 01 00 00 00 00 02 6F 17
				23 01 00 00 00 00 02 F4 60
				23 01 00 00 00 00 02 6F 01
				23 01 00 00 00 00 02 F9 46
				29 01 00 00 00 00 06 F0 55 AA 52 08 06
				29 01 00 00 00 00 03 B0 2E 2E
				29 01 00 00 00 00 03 B1 2E 2E
				29 01 00 00 00 00 03 B2 2E 2E
				29 01 00 00 00 00 03 B3 2E 09
				29 01 00 00 00 00 03 B4 0B 11
				29 01 00 00 00 00 03 B5 17 19
				29 01 00 00 00 00 03 B6 23 1D
				29 01 00 00 00 00 03 B7 25 1F
				29 01 00 00 00 00 03 B8 01 03
				29 01 00 00 00 00 03 B9 2E 2E
				29 01 00 00 00 00 03 BA 2E 2E
				29 01 00 00 00 00 03 BB 02 00
				29 01 00 00 00 00 03 BC 1E 24
				29 01 00 00 00 00 03 BD 1C 22
                                29 01 00 00 00 00 03 BE 18 16
                                29 01 00 00 00 00 03 BF 10 0A
                                29 01 00 00 00 00 03 C0 08 2E
                                29 01 00 00 00 00 03 C1 2E 2E
                                29 01 00 00 00 00 03 C2 2E 2E
                                29 01 00 00 00 00 03 C3 2E 2E
                                29 01 00 00 00 00 03 E5 13 12
                                29 01 00 00 00 00 03 C4 2E 2E
                                29 01 00 00 00 00 03 C5 2E 2E
                                29 01 00 00 00 00 03 C6 2E 2E
                                29 01 00 00 00 00 03 C7 2E 02
                                29 01 00 00 00 00 03 C8 00 18
                                29 01 00 00 00 00 03 C9 12 10
                                29 01 00 00 00 00 03 CA 24 1E
                                29 01 00 00 00 00 03 CB 22 1C
                                29 01 00 00 00 00 03 CC 0A 08
                                29 01 00 00 00 00 03 CD 2E 2E
                                29 01 00 00 00 00 03 CE 2E 2E
                                29 01 00 00 00 00 03 CF 09 0B
                                29 01 00 00 00 00 03 D0 1D 23
                                29 01 00 00 00 00 03 D1 1F 25
                                29 01 00 00 00 00 03 D2 11 13
                                29 01 00 00 00 00 03 D3 19 01
                                29 01 00 00 00 00 03 D4 03 2E
                                29 01 00 00 00 00 03 D5 2E 2E
                                29 01 00 00 00 00 03 D6 2E 2E
                                29 01 00 00 00 00 03 D7 2E 2E
                                29 01 00 00 00 00 03 E6 16 17
                                29 01 00 00 00 00 06 D8 00 00 00 00 00
                                29 01 00 00 00 00 06 D9 00 00 00 00 00
                                23 01 00 00 00 00 02 E7 00
                                29 01 00 00 00 00 06 F0 55 AA 52 08 05
				23 01 00 00 00 00 02 ED 30
                                29 01 00 00 00 00 06 F0 55 AA 52 08 03
				29 01 00 00 00 00 03 B0 20 00
                                29 01 00 00 00 00 03 B1 20 00
				29 01 00 00 00 00 06 F0 55 AA 52 08 05
                                29 01 00 00 00 00 03 B0 17 06
				23 01 00 00 00 00 02 B8 00
				29 01 00 00 00 00 06 BD 0F 03 03 00 03
                                29 01 00 00 00 00 03 B1 17 06
                                29 01 00 00 00 00 03 B9 00 03
                                29 01 00 00 00 00 03 B2 17 06
                                29 01 00 00 00 00 03 BA 00 03
                                29 01 00 00 00 00 03 B3 17 06
                                29 01 00 00 00 00 03 BB 00 00
                                29 01 00 00 00 00 03 B4 17 06
                                29 01 00 00 00 00 03 B5 17 06
                                29 01 00 00 00 00 03 B6 17 06
                                29 01 00 00 00 00 03 B7 17 06
                                29 01 00 00 00 00 03 BC 00 01
                                23 01 00 00 00 00 02 E5 06
                                23 01 00 00 00 00 02 E6 06
                                23 01 00 00 00 00 02 E7 06
                                23 01 00 00 00 00 02 E8 06
                                23 01 00 00 00 00 02 E9 0A
                                23 01 00 00 00 00 02 EA 06
                                23 01 00 00 00 00 02 EB 06
                                23 01 00 00 00 00 02 EC 06
                                29 01 00 00 00 00 06 F0 55 AA 52 08 05
				23 01 00 00 00 00 02 C0 07
                                23 01 00 00 00 00 02 C1 05
                                29 01 00 00 00 00 06 F0 55 AA 52 08 03
				29 01 00 00 00 00 06 B2 04 00 52 01 51
				29 01 00 00 00 00 06 B3 04 00 52 01 51
				29 01 00 00 00 00 06 F0 55 AA 52 08 05
				23 01 00 00 00 00 02 C4 82
                                23 01 00 00 00 00 02 C5 80
				29 01 00 00 00 00 06 F0 55 AA 52 08 03
				29 01 00 00 00 00 06 B6 04 00 52 01 51
				29 01 00 00 00 00 06 B7 04 00 52 01 51
				29 01 00 00 00 00 06 F0 55 AA 52 08 05
				29 01 00 00 00 00 03 C8 03 20
                                29 01 00 00 00 00 03 C9 01 21
                                29 01 00 00 00 00 03 CA 03 20
                                29 01 00 00 00 00 03 CB 07 20
				29 01 00 00 00 00 06 F0 55 AA 52 08 03
				23 01 00 00 00 00 02 C4 60
				23 01 00 00 00 00 02 C5 40
				29 01 00 00 00 00 06 F0 55 AA 52 08 03
				29 01 00 00 00 00 06 BA 44 00 60 01 72
				29 01 00 00 00 00 06 BB 44 00 60 01 72
				29 01 00 00 00 00 06 BC 53 00 03 00 48
				29 01 00 00 00 00 06 BD 53 00 03 00 48
				29 01 00 00 00 00 06 F0 55 AA 52 08 05
				29 01 00 00 00 00 0C D1 03 05 00 05 00 00 00 00 00 00 00
                                29 01 00 00 00 00 0C D2 03 05 00 03 00 00 00 00 00 00 00
                                29 01 00 00 00 00 0C D3 00 05 04 05 00 00 00 00 00 00 00
                                29 01 00 00 00 00 0C D4 00 05 04 03 00 00 00 00 00 00 00
                                29 01 00 00 00 00 06 F0 55 AA 52 08 03
				23 01 00 00 00 00 02 C4 40
				23 01 00 00 00 00 02 C5 40
				29 01 00 00 00 00 06 F0 55 AA 52 08 00
				23 01 00 00 00 00 02 6F 08
				23 01 00 00 00 00 02 F2 70
				23 01 00 00 00 00 02 6F 02
				23 01 00 00 00 00 02 B8 08
				23 01 00 00 00 00 02 6F 07
				23 01 00 00 00 00 02 F4 F0
				29 01 00 00 00 00 06 F0 55 AA 52 08 01
				23 01 00 00 00 00 02 CB 92
                                23 01 00 00 00 00 02 CD 08
                                23 01 00 00 00 00 02 6F 01
                                23 01 00 00 00 00 02 CD 01
                                23 01 00 00 00 00 02 6F 01
                                23 01 00 00 00 00 02 CB 8A
                                23 01 00 00 00 00 02 BF 60
                                23 01 00 00 00 00 02 D3 40
                                23 01 00 00 00 00 02 6F 11
                                23 01 00 00 00 00 02 F3 01
				15 01 00 00 10 00 02 51 ff
				15 01 00 00 10 00 02 53 2c
				15 01 00 00 10 00 02 55 01
				05 01 00 00 78 00 02 11 00
				05 01 00 00 14 00 02 29 00];
		qcom,mdss-dsi-off-command = [05 01 00 00 14 00 02 28 00
					05 01 00 00 78 00 02 10 00];
		qcom,mdss-dsi-on-command-state = "dsi_lp_mode";
		qcom,mdss-dsi-off-command-state = "dsi_hs_mode";
		qcom,mdss-dsi-h-sync-pulse = <1>;
		qcom,mdss-dsi-traffic-mode = "burst_mode";
		qcom,mdss-dsi-bllp-eof-power-mode;
		qcom,mdss-dsi-bllp-power-mode;
		qcom,mdss-dsi-lane-0-state;
		qcom,mdss-dsi-lane-1-state;
		qcom,mdss-dsi-lane-2-state;
		qcom,mdss-dsi-lane-3-state;
		qcom,mdss-dsi-lp11-init;
		qcom,mdss-dsi-panel-timings = [b0 8c 1B 00 94 93 1e 8e 1e 03 04 00];
		qcom,mdss-dsi-t-clk-post = <0x19>;
		qcom,mdss-dsi-t-clk-pre = <0x2f>;
		qcom,mdss-dsi-bl-min-level = <30>;
		qcom,mdss-dsi-bl-max-level = <255>;
		qcom,mdss-dsi-dma-trigger = "trigger_sw";
		qcom,mdss-dsi-mdp-trigger = "none";
		qcom,mdss-dsi-bl-pmic-control-type = "bl_ctrl_sic";
		qcom,mdss-dsi-reset-sequence = <1 5>, <0 5>, <1 120>;

	};
};
