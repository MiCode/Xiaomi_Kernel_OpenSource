/dts-v1/;

#include "tegra124-tn8.dtsi"
#include "tegra124-platforms/tegra124-tn8-emc-e1780-1100-a02.dtsi"
#include "tegra124-platforms/tegra124-tn8-powermon-e1780-1100-a02.dtsi"
#include "tegra124-platforms/tegra124-tn8-pmic-e1736-1000-a00.dtsi"
#include "tegra124-platforms/tegra124-tn8-fixed-e1736-1000-a00.dtsi"
#include "tegra124-platforms/tegra124-tn8-gpio-e1780-1100-a02.dtsi"
#include "tegra124-platforms/tegra124-tn8-pinmux-e1780-1100-a02.dtsi"
#include "tegra124-platforms/tegra124-tn8-keys-e1780-1100-a02.dtsi"
#include "tegra124-platforms/tegra124-tn8-sensor-e1794-1000-a00.dtsi"

/ {
	model = "NVIDIA Tegra124 TN8";
	compatible = "nvidia,tn8", "nvidia,tegra124";
	nvidia,dtsfilename = __FILE__;
	nvidia,boardids = "1780:1100:2","1794:1000:0";
	#address-cells = <1>;
	#size-cells = <1>;

	chosen {
		bootargs = "tegraid=40.0.0.00.00 vmalloc=256M video=tegrafb console=ttyS0,115200n8 earlyprintk";
		linux,initrd-start = <0x85000000>;
		linux,initrd-end = <0x851bc400>;
	};

	i2c@7000c400 {
		pca9546@71 {
			vcc-supply = <&palmas_smps9>;
		};
	};
};

