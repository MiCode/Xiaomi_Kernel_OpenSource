/* Copyright (c) 2012-2013, The Linux Foundation. All rights reserved.
 * Copyright (C) 2015 XiaoMi, Inc.
 *
 * This program is free software; you can redistribute it and/or modify
 * it under the terms of the GNU General Public License version 2 and
 * only version 2 as published by the Free Software Foundation.
 *
 * This program is distributed in the hope that it will be useful,
 * but WITHOUT ANY WARRANTY; without even the implied warranty of
 * MERCHANTABILITY or FITNESS FOR A PARTICULAR PURPOSE.  See the
 * GNU General Public License for more details.
 */

/*---------------------------------------------------------------------------
 * This file is autogenerated file using gcdb parser. Please do not edit it.
 * Update input XML file to add a new entry or update variable in this file
 * VERSION = "1.0"
 *---------------------------------------------------------------------------*/
&soc {
	dsi_rsp_fhd_xcmd: qcom,mdss_dsi_rsp_fhd_xcmd {
		compatible = "qcom,mdss-dsi-panel";
		status = "okay";
		qcom,mdss-dsi-panel-name = "sharp fhd cmd oncell dsi panel";
		qcom,mdss-dsi-panel-id = <3>;
		qcom,mdss-dsi-panel-sleepwrmod = <0>;
		qcom,mdss-dsi-panel-controller = <&mdss_dsi0>;
		qcom,mdss-dsi-panel-type = "dsi_cmd_mode";
		qcom,mdss-dsi-panel-destination = "display_1";
		qcom,mdss-dsi-panel-framerate = <60>;
		qcom,mdss-dsi-virtual-channel-id = <0>;
		qcom,mdss-dsi-stream = <0>;
		qcom,mdss-dsi-panel-width = <1080>;
		qcom,mdss-dsi-panel-height = <1920>;
		qcom,mdss-dsi-h-front-porch = <180>;
		qcom,mdss-dsi-h-back-porch = <142>;
		qcom,mdss-dsi-h-pulse-width = <10>;
		qcom,mdss-dsi-h-sync-skew = <0>;
		qcom,mdss-dsi-v-back-porch = <4>;
		qcom,mdss-dsi-v-front-porch = <10>;
		qcom,mdss-dsi-v-pulse-width = <2>;
		qcom,mdss-dsi-h-left-border = <0>;
		qcom,mdss-dsi-h-right-border = <0>;
		qcom,mdss-dsi-v-top-border = <0>;
		qcom,mdss-dsi-v-bottom-border = <0>;
		qcom,mdss-dsi-bpp = <24>;
		qcom,mdss-dsi-color-order = <0>;
		qcom,mdss-dsi-underflow-color = <0xff>;
		qcom,mdss-dsi-border-color = <0>;
		qcom,mdss-dsi-on-command = [
				29 01 00 00 00 00 02 B0 00
				29 01 00 00 00 00 02 D6 01
				29 01 00 00 00 00 05 B3 0C 00 00 00
				29 01 00 00 00 00 02 B0 03

				39 01 00 00 00 00 05 2A 00 00 04 37
				39 01 00 00 00 00 05 2B 00 00 07 7F

				15 01 00 00 00 00 02 51 de
				15 01 00 00 00 00 02 53 2c
				15 01 00 00 00 00 02 55 00
				05 01 00 00 78 00 02 11 00
				05 01 00 00 14 00 02 29 00];
		qcom,mdss-dsi-off-command = [
				15 01 00 00 00 00 02 FF 10
				05 01 00 00 02 00 02 28 00
				05 01 00 00 78 00 02 10 00];
		qcom,mdss-dsi-on-command-state = "dsi_lp_mode";
		qcom,mdss-dsi-off-command-state = "dsi_hs_mode";
		qcom,mdss-dsi-h-sync-pulse = <0>;
		qcom,mdss-dsi-traffic-mode = <1>;
		qcom,mdss-dsi-lane-map = <0>;
		qcom,mdss-dsi-bllp-eof-power-mode;
		qcom,mdss-dsi-bllp-power-mode;
		qcom,mdss-dsi-lane-0-state;
		qcom,mdss-dsi-lane-1-state;
		qcom,mdss-dsi-lane-2-state;
		qcom,mdss-dsi-lane-3-state;
		qcom,mdss-dsi-te-pin-select = <1>;
		qcom,mdss-dsi-te-v-sync-rd-ptr-irq-line = <0x2c>;
		qcom,mdss-dsi-te-v-sync-continues-lines = <0x3c>;
		qcom,mdss-dsi-te-dcs-command = <1>;
		qcom,mdss-dsi-te-check-enable;
		qcom,mdss-dsi-te-using-te-pin;
		qcom,mdss-dsi-panel-timings = [e3 50 36 00 a9 a3 3a 50 3d 03 04 00];
		qcom,mdss-dsi-t-clk-post = <0x20>;
		qcom,mdss-dsi-t-clk-pre = <0x36>;
		qcom,mdss-dsi-bl-min-level = <8>;
		qcom,mdss-dsi-bl-max-level = <4095>;
		qcom,mdss-dsi-dma-trigger = <0x04>;
		qcom,mdss-dsi-mdp-trigger = <0x0>;
		qcom,mdss-dsi-bl-pmic-control-type = "bl_ctrl_wled";
		qcom,mdss-dsi-reset-sequence = <1 10>, <0 1>, <1 10>;
		qcom,mdss-pan-physical-width-dimension = <71>;
		qcom,mdss-pan-physical-height-dimension = <126>;
		qcom,dispparam-enabled;
		qcom,mdss-dsi-dispparam-ceon-command = [
			15 00 00 00 01 00 02 FF 10
			15 01 00 00 10 00 02 55 80
			];
		qcom,mdss-dsi-dispparam-ceon-command-state = "dsi_hs_mode";
		qcom,mdss-dsi-dispparam-ceoff-command = [
			15 00 00 00 01 00 02 FF 10
			15 01 00 00 10 00 02 55 00
			];
		qcom,mdss-dsi-dispparam-ceoff-command-state = "dsi_hs_mode";
		qcom,mdss-dsi-dispparam-cabcon-command = [
			15 00 00 00 01 00 02 FF 10
			15 00 00 00 01 00 02 51 DE
			15 00 00 00 01 00 02 53 2C
			15 01 00 00 01 00 02 55 01
			];
		qcom,mdss-dsi-dispparam-cabcguion-command = [
			15 00 00 00 01 00 02 FF 10
			15 01 00 00 01 00 02 55 01
			];
		qcom,mdss-dsi-dispparam-cabcstillon-command = [
			15 00 00 00 01 00 02 FF 10
			15 01 00 00 01 00 02 55 02
			];
		qcom,mdss-dsi-dispparam-cabcmovieon-command = [
			15 00 00 00 01 00 02 FF 10
			15 01 00 00 01 00 02 55 03
			];
		qcom,mdss-dsi-dispparam-cabcon-command-state = "dsi_hs_mode";
		qcom,mdss-dsi-dispparam-cabcoff-command = [
			15 00 00 00 01 00 02 FF 10
			15 01 00 00 01 00 02 55 00
			];
		qcom,mdss-dsi-dispparam-cabcoff-command-state = "dsi_hs_mode";
		qcom,mdss-dsi-dispparam-warm-command = [
			15 00 00 00 01 00 02 FF 20
			15 00 00 00 01 00 02 75 00
			15 00 00 00 01 00 02 76 00
			15 00 00 00 01 00 02 77 00
			15 00 00 00 01 00 02 78 14
			15 00 00 00 01 00 02 79 00
			15 00 00 00 01 00 02 7A 3D
			15 00 00 00 01 00 02 7B 00
			15 00 00 00 01 00 02 7C 5C
			15 00 00 00 01 00 02 7D 00
			15 00 00 00 01 00 02 7E 7A
			15 00 00 00 01 00 02 7F 00
			15 00 00 00 01 00 02 80 94
			15 00 00 00 01 00 02 81 00
			15 00 00 00 01 00 02 82 AD
			15 00 00 00 01 00 02 83 00
			15 00 00 00 01 00 02 84 C1
			15 00 00 00 01 00 02 85 00
			15 00 00 00 01 00 02 86 D4
			15 00 00 00 01 00 02 87 01
			15 00 00 00 01 00 02 88 14
			15 00 00 00 01 00 02 89 01
			15 00 00 00 01 00 02 8A 46
			15 00 00 00 01 00 02 8B 01
			15 00 00 00 01 00 02 8C 90
			15 00 00 00 01 00 02 8D 01
			15 00 00 00 01 00 02 8E C6
			15 00 00 00 01 00 02 8F 02
			15 00 00 00 01 00 02 90 17
			15 00 00 00 01 00 02 91 02
			15 00 00 00 01 00 02 92 56
			15 00 00 00 01 00 02 93 02
			15 00 00 00 01 00 02 94 58
			15 00 00 00 01 00 02 95 02
			15 00 00 00 01 00 02 96 92
			15 00 00 00 01 00 02 97 02
			15 00 00 00 01 00 02 98 D0
			15 00 00 00 01 00 02 99 02
			15 00 00 00 01 00 02 9A F6
			15 00 00 00 01 00 02 9B 03
			15 00 00 00 01 00 02 9C 26
			15 00 00 00 01 00 02 9D 03
			15 00 00 00 01 00 02 9E 46
			15 00 00 00 01 00 02 9F 03
			15 00 00 00 01 00 02 A0 72
			15 00 00 00 01 00 02 A2 03
			15 00 00 00 01 00 02 A3 81
			15 00 00 00 01 00 02 A4 03
			15 00 00 00 01 00 02 A5 90
			15 00 00 00 01 00 02 A6 03
			15 00 00 00 01 00 02 A7 A1
			15 00 00 00 01 00 02 A9 03
			15 00 00 00 01 00 02 AA B3
			15 00 00 00 01 00 02 AB 03
			15 00 00 00 01 00 02 AC C6
			15 00 00 00 01 00 02 AD 03
			15 00 00 00 01 00 02 AE DC
			15 00 00 00 01 00 02 AF 03
			15 00 00 00 01 00 02 B0 F4
			15 00 00 00 01 00 02 B1 03
			15 00 00 00 01 00 02 B2 FF
			15 00 00 00 01 00 02 B3 00
			15 00 00 00 01 00 02 B4 00
			15 00 00 00 01 00 02 B5 00
			15 00 00 00 01 00 02 B6 14
			15 00 00 00 01 00 02 B7 00
			15 00 00 00 01 00 02 B8 3D
			15 00 00 00 01 00 02 B9 00
			15 00 00 00 01 00 02 BA 5C
			15 00 00 00 01 00 02 BB 00
			15 00 00 00 01 00 02 BC 7A
			15 00 00 00 01 00 02 BD 00
			15 00 00 00 01 00 02 BE 94
			15 00 00 00 01 00 02 BF 00
			15 00 00 00 01 00 02 C0 AD
			15 00 00 00 01 00 02 C1 00
			15 00 00 00 01 00 02 C2 C1
			15 00 00 00 01 00 02 C3 00
			15 00 00 00 01 00 02 C4 D4
			15 00 00 00 01 00 02 C5 01
			15 00 00 00 01 00 02 C6 14
			15 00 00 00 01 00 02 C7 01
			15 00 00 00 01 00 02 C8 46
			15 00 00 00 01 00 02 C9 01
			15 00 00 00 01 00 02 CA 90
			15 00 00 00 01 00 02 CB 01
			15 00 00 00 01 00 02 CC C6
			15 00 00 00 01 00 02 CD 02
			15 00 00 00 01 00 02 CE 17
			15 00 00 00 01 00 02 CF 02
			15 00 00 00 01 00 02 D0 56
			15 00 00 00 01 00 02 D1 02
			15 00 00 00 01 00 02 D2 58
			15 00 00 00 01 00 02 D3 02
			15 00 00 00 01 00 02 D4 92
			15 00 00 00 01 00 02 D5 02
			15 00 00 00 01 00 02 D6 D0
			15 00 00 00 01 00 02 D7 02
			15 00 00 00 01 00 02 D8 F6
			15 00 00 00 01 00 02 D9 03
			15 00 00 00 01 00 02 DA 26
			15 00 00 00 01 00 02 DB 03
			15 00 00 00 01 00 02 DC 46
			15 00 00 00 01 00 02 DD 03
			15 00 00 00 01 00 02 DE 72
			15 00 00 00 01 00 02 DF 03
			15 00 00 00 01 00 02 E0 81
			15 00 00 00 01 00 02 E1 03
			15 00 00 00 01 00 02 E2 90
			15 00 00 00 01 00 02 E3 03
			15 00 00 00 01 00 02 E4 A1
			15 00 00 00 01 00 02 E5 03
			15 00 00 00 01 00 02 E6 B3
			15 00 00 00 01 00 02 E7 03
			15 00 00 00 01 00 02 E8 C6
			15 00 00 00 01 00 02 E9 03
			15 00 00 00 01 00 02 EA DC
			15 00 00 00 01 00 02 EB 03
			15 00 00 00 01 00 02 EC F4
			15 00 00 00 01 00 02 ED 03
			15 00 00 00 01 00 02 EE FF
			15 00 00 00 01 00 02 EF 00
			15 00 00 00 01 00 02 F0 C7
			15 00 00 00 01 00 02 F1 00
			15 00 00 00 01 00 02 F2 D0
			15 00 00 00 01 00 02 F3 00
			15 00 00 00 01 00 02 F4 E2
			15 00 00 00 01 00 02 F5 00
			15 00 00 00 01 00 02 F6 F2
			15 00 00 00 01 00 02 F7 01
			15 00 00 00 01 00 02 F8 02
			15 00 00 00 01 00 02 F9 01
			15 00 00 00 01 00 02 FA 10
			15 00 00 00 01 00 02 FB 01
			15 00 00 00 01 00 02 FF 21
			15 00 00 00 01 00 02 00 01
			15 00 00 00 01 00 02 01 1F
			15 00 00 00 01 00 02 02 01
			15 00 00 00 01 00 02 03 2B
			15 00 00 00 01 00 02 04 01
			15 00 00 00 01 00 02 05 37
			15 00 00 00 01 00 02 06 01
			15 00 00 00 01 00 02 07 60
			15 00 00 00 01 00 02 08 01
			15 00 00 00 01 00 02 09 84
			15 00 00 00 01 00 02 0A 01
			15 00 00 00 01 00 02 0B BB
			15 00 00 00 01 00 02 0C 01
			15 00 00 00 01 00 02 0D E7
			15 00 00 00 01 00 02 0E 02
			15 00 00 00 01 00 02 0F 2C
			15 00 00 00 01 00 02 10 02
			15 00 00 00 01 00 02 11 66
			15 00 00 00 01 00 02 12 02
			15 00 00 00 01 00 02 13 68
			15 00 00 00 01 00 02 14 02
			15 00 00 00 01 00 02 15 9E
			15 00 00 00 01 00 02 16 02
			15 00 00 00 01 00 02 17 DA
			15 00 00 00 01 00 02 18 02
			15 00 00 00 01 00 02 19 FF
			15 00 00 00 01 00 02 1A 03
			15 00 00 00 01 00 02 1B 2D
			15 00 00 00 01 00 02 1C 03
			15 00 00 00 01 00 02 1D 4D
			15 00 00 00 01 00 02 1E 03
			15 00 00 00 01 00 02 1F 78
			15 00 00 00 01 00 02 20 03
			15 00 00 00 01 00 02 21 86
			15 00 00 00 01 00 02 22 03
			15 00 00 00 01 00 02 23 94
			15 00 00 00 01 00 02 24 03
			15 00 00 00 01 00 02 25 A4
			15 00 00 00 01 00 02 26 03
			15 00 00 00 01 00 02 27 B5
			15 00 00 00 01 00 02 28 03
			15 00 00 00 01 00 02 29 C8
			15 00 00 00 01 00 02 2A 03
			15 00 00 00 01 00 02 2B DD
			15 00 00 00 01 00 02 2D 03
			15 00 00 00 01 00 02 2F F4
			15 00 00 00 01 00 02 30 03
			15 00 00 00 01 00 02 31 FF
			15 00 00 00 01 00 02 32 00
			15 00 00 00 01 00 02 33 C7
			15 00 00 00 01 00 02 34 00
			15 00 00 00 01 00 02 35 D0
			15 00 00 00 01 00 02 36 00
			15 00 00 00 01 00 02 37 E2
			15 00 00 00 01 00 02 38 00
			15 00 00 00 01 00 02 39 F2
			15 00 00 00 01 00 02 3A 01
			15 00 00 00 01 00 02 3B 02
			15 00 00 00 01 00 02 3D 01
			15 00 00 00 01 00 02 3F 10
			15 00 00 00 01 00 02 40 01
			15 00 00 00 01 00 02 41 1F
			15 00 00 00 01 00 02 42 01
			15 00 00 00 01 00 02 43 2B
			15 00 00 00 01 00 02 44 01
			15 00 00 00 01 00 02 45 37
			15 00 00 00 01 00 02 46 01
			15 00 00 00 01 00 02 47 60
			15 00 00 00 01 00 02 48 01
			15 00 00 00 01 00 02 49 84
			15 00 00 00 01 00 02 4A 01
			15 00 00 00 01 00 02 4B BB
			15 00 00 00 01 00 02 4C 01
			15 00 00 00 01 00 02 4D E7
			15 00 00 00 01 00 02 4E 02
			15 00 00 00 01 00 02 4F 2C
			15 00 00 00 01 00 02 50 02
			15 00 00 00 01 00 02 51 66
			15 00 00 00 01 00 02 52 02
			15 00 00 00 01 00 02 53 68
			15 00 00 00 01 00 02 54 02
			15 00 00 00 01 00 02 55 9E
			15 00 00 00 01 00 02 56 02
			15 00 00 00 01 00 02 58 DA
			15 00 00 00 01 00 02 59 02
			15 00 00 00 01 00 02 5A FF
			15 00 00 00 01 00 02 5B 03
			15 00 00 00 01 00 02 5C 2D
			15 00 00 00 01 00 02 5D 03
			15 00 00 00 01 00 02 5E 4D
			15 00 00 00 01 00 02 5F 03
			15 00 00 00 01 00 02 60 78
			15 00 00 00 01 00 02 61 03
			15 00 00 00 01 00 02 62 86
			15 00 00 00 01 00 02 63 03
			15 00 00 00 01 00 02 64 94
			15 00 00 00 01 00 02 65 03
			15 00 00 00 01 00 02 66 A4
			15 00 00 00 01 00 02 67 03
			15 00 00 00 01 00 02 68 B5
			15 00 00 00 01 00 02 69 03
			15 00 00 00 01 00 02 6A C8
			15 00 00 00 01 00 02 6B 03
			15 00 00 00 01 00 02 6C DD
			15 00 00 00 01 00 02 6D 03
			15 00 00 00 01 00 02 6E F4
			15 00 00 00 01 00 02 6F 03
			15 00 00 00 01 00 02 70 FF
			15 00 00 00 01 00 02 71 01
			15 00 00 00 01 00 02 72 79
			15 00 00 00 01 00 02 73 01
			15 00 00 00 01 00 02 74 7D
			15 00 00 00 01 00 02 75 01
			15 00 00 00 01 00 02 76 84
			15 00 00 00 01 00 02 77 01
			15 00 00 00 01 00 02 78 8B
			15 00 00 00 01 00 02 79 01
			15 00 00 00 01 00 02 7A 92
			15 00 00 00 01 00 02 7B 01
			15 00 00 00 01 00 02 7C 99
			15 00 00 00 01 00 02 7D 01
			15 00 00 00 01 00 02 7E 9F
			15 00 00 00 01 00 02 7F 01
			15 00 00 00 01 00 02 80 A5
			15 00 00 00 01 00 02 81 01
			15 00 00 00 01 00 02 82 AB
			15 00 00 00 01 00 02 83 01
			15 00 00 00 01 00 02 84 C1
			15 00 00 00 01 00 02 85 01
			15 00 00 00 01 00 02 86 D6
			15 00 00 00 01 00 02 87 01
			15 00 00 00 01 00 02 88 F9
			15 00 00 00 01 00 02 89 02
			15 00 00 00 01 00 02 8A 19
			15 00 00 00 01 00 02 8B 02
			15 00 00 00 01 00 02 8C 4E
			15 00 00 00 01 00 02 8D 02
			15 00 00 00 01 00 02 8E 7F
			15 00 00 00 01 00 02 8F 02
			15 00 00 00 01 00 02 90 80
			15 00 00 00 01 00 02 91 02
			15 00 00 00 01 00 02 92 B1
			15 00 00 00 01 00 02 93 02
			15 00 00 00 01 00 02 94 E9
			15 00 00 00 01 00 02 95 03
			15 00 00 00 01 00 02 96 0E
			15 00 00 00 01 00 02 97 03
			15 00 00 00 01 00 02 98 3A
			15 00 00 00 01 00 02 99 03
			15 00 00 00 01 00 02 9A 59
			15 00 00 00 01 00 02 9B 03
			15 00 00 00 01 00 02 9C 82
			15 00 00 00 01 00 02 9D 03
			15 00 00 00 01 00 02 9E 8F
			15 00 00 00 01 00 02 9F 03
			15 00 00 00 01 00 02 A0 9D
			15 00 00 00 01 00 02 A2 03
			15 00 00 00 01 00 02 A3 AC
			15 00 00 00 01 00 02 A4 03
			15 00 00 00 01 00 02 A5 BB
			15 00 00 00 01 00 02 A6 03
			15 00 00 00 01 00 02 A7 CD
			15 00 00 00 01 00 02 A9 03
			15 00 00 00 01 00 02 AA E0
			15 00 00 00 01 00 02 AB 03
			15 00 00 00 01 00 02 AC F5
			15 00 00 00 01 00 02 AD 03
			15 00 00 00 01 00 02 AE FF
			15 00 00 00 01 00 02 AF 01
			15 00 00 00 01 00 02 B0 79
			15 00 00 00 01 00 02 B1 01
			15 00 00 00 01 00 02 B2 7D
			15 00 00 00 01 00 02 B3 01
			15 00 00 00 01 00 02 B4 84
			15 00 00 00 01 00 02 B5 01
			15 00 00 00 01 00 02 B6 8B
			15 00 00 00 01 00 02 B7 01
			15 00 00 00 01 00 02 B8 92
			15 00 00 00 01 00 02 B9 01
			15 00 00 00 01 00 02 BA 99
			15 00 00 00 01 00 02 BB 01
			15 00 00 00 01 00 02 BC 9F
			15 00 00 00 01 00 02 BD 01
			15 00 00 00 01 00 02 BE A5
			15 00 00 00 01 00 02 BF 01
			15 00 00 00 01 00 02 C0 AB
			15 00 00 00 01 00 02 C1 01
			15 00 00 00 01 00 02 C2 C1
			15 00 00 00 01 00 02 C3 01
			15 00 00 00 01 00 02 C4 D6
			15 00 00 00 01 00 02 C5 01
			15 00 00 00 01 00 02 C6 F9
			15 00 00 00 01 00 02 C7 02
			15 00 00 00 01 00 02 C8 19
			15 00 00 00 01 00 02 C9 02
			15 00 00 00 01 00 02 CA 4E
			15 00 00 00 01 00 02 CB 02
			15 00 00 00 01 00 02 CC 7F
			15 00 00 00 01 00 02 CD 02
			15 00 00 00 01 00 02 CE 80
			15 00 00 00 01 00 02 CF 02
			15 00 00 00 01 00 02 D0 B1
			15 00 00 00 01 00 02 D1 02
			15 00 00 00 01 00 02 D2 E9
			15 00 00 00 01 00 02 D3 03
			15 00 00 00 01 00 02 D4 0E
			15 00 00 00 01 00 02 D5 03
			15 00 00 00 01 00 02 D6 3A
			15 00 00 00 01 00 02 D7 03
			15 00 00 00 01 00 02 D8 59
			15 00 00 00 01 00 02 D9 03
			15 00 00 00 01 00 02 DA 82
			15 00 00 00 01 00 02 DB 03
			15 00 00 00 01 00 02 DC 8F
			15 00 00 00 01 00 02 DD 03
			15 00 00 00 01 00 02 DE 9D
			15 00 00 00 01 00 02 DF 03
			15 00 00 00 01 00 02 E0 AC
			15 00 00 00 01 00 02 E1 03
			15 00 00 00 01 00 02 E2 BB
			15 00 00 00 01 00 02 E3 03
			15 00 00 00 01 00 02 E4 CD
			15 00 00 00 01 00 02 E5 03
			15 00 00 00 01 00 02 E6 E0
			15 00 00 00 01 00 02 E7 03
			15 00 00 00 01 00 02 E8 F5
			15 00 00 00 01 00 02 E9 03
			15 00 00 00 01 00 02 EA FF
			15 00 00 00 01 00 02 FB 01
			15 01 00 00 01 00 02 FF 10
			];
		qcom,mdss-dsi-dispparam-warm-command-state = "dsi_hs_mode";

		qcom,mdss-dsi-dispparam-default-command = [
			15 00 00 00 01 00 02 FF 20
			15 00 00 00 01 00 02 75 00
			15 00 00 00 01 00 02 76 00
			15 00 00 00 01 00 02 77 00
			15 00 00 00 01 00 02 78 13
			15 00 00 00 01 00 02 79 00
			15 00 00 00 01 00 02 7A 3D
			15 00 00 00 01 00 02 7B 00
			15 00 00 00 01 00 02 7C 5E
			15 00 00 00 01 00 02 7D 00
			15 00 00 00 01 00 02 7E 7F
			15 00 00 00 01 00 02 7F 00
			15 00 00 00 01 00 02 80 97
			15 00 00 00 01 00 02 81 00
			15 00 00 00 01 00 02 82 B0
			15 00 00 00 01 00 02 83 00
			15 00 00 00 01 00 02 84 C3
			15 00 00 00 01 00 02 85 00
			15 00 00 00 01 00 02 86 D8
			15 00 00 00 01 00 02 87 01
			15 00 00 00 01 00 02 88 17
			15 00 00 00 01 00 02 89 01
			15 00 00 00 01 00 02 8A 48
			15 00 00 00 01 00 02 8B 01
			15 00 00 00 01 00 02 8C 91
			15 00 00 00 01 00 02 8D 01
			15 00 00 00 01 00 02 8E C8
			15 00 00 00 01 00 02 8F 02
			15 00 00 00 01 00 02 90 18
			15 00 00 00 01 00 02 91 02
			15 00 00 00 01 00 02 92 57
			15 00 00 00 01 00 02 93 02
			15 00 00 00 01 00 02 94 59
			15 00 00 00 01 00 02 95 02
			15 00 00 00 01 00 02 96 93
			15 00 00 00 01 00 02 97 02
			15 00 00 00 01 00 02 98 D0
			15 00 00 00 01 00 02 99 02
			15 00 00 00 01 00 02 9A F8
			15 00 00 00 01 00 02 9B 03
			15 00 00 00 01 00 02 9C 28
			15 00 00 00 01 00 02 9D 03
			15 00 00 00 01 00 02 9E 4A
			15 00 00 00 01 00 02 9F 03
			15 00 00 00 01 00 02 A0 7A
			15 00 00 00 01 00 02 A2 03
			15 00 00 00 01 00 02 A3 88
			15 00 00 00 01 00 02 A4 03
			15 00 00 00 01 00 02 A5 97
			15 00 00 00 01 00 02 A6 03
			15 00 00 00 01 00 02 A7 A7
			15 00 00 00 01 00 02 A9 03
			15 00 00 00 01 00 02 AA B9
			15 00 00 00 01 00 02 AB 03
			15 00 00 00 01 00 02 AC CB
			15 00 00 00 01 00 02 AD 03
			15 00 00 00 01 00 02 AE DF
			15 00 00 00 01 00 02 AF 03
			15 00 00 00 01 00 02 B0 F5
			15 00 00 00 01 00 02 B1 03
			15 00 00 00 01 00 02 B2 FF
			15 00 00 00 01 00 02 B3 00
			15 00 00 00 01 00 02 B4 00
			15 00 00 00 01 00 02 B5 00
			15 00 00 00 01 00 02 B6 13
			15 00 00 00 01 00 02 B7 00
			15 00 00 00 01 00 02 B8 3D
			15 00 00 00 01 00 02 B9 00
			15 00 00 00 01 00 02 BA 5E
			15 00 00 00 01 00 02 BB 00
			15 00 00 00 01 00 02 BC 7F
			15 00 00 00 01 00 02 BD 00
			15 00 00 00 01 00 02 BE 97
			15 00 00 00 01 00 02 BF 00
			15 00 00 00 01 00 02 C0 B0
			15 00 00 00 01 00 02 C1 00
			15 00 00 00 01 00 02 C2 C3
			15 00 00 00 01 00 02 C3 00
			15 00 00 00 01 00 02 C4 D8
			15 00 00 00 01 00 02 C5 01
			15 00 00 00 01 00 02 C6 17
			15 00 00 00 01 00 02 C7 01
			15 00 00 00 01 00 02 C8 48
			15 00 00 00 01 00 02 C9 01
			15 00 00 00 01 00 02 CA 91
			15 00 00 00 01 00 02 CB 01
			15 00 00 00 01 00 02 CC C8
			15 00 00 00 01 00 02 CD 02
			15 00 00 00 01 00 02 CE 18
			15 00 00 00 01 00 02 CF 02
			15 00 00 00 01 00 02 D0 57
			15 00 00 00 01 00 02 D1 02
			15 00 00 00 01 00 02 D2 59
			15 00 00 00 01 00 02 D3 02
			15 00 00 00 01 00 02 D4 93
			15 00 00 00 01 00 02 D5 02
			15 00 00 00 01 00 02 D6 D0
			15 00 00 00 01 00 02 D7 02
			15 00 00 00 01 00 02 D8 F8
			15 00 00 00 01 00 02 D9 03
			15 00 00 00 01 00 02 DA 28
			15 00 00 00 01 00 02 DB 03
			15 00 00 00 01 00 02 DC 4A
			15 00 00 00 01 00 02 DD 03
			15 00 00 00 01 00 02 DE 7A
			15 00 00 00 01 00 02 DF 03
			15 00 00 00 01 00 02 E0 88
			15 00 00 00 01 00 02 E1 03
			15 00 00 00 01 00 02 E2 97
			15 00 00 00 01 00 02 E3 03
			15 00 00 00 01 00 02 E4 A7
			15 00 00 00 01 00 02 E5 03
			15 00 00 00 01 00 02 E6 B9
			15 00 00 00 01 00 02 E7 03
			15 00 00 00 01 00 02 E8 CB
			15 00 00 00 01 00 02 E9 03
			15 00 00 00 01 00 02 EA DF
			15 00 00 00 01 00 02 EB 03
			15 00 00 00 01 00 02 EC F5
			15 00 00 00 01 00 02 ED 03
			15 00 00 00 01 00 02 EE FF
			15 00 00 00 01 00 02 EF 00
			15 00 00 00 01 00 02 F0 64
			15 00 00 00 01 00 02 F1 00
			15 00 00 00 01 00 02 F2 73
			15 00 00 00 01 00 02 F3 00
			15 00 00 00 01 00 02 F4 91
			15 00 00 00 01 00 02 F5 00
			15 00 00 00 01 00 02 F6 A9
			15 00 00 00 01 00 02 F7 00
			15 00 00 00 01 00 02 F8 C0
			15 00 00 00 01 00 02 F9 00
			15 00 00 00 01 00 02 FA D4
			15 00 00 00 01 00 02 FB 01
			15 00 00 00 01 00 02 FF 21
			15 00 00 00 01 00 02 00 00
			15 00 00 00 01 00 02 01 E7
			15 00 00 00 01 00 02 02 00
			15 00 00 00 01 00 02 03 F7
			15 00 00 00 01 00 02 04 01
			15 00 00 00 01 00 02 05 08
			15 00 00 00 01 00 02 06 01
			15 00 00 00 01 00 02 07 3D
			15 00 00 00 01 00 02 08 01
			15 00 00 00 01 00 02 09 67
			15 00 00 00 01 00 02 0A 01
			15 00 00 00 01 00 02 0B A7
			15 00 00 00 01 00 02 0C 01
			15 00 00 00 01 00 02 0D DA
			15 00 00 00 01 00 02 0E 02
			15 00 00 00 01 00 02 0F 25
			15 00 00 00 01 00 02 10 02
			15 00 00 00 01 00 02 11 60
			15 00 00 00 01 00 02 12 02
			15 00 00 00 01 00 02 13 62
			15 00 00 00 01 00 02 14 02
			15 00 00 00 01 00 02 15 9A
			15 00 00 00 01 00 02 16 02
			15 00 00 00 01 00 02 17 D7
			15 00 00 00 01 00 02 18 02
			15 00 00 00 01 00 02 19 FC
			15 00 00 00 01 00 02 1A 03
			15 00 00 00 01 00 02 1B 2B
			15 00 00 00 01 00 02 1C 03
			15 00 00 00 01 00 02 1D 4B
			15 00 00 00 01 00 02 1E 03
			15 00 00 00 01 00 02 1F 76
			15 00 00 00 01 00 02 20 03
			15 00 00 00 01 00 02 21 85
			15 00 00 00 01 00 02 22 03
			15 00 00 00 01 00 02 23 94
			15 00 00 00 01 00 02 24 03
			15 00 00 00 01 00 02 25 A4
			15 00 00 00 01 00 02 26 03
			15 00 00 00 01 00 02 27 B5
			15 00 00 00 01 00 02 28 03
			15 00 00 00 01 00 02 29 C8
			15 00 00 00 01 00 02 2A 03
			15 00 00 00 01 00 02 2B DD
			15 00 00 00 01 00 02 2D 03
			15 00 00 00 01 00 02 2F F4
			15 00 00 00 01 00 02 30 03
			15 00 00 00 01 00 02 31 FF
			15 00 00 00 01 00 02 32 00
			15 00 00 00 01 00 02 33 64
			15 00 00 00 01 00 02 34 00
			15 00 00 00 01 00 02 35 73
			15 00 00 00 01 00 02 36 00
			15 00 00 00 01 00 02 37 91
			15 00 00 00 01 00 02 38 00
			15 00 00 00 01 00 02 39 A9
			15 00 00 00 01 00 02 3A 00
			15 00 00 00 01 00 02 3B C0
			15 00 00 00 01 00 02 3D 00
			15 00 00 00 01 00 02 3F D4
			15 00 00 00 01 00 02 40 00
			15 00 00 00 01 00 02 41 E7
			15 00 00 00 01 00 02 42 00
			15 00 00 00 01 00 02 43 F7
			15 00 00 00 01 00 02 44 01
			15 00 00 00 01 00 02 45 08
			15 00 00 00 01 00 02 46 01
			15 00 00 00 01 00 02 47 3D
			15 00 00 00 01 00 02 48 01
			15 00 00 00 01 00 02 49 67
			15 00 00 00 01 00 02 4A 01
			15 00 00 00 01 00 02 4B A7
			15 00 00 00 01 00 02 4C 01
			15 00 00 00 01 00 02 4D DA
			15 00 00 00 01 00 02 4E 02
			15 00 00 00 01 00 02 4F 25
			15 00 00 00 01 00 02 50 02
			15 00 00 00 01 00 02 51 60
			15 00 00 00 01 00 02 52 02
			15 00 00 00 01 00 02 53 62
			15 00 00 00 01 00 02 54 02
			15 00 00 00 01 00 02 55 9A
			15 00 00 00 01 00 02 56 02
			15 00 00 00 01 00 02 58 D7
			15 00 00 00 01 00 02 59 02
			15 00 00 00 01 00 02 5A FC
			15 00 00 00 01 00 02 5B 03
			15 00 00 00 01 00 02 5C 2B
			15 00 00 00 01 00 02 5D 03
			15 00 00 00 01 00 02 5E 4B
			15 00 00 00 01 00 02 5F 03
			15 00 00 00 01 00 02 60 76
			15 00 00 00 01 00 02 61 03
			15 00 00 00 01 00 02 62 85
			15 00 00 00 01 00 02 63 03
			15 00 00 00 01 00 02 64 94
			15 00 00 00 01 00 02 65 03
			15 00 00 00 01 00 02 66 A4
			15 00 00 00 01 00 02 67 03
			15 00 00 00 01 00 02 68 B5
			15 00 00 00 01 00 02 69 03
			15 00 00 00 01 00 02 6A C8
			15 00 00 00 01 00 02 6B 03
			15 00 00 00 01 00 02 6C DD
			15 00 00 00 01 00 02 6D 03
			15 00 00 00 01 00 02 6E F4
			15 00 00 00 01 00 02 6F 03
			15 00 00 00 01 00 02 70 FF
			15 00 00 00 01 00 02 71 01
			15 00 00 00 01 00 02 72 1F
			15 00 00 00 01 00 02 73 01
			15 00 00 00 01 00 02 74 25
			15 00 00 00 01 00 02 75 01
			15 00 00 00 01 00 02 76 31
			15 00 00 00 01 00 02 77 01
			15 00 00 00 01 00 02 78 3C
			15 00 00 00 01 00 02 79 01
			15 00 00 00 01 00 02 7A 48
			15 00 00 00 01 00 02 7B 01
			15 00 00 00 01 00 02 7C 52
			15 00 00 00 01 00 02 7D 01
			15 00 00 00 01 00 02 7E 5C
			15 00 00 00 01 00 02 7F 01
			15 00 00 00 01 00 02 80 65
			15 00 00 00 01 00 02 81 01
			15 00 00 00 01 00 02 82 6E
			15 00 00 00 01 00 02 83 01
			15 00 00 00 01 00 02 84 8E
			15 00 00 00 01 00 02 85 01
			15 00 00 00 01 00 02 86 AA
			15 00 00 00 01 00 02 87 01
			15 00 00 00 01 00 02 88 D9
			15 00 00 00 01 00 02 89 01
			15 00 00 00 01 00 02 8A FE
			15 00 00 00 01 00 02 8B 02
			15 00 00 00 01 00 02 8C 3D
			15 00 00 00 01 00 02 8D 02
			15 00 00 00 01 00 02 8E 72
			15 00 00 00 01 00 02 8F 02
			15 00 00 00 01 00 02 90 73
			15 00 00 00 01 00 02 91 02
			15 00 00 00 01 00 02 92 A7
			15 00 00 00 01 00 02 93 02
			15 00 00 00 01 00 02 94 E1
			15 00 00 00 01 00 02 95 03
			15 00 00 00 01 00 02 96 05
			15 00 00 00 01 00 02 97 03
			15 00 00 00 01 00 02 98 33
			15 00 00 00 01 00 02 99 03
			15 00 00 00 01 00 02 9A 52
			15 00 00 00 01 00 02 9B 03
			15 00 00 00 01 00 02 9C 7D
			15 00 00 00 01 00 02 9D 03
			15 00 00 00 01 00 02 9E 8A
			15 00 00 00 01 00 02 9F 03
			15 00 00 00 01 00 02 A0 98
			15 00 00 00 01 00 02 A2 03
			15 00 00 00 01 00 02 A3 A7
			15 00 00 00 01 00 02 A4 03
			15 00 00 00 01 00 02 A5 B8
			15 00 00 00 01 00 02 A6 03
			15 00 00 00 01 00 02 A7 CA
			15 00 00 00 01 00 02 A9 03
			15 00 00 00 01 00 02 AA DE
			15 00 00 00 01 00 02 AB 03
			15 00 00 00 01 00 02 AC F5
			15 00 00 00 01 00 02 AD 03
			15 00 00 00 01 00 02 AE FF
			15 00 00 00 01 00 02 AF 01
			15 00 00 00 01 00 02 B0 1F
			15 00 00 00 01 00 02 B1 01
			15 00 00 00 01 00 02 B2 25
			15 00 00 00 01 00 02 B3 01
			15 00 00 00 01 00 02 B4 31
			15 00 00 00 01 00 02 B5 01
			15 00 00 00 01 00 02 B6 3C
			15 00 00 00 01 00 02 B7 01
			15 00 00 00 01 00 02 B8 48
			15 00 00 00 01 00 02 B9 01
			15 00 00 00 01 00 02 BA 52
			15 00 00 00 01 00 02 BB 01
			15 00 00 00 01 00 02 BC 5C
			15 00 00 00 01 00 02 BD 01
			15 00 00 00 01 00 02 BE 65
			15 00 00 00 01 00 02 BF 01
			15 00 00 00 01 00 02 C0 6E
			15 00 00 00 01 00 02 C1 01
			15 00 00 00 01 00 02 C2 8E
			15 00 00 00 01 00 02 C3 01
			15 00 00 00 01 00 02 C4 AA
			15 00 00 00 01 00 02 C5 01
			15 00 00 00 01 00 02 C6 D9
			15 00 00 00 01 00 02 C7 01
			15 00 00 00 01 00 02 C8 FE
			15 00 00 00 01 00 02 C9 02
			15 00 00 00 01 00 02 CA 3D
			15 00 00 00 01 00 02 CB 02
			15 00 00 00 01 00 02 CC 72
			15 00 00 00 01 00 02 CD 02
			15 00 00 00 01 00 02 CE 73
			15 00 00 00 01 00 02 CF 02
			15 00 00 00 01 00 02 D0 A7
			15 00 00 00 01 00 02 D1 02
			15 00 00 00 01 00 02 D2 E1
			15 00 00 00 01 00 02 D3 03
			15 00 00 00 01 00 02 D4 05
			15 00 00 00 01 00 02 D5 03
			15 00 00 00 01 00 02 D6 33
			15 00 00 00 01 00 02 D7 03
			15 00 00 00 01 00 02 D8 52
			15 00 00 00 01 00 02 D9 03
			15 00 00 00 01 00 02 DA 7D
			15 00 00 00 01 00 02 DB 03
			15 00 00 00 01 00 02 DC 8A
			15 00 00 00 01 00 02 DD 03
			15 00 00 00 01 00 02 DE 98
			15 00 00 00 01 00 02 DF 03
			15 00 00 00 01 00 02 E0 A7
			15 00 00 00 01 00 02 E1 03
			15 00 00 00 01 00 02 E2 B8
			15 00 00 00 01 00 02 E3 03
			15 00 00 00 01 00 02 E4 CA
			15 00 00 00 01 00 02 E5 03
			15 00 00 00 01 00 02 E6 DE
			15 00 00 00 01 00 02 E7 03
			15 00 00 00 01 00 02 E8 F5
			15 00 00 00 01 00 02 E9 03
			15 00 00 00 01 00 02 EA FF
			15 00 00 00 01 00 02 FB 01
			15 01 00 00 01 00 02 FF 10
			];
		qcom,mdss-dsi-dispparam-default-command-state = "dsi_hs_mode";
		qcom,mdss-dsi-dispparam-cold-command = [
			15 00 00 00 01 00 02 FF 20
			15 00 00 00 01 00 02 75 00
			15 00 00 00 01 00 02 76 73
			15 00 00 00 01 00 02 77 00
			15 00 00 00 01 00 02 78 82
			15 00 00 00 01 00 02 79 00
			15 00 00 00 01 00 02 7A 9F
			15 00 00 00 01 00 02 7B 00
			15 00 00 00 01 00 02 7C B5
			15 00 00 00 01 00 02 7D 00
			15 00 00 00 01 00 02 7E CB
			15 00 00 00 01 00 02 7F 00
			15 00 00 00 01 00 02 80 DD
			15 00 00 00 01 00 02 81 00
			15 00 00 00 01 00 02 82 F0
			15 00 00 00 01 00 02 83 01
			15 00 00 00 01 00 02 84 00
			15 00 00 00 01 00 02 85 01
			15 00 00 00 01 00 02 86 10
			15 00 00 00 01 00 02 87 01
			15 00 00 00 01 00 02 88 46
			15 00 00 00 01 00 02 89 01
			15 00 00 00 01 00 02 8A 70
			15 00 00 00 01 00 02 8B 01
			15 00 00 00 01 00 02 8C AF
			15 00 00 00 01 00 02 8D 01
			15 00 00 00 01 00 02 8E E3
			15 00 00 00 01 00 02 8F 02
			15 00 00 00 01 00 02 90 2E
			15 00 00 00 01 00 02 91 02
			15 00 00 00 01 00 02 92 6B
			15 00 00 00 01 00 02 93 02
			15 00 00 00 01 00 02 94 6C
			15 00 00 00 01 00 02 95 02
			15 00 00 00 01 00 02 96 A6
			15 00 00 00 01 00 02 97 02
			15 00 00 00 01 00 02 98 E6
			15 00 00 00 01 00 02 99 03
			15 00 00 00 01 00 02 9A 0C
			15 00 00 00 01 00 02 9B 03
			15 00 00 00 01 00 02 9C 3F
			15 00 00 00 01 00 02 9D 03
			15 00 00 00 01 00 02 9E 64
			15 00 00 00 01 00 02 9F 03
			15 00 00 00 01 00 02 A0 91
			15 00 00 00 01 00 02 A2 03
			15 00 00 00 01 00 02 A3 9E
			15 00 00 00 01 00 02 A4 03
			15 00 00 00 01 00 02 A5 AB
			15 00 00 00 01 00 02 A6 03
			15 00 00 00 01 00 02 A7 B9
			15 00 00 00 01 00 02 A9 03
			15 00 00 00 01 00 02 AA C7
			15 00 00 00 01 00 02 AB 03
			15 00 00 00 01 00 02 AC D6
			15 00 00 00 01 00 02 AD 03
			15 00 00 00 01 00 02 AE E6
			15 00 00 00 01 00 02 AF 03
			15 00 00 00 01 00 02 B0 F7
			15 00 00 00 01 00 02 B1 03
			15 00 00 00 01 00 02 B2 FF
			15 00 00 00 01 00 02 B3 00
			15 00 00 00 01 00 02 B4 73
			15 00 00 00 01 00 02 B5 00
			15 00 00 00 01 00 02 B6 82
			15 00 00 00 01 00 02 B7 00
			15 00 00 00 01 00 02 B8 9F
			15 00 00 00 01 00 02 B9 00
			15 00 00 00 01 00 02 BA B5
			15 00 00 00 01 00 02 BB 00
			15 00 00 00 01 00 02 BC CB
			15 00 00 00 01 00 02 BD 00
			15 00 00 00 01 00 02 BE DD
			15 00 00 00 01 00 02 BF 00
			15 00 00 00 01 00 02 C0 F0
			15 00 00 00 01 00 02 C1 01
			15 00 00 00 01 00 02 C2 00
			15 00 00 00 01 00 02 C3 01
			15 00 00 00 01 00 02 C4 10
			15 00 00 00 01 00 02 C5 01
			15 00 00 00 01 00 02 C6 46
			15 00 00 00 01 00 02 C7 01
			15 00 00 00 01 00 02 C8 70
			15 00 00 00 01 00 02 C9 01
			15 00 00 00 01 00 02 CA AF
			15 00 00 00 01 00 02 CB 01
			15 00 00 00 01 00 02 CC E3
			15 00 00 00 01 00 02 CD 02
			15 00 00 00 01 00 02 CE 2E
			15 00 00 00 01 00 02 CF 02
			15 00 00 00 01 00 02 D0 6B
			15 00 00 00 01 00 02 D1 02
			15 00 00 00 01 00 02 D2 6C
			15 00 00 00 01 00 02 D3 02
			15 00 00 00 01 00 02 D4 A6
			15 00 00 00 01 00 02 D5 02
			15 00 00 00 01 00 02 D6 E6
			15 00 00 00 01 00 02 D7 03
			15 00 00 00 01 00 02 D8 0C
			15 00 00 00 01 00 02 D9 03
			15 00 00 00 01 00 02 DA 3F
			15 00 00 00 01 00 02 DB 03
			15 00 00 00 01 00 02 DC 64
			15 00 00 00 01 00 02 DD 03
			15 00 00 00 01 00 02 DE 91
			15 00 00 00 01 00 02 DF 03
			15 00 00 00 01 00 02 E0 9E
			15 00 00 00 01 00 02 E1 03
			15 00 00 00 01 00 02 E2 AB
			15 00 00 00 01 00 02 E3 03
			15 00 00 00 01 00 02 E4 B9
			15 00 00 00 01 00 02 E5 03
			15 00 00 00 01 00 02 E6 C7
			15 00 00 00 01 00 02 E7 03
			15 00 00 00 01 00 02 E8 D6
			15 00 00 00 01 00 02 E9 03
			15 00 00 00 01 00 02 EA E6
			15 00 00 00 01 00 02 EB 03
			15 00 00 00 01 00 02 EC F7
			15 00 00 00 01 00 02 ED 03
			15 00 00 00 01 00 02 EE FF
			15 00 00 00 01 00 02 EF 00
			15 00 00 00 01 00 02 F0 00
			15 00 00 00 01 00 02 F1 00
			15 00 00 00 01 00 02 F2 18
			15 00 00 00 01 00 02 F3 00
			15 00 00 00 01 00 02 F4 49
			15 00 00 00 01 00 02 F5 00
			15 00 00 00 01 00 02 F6 6C
			15 00 00 00 01 00 02 F7 00
			15 00 00 00 01 00 02 F8 8F
			15 00 00 00 01 00 02 F9 00
			15 00 00 00 01 00 02 FA A9
			15 00 00 00 01 00 02 FB 01
			15 00 00 00 01 00 02 FF 21
			15 00 00 00 01 00 02 00 00
			15 00 00 00 01 00 02 01 C2
			15 00 00 00 01 00 02 02 00
			15 00 00 00 01 00 02 03 D7
			15 00 00 00 01 00 02 04 00
			15 00 00 00 01 00 02 05 ED
			15 00 00 00 01 00 02 06 01
			15 00 00 00 01 00 02 07 2D
			15 00 00 00 01 00 02 08 01
			15 00 00 00 01 00 02 09 60
			15 00 00 00 01 00 02 0A 01
			15 00 00 00 01 00 02 0B A8
			15 00 00 00 01 00 02 0C 01
			15 00 00 00 01 00 02 0D DC
			15 00 00 00 01 00 02 0E 02
			15 00 00 00 01 00 02 0F 2A
			15 00 00 00 01 00 02 10 02
			15 00 00 00 01 00 02 11 69
			15 00 00 00 01 00 02 12 02
			15 00 00 00 01 00 02 13 6A
			15 00 00 00 01 00 02 14 02
			15 00 00 00 01 00 02 15 A5
			15 00 00 00 01 00 02 16 02
			15 00 00 00 01 00 02 17 E6
			15 00 00 00 01 00 02 18 03
			15 00 00 00 01 00 02 19 0C
			15 00 00 00 01 00 02 1A 03
			15 00 00 00 01 00 02 1B 3C
			15 00 00 00 01 00 02 1C 03
			15 00 00 00 01 00 02 1D 5D
			15 00 00 00 01 00 02 1E 03
			15 00 00 00 01 00 02 1F 88
			15 00 00 00 01 00 02 20 03
			15 00 00 00 01 00 02 21 95
			15 00 00 00 01 00 02 22 03
			15 00 00 00 01 00 02 23 A2
			15 00 00 00 01 00 02 24 03
			15 00 00 00 01 00 02 25 B1
			15 00 00 00 01 00 02 26 03
			15 00 00 00 01 00 02 27 C0
			15 00 00 00 01 00 02 28 03
			15 00 00 00 01 00 02 29 D1
			15 00 00 00 01 00 02 2A 03
			15 00 00 00 01 00 02 2B E3
			15 00 00 00 01 00 02 2D 03
			15 00 00 00 01 00 02 2F F6
			15 00 00 00 01 00 02 30 03
			15 00 00 00 01 00 02 31 FF
			15 00 00 00 01 00 02 32 00
			15 00 00 00 01 00 02 33 00
			15 00 00 00 01 00 02 34 00
			15 00 00 00 01 00 02 35 18
			15 00 00 00 01 00 02 36 00
			15 00 00 00 01 00 02 37 49
			15 00 00 00 01 00 02 38 00
			15 00 00 00 01 00 02 39 6C
			15 00 00 00 01 00 02 3A 00
			15 00 00 00 01 00 02 3B 8F
			15 00 00 00 01 00 02 3D 00
			15 00 00 00 01 00 02 3F A9
			15 00 00 00 01 00 02 40 00
			15 00 00 00 01 00 02 41 C2
			15 00 00 00 01 00 02 42 00
			15 00 00 00 01 00 02 43 D7
			15 00 00 00 01 00 02 44 00
			15 00 00 00 01 00 02 45 ED
			15 00 00 00 01 00 02 46 01
			15 00 00 00 01 00 02 47 2D
			15 00 00 00 01 00 02 48 01
			15 00 00 00 01 00 02 49 60
			15 00 00 00 01 00 02 4A 01
			15 00 00 00 01 00 02 4B A8
			15 00 00 00 01 00 02 4C 01
			15 00 00 00 01 00 02 4D DC
			15 00 00 00 01 00 02 4E 02
			15 00 00 00 01 00 02 4F 2A
			15 00 00 00 01 00 02 50 02
			15 00 00 00 01 00 02 51 69
			15 00 00 00 01 00 02 52 02
			15 00 00 00 01 00 02 53 6A
			15 00 00 00 01 00 02 54 02
			15 00 00 00 01 00 02 55 A5
			15 00 00 00 01 00 02 56 02
			15 00 00 00 01 00 02 58 E6
			15 00 00 00 01 00 02 59 03
			15 00 00 00 01 00 02 5A 0C
			15 00 00 00 01 00 02 5B 03
			15 00 00 00 01 00 02 5C 3C
			15 00 00 00 01 00 02 5D 03
			15 00 00 00 01 00 02 5E 5D
			15 00 00 00 01 00 02 5F 03
			15 00 00 00 01 00 02 60 88
			15 00 00 00 01 00 02 61 03
			15 00 00 00 01 00 02 62 95
			15 00 00 00 01 00 02 63 03
			15 00 00 00 01 00 02 64 A2
			15 00 00 00 01 00 02 65 03
			15 00 00 00 01 00 02 66 B1
			15 00 00 00 01 00 02 67 03
			15 00 00 00 01 00 02 68 C0
			15 00 00 00 01 00 02 69 03
			15 00 00 00 01 00 02 6A D1
			15 00 00 00 01 00 02 6B 03
			15 00 00 00 01 00 02 6C E3
			15 00 00 00 01 00 02 6D 03
			15 00 00 00 01 00 02 6E F6
			15 00 00 00 01 00 02 6F 03
			15 00 00 00 01 00 02 70 FF
			15 00 00 00 01 00 02 71 00
			15 00 00 00 01 00 02 72 CF
			15 00 00 00 01 00 02 73 00
			15 00 00 00 01 00 02 74 D9
			15 00 00 00 01 00 02 75 00
			15 00 00 00 01 00 02 76 EE
			15 00 00 00 01 00 02 77 00
			15 00 00 00 01 00 02 78 FF
			15 00 00 00 01 00 02 79 01
			15 00 00 00 01 00 02 7A 10
			15 00 00 00 01 00 02 7B 01
			15 00 00 00 01 00 02 7C 1F
			15 00 00 00 01 00 02 7D 01
			15 00 00 00 01 00 02 7E 2E
			15 00 00 00 01 00 02 7F 01
			15 00 00 00 01 00 02 80 3A
			15 00 00 00 01 00 02 81 01
			15 00 00 00 01 00 02 82 48
			15 00 00 00 01 00 02 83 01
			15 00 00 00 01 00 02 84 72
			15 00 00 00 01 00 02 85 01
			15 00 00 00 01 00 02 86 95
			15 00 00 00 01 00 02 87 01
			15 00 00 00 01 00 02 88 CD
			15 00 00 00 01 00 02 89 01
			15 00 00 00 01 00 02 8A F9
			15 00 00 00 01 00 02 8B 02
			15 00 00 00 01 00 02 8C 3D
			15 00 00 00 01 00 02 8D 02
			15 00 00 00 01 00 02 8E 75
			15 00 00 00 01 00 02 8F 02
			15 00 00 00 01 00 02 90 77
			15 00 00 00 01 00 02 91 02
			15 00 00 00 01 00 02 92 AE
			15 00 00 00 01 00 02 93 02
			15 00 00 00 01 00 02 94 EC
			15 00 00 00 01 00 02 95 03
			15 00 00 00 01 00 02 96 13
			15 00 00 00 01 00 02 97 03
			15 00 00 00 01 00 02 98 43
			15 00 00 00 01 00 02 99 03
			15 00 00 00 01 00 02 9A 63
			15 00 00 00 01 00 02 9B 03
			15 00 00 00 01 00 02 9C 8C
			15 00 00 00 01 00 02 9D 03
			15 00 00 00 01 00 02 9E 98
			15 00 00 00 01 00 02 9F 03
			15 00 00 00 01 00 02 A0 A5
			15 00 00 00 01 00 02 A2 03
			15 00 00 00 01 00 02 A3 B3
			15 00 00 00 01 00 02 A4 03
			15 00 00 00 01 00 02 A5 C2
			15 00 00 00 01 00 02 A6 03
			15 00 00 00 01 00 02 A7 D2
			15 00 00 00 01 00 02 A9 03
			15 00 00 00 01 00 02 AA E3
			15 00 00 00 01 00 02 AB 03
			15 00 00 00 01 00 02 AC F6
			15 00 00 00 01 00 02 AD 03
			15 00 00 00 01 00 02 AE FF
			15 00 00 00 01 00 02 AF 00
			15 00 00 00 01 00 02 B0 CF
			15 00 00 00 01 00 02 B1 00
			15 00 00 00 01 00 02 B2 D9
			15 00 00 00 01 00 02 B3 00
			15 00 00 00 01 00 02 B4 EE
			15 00 00 00 01 00 02 B5 00
			15 00 00 00 01 00 02 B6 FF
			15 00 00 00 01 00 02 B7 01
			15 00 00 00 01 00 02 B8 10
			15 00 00 00 01 00 02 B9 01
			15 00 00 00 01 00 02 BA 1F
			15 00 00 00 01 00 02 BB 01
			15 00 00 00 01 00 02 BC 2E
			15 00 00 00 01 00 02 BD 01
			15 00 00 00 01 00 02 BE 3A
			15 00 00 00 01 00 02 BF 01
			15 00 00 00 01 00 02 C0 48
			15 00 00 00 01 00 02 C1 01
			15 00 00 00 01 00 02 C2 72
			15 00 00 00 01 00 02 C3 01
			15 00 00 00 01 00 02 C4 95
			15 00 00 00 01 00 02 C5 01
			15 00 00 00 01 00 02 C6 CD
			15 00 00 00 01 00 02 C7 01
			15 00 00 00 01 00 02 C8 F9
			15 00 00 00 01 00 02 C9 02
			15 00 00 00 01 00 02 CA 3D
			15 00 00 00 01 00 02 CB 02
			15 00 00 00 01 00 02 CC 75
			15 00 00 00 01 00 02 CD 02
			15 00 00 00 01 00 02 CE 77
			15 00 00 00 01 00 02 CF 02
			15 00 00 00 01 00 02 D0 AE
			15 00 00 00 01 00 02 D1 02
			15 00 00 00 01 00 02 D2 EC
			15 00 00 00 01 00 02 D3 03
			15 00 00 00 01 00 02 D4 13
			15 00 00 00 01 00 02 D5 03
			15 00 00 00 01 00 02 D6 43
			15 00 00 00 01 00 02 D7 03
			15 00 00 00 01 00 02 D8 63
			15 00 00 00 01 00 02 D9 03
			15 00 00 00 01 00 02 DA 8C
			15 00 00 00 01 00 02 DB 03
			15 00 00 00 01 00 02 DC 98
			15 00 00 00 01 00 02 DD 03
			15 00 00 00 01 00 02 DE A5
			15 00 00 00 01 00 02 DF 03
			15 00 00 00 01 00 02 E0 B3
			15 00 00 00 01 00 02 E1 03
			15 00 00 00 01 00 02 E2 C2
			15 00 00 00 01 00 02 E3 03
			15 00 00 00 01 00 02 E4 D2
			15 00 00 00 01 00 02 E5 03
			15 00 00 00 01 00 02 E6 E3
			15 00 00 00 01 00 02 E7 03
			15 00 00 00 01 00 02 E8 F6
			15 00 00 00 01 00 02 E9 03
			15 00 00 00 01 00 02 EA FF
			15 00 00 00 01 00 02 FB 01
			15 01 00 00 01 00 02 FF 10
			];
		qcom,mdss-dsi-dispparam-cold-command-state = "dsi_hs_mode";
	};
};
