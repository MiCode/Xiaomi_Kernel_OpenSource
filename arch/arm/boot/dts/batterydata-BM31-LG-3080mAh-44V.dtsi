/* Copyright (c) 2013, The Linux Foundation. All rights reserved.
 * Copyright (C) 2015 XiaoMi, Inc.
 *
 * This program is free software; you can redistribute it and/or modify
 * it under the terms of the GNU General Public License version 2 and
 * only version 2 as published by the Free Software Foundation.
 *
 * This program is distributed in the hope that it will be useful,
 * but WITHOUT ANY WARRANTY; without even the implied warranty of
 * MERCHANTABILITY or FITNESS FOR A PARTICULAR PURPOSE.  See the
 * GNU General Public License for more details.
 */

qcom,BM31-LG-3080mAh-44V-data {
	qcom,fcc-mah = <3020>;
	qcom,default-rbatt-mohm = <116>;
	qcom,rbatt-capacitive-mohm = <0>;
	qcom,flat-ocv-threshold-uv = <3800000>;
	qcom,max-voltage-uv = <4400000>;
	qcom,v-cutoff-uv = <3400000>;
	qcom,chg-term-ua = <200000>;
	qcom,batt-id-kohm = <50>;
	xiaomi,batt-version = <5>;

	qcom,rbatt-sf-lut {
		qcom,lut-col-legend = <(-20) (-10) 0 5 10 15 20 25 30 40 60>;
		qcom,lut-row-legend = <100 95 90 85 80>,
				<75 70 65 60 55>,
				<50 45 40 35 30>,
				<25 20 16 13 11>,
				<10 9 8 7 6>,
				<5 4 3 2 1>;
		qcom,lut-data = <1433 625 292 217 166 134 114 100 91 78 79>,
				<1433 625 292 217 166 134 114 100 91 78 79>,
				<1384 634 295 221 171 139 117 104 95 82 79>,
				<1334 634 302 227 177 144 122 109 99 86 79>,
				<1307 632 313 238 185 152 129 115 103 90 81>,
				<1311 654 314 243 193 159 136 122 109 94 84>,
				<1170 617 345 274 217 178 150 131 118 102 88>,
				<1179 559 284 229 203 175 153 134 122 105 95>,
				<1172 577 284 219 183 165 157 145 131 112 99>,
				<1180 578 279 211 164 136 119 109 100 90 105>,
				<1222 575 278 206 161 132 113 101 93 81 88>,
				<1284 582 280 209 164 135 116 103 95 84 82>,
				<1357 612 284 216 169 141 123 108 99 90 86>,
				<1447 653 293 219 174 148 129 114 103 91 81>,
				<1556 712 312 232 178 148 132 118 107 91 84>,
				<1679 787 339 248 193 156 133 116 103 85 88>,
				<1825 886 357 259 196 156 130 112 100 85 85>,
				<1946 974 385 258 188 148 125 109 98 83 83>,
				<2043 1042 426 274 191 147 121 105 95 83 81>,
				<2014 1056 457 297 204 156 128 111 100 86 85>,
				<1822 995 441 296 207 159 133 115 104 90 88>,
				<1884 1003 451 303 214 165 136 119 107 92 90>,
				<2002 1042 471 319 225 174 143 124 110 94 90>,
				<2167 1084 492 334 235 181 148 127 114 95 88>,
				<2398 1127 510 346 241 183 147 124 109 90 84>,
				<2679 1174 533 355 243 181 143 120 104 87 87>,
				<3046 1230 557 369 247 183 144 121 106 91 91>,
				<3559 1298 597 393 262 191 153 128 112 97 103>,
				<4321 1407 653 436 291 215 171 145 129 111 125>,
				<6087 1979 814 534 372 280 228 197 166 145 181>;
	};

	qcom,fcc-temp-lut {
		qcom,lut-col-legend = <(-20) (-10) 0 5 10 15 20 25 30 40 60>;
		qcom,lut-data = <3022 3015 3014 3012 3008 3006 3002 3000 2996 2990 2978>;
	};

	qcom,pc-temp-ocv-lut {
		qcom,lut-col-legend = <(-20) (-10) 0 5 10 15 20 25 30 40 60>;
		qcom,lut-row-legend = <100 95 90 85 80>,
				<75 70 65 60 55>,
				<50 45 40 35 30>,
				<25 20 16 13 11>,
				<10 9 8 7 6>,
				<5 4 3 2 1 0>;
		qcom,lut-data = <4392 4392 4390 4388 4386 4384 4382 4382 4380 4376 4373>,
				<4291 4306 4316 4318 4319 4320 4320 4320 4319 4317 4319>,
				<4218 4242 4254 4258 4260 4261 4262 4262 4261 4260 4264>,
				<4155 4185 4198 4201 4203 4204 4204 4205 4205 4204 4208>,
				<4102 4128 4144 4147 4149 4150 4150 4150 4150 4148 4152>,
				<4060 4082 4092 4094 4096 4096 4096 4097 4096 4096 4100>,
				<3954 4006 4040 4050 4053 4054 4054 4054 4054 4051 4049>,
				<3912 3934 3953 3962 3976 3981 3984 3987 3990 3996 4002>,
				<3871 3902 3918 3923 3931 3940 3949 3952 3954 3957 3959>,
				<3836 3867 3882 3886 3888 3891 3894 3896 3898 3900 3904>,
				<3814 3834 3850 3853 3856 3858 3858 3860 3860 3861 3866>,
				<3796 3806 3823 3826 3829 3830 3832 3832 3834 3834 3838>,
				<3780 3788 3799 3804 3806 3808 3810 3810 3810 3812 3814>,
				<3764 3773 3782 3784 3788 3790 3792 3792 3792 3792 3794>,
				<3750 3760 3768 3773 3774 3774 3776 3776 3777 3774 3768>,
				<3734 3747 3756 3762 3764 3764 3763 3762 3760 3754 3742>,
				<3716 3734 3735 3740 3743 3744 3742 3740 3738 3731 3716>,
				<3700 3720 3717 3714 3714 3712 3711 3708 3706 3700 3686>,
				<3682 3707 3706 3702 3700 3698 3695 3692 3690 3684 3672>,
				<3669 3696 3698 3696 3694 3693 3690 3688 3686 3680 3669>,
				<3662 3691 3695 3694 3692 3691 3690 3687 3685 3680 3668>,
				<3652 3685 3692 3692 3691 3690 3688 3686 3684 3678 3666>,
				<3642 3677 3687 3688 3688 3688 3686 3685 3682 3677 3664>,
				<3628 3667 3680 3682 3683 3683 3682 3680 3678 3672 3654>,
				<3611 3650 3662 3666 3668 3669 3668 3666 3664 3655 3630>,
				<3587 3625 3633 3636 3638 3638 3636 3632 3628 3618 3590>,
				<3553 3586 3590 3592 3592 3590 3586 3582 3578 3569 3537>,
				<3503 3530 3532 3532 3528 3524 3521 3517 3513 3504 3472>,
				<3426 3450 3450 3448 3442 3438 3436 3432 3428 3420 3386>,
				<3292 3317 3317 3318 3312 3309 3305 3302 3300 3289 3254>,
				<3000 3000 3000 3000 3000 3000 3000 3000 3000 3000 3000>;
	};
};
