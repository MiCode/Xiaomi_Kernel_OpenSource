/* Copyright (c) 2013, The Linux Foundation. All rights reserved.
 *
 * This program is free software; you can redistribute it and/or modify
 * it under the terms of the GNU General Public License version 2 and
 * only version 2 as published by the Free Software Foundation.
 *
 * This program is distributed in the hope that it will be useful,
 * but WITHOUT ANY WARRANTY; without even the implied warranty of
 * MERCHANTABILITY or FITNESS FOR A PARTICULAR PURPOSE.  See the
 * GNU General Public License for more details.
 */

qcom,qrd-4v2-2200mah-data {
	qcom,default-rbatt-mohm = <163>;
	qcom,max-voltage-uv = <4200>;
	qcom,fcc-mah = <2200>;
	qcom,rbatt-capacitive-mohm = <0>;
	qcom,v-cutoff-uv = <3400000>;
	qcom,chg-term-ua = <100000>;
	qcom,batt-id-kohm = <10>;
	qcom,flat-ocv-threshold-uv = <3800000>;

	qcom,fcc-temp-lut {
		qcom,lut-col-legend = <(-20) 0 25 40 60>;
		qcom,lut-data = <2167 2179 2234 2178 2164>;
	};

	qcom,pc-temp-ocv-lut {
		qcom,lut-col-legend = <(-20) 0 25 40 60>;
		qcom,lut-row-legend = <100 95 90 85 80>,
				<75 70 65 60 55>,
				<50 45 40 35 30>,
				<25 20 15 10 9>,
				<8 7 6 5 4>,
				<3 2 1 0>;
		qcom,lut-data = <4188 4184 4199 4176 4170>,
				<4109 4124 4145 4124 4118>,
				<4051 4082 4097 4077 4072>,
				<3963 4024 4055 4034 4029>,
				<3920 3971 4002 3993 3989>,
				<3880 3932 3963 3957 3952>,
				<3846 3892 3920 3913 3910>,
				<3822 3859 3881 3873 3871>,
				<3805 3834 3851 3845 3844>,
				<3790 3813 3828 3823 3822>,
				<3777 3796 3808 3805 3803>,
				<3764 3784 3792 3790 3788>,
				<3750 3775 3778 3777 3774>,
				<3736 3766 3766 3761 3751>,
				<3721 3752 3755 3745 3732>,
				<3704 3733 3737 3729 3716>,
				<3684 3707 3713 3707 3694>,
				<3655 3686 3688 3682 3672>,
				<3598 3661 3677 3671 3659>,
				<3585 3655 3673 3669 3656>,
				<3571 3644 3664 3663 3650>,
				<3551 3626 3643 3648 3631>,
				<3523 3598 3609 3618 3600>,
				<3489 3561 3565 3578 3561>,
				<3445 3514 3510 3529 3512>,
				<3389 3453 3440 3468 3450>,
				<3313 3372 3345 3386 3366>,
				<3207 3252 3209 3262 3239>,
				<3000 3000 3000 3000 3000>;
	};

	qcom,rbatt-sf-lut {
		qcom,lut-col-legend = <(-20) 0 25 40 60>;
		qcom,lut-row-legend = <100 95 90 85 80>,
				<75 70 65 60 55>,
				<50 45 40 35 30>,
				<25 20 15 10 9>,
				<8 7 6 5 4>,
				<3 2 1 0>;
		qcom,lut-data = <1371 224 100 79 74>,
				<1358 242 100 80 74>,
				<1358 242 103 80 74>,
				<1195 257 107 82 75>,
				<1171 256 112 84 77>,
				<1149 250 119 89 79>,
				<1144 232 114 90 79>,
				<1150 225 101 83 76>,
				<1175 227 98 81 76>,
				<1210 232 98 82 76>,
				<1260 236 98 82 77>,
				<1329 242 100 84 77>,
				<1421 251 100 86 79>,
				<1536 263 101 81 76>,
				<1671 280 100 80 74>,
				<1830 304 100 81 75>,
				<2036 338 101 82 76>,
				<2326 443 103 82 76>,
				<2788 708 112 88 79>,
				<2890 747 115 90 80>,
				<2755 676 117 89 79>,
				<2750 716 118 87 78>,
				<2916 765 119 87 79>,
				<3336 833 123 89 80>,
				<4214 920 133 92 81>,
				<5615 1031 151 96 83>,
				<7923 1188 192 104 89>,
				<13252 1886 585 137 122>,
				<43764 20050 47711 3680 16847>;
	};
};
