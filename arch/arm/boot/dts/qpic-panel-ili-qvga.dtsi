/* Copyright (c) 2013, The Linux Foundation. All rights reserved.
 *
 * This program is free software; you can redistribute it and/or modify
 * it under the terms of the GNU General Public License version 2 and
 * only version 2 as published by the Free Software Foundation.
 *
 * This program is distributed in the hope that it will be useful,
 * but WITHOUT ANY WARRANTY; without even the implied warranty of
 * MERCHANTABILITY or FITNESS FOR A PARTICULAR PURPOSE.  See the
 * GNU General Public License for more details.
 */

&soc {
	qcom,mdss_lcdc_ili9341_qvga {
		compatible = "qcom,mdss-qpic-panel";
		label = "ili qvga lcdc panel";
		vdd-supply = <&pm8019_l11>;
		avdd-supply = <&pm8019_l14>;
		qcom,cs-gpio = <&msmgpio 21 0>;
		qcom,te-gpio = <&msmgpio 22 0>;
		qcom,rst-gpio = <&msmgpio 23 0>;
		qcom,ad8-gpio = <&msmgpio 20 0>;
		qcom,mdss-pan-res = <240 320>;
		qcom,mdss-pan-bpp = <18>;
		qcom,refresh_rate = <60>;
	};
};
