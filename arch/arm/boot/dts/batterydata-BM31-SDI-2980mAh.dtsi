/* Copyright (c) 2013, The Linux Foundation. All rights reserved.
 * Copyright (C) 2015 XiaoMi, Inc.
 *
 * This program is free software; you can redistribute it and/or modify
 * it under the terms of the GNU General Public License version 2 and
 * only version 2 as published by the Free Software Foundation.
 *
 * This program is distributed in the hope that it will be useful,
 * but WITHOUT ANY WARRANTY; without even the implied warranty of
 * MERCHANTABILITY or FITNESS FOR A PARTICULAR PURPOSE.  See the
 * GNU General Public License for more details.
 */

qcom,BM31-SDI-2980mAh-data {
	qcom,fcc-mah = <2980>;
	qcom,default-rbatt-mohm = <188>;
	qcom,rbatt-capacitive-mohm = <0>;
	qcom,flat-ocv-threshold-uv = <3800000>;
	qcom,max-voltage-uv = <4350000>;
	qcom,v-cutoff-uv = <3400000>;
	qcom,chg-term-ua = <100000>;
	qcom,batt-id-kohm = <29>;
	xiaomi,batt-version = <3>;

	qcom,rbatt-sf-lut {
		qcom,lut-col-legend = <(-20) (-10) 0 5 10 15 20 25 30 40 60>;
		qcom,lut-row-legend = <100 95 90 85 80>,
				<75 70 65 60 55>,
				<50 45 40 35 30>,
				<25 20 16 13 11>,
				<10 9 8 7 6>,
				<5 4 3 2 1>;
		qcom,lut-data = <1203 454 331 179 149 134 115 100 102 79 73>,
				<1127 454 331 179 149 133 115 100 102 79 73>,
				<1128 441 335 182 153 129 116 102 103 80 74>,
				<1039 429 330 183 157 132 118 104 105 82 75>,
				<987 398 337 187 161 135 120 108 107 84 76>,
				<951 389 302 190 167 142 126 110 112 86 77>,
				<1023 377 293 180 163 140 125 118 112 90 80>,
				<1083 354 296 185 170 150 135 122 119 94 82>,
				<1117 379 288 177 160 143 132 113 120 97 86>,
				<1145 411 279 163 145 127 113 99 104 81 75>,
				<1172 431 270 160 142 124 110 98 100 80 74>,
				<1198 444 253 156 141 125 110 100 101 81 76>,
				<1226 456 276 156 139 127 112 102 102 84 78>,
				<1257 466 314 170 141 128 113 104 104 85 80>,
				<1307 479 344 186 151 130 115 106 106 86 79>,
				<1404 492 368 198 161 137 116 106 106 84 77>,
				<1595 510 403 207 166 141 118 105 104 84 77>,
				<1806 526 442 211 166 139 117 102 104 82 77>,
				<1993 531 477 217 165 137 114 96 101 80 75>,
				<2090 505 472 214 162 134 112 97 101 81 77>,
				<1956 515 452 218 164 136 113 98 102 83 78>,
				<1991 532 463 226 169 138 117 101 104 85 80>,
				<2147 538 478 234 175 143 120 105 107 87 82>,
				<2340 550 492 243 182 148 125 109 111 90 85>,
				<2578 563 507 253 192 154 130 113 115 92 84>,
				<2865 575 523 257 195 157 131 110 115 86 79>,
				<3243 591 544 257 192 154 128 105 112 83 79>,
				<3779 626 569 265 195 154 129 106 113 86 82>,
				<4715 727 606 284 211 166 138 115 121 95 90>,
				<7688 1365 837 320 243 193 162 214 144 136 179>;
	};

	qcom,fcc-temp-lut {
		qcom,lut-col-legend = <(-20) (-10) 0 5 10 15 20 25 30 40 60>;
		qcom,lut-data = <2969 3073 2994 3033 3031 3030 3029 3004 3028 3006 2993>;
	};

	qcom,pc-temp-ocv-lut {
		qcom,lut-col-legend = <(-20) (-10) 0 5 10 15 20 25 30 40 60>;
		qcom,lut-row-legend = <100 95 90 85 80>,
				<75 70 65 60 55>,
				<50 45 40 35 30>,
				<25 20 16 13 11>,
				<10 9 8 7 6>,
				<5 4 3 2 1 0>;
		qcom,lut-data = <4287 4317 4294 4307 4307 4307 4307 4292 4306 4288 4281>,
				<4123 4227 4213 4235 4237 4238 4240 4224 4240 4223 4220>,
				<4046 4166 4158 4180 4183 4184 4185 4171 4186 4170 4167>,
				<3952 4114 4105 4129 4131 4133 4134 4120 4135 4119 4116>,
				<3878 4048 4063 4082 4083 4084 4085 4072 4085 4070 4068>,
				<3815 3997 3989 4035 4039 4041 4042 4024 4042 4025 4023>,
				<3803 3946 3938 3974 3979 3982 3983 3976 3986 3983 3982>,
				<3794 3889 3906 3940 3947 3951 3954 3945 3956 3947 3945>,
				<3784 3858 3874 3899 3904 3909 3912 3899 3915 3907 3907>,
				<3774 3833 3843 3858 3860 3863 3864 3857 3866 3859 3858>,
				<3762 3813 3815 3829 3832 3833 3834 3830 3835 3831 3831>,
				<3750 3796 3782 3806 3809 3811 3812 3810 3814 3811 3810>,
				<3736 3780 3767 3786 3791 3793 3795 3793 3796 3793 3793>,
				<3721 3765 3755 3774 3775 3778 3780 3779 3781 3778 3778>,
				<3705 3751 3742 3763 3765 3766 3768 3767 3769 3765 3759>,
				<3686 3738 3724 3749 3753 3755 3755 3754 3755 3749 3737>,
				<3663 3721 3707 3728 3732 3735 3735 3733 3735 3728 3716>,
				<3639 3700 3696 3702 3705 3707 3708 3705 3708 3702 3690>,
				<3618 3685 3689 3686 3686 3687 3687 3685 3687 3681 3670>,
				<3600 3678 3683 3682 3682 3682 3682 3682 3682 3679 3669>,
				<3590 3674 3679 3680 3680 3681 3681 3681 3681 3678 3668>,
				<3580 3670 3674 3678 3679 3680 3680 3680 3680 3678 3667>,
				<3568 3664 3668 3676 3677 3678 3679 3679 3679 3676 3665>,
				<3552 3656 3659 3673 3675 3676 3677 3677 3677 3674 3662>,
				<3535 3643 3646 3668 3670 3672 3672 3670 3672 3666 3650>,
				<3513 3616 3625 3652 3655 3657 3658 3649 3656 3640 3620>,
				<3485 3574 3594 3616 3620 3621 3621 3604 3618 3592 3570>,
				<3448 3515 3546 3561 3563 3564 3563 3540 3560 3527 3505>,
				<3394 3431 3472 3482 3484 3484 3484 3451 3480 3439 3414>,
				<3302 3301 3346 3361 3365 3367 3367 3313 3362 3299 3267>,
				<3000 3000 3000 3000 3000 3000 3000 3000 3000 3000 3000>;
	};
};
