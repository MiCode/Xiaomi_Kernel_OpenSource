/* Copyright (c) 2014, The Linux Foundation. All rights reserved.
 * Copyright (C) 2015 XiaoMi, Inc.
 *
 * This program is free software; you can redistribute it and/or modify
 * it under the terms of the GNU General Public License version 2 and
 * only version 2 as published by the Free Software Foundation.
 *
 * This program is distributed in the hope that it will be useful,
 * but WITHOUT ANY WARRANTY; without even the implied warranty of
 * MERCHANTABILITY or FITNESS FOR A PARTICULAR PURPOSE.  See the
 * GNU General Public License for more details.
 */

/*---------------------------------------------------------------------------
 * This file is autogenerated file using gcdb parser. Please do not edit it.
 * Update input XML file to add a new entry or update variable in this file
 * VERSION = "1.0"
 *---------------------------------------------------------------------------*/
&mdss_mdp {
	dsi_lgd_nt35521_720_vid: qcom,mdss_dsi_lgd_nt35521_720p_video {
		qcom,mdss-dsi-panel-name = "lgd nt35521 720p video mode dsi panel";
		qcom,mdss-dsi-panel-controller = <&mdss_dsi0>;
		qcom,mdss-dsi-panel-type = "dsi_video_mode";
		qcom,mdss-dsi-panel-destination = "display_1";
		qcom,mdss-dsi-panel-framerate = <60>;
		qcom,mdss-dsi-virtual-channel-id = <0>;
		qcom,mdss-dsi-stream = <0>;
		qcom,mdss-dsi-panel-width = <720>;
		qcom,mdss-dsi-panel-height = <1280>;
		qcom,mdss-dsi-h-front-porch = <180>;
		qcom,mdss-dsi-h-back-porch = <180>;
		qcom,mdss-dsi-h-pulse-width = <8>;
		qcom,mdss-dsi-h-sync-skew = <0>;
		qcom,mdss-dsi-v-back-porch = <16>;
		qcom,mdss-dsi-v-front-porch = <16>;
		qcom,mdss-dsi-v-pulse-width = <2>;
		qcom,mdss-dsi-h-left-border = <0>;
		qcom,mdss-dsi-h-right-border = <0>;
		qcom,mdss-dsi-v-top-border = <0>;
		qcom,mdss-dsi-v-bottom-border = <0>;
		qcom,mdss-dsi-bpp = <24>;
		qcom,mdss-dsi-underflow-color = <0xff>;
		qcom,mdss-dsi-border-color = <0>;
		qcom,mdss-dsi-pixel-packing = "tight";
		qcom,mdss-dsi-on-command = [
				29 01 00 00 00 00 06 F0 55 AA 52 08 00
				29 01 00 00 00 00 05 FF AA 55 A5 80
				29 01 00 00 00 00 03 B1 68 21
				29 01 00 00 00 00 02 B5 C8
				29 01 00 00 00 00 02 B6 12
				29 01 00 00 00 00 05 B8 00 00 00 00
				29 01 00 00 00 00 03 BB 74 44
				29 01 00 00 00 00 06 BD 02 68 20 20 00
				29 01 00 00 00 00 04 D9 01 01 00
				29 01 00 00 00 00 02 6F 02
				29 01 00 00 00 00 02 F7 47
				29 01 00 00 00 00 02 6F 17
				29 01 00 00 00 00 02 F4 60

				29 01 00 00 00 00 06 F0 55 AA 52 08 01
				29 01 00 00 00 00 03 B3 20 20
				29 01 00 00 00 00 03 B4 20 20
				29 01 00 00 00 00 03 B9 35 35
				29 01 00 00 00 00 03 BA 35 35
				29 01 00 00 00 00 03 BC 90 00
				29 01 00 00 00 00 03 BD 98 00
				29 01 00 00 00 00 02 CA 00
				29 01 00 00 00 00 02 C0 0C

				29 01 00 00 00 00 06 F0 55 AA 52 08 02
				29 01 00 00 00 00 02 EE 00
				29 01 00 00 00 00 11 B0 00 2D 00 3C 00 5B 00 70 00 84 00 A7 00 C0 00 EB
				29 01 00 00 00 00 11 B1 01 15 01 50 01 7F 01 CC 02 0B 02 0C 02 4A 02 8E
				29 01 00 00 00 00 11 B2 02 BB 02 F3 03 1C 03 45 03 5B 03 77 03 90 03 A8
				29 01 00 00 00 00 05 B3 03 CF 03 FF
				29 01 00 00 00 00 11 B4 00 2D 00 3C 00 5B 00 70 00 84 00 A7 00 C4 00 F1
				29 01 00 00 00 00 11 B5 01 18 01 52 01 81 01 CB 02 0A 02 0C 02 4A 02 8E
				29 01 00 00 00 00 11 B6 02 BA 02 F3 03 1C 03 45 03 5B 03 77 03 90 03 A8
				29 01 00 00 00 00 05 B7 03 CF 03 FF
				29 01 00 00 00 00 11 B8 00 2D 00 3C 00 55 00 6A 00 7B 00 9B 00 B6 00 E2
				29 01 00 00 00 00 11 B9 01 0C 01 48 01 76 01 C5 02 04 02 06 02 46 02 8A
				29 01 00 00 00 00 11 BA 02 B9 02 F5 03 1C 03 45 03 5B 03 77 03 90 03 A8
				29 01 00 00 00 00 05 BB 03 CF 03 FF
				29 01 00 00 00 00 11 BC 00 00 00 15 00 3E 00 55 00 6C 00 93 00 AD 00 DB
				29 01 00 00 00 00 11 BD 01 0A 01 46 01 77 01 C7 02 0B 02 0C 02 4A 02 8E
				29 01 00 00 00 00 11 BE 02 BB 02 F3 03 1C 03 45 03 5B 03 77 03 90 03 A8
				29 01 00 00 00 00 05 BF 03 CF 03 FF
				29 01 00 00 00 00 11 C0 00 00 00 19 00 3D 00 59 00 6B 00 93 00 B2 00 E1
				29 01 00 00 00 00 11 C1 01 0C 01 48 01 79 01 C6 02 0A 02 0C 02 4A 02 8E
				29 01 00 00 00 00 11 C2 02 BA 02 F3 03 1C 03 45 03 5B 03 77 03 90 03 A8
				29 01 00 00 00 00 05 C3 03 CF 03 FF
				29 01 00 00 00 00 11 C4 00 00 00 12 00 2A 00 42 00 56 00 76 00 A3 00 D2
				29 01 00 00 00 00 11 C5 01 01 01 3B 01 6E 01 C0 02 04 02 06 02 46 02 8A
				29 01 00 00 00 00 11 C6 02 B9 02 F5 03 1C 03 45 03 5B 03 77 03 90 03 A8
				29 01 00 00 00 00 05 C7 03 CF 03 FF

				29 01 00 00 00 00 06 F0 55 AA 52 08 03
				29 01 00 00 00 00 03 B0 22 00
				29 01 00 00 00 00 03 B1 22 00
				29 01 00 00 00 00 06 B2 05 00 B0 00 00
				29 01 00 00 00 00 06 B3 05 00 B0 00 00
				29 01 00 00 00 00 06 B4 05 00 B0 00 00
				29 01 00 00 00 00 06 B5 05 00 B0 00 00
				29 01 00 00 00 00 06 BA 53 00 B0 00 00
				29 01 00 00 00 00 06 BB 53 00 B0 00 00
				29 01 00 00 00 00 06 BC 53 00 B0 00 00
				29 01 00 00 00 00 06 BD 53 00 B0 00 00
				29 01 00 00 00 00 05 C0 00 60 00 00
				29 01 00 00 00 00 05 C1 00 00 60 00
				29 01 00 00 00 00 05 C2 00 00 34 00
				29 01 00 00 00 00 05 C3 00 00 34 00
				29 01 00 00 00 00 02 C4 60
				29 01 00 00 00 00 02 C5 C0
				29 01 00 00 00 00 02 C6 00
				29 01 00 00 00 00 02 C7 00

				29 01 00 00 00 00 06 F0 55 AA 52 08 05
				29 01 00 00 00 00 03 B0 17 06
				29 01 00 00 00 00 03 B1 17 06
				29 01 00 00 00 00 03 B2 17 06
				29 01 00 00 00 00 03 B3 17 06
				29 01 00 00 00 00 03 B4 17 06
				29 01 00 00 00 00 03 B5 17 06
				29 01 00 00 00 00 03 B6 17 06
				29 01 00 00 00 00 03 B7 17 06
				29 01 00 00 00 00 02 B8 00
				29 01 00 00 00 00 02 B9 00
				29 01 00 00 00 00 02 BA 00
				29 01 00 00 00 00 02 BB 0A
				29 01 00 00 00 00 02 BC 02
				29 01 00 00 00 00 06 BD 03 03 00 03 03
				29 01 00 00 00 00 02 C0 0B
				29 01 00 00 00 00 02 C1 09
				29 01 00 00 00 00 02 C2 A6
				29 01 00 00 00 00 02 C3 05
				29 01 00 00 00 00 02 C4 00
				29 01 00 00 00 00 02 C5 02
				29 01 00 00 00 00 02 C6 22
				29 01 00 00 00 00 02 C7 03
				29 01 00 00 00 00 03 C8 07 20
				29 01 00 00 00 00 03 C9 03 20
				29 01 00 00 00 00 03 CA 01 60
				29 01 00 00 00 00 03 CB 01 60
				29 01 00 00 00 00 04 CC 00 00 02
				29 01 00 00 00 00 04 CD 00 00 02
				29 01 00 00 00 00 04 CE 00 00 02
				29 01 00 00 00 00 04 CF 00 00 02
				29 01 00 00 00 00 02 D0 00
				29 01 00 00 00 00 06 D1 00 05 01 07 10
				29 01 00 00 00 00 06 D2 10 05 05 03 10
				29 01 00 00 00 00 06 D3 20 00 43 07 10
				29 01 00 00 00 00 06 D4 30 00 43 07 10
				29 01 00 00 00 00 02 E5 06
				29 01 00 00 00 00 02 E6 06
				29 01 00 00 00 00 02 E7 00
				29 01 00 00 00 00 02 E8 06
				29 01 00 00 00 00 02 E9 06
				29 01 00 00 00 00 02 EA 06
				29 01 00 00 00 00 02 EB 00
				29 01 00 00 00 00 02 EC 00
				29 01 00 00 00 00 02 ED 33

				29 01 00 00 00 00 06 F0 55 AA 52 08 06
				29 01 00 00 00 00 03 B0 34 34
				29 01 00 00 00 00 03 B1 34 34
				29 01 00 00 00 00 03 B2 2D 2E
				29 01 00 00 00 00 03 B3 34 34
				29 01 00 00 00 00 03 B4 29 2A
				29 01 00 00 00 00 03 B5 12 10
				29 01 00 00 00 00 03 B6 18 16
				29 01 00 00 00 00 03 B7 00 02
				29 01 00 00 00 00 03 B8 34 31
				29 01 00 00 00 00 03 B9 31 31
				29 01 00 00 00 00 03 BA 31 31
				29 01 00 00 00 00 03 BB 31 34
				29 01 00 00 00 00 03 BC 03 01
				29 01 00 00 00 00 03 BD 17 19
				29 01 00 00 00 00 03 BE 11 13
				29 01 00 00 00 00 03 BF 2A 29
				29 01 00 00 00 00 03 C0 34 34
				29 01 00 00 00 00 03 C1 2E 2D
				29 01 00 00 00 00 03 C2 34 34
				29 01 00 00 00 00 03 C3 34 34
				29 01 00 00 00 00 03 C4 34 34
				29 01 00 00 00 00 03 C5 34 34
				29 01 00 00 00 00 03 C6 2E 2D
				29 01 00 00 00 00 03 C7 34 34
				29 01 00 00 00 00 03 C8 29 2A
				29 01 00 00 00 00 03 C9 17 19
				29 01 00 00 00 00 03 CA 11 13
				29 01 00 00 00 00 03 CB 03 01
				29 01 00 00 00 00 03 CC 34 31
				29 01 00 00 00 00 03 CD 31 31
				29 01 00 00 00 00 03 CE 31 31
				29 01 00 00 00 00 03 CF 31 34
				29 01 00 00 00 00 03 D0 00 02
				29 01 00 00 00 00 03 D1 12 10
				29 01 00 00 00 00 03 D2 18 16
				29 01 00 00 00 00 03 D3 2A 29
				29 01 00 00 00 00 03 D4 34 34
				29 01 00 00 00 00 03 D5 2D 2E
				29 01 00 00 00 00 03 D6 34 34
				29 01 00 00 00 00 03 D7 34 34
				29 01 00 00 00 00 06 D8 00 00 00 00 00
				29 01 00 00 00 00 06 D9 00 00 00 00 00

				29 01 00 00 00 00 02 51 FF
				29 01 00 00 00 00 02 53 2C
				29 01 00 00 00 00 02 55 01
				29 01 00 00 00 00 02 34 00
				05 01 00 00 78 00 02 11 00
				05 01 00 00 14 00 02 29 00
		];
		qcom,mdss-dsi-off-command = [05 01 00 00 14 00 02 28 00
					05 01 00 00 78 00 02 10 00];
		qcom,mdss-dsi-on-command-state = "dsi_lp_mode";
		qcom,mdss-dsi-off-command-state = "dsi_hs_mode";
		qcom,mdss-dsi-h-sync-pulse = <1>;
		qcom,mdss-dsi-traffic-mode = "non_burst_sync_pulse";
		qcom,mdss-dsi-bllp-eof-power-mode;
		qcom,mdss-dsi-bllp-power-mode;
		qcom,mdss-dsi-lane-0-state;
		qcom,mdss-dsi-lane-1-state;
		qcom,mdss-dsi-lane-2-state;
		qcom,mdss-dsi-lane-3-state;
		qcom,mdss-dsi-lp11-init;
		qcom,mdss-dsi-panel-timings = [bb 8e 21 00 99 9C 19 90 25 03 04 00];//514M
		qcom,mdss-dsi-t-clk-post = <0x19>;
		qcom,mdss-dsi-t-clk-pre = <0x2f>;
		qcom,mdss-dsi-bl-min-level = <1>;
		qcom,mdss-dsi-bl-max-level = <255>;
		qcom,mdss-dsi-dma-trigger = "trigger_sw";
		qcom,mdss-dsi-mdp-trigger = "none";
		qcom,mdss-dsi-bl-pmic-control-type = "bl_ctrl_sic";
		qcom,mdss-dsi-reset-sequence = <1 5>, <0 5>, <1 120>;
		qcom,mdss-pan-physical-width-dimension = <68>;
		qcom,mdss-pan-physical-height-dimension = <121>;
		qcom,cont-splash-enabled;
		qcom,dispparam-enabled;

	};
};
