/* Copyright (c) 2013, The Linux Foundation. All rights reserved.
 * Copyright (C) 2015 XiaoMi, Inc.
 *
 * This program is free software; you can redistribute it and/or modify
 * it under the terms of the GNU General Public License version 2 and
 * only version 2 as published by the Free Software Foundation.
 *
 * This program is distributed in the hope that it will be useful,
 * but WITHOUT ANY WARRANTY; without even the implied warranty of
 * MERCHANTABILITY or FITNESS FOR A PARTICULAR PURPOSE.  See the
 * GNU General Public License for more details.
 */

qcom,h2a-4v35-SONY {
	qcom,fcc-mah = <2050>;
	qcom,default-rbatt-mohm = <167>;
	qcom,rbatt-capacitive-mohm = <0>;
	qcom,flat-ocv-threshold-uv = <3800000>;
	qcom,max-voltage-uv = <4350000>;
	qcom,v-cutoff-uv = <3400000>;
	qcom,chg-term-ua = <100000>;
	qcom,batt-id-kohm = <22>;

	qcom,rbatt-sf-lut {
		qcom,lut-col-legend = <(-20) (-10) 0 5 10 15 20 25 30 40 60>;
		qcom,lut-row-legend = <100 95 90 85 80>,
				<75 70 65 60 55>,
				<50 45 40 35 30>,
				<25 20 16 13 11>,
				<10 9 8 7 6>,
				<5 4 3 2 1>;
		qcom,lut-data = <1257  528  271  203  160  131  113  100  91  80  74>,
										<1257  528  271  203  160  131  113  100  91  82  74>,
										<1246  533  274  208  164  135  116  103  94  83  74>,
										<1225  537  280  213  170  140  121  107  98  86  77>,
										<1204  532  281  218  176  147  127  113  102  89  78>,
										<1194  526  277  216  179  153  134  118  107  92  80>,
										<1189  522  270  208  173  152  136  123  113  97  83>,
										<1195  523  267  204  165  141  128  121  113  102  86>,
										<1205  526  267  202  161  135  118  108  101  94  85>,
										<1232  530  268  204  161  134  116  103  95  84  76>,
										<1264  540  273  207  165  136  117  104  95  84  76>,
										<1299  552  277  210  167  138  119  106  97  85  77>,
										<1353  571  285  214  170  143  123  110  100  88  78>,
										<1476  594  295  220  173  146  126  113  102  91  81>,
										<1628  623  308  230  177  146  126  113  102  89  78>,
										<1841  661  324  238  182  146  123  108  97  85  77>,
										<2153  720  340  248  186  148  123  108  98  86  77>,
										<2465  789  352  253  190  149  125  108  98  86  77>,
										<2735  843  364  257  191  150  125  108  98  86  77>,
										<2640  816  362  254  188  149  124  109  98  86  77>,
										<2504  778  350  247  185  147  125  109  98  86  79>,
										<2856  825  365  256  189  151  126  111  100  88  80>,
										<3330  888  387  269  197  156  130  114  102  89  82>,
										<4004  970  416  284  207  162  134  116  104  90  81>,
										<5033  1143  452  302  215  164  135  116  102  88  79>,
										<6530  1532  498  325  223  166  134  113  101  88  80>,
										<9103  2273  581  362  241  176  140  118  104  90  81>,
										<14061  3773  758  437  278  196  150  124  108  93  84>,
										<24620  7342  1383  606  347  229  169  137  119  101  91>,
										<46956  17139  4108  1637  726  367  241  190  170  149  119>;
	};

	qcom,fcc-temp-lut {
		qcom,lut-col-legend = <(-20) (-10) 0 5 10 15 20 25 30 40 60>;
		qcom,lut-data = <2059 2059 2059 2057 2057 2056 2055 2055 2054 2053 2047>;
	};

	qcom,pc-temp-ocv-lut {
		qcom,lut-col-legend = <(-20) (-10) 0 5 10 15 20 25 30 40 60>;
		qcom,lut-row-legend = <100 95 90 85 80>,
				<75 70 65 60 55>,
				<50 45 40 35 30>,
				<25 20 16 13 11>,
				<10 9 8 7 6>,
				<5 4 3 2 1>,
				<0>;
		qcom,lut-data = <4328 4327 4325 4324 4323 4322 4321 4319 4318 4314 4306>,
				<4208 4227 4237 4240 4241 4242 4242 4242 4242 4241 4237>,
				<4133 4163 4176 4181 4183 4184 4185 4186 4186 4185 4181>,
				<4068 4104 4121 4126 4129 4131 4132 4132 4133 4132 4129>,
				<4007 4047 4067 4074 4077 4080 4081 4082 4082 4082 4079>,
				<3955 3992 4013 4021 4028 4031 4033 4034 4035 4035 4034>,
				<3907 3944 3963 3970 3977 3983 3987 3990 3991 3992 3991>,
				<3865 3903 3920 3925 3931 3935 3940 3945 3948 3951 3951>,
				<3830 3866 3883 3888 3891 3894 3897 3900 3902 3906 3908>,
				<3801 3834 3850 3856 3859 3862 3864 3865 3866 3867 3867>,
				<3778 3806 3823 3829 3833 3835 3837 3838 3839 3840 3839>,
				<3757 3784 3800 3806 3810 3812 3814 3816 3817 3818 3817>,
				<3738 3766 3781 3786 3790 3794 3796 3797 3798 3799 3798>,
				<3718 3749 3767 3771 3774 3778 3780 3781 3782 3784 3783>,
				<3701 3733 3755 3759 3761 3763 3764 3765 3765 3764 3757>,
				<3682 3713 3741 3745 3747 3747 3747 3745 3744 3739 3728>,
				<3658 3691 3719 3724 3727 3727 3727 3726 3725 3720 3708>,
				<3635 3671 3694 3700 3704 3705 3705 3705 3704 3700 3688>,
				<3613 3654 3671 3677 3681 3683 3684 3684 3684 3680 3669>,
				<3595 3641 3657 3662 3667 3669 3672 3673 3673 3671 3661>,
				<3585 3633 3650 3656 3661 3665 3668 3669 3670 3668 3658>,
				<3572 3622 3642 3649 3655 3659 3663 3665 3666 3665 3655>,
				<3556 3609 3632 3640 3647 3652 3656 3659 3661 3659 3649>,
				<3535 3592 3617 3628 3635 3641 3645 3648 3650 3648 3636>,
				<3511 3569 3596 3606 3614 3618 3622 3625 3626 3622 3606>,
				<3480 3536 3561 3570 3576 3579 3583 3584 3585 3581 3565>,
				<3439 3488 3510 3518 3523 3526 3530 3532 3533 3529 3514>,
				<3384 3421 3441 3449 3454 3459 3463 3466 3467 3463 3449>,
				<3305 3329 3349 3358 3363 3369 3375 3379 3380 3377 3365>,
				<3180 3195 3216 3224 3229 3234 3243 3248 3251 3250 3239>,
				<3000 3000 3000 3000 3000 3000 3000 3000 3000 3000 3000>;
	};
};
