/* Copyright (c) 2013, The Linux Foundation. All rights reserved.
 *
 * This program is free software; you can redistribute it and/or modify
 * it under the terms of the GNU General Public License version 2 and
 * only version 2 as published by the Free Software Foundation.
 *
 * This program is distributed in the hope that it will be useful,
 * but WITHOUT ANY WARRANTY; without even the implied warranty of
 * MERCHANTABILITY or FITNESS FOR A PARTICULAR PURPOSE.  See the
 * GNU General Public License for more details.
 */

/dts-v1/;

/include/ "msm8610-v1.dtsi"
/include/ "msm8610-mtp.dtsi"
/include/ "msm8610-camera-sensor-cdp-mtp.dtsi"

/ {
	model = "Qualcomm MSM 8610 MTP";
	compatible = "qcom,msm8610-mtp", "qcom,msm8610", "qcom,mtp";
	qcom,msm-id = <147 8 0>, <165 8 0>, <161 8 0>, <162 8 0>,
		      <163 8 0>, <164 8 0>, <166 8 0>;
};


