/* Copyright (c) 2013, The Linux Foundation. All rights reserved.
 *
 * This program is free software; you can redistribute it and/or modify
 * it under the terms of the GNU General Public License version 2 and
 * only version 2 as published by the Free Software Foundation.
 *
 * This program is distributed in the hope that it will be useful,
 * but WITHOUT ANY WARRANTY; without even the implied warranty of
 * MERCHANTABILITY or FITNESS FOR A PARTICULAR PURPOSE.  See the
 * GNU General Public License for more details.
 */

/dts-v1/;

/include/ "msm8974-v2.dtsi"
/include/ "msm8974-cdp.dtsi"

/ {
	model = "Qualcomm MSM 8974v2 CDP";
	compatible = "qcom,msm8974-cdp", "qcom,msm8974";
	qcom,msm-id = <126 1 0x20000>;
};

&usb3 {
	#address-cells = <0>;
	interrupt-parent = <&usb3>;
	interrupts = <0 1 2 3>;
	#interrupt-cells = <1>;
	interrupt-map-mask = <0xffffffff>;
	interrupt-map = <0 &intc 0 131 0
			1 &intc 0 179 0
			2 &intc 0 133 0
			3 &spmi_bus 0x0 0x0 0x9 0x0>;
	interrupt-names = "irq", "otg_irq", "hs_phy_irq", "pmic_id_irq";
};
