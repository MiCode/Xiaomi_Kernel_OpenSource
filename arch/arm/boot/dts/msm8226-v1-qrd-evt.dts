/* Copyright (c) 2013, The Linux Foundation. All rights reserved.
 *
 * This program is free software; you can redistribute it and/or modify
 * it under the terms of the GNU General Public License version 2 and
 * only version 2 as published by the Free Software Foundation.
 *
 * This program is distributed in the hope that it will be useful,
 * but WITHOUT ANY WARRANTY; without even the implied warranty of
 * MERCHANTABILITY or FITNESS FOR A PARTICULAR PURPOSE.  See the
 * GNU General Public License for more details.
 */

/dts-v1/;
/include/ "msm8226-v1.dtsi"
/include/ "msm8226-qrd.dtsi"
/include/ "dsi-panel-nt35590-720p-video.dtsi"

/ {
	model = "Qualcomm MSM 8226 QRD";
	compatible = "qcom,msm8226-qrd", "qcom,msm8226", "qcom,qrd";
	qcom,msm-id = <145 11 0>,
		      <158 11 0>,
		      <159 11 0>,
		      <198 11 0>,
		      <205 11 0>;
};

&soc {
        qcom,mdss_dsi_nt35590_720p_video {
                status = "ok";
        };
};
