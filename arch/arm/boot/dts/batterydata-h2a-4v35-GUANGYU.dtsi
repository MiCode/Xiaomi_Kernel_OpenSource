/* Copyright (c) 2013, The Linux Foundation. All rights reserved.
 * Copyright (C) 2015 XiaoMi, Inc.
 *
 * This program is free software; you can redistribute it and/or modify
 * it under the terms of the GNU General Public License version 2 and
 * only version 2 as published by the Free Software Foundation.
 *
 * This program is distributed in the hope that it will be useful,
 * but WITHOUT ANY WARRANTY; without even the implied warranty of
 * MERCHANTABILITY or FITNESS FOR A PARTICULAR PURPOSE.  See the
 * GNU General Public License for more details.
 */

qcom,h2a-4v35-GUANGYU {
	qcom,fcc-mah = <2050>;
	qcom,default-rbatt-mohm = <204>;
	qcom,rbatt-capacitive-mohm = <0>;
	qcom,flat-ocv-threshold-uv = <3800000>;
	qcom,max-voltage-uv = <4350000>;
	qcom,v-cutoff-uv = <3400000>;
	qcom,chg-term-ua = <100000>;
	qcom,batt-id-kohm = <28>;

	qcom,rbatt-sf-lut {
		qcom,lut-col-legend = <(-20) (-10) 0 5 10 15 20 25 30 40 60>;
		qcom,lut-row-legend = <100 95 90 85 80>,
				<75 70 65 60 55>,
				<50 45 40 35 30>,
				<25 20 16 13 11>,
				<10 9 8 7 6>,
				<5 4 3 2 1>;
		qcom,lut-data = 	<1505 764 367 264 192 147 118 100 87 74 65>,
				<1399 755 368 265 195 148 119 100 88 75 66>,
				<1402 756 369 265 195 148 119 100 88 75 66>,
				<1355 739 364 265 197 150 121 102 90 76 67>,
				<1265 749 370 266 197 151 124 105 92 78 68>,
				<1228 696 366 272 205 160 131 111 98 82 69>,
				<1208 684 339 249 188 151 127 111 99 86 72>,
				<1198 686 345 253 189 150 125 108 96 84 73>,
				<1231 684 342 249 184 143 117 100 89 76 68>,
				<1289 684 339 247 182 141 114 98 86 75 66>,
				<1376 697 339 247 182 141 115 99 87 75 66>,
				<1471 725 338 247 184 143 117 100 89 76 68>,
				<1587 758 345 248 184 144 119 102 91 78 70>,
				<1728 793 359 254 186 145 118 102 92 80 71>,
				<1905 830 380 264 191 147 119 101 89 76 68>,
				<2128 875 408 278 199 151 121 102 89 75 66>,
				<2439 926 446 300 206 156 125 104 90 76 66>,
				<2772 969 484 329 219 159 125 105 92 76 67>,
				<3107 1016 514 356 237 166 128 105 92 77 67>,
				<3375 1049 529 370 249 174 131 107 93 78 69>,
				<3526 1056 525 368 251 177 135 109 94 79 70>,
				<3579 993 495 349 241 175 136 111 96 80 71>,
				<3630 952 477 328 231 174 136 113 98 81 72>,
				<3969 1036 491 334 234 175 138 114 99 81 71>,
				<4383 1125 506 341 234 172 135 112 96 77 68>,
				<4900 1253 531 351 238 173 135 109 95 78 69>,
				<5583 1431 556 371 247 177 136 111 96 80 71>,
				<6533 1649 586 393 261 184 141 116 100 83 73>,
				<8200 1931 636 427 283 199 152 124 106 90 78>,
				<14506 2708 1444 702 617 402 272 222 187 156 94>;
	};

	qcom,fcc-temp-lut {
		qcom,lut-col-legend = <(-20) (-10) 0 5 10 15 20 25 30 40 60>;
		qcom,lut-data = <2014 2018 2020 2019 2020 2020 2019 2019 2019 2018 2015>;
	};

	qcom,pc-temp-ocv-lut {
		qcom,lut-col-legend = <(-20) (-10) 0 5 10 15 20 25 30 40 60>;
		qcom,lut-row-legend = <100 95 90 85 80>,
				<75 70 65 60 55>,
				<50 45 40 35 30>,
				<25 20 16 13 11>,
				<10 9 8 7 6>,
				<5 4 3 2 1>,
				<0>;
		qcom,lut-data = 		<4322 4323 4323 4322 4322 4321 4320 4319 4317 4313 4305>,
				<4207 4232 4243 4246 4248 4250 4250 4250 4250 4249 4245>,
				<4134 4171 4186 4190 4192 4194 4194 4195 4194 4194 4190>,
				<4092 4112 4132 4137 4140 4141 4142 4142 4141 4141 4137>,
				<4005 4072 4085 4088 4090 4091 4091 4091 4090 4089 4087>,
				<3945 3989 4028 4036 4042 4045 4047 4048 4048 4046 4039>,
				<3898 3936 3955 3962 3968 3974 3978 3983 3986 3994 3995>,
				<3857 3896 3919 3926 3931 3936 3939 3943 3945 3948 3949>,
				<3830 3859 3885 3890 3895 3896 3898 3899 3900 3900 3900>,
				<3810 3826 3851 3857 3861 3863 3864 3865 3865 3866 3865>,
				<3792 3804 3822 3829 3833 3835 3837 3838 3839 3839 3839>,
				<3775 3788 3796 3804 3809 3812 3815 3816 3817 3817 3816>,
				<3758 3774 3779 3784 3788 3792 3795 3796 3797 3798 3797>,
				<3740 3760 3764 3768 3772 3774 3776 3777 3779 3780 3779>,
				<3721 3746 3750 3754 3758 3760 3760 3759 3759 3757 3750>,
				<3699 3730 3737 3738 3742 3744 3744 3744 3742 3737 3726>,
				<3671 3711 3722 3721 3722 3726 3726 3725 3724 3719 3706>,
				<3642 3691 3708 3709 3708 3707 3707 3706 3705 3700 3687>,
				<3615 3672 3695 3699 3699 3697 3694 3693 3691 3686 3674>,
				<3593 3656 3684 3690 3692 3691 3689 3687 3685 3680 3669>,
				<3580 3646 3677 3684 3688 3688 3686 3685 3683 3678 3667>,
				<3568 3635 3668 3678 3682 3684 3684 3682 3681 3676 3665>,
				<3552 3621 3657 3668 3674 3678 3679 3679 3677 3673 3660>,
				<3533 3604 3643 3654 3662 3666 3668 3669 3668 3663 3648>,
				<3510 3585 3621 3634 3641 3644 3646 3646 3645 3637 3620>,
				<3482 3558 3594 3606 3611 3613 3613 3611 3608 3600 3582>,
				<3446 3524 3558 3568 3570 3570 3568 3565 3562 3553 3534>,
				<3398 3478 3507 3515 3515 3513 3510 3506 3503 3493 3475>,
				<3329 3411 3434 3440 3437 3434 3431 3427 3423 3415 3396>,
				<3216 3298 3311 3318 3313 3311 3310 3306 3303 3294 3275>,
				<3000 3000 3000 3000 3000 3000 3000 3000 3000 3000 3000>;
	};
};
