/*
 * Copyright (c) 2019 MediaTek Inc.
 *
 * This program is free software; you can redistribute it and/or modify
 * it under the terms of the GNU General Public License version 2 as
 * published by the Free Software Foundation.
 *
 * This program is distributed in the hope that it will be useful,
 * but WITHOUT ANY WARRANTY; without even the implied warranty of
 * MERCHANTABILITY or FITNESS FOR A PARTICULAR PURPOSE.  See the
 * GNU General Public License for more details.
 */
&i2c3 {
	speaker_amp: speaker_amp@34 {
		status = "disabled";
	};
};

&i2c0 {
/* AWINIC AW87XXX Smart K PA */
	aw87xxx_pa@58 {
		compatible = "awinic,aw87xxx_pa";
		reg = <0x58>;
		//reset-gpio = <&pio 1 0>;
		dev_index = < 0 >;
		status = "okay";
	};
/* AWINIC AW87XXX Smart K PA End */
};

