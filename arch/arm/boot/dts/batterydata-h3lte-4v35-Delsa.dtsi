/* Copyright (c) 2013, The Linux Foundation. All rights reserved.
 * Copyright (C) 2015 XiaoMi, Inc.
 *
 * This program is free software; you can redistribute it and/or modify
 * it under the terms of the GNU General Public License version 2 and
 * only version 2 as published by the Free Software Foundation.
 *
 * This program is distributed in the hope that it will be useful,
 * but WITHOUT ANY WARRANTY; without even the implied warranty of
 * MERCHANTABILITY or FITNESS FOR A PARTICULAR PURPOSE.  See the
 * GNU General Public License for more details.
 */

qcom,h3lte-4v35-Delsa {
	qcom,fcc-mah = <3200>;
	qcom,default-rbatt-mohm = <128>;
	qcom,rbatt-capacitive-mohm = <0>;
	qcom,flat-ocv-threshold-uv = <3800000>;
	qcom,max-voltage-uv = <4350000>;
	qcom,v-cutoff-uv = <3400000>;
	qcom,chg-term-ua = <150000>;
	qcom,batt-id-kohm = <22>;

	qcom,rbatt-sf-lut {
		qcom,lut-col-legend = <(-20) (-10) 0 5 20 25 30 40 50 60>;
		qcom,lut-row-legend = <100 95 90 85 80>,
				<75 70 65 60 55>,
				<50 45 40 35 30>,
				<25 20 16 13 11>,
				<10 9 8 7 6>,
				<5 4 3 2 1>;
		qcom,lut-data = 	<1506 528 255 194 109 99 93 85 81 80>,
				<1506 528 255 194 109 99 93 85 81 80>,
				<1404 532 266 202 112 102 95 86 83 81>,
				<1345 521 276 212 116 105 98 88 84 83>,
				<1294 520 277 222 123 109 101 90 86 84>,
				<1155 513 291 240 134 117 108 95 88 86>,
				<1125 473 255 219 138 120 109 98 91 88>,
				<1112 474 248 203 150 131 117 102 95 91>,
				<1104 489 245 193 134 125 119 108 99 92>,
				<1111 500 244 188 116 109 102 94 89 86>,
				<1133 498 245 188 111 102 95 87 84 83>,
				<1166 504 247 191 112 102 96 88 86 85>,
				<1211 516 252 195 115 105 98 92 88 88>,
				<1267 527 258 200 119 109 100 94 91 89>,
				<1334 555 267 207 122 111 101 92 89 88>,
				<1417 600 275 214 122 109 98 89 85 84>,
				<1516 665 277 213 119 106 97 88 84 83>,
				<1601 729 282 212 116 104 96 87 84 83>,
				<1668 779 301 217 114 102 94 85 83 83>,
				<1708 818 327 230 116 105 97 88 84 84>,
				<1725 836 341 237 118 107 98 89 86 86>,
				<1730 844 358 249 122 110 101 92 90 88>,
				<1712 837 368 259 126 113 104 95 93 93>,
				<1620 779 355 262 130 116 107 98 98 98>,
				<1647 784 356 268 136 122 112 102 97 97>,
				<1766 804 361 268 136 120 109 96 91 88>,
				<2017 826 363 262 129 113 103 92 88 87>,
				<2544 859 372 263 130 115 103 94 91 91>,
				<4210 919 395 274 138 123 112 102 99 100>,
				<10293 3423 1711 1216 734 611 138 138 479 158>;
	};

	qcom,fcc-temp-lut {
		qcom,lut-col-legend = <(-20) (-10) 0 5 20 25 30 40 50 60>;
		qcom,lut-data = <3096 3098 3099 3099 3100 3098 3095 3089 3078 3058>;
	};

	qcom,pc-temp-ocv-lut {
		qcom,lut-col-legend = <(-20) (-10) 0 5 20 25 30 40 50 60>;
		qcom,lut-row-legend = <100 95 90 85 80>,
				<75 70 65 60 55>,
				<50 45 40 35 30>,
				<25 20 16 13 11>,
				<10 9 8 7 6>,
				<5 4 3 2 1>,
				<0>;
		qcom,lut-data = 					<4324 4326 4325 4324 4322 4322 4320 4316 4313 4309>,
				<4224 4247 4254 4256 4258 4258 4257 4255 4252 4250>,
				<4150 4187 4199 4202 4203 4203 4203 4201 4198 4196>,
				<4096 4129 4148 4151 4151 4151 4150 4149 4147 4144>,
				<4050 4078 4096 4100 4101 4100 4100 4099 4097 4096>,
				<3962 4022 4050 4059 4062 4060 4059 4053 4050 4048>,
				<3914 3952 3971 3984 4000 4002 4002 4007 4007 4006>,
				<3876 3913 3928 3936 3964 3967 3968 3969 3968 3967>,
				<3842 3883 3897 3901 3917 3921 3924 3926 3924 3921>,
				<3818 3854 3866 3869 3874 3876 3878 3878 3878 3878>,
				<3799 3826 3840 3842 3844 3845 3845 3846 3846 3846>,
				<3783 3802 3816 3818 3822 3822 3822 3823 3823 3823>,
				<3768 3782 3796 3800 3803 3803 3804 3804 3804 3804>,
				<3754 3765 3781 3784 3788 3788 3788 3788 3788 3787>,
				<3740 3750 3768 3772 3775 3775 3774 3771 3769 3766>,
				<3724 3738 3752 3758 3762 3760 3758 3752 3746 3740>,
				<3705 3726 3730 3734 3741 3739 3736 3730 3722 3716>,
				<3686 3716 3714 3715 3716 3714 3712 3706 3700 3692>,
				<3666 3707 3707 3704 3696 3693 3690 3684 3680 3676>,
				<3647 3696 3702 3700 3693 3690 3688 3682 3676 3670>,
				<3637 3691 3700 3698 3692 3690 3687 3681 3676 3669>,
				<3624 3683 3696 3696 3690 3688 3686 3680 3674 3668>,
				<3610 3674 3692 3693 3689 3688 3684 3679 3673 3666>,
				<3594 3662 3685 3688 3687 3685 3683 3677 3670 3664>,
				<3573 3644 3672 3678 3682 3680 3678 3672 3663 3656>,
				<3546 3621 3650 3658 3664 3662 3660 3650 3638 3626>,
				<3510 3588 3616 3623 3623 3621 3618 3608 3591 3576>,
				<3461 3539 3563 3569 3562 3561 3561 3547 3528 3510>,
				<3392 3466 3486 3490 3477 3476 3478 3463 3440 3424>,
				<3296 3342 3357 3360 3343 3344 3348 3328 3298 3280>,
				<3000 3000 3000 3000 3000 3000 3000 3000 3000 3000>;
};
};
