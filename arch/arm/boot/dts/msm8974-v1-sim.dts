/* Copyright (c) 2012-2013, The Linux Foundation. All rights reserved.
 *
 * This program is free software; you can redistribute it and/or modify
 * it under the terms of the GNU General Public License version 2 and
 * only version 2 as published by the Free Software Foundation.
 *
 * This program is distributed in the hope that it will be useful,
 * but WITHOUT ANY WARRANTY; without even the implied warranty of
 * MERCHANTABILITY or FITNESS FOR A PARTICULAR PURPOSE.  See the
 * GNU General Public License for more details.
 */

/dts-v1/;

/include/ "msm8974-v1.dtsi"
/include/ "msm8974-sim.dtsi"

/ {
	model = "Qualcomm MSM 8974 Simulator";
	compatible = "qcom,msm8974-sim", "qcom,msm8974", "qcom,sim";
	qcom,msm-id = <126 16 0>,
		      <185 16 0>,
		      <186 16 0>;
};
