/* Copyright (c) 2013, The Linux Foundation. All rights reserved.
 *
 * This program is free software; you can redistribute it and/or modify
 * it under the terms of the GNU General Public License version 2 and
 * only version 2 as published by the Free Software Foundation.
 *
 * This program is distributed in the hope that it will be useful,
 * but WITHOUT ANY WARRANTY; without even the implied warranty of
 * MERCHANTABILITY or FITNESS FOR A PARTICULAR PURPOSE.  See the
 * GNU General Public License for more details.
 */

/*---------------------------------------------------------------------------
 * This file is autogenerated file using gcdb parser. Please do not edit it.
 * Update input XML file to add a new entry or update variable in this file
 * VERSION = "1.0"
 *---------------------------------------------------------------------------*/
&mdss_mdp {
	dsi_ssd2080m_720_vid: qcom,mdss_dsi_ssd2080m_720p_video {
		qcom,mdss-dsi-panel-name = "ssd2080m 720p video mode dsi panel";
		qcom,mdss-dsi-panel-controller = <&mdss_dsi0>;
		qcom,mdss-dsi-panel-type = "dsi_video_mode";
		qcom,mdss-dsi-panel-destination = "display_1";
		qcom,mdss-dsi-panel-framerate = <60>;
		qcom,mdss-dsi-virtual-channel-id = <0>;
		qcom,mdss-dsi-stream = <0>;
		qcom,mdss-dsi-panel-width = <720>;
		qcom,mdss-dsi-panel-height = <1280>;
		qcom,mdss-dsi-h-front-porch = <80>;
		qcom,mdss-dsi-h-back-porch = <24>;
		qcom,mdss-dsi-h-pulse-width = <14>;
		qcom,mdss-dsi-h-sync-skew = <0>;
		qcom,mdss-dsi-v-back-porch = <14>;
		qcom,mdss-dsi-v-front-porch = <25>;
		qcom,mdss-dsi-v-pulse-width = <2>;
		qcom,mdss-dsi-h-left-border = <0>;
		qcom,mdss-dsi-h-right-border = <0>;
		qcom,mdss-dsi-v-top-border = <0>;
		qcom,mdss-dsi-v-bottom-border = <0>;
		qcom,mdss-dsi-bpp = <24>;
		qcom,mdss-dsi-color-order = "rgb_swap_rgb";
		qcom,mdss-dsi-underflow-color = <0xff>;
		qcom,mdss-dsi-border-color = <0>;
		qcom,mdss-dsi-pixel-packing = "tight";
		qcom,mdss-dsi-on-command = [15 01 00 00 00 00 02 FF 01
			29 01 00 00 00 00 02 53 00
			29 01 00 00 00 00 05 C6 63 00 81 31
			29 01 00 00 00 00 05 CB E7 80 73 33
			29 01 00 00 00 00 02 EC D2
			29 01 00 00 00 00 03 B3 04 9F
			29 01 00 00 00 00 04 B2 16 26 10
			29 01 00 00 00 00 02 B4 00
			29 01 00 00 00 00 02 C1 04
			29 01 00 00 00 00 04 C2 BE 00 58
			29 01 00 00 00 00 09 C3 01 22 11 21 0E 80 80 24
			29 01 00 00 00 00 08 B6 09 16 42 01 13 00 00
			29 01 00 00 00 00 04 B7 24 26 43
			29 01 00 00 00 00 06 B8 16 08 25 44 08
			29 01 00 00 00 00 09 B9 06 08 07 09 00 00 00 00
			29 01 00 00 00 00 09 BA 0E 10 0A 0C 16 05 00 00
			29 01 00 00 00 00 09 BB A1 A1 A1 A1 00 00 00 00
			29 01 00 00 00 00 09 BC 0F 11 0B 0D 16 05 00 00
			29 01 00 00 00 00 09 BD A1 A1 A1 A1 00 00 00 00
			29 01 00 00 00 00 04 E6 FF FF 0F
			29 01 00 00 00 00 02 C7 3F
			29 01 00 00 00 00 07 B5 47 00 00 08 00 01
			29 01 00 00 00 00 08 C4 DF C2 0C 0C 63 E3 99
			29 01 00 00 00 00 07 D0 0A 00 06 09 10 20
			29 01 00 00 00 00 06 D1 1D 32 1B 00 00
			29 01 00 00 00 00 07 D2 0A 00 06 09 10 20
			29 01 00 00 00 00 06 D3 1D 32 1B 00 00
			29 01 00 00 00 00 07 D4 0A 00 06 09 10 20
			29 01 00 00 00 00 06 D5 1D 32 1B 00 00
			29 01 00 00 00 00 07 D6 0A 00 06 09 10 20
			29 01 00 00 00 00 06 D7 1D 32 1B 00 00
			29 01 00 00 00 00 07 D8 0A 00 06 09 10 20
			29 01 00 00 00 00 06 D9 1D 32 1B 00 00
			29 01 00 00 00 00 07 DA 0A 00 06 09 10 20
			29 01 00 00 00 00 06 DB 1D 32 1B 00 00
			29 01 00 00 00 00 03 CC 10 00
			29 01 00 00 00 00 04 CE 4E 55 A5
			29 01 00 00 00 00 04 E0 01 02 02
			29 01 00 00 00 00 05 F6 00 00 00 00
			29 01 00 00 00 00 05 F7 00 00 00 00
			29 01 00 00 00 00 03 E1 90 00
			29 01 00 00 00 00 07 DE 95 CF E2 CE 11 15
			29 01 00 00 00 00 02 CF 46
			29 01 00 00 00 00 02 C5 66
			29 01 00 00 00 00 03 ED 00 20
			15 01 00 00 00 00 02 53 2c
			05 01 00 00 20 00 02 11 00
			05 01 00 00 20 00 02 29 00];

		qcom,mdss-dsi-off-command = [05 01 00 00 32 00 02 10 00
			39 01 00 00 20 00 02 53 00
			39 01 00 00 20 00 02 c2 00
			39 01 00 00 00 00 02 cf 40
			39 01 00 00 20 00 03 de 84 00
			39 01 00 00 00 00 02 cb 22
			39 01 00 00 00 00 02 c3 00];

		qcom,mdss-dsi-on-command-state = "dsi_lp_mode";
		qcom,mdss-dsi-off-command-state = "dsi_hs_mode";
		qcom,mdss-dsi-h-sync-pulse = <1>;
		qcom,mdss-dsi-traffic-mode = "burst_mode";
		qcom,mdss-dsi-lane-map = "lane_map_0123";
		qcom,mdss-dsi-bllp-eof-power-mode;
		qcom,mdss-dsi-lane-0-state;
		qcom,mdss-dsi-lane-1-state;
		qcom,mdss-dsi-lane-2-state;
		qcom,mdss-dsi-lane-3-state;
		qcom,mdss-dsi-panel-timings = [68 1d 15 00 2e 2d 19 1f 24 03 04 00];
		qcom,mdss-dsi-t-clk-post = <0x20>;
		qcom,mdss-dsi-t-clk-pre = <0x2f>;
		qcom,mdss-dsi-bl-min-level = <1>;
		qcom,mdss-dsi-bl-max-level = <4095>;
		qcom,mdss-dsi-dma-trigger = "trigger_sw";
		qcom,mdss-dsi-mdp-trigger = "none";
		qcom,mdss-dsi-bl-pmic-control-type = "bl_ctrl_wled";
		qcom,mdss-dsi-reset-sequence = <1 20>, <0 2>, <1 20>;
		qcom,mdss-dsi-lp11-init;
		qcom,mdss-dsi-init-delay-us = <50000>;
	};
};
