/* SPDX-License-Identifier: GPL-2.0 */
/*
* Copyright (C) 2021 MediaTek Inc.
*/
&i2c1 {
	rt9458@6a {
		status = "okay";
		compatible = "richtek,rt9458";
		reg = <0x6a>;
		rt,intr_gpio = <&pio 25 0x0>;
		rt,intr_gpio_num = <25>; /* direct defined GPIO num */
		/*
		 * Charger name
		 * Main charger: primary_chg
		 * Slave charger: secondary_chg
		 */
		charger_name = "primary_chg";
		ichg = <1550000>; /* uA */
		aicr = <500000>;  /* uA */
		mivr = <4500000>; /* uV */
		ieoc = <200000>;  /* uA */
		cv = <4350000>; /* uV */
		vmreg = <4350000>; /* uV */
		enable_te;
		enable_eoc_shdn;
	};
};
