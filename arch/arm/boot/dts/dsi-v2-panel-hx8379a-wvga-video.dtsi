/* Copyright (c) 2013, The Linux Foundation. All rights reserved.
 *
 * This program is free software; you can redistribute it and/or modify
 * it under the terms of the GNU General Public License version 2 and
 * only version 2 as published by the Free Software Foundation.
 *
 * This program is distributed in the hope that it will be useful,
 * but WITHOUT ANY WARRANTY; without even the implied warranty of
 * MERCHANTABILITY or FITNESS FOR A PARTICULAR PURPOSE.  See the
 * GNU General Public License for more details.
 */

&soc {
	qcom,dsi_v2_hx8379a_wvga_video {
		compatible = "qcom,dsi-panel-v2";
		label = "HX8379A WVGA video mode dsi panel";
		qcom,dsi-ctrl-phandle = <&mdss_dsi0>;
		qcom,rst-gpio = <&msmgpio 41 0>;
		vdda-supply = <&pm8110_l19>;
		vddio-supply=<&pm8110_l14>;
		qcom,mdss-pan-res = <480 800>;
		qcom,mdss-pan-bpp = <24>;
		qcom,mdss-pan-dest = "display_1";
		qcom,mdss-pan-porch-values = <100 40 70 6 4 6>;
		qcom,mdss-pan-underflow-clr = <0xff>;
		qcom,mdss-pan-bl-levels = <1 255>;
		qcom,mdss-pan-bl-ctrl = "bl_ctrl_wled";
		qcom,mdss-pan-dsi-mode = <0>;
		qcom,mdss-pan-dsi-h-pulse-mode = <1>;
		qcom,mdss-pan-dsi-h-power-stop = <0 0 0>;
		qcom,mdss-pan-dsi-bllp-power-stop = <1 1>;
		qcom,mdss-pan-dsi-traffic-mode = <2>;
		qcom,mdss-pan-dsi-dst-format = <3>;
		qcom,mdss-pan-dsi-vc = <0>;
		qcom,mdss-pan-dsi-rgb-swap = <0>;
		qcom,mdss-pan-dsi-data-lanes = <1 1 0 0>;
		qcom,mdss-pan-dsi-dlane-swap = <1>;
		qcom,mdss-pan-dsi-t-clk = <0x1b 0x04>;
		qcom,mdss-pan-dsi-stream = <0>;
		qcom,mdss-pan-dsi-mdp-tr = <0x0>;/*todo*/
		qcom,mdss-pan-dsi-dma-tr = <0x04>;
		qcom,mdss-pan-dsi-frame-rate = <60>;
		qcom,panel-phy-regulatorSettings =[02 08 05 00 20 03];
		qcom,panel-phy-timingSettings = [75 1A 11  00 3D 45
						 15 1D 1C  03 04 00];
		qcom,panel-phy-strengthCtrl = [ff 06];
		qcom,panel-phy-bistCtrl = [03 03 00 00 0f 00];
		qcom,panel-phy-laneConfig =
					[80 45 00 00 01 66 /*lane0**/
					80 45 00 00 01 66 /*lane1*/
					80 45 00 00 01 66 /*lane2*/
					80 45 00 00 01 66 /*lane3*/
					40 67 00 00 01 88]; /*Clk*/

		qcom,on-cmds-dsi-state = "DSI_LP_MODE";
		qcom,panel-on-cmds = [
					39 01 00 00 00 04
						B9 FF 83 79
					39 01 00 00 00 03
						BA 51 93
					39 01 00 00 00 14
						B1 00 50 44
						EA 8D 08 11
						11 11 27 2F
						9A 1A 42 0B
						6E F1 00 E6
					39 01 00 00 00 0E
						B2 00 00 3C
						08 04 19 22
						00 FF 08 04
						19 20
					39 01 00 00 00 20
						B4 82 08 00
						32 10 03 32
						13 70 32 10
						08 37 01 28
						07 37 08 3C
						08 44 44 08
						00 40 08 28
						08 30 30 04
					39 01 00 00 00 30
						D5 00 00 0A
						00 01 05 00
						03 00 88 88
						88 88 23 01
						67 45 02 13
						88 88 88 88
						88 88 88 88
						88 88 54 76
						10 32 31 20
						88 88 88 88
						88 88 00 00
						00 00 00 00
					39 01 00 00 00 24
						E0 79 05 0F
						14 26 29 3F
						2B 44 04 0E
						12 15 18 16
						16 12 15 05
						0F 14 26 29
						3F 2B 44 04
						0E 12 15 18
						16 16 12 15
					23 01 00 00 00 02
						cc 02
					39 01 00 00 00 05
						B6 00 9C 00 9C
					05 01 00 00 96 02
						11 00
					05 01 00 00 78 02
						29 00
					];
		qcom,panel-off-cmds = [05 01 00 00 32 02 28 00
					05 01 00 00 78 02 10 00];
		qcom,off-cmds-dsi-state = "DSI_LP_MODE";
	};
};
