/* Copyright (c) 2013, The Linux Foundation. All rights reserved.
 * Copyright (C) 2015 XiaoMi, Inc.
 *
 * This program is free software; you can redistribute it and/or modify
 * it under the terms of the GNU General Public License version 2 and
 * only version 2 as published by the Free Software Foundation.
 *
 * This program is distributed in the hope that it will be useful,
 * but WITHOUT ANY WARRANTY; without even the implied warranty of
 * MERCHANTABILITY or FITNESS FOR A PARTICULAR PURPOSE.  See the
 * GNU General Public License for more details.
 */

qcom,h2a-4v35-SAMSUNG_a {
	qcom,fcc-mah = <2050>;
	qcom,default-rbatt-mohm = <176>;
	qcom,rbatt-capacitive-mohm = <0>;
	qcom,flat-ocv-threshold-uv = <3800000>;
	qcom,max-voltage-uv = <4350000>;
	qcom,v-cutoff-uv = <3400000>;
	qcom,chg-term-ua = <100000>;
	qcom,batt-id-kohm = <38>;

	qcom,rbatt-sf-lut {
		qcom,lut-col-legend = <(-20) (-10) 0 5 10 15 20 25 30 40 60>;
		qcom,lut-row-legend = <100 95 90 85 80>,
				<75 70 65 60 55>,
				<50 45 40 35 30>,
				<25 20 16 13 11>,
				<10 9 8 7 6>,
				<5 4 3 2 1>;
		qcom,lut-data = 		<1467 670 335 244 177 140 115 100 90 79 73>,
				<1467 669 335 244 177 140 115 101 90 79 73>,
				<1344 668 341 249 184 143 118 102 92 81 73>,
				<1314 657 342 257 192 149 122 106 94 82 74>,
				<1228 662 334 252 199 157 128 111 98 85 76>,
				<1172 641 357 272 217 172 141 120 106 90 78>,
				<1169 593 307 231 192 164 140 121 107 91 80>,
				<1158 607 314 231 185 164 147 132 117 98 84>,
				<1176 614 318 233 181 147 130 122 115 101 88>,
				<1213 612 315 230 174 137 116 103 93 84 75>,
				<1255 619 315 228 174 137 115 102 92 81 75>,
				<1300 647 314 230 177 139 116 102 93 84 76>,
				<1348 691 315 230 177 141 119 105 96 86 78>,
				<1399 743 327 236 179 143 121 107 99 89 81>,
				<1452 802 345 249 189 148 123 109 99 88 80>,
				<1515 874 374 261 199 155 127 110 99 85 76>,
				<1585 956 418 272 205 159 131 110 97 83 76>,
				<1680 1013 461 292 202 154 126 107 95 84 75>,
				<1748 1014 482 311 206 151 122 104 93 81 75>,
				<1547 918 440 294 198 149 119 103 93 83 76>,
				<1625 968 450 302 203 151 122 105 94 85 77>,
				<1758 991 465 314 211 155 124 108 96 86 80>,
				<1911 1024 479 327 222 163 130 113 99 89 83>,
				<2089 1064 497 336 232 172 136 118 105 93 88>,
				<2352 1097 519 346 242 182 144 124 109 94 84>,
				<2761 1132 541 351 244 182 148 123 106 89 78>,
				<3131 1185 555 358 240 174 136 115 100 86 80>,
				<3610 1237 583 374 242 180 139 119 105 92 85>,
				<4646 1343 639 410 264 199 149 130 115 101 91>,
				<6462 2505 936 591 331 328 223 258 240 297 116>;
	};

	qcom,fcc-temp-lut {
		qcom,lut-col-legend = <(-20) (-10) 0 5 10 15 20 25 30 40 60>;
		qcom,lut-data = <2088 2096 2098 2096 2095 2098 2094 2097 2097 2097 2090>;
	};

	qcom,pc-temp-ocv-lut {
		qcom,lut-col-legend = <(-20) (-10) 0 5 10 15 20 25 30 40 60>;
		qcom,lut-row-legend = <100 95 90 85 80>,
				<75 70 65 60 55>,
				<50 45 40 35 30>,
				<25 20 16 13 11>,
				<10 9 8 7 6>,
				<5 4 3 2 1>,
				<0>;
		qcom,lut-data = 				<4318 4322 4322 4322 4322 4322 4320 4320 4319 4315 4308>,
				<4201 4232 4245 4248 4252 4253 4254 4254 4254 4252 4249>,
				<4114 4171 4190 4193 4196 4198 4199 4199 4199 4198 4194>,
				<4076 4112 4136 4142 4146 4146 4146 4146 4146 4144 4141>,
				<3993 4068 4080 4092 4097 4098 4098 4097 4096 4094 4090>,
				<3922 4004 4037 4048 4057 4058 4058 4058 4056 4050 4042>,
				<3882 3928 3951 3960 3972 3982 3987 3989 3992 3995 3998>,
				<3842 3896 3916 3922 3930 3946 3954 3958 3961 3962 3958>,
				<3815 3864 3888 3894 3898 3902 3908 3914 3918 3920 3918>,
				<3798 3832 3856 3862 3864 3864 3866 3866 3868 3868 3866>,
				<3784 3802 3828 3832 3836 3836 3838 3838 3839 3840 3838>,
				<3769 3784 3804 3809 3812 3814 3816 3816 3817 3818 3816>,
				<3754 3770 3782 3790 3794 3796 3798 3798 3798 3800 3798>,
				<3738 3758 3766 3774 3778 3780 3782 3784 3784 3784 3782>,
				<3720 3745 3752 3763 3768 3770 3770 3770 3770 3768 3762>,
				<3700 3732 3736 3746 3754 3758 3758 3757 3756 3750 3737>,
				<3674 3718 3723 3724 3732 3736 3738 3737 3735 3729 3714>,
				<3650 3705 3714 3711 3710 3711 3712 3710 3708 3702 3688>,
				<3630 3692 3706 3704 3700 3696 3694 3690 3688 3683 3672>,
				<3615 3678 3700 3698 3696 3692 3691 3688 3686 3682 3670>,
				<3605 3670 3695 3696 3694 3692 3690 3688 3686 3680 3668>,
				<3596 3659 3689 3692 3691 3690 3688 3687 3684 3680 3668>,
				<3584 3650 3683 3688 3689 3688 3688 3686 3684 3678 3666>,
				<3570 3638 3675 3682 3686 3685 3686 3684 3682 3676 3663>,
				<3550 3622 3662 3672 3680 3679 3680 3678 3676 3668 3650>,
				<3531 3604 3642 3654 3664 3661 3666 3659 3655 3643 3613>,
				<3508 3575 3610 3620 3630 3620 3626 3614 3609 3594 3560>,
				<3475 3534 3560 3566 3576 3559 3566 3550 3546 3525 3493>,
				<3426 3468 3480 3484 3496 3473 3485 3464 3458 3432 3396>,
				<3342 3344 3338 3343 3370 3326 3356 3312 3306 3269 3222>,
				<3000 3000 3000 3000 3000 3000 3000 3000 3000 3000 3000>;
	};
};
