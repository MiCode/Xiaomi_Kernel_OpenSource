/*
 * Copyright (c) 2012-2013, The Linux Foundation. All rights reserved.
 *
 * This program is free software; you can redistribute it and/or modify
 * it under the terms of the GNU General Public License version 2 and
 * only version 2 as published by the Free Software Foundation.
 *
 * This program is distributed in the hope that it will be useful,
 * but WITHOUT ANY WARRANTY; without even the implied warranty of
 * MERCHANTABILITY or FITNESS FOR A PARTICULAR PURPOSE.  See the
 * GNU General Public License for more details.
 */

&i2c {
        qcom,camera@7d {
                compatible = "qcom,hi256";
                reg = <0x7d>;
                qcom,slave-id = <0x40 0x04 0xc0>;
                qcom,csiphy-sd-index = <0>;
                qcom,csid-sd-index = <0>;
                qcom,mount-angle = <270>;
                qcom,sensor-name = "hi256";
                cam_vdig-supply = <&pm8110_l2>;
                cam_vana-supply = <&pm8110_l19>;
                cam_vio-supply = <&pm8110_l14>;
                qcom,cam-vreg-name = "cam_vdig", "cam_vio", "cam_vana";
                qcom,cam-vreg-type = <0 0 0>;
                qcom,cam-vreg-min-voltage = <1200000 1800000 2850000>;
                qcom,cam-vreg-max-voltage = <1200000 1800000 2850000>;
                qcom,cam-vreg-op-mode = <200000 8000 80000>;
                qcom,gpio-no-mux = <0>;
                gpios = <&msmgpio 13 0>,
                        <&msmgpio 21 0>,
                        <&msmgpio 20 0>;
                qcom,gpio-reset = <1>;
                qcom,gpio-standby = <2>;
                qcom,gpio-req-tbl-num = <0 1 2>;
                qcom,gpio-req-tbl-flags = <1 0 0>;
                qcom,gpio-req-tbl-label = "CAMIF_MCLK",
                        "CAM_RESET1",
                        "CAM_STANDBY";
                qcom,csi-lane-assign = <0xe4>;
                qcom,csi-lane-mask = <0x03>;
                qcom,sensor-position = <0>;
                qcom,sensor-mode = <1>;
                qcom,cci-master = <0>;
        };


};

