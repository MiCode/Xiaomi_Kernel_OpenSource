/* Copyright (c) 2013, The Linux Foundation. All rights reserved.
 *
 * This program is free software; you can redistribute it and/or modify
 * it under the terms of the GNU General Public License version 2 and
 * only version 2 as published by the Free Software Foundation.
 *
 * This program is distributed in the hope that it will be useful,
 * but WITHOUT ANY WARRANTY; without even the implied warranty of
 * MERCHANTABILITY or FITNESS FOR A PARTICULAR PURPOSE.  See the
 * GNU General Public License for more details.
 */

&soc {
	mdm0: qti,mdm0 {
                compatible = "qti,mdm2-modem";
		cell-index = <0>;
		#address-cells = <0>;
                interrupt-parent = <&mdm0>;
                interrupts = <0 1 2 3>;
                #interrupt-cells = <1>;
                interrupt-map-mask = <0xffffffff>;
                interrupt-names =
			"err_fatal_irq",
			"status_irq",
			"plbrdy_irq",
			"mdm2ap_vddmin_irq";
		/* modem attributes */
                qti,ramdump-delay-ms = <2000>;
                qti,ramdump-timeout-ms = <120000>;
                qti,vddmin-modes  = "normal";
                qti,vddmin-drive-strength = <8>;
		qti,sfr-query;
		qti,sysmon-subsys-id = <20>;
		qti,support-shutdown;
		status = "disabled";
	};
};

