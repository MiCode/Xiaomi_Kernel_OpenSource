/* Copyright (c) 2013, The Linux Foundation. All rights reserved.
 *
 * This program is free software; you can redistribute it and/or modify
 * it under the terms of the GNU General Public License version 2 and
 * only version 2 as published by the Free Software Foundation.
 *
 * This program is distributed in the hope that it will be useful,
 * but WITHOUT ANY WARRANTY; without even the implied warranty of
 * MERCHANTABILITY or FITNESS FOR A PARTICULAR PURPOSE.  See the
 * GNU General Public License for more details.
 */


/dts-v1/;
#include "apq8026-v2.dtsi"
#include "msm8226-720p-mtp.dtsi"

/ {
	model = "Qualcomm APQ 8026v2 MTP";
	compatible = "qcom,apq8026-mtp", "qcom,apq8026", "qcom,mtp";
	qcom,board-id = <8 0>;
};
