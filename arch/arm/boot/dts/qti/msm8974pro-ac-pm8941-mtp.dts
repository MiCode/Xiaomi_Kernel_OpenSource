/* Copyright (c) 2013, The Linux Foundation. All rights reserved.
 *
 * This program is free software; you can redistribute it and/or modify
 * it under the terms of the GNU General Public License version 2 and
 * only version 2 as published by the Free Software Foundation.
 *
 * This program is distributed in the hope that it will be useful,
 * but WITHOUT ANY WARRANTY; without even the implied warranty of
 * MERCHANTABILITY or FITNESS FOR A PARTICULAR PURPOSE.  See the
 * GNU General Public License for more details.
 */

/dts-v1/;

#include "msm8974pro-ac-pm8941.dtsi"
#include "msm8974-mtp.dtsi"

/ {
	model = "Qualcomm MSM 8974Pro-AC MTP";
	compatible = "qcom,msm8974-mtp", "qcom,msm8974", "qcom,mtp";
	qcom,board-id = <8 0>;
};

&sdhc_1 {
	qcom,clk-rates = <400000 20000000 25000000 50000000 100000000 192000000 384000000>;
	qcom,bus-speed-mode = "HS400_1p8v", "HS200_1p8v", "DDR_1p8v";

	qcom,pad-pull-on = <0x0 0x3 0x3 0x1>; /* no-pull, pull-up, pull-up, pull-down */
	qcom,pad-pull-off = <0x0 0x3 0x3 0x1>; /* no-pull, pull-up, pull-up, pull-down */
};
