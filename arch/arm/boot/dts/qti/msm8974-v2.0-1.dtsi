/* Copyright (c) 2013, The Linux Foundation. All rights reserved.
 *
 * This program is free software; you can redistribute it and/or modify
 * it under the terms of the GNU General Public License version 2 and
 * only version 2 as published by the Free Software Foundation.
 *
 * This program is distributed in the hope that it will be useful,
 * but WITHOUT ANY WARRANTY; without even the implied warranty of
 * MERCHANTABILITY or FITNESS FOR A PARTICULAR PURPOSE.  See the
 * GNU General Public License for more details.
 */

/*
 * As a general rule, only version-specific property overrides should be placed
 * inside this file. However, device definitions should be placed inside the
 * msm8974.dtsi file.
 */

#include "msm8974-v2.dtsi"

&gdsc_venus {
	qcom,skip-logic-collapse;
	qcom,retain-periph;
	qcom,retain-mem;
};

&gdsc_mdss {
	qcom,skip-logic-collapse;
	qcom,retain-periph;
	qcom,retain-mem;
};

&gdsc_oxili_gx {
	qcom,retain-mem;
	qcom,retain-periph;
};
