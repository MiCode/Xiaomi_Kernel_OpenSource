/* Copyright (c) 2013, The Linux Foundation. All rights reserved.
 *
 * This program is free software; you can redistribute it and/or modify
 * it under the terms of the GNU General Public License version 2 and
 * only version 2 as published by the Free Software Foundation.
 *
 * This program is distributed in the hope that it will be useful,
 * but WITHOUT ANY WARRANTY; without even the implied warranty of
 * MERCHANTABILITY or FITNESS FOR A PARTICULAR PURPOSE.  See the
 * GNU General Public License for more details.
 */

/*---------------------------------------------------------------------------
 * This file is autogenerated file using gcdb parser. Please do not edit it.
 * Update input XML file to add a new entry or update variable in this file
 * VERSION = "1.0"
 *---------------------------------------------------------------------------*/
&mdss_mdp {
	dsi_hx8389b_qhd_vid: qcom,mdss_dsi_hx8389b_qhd_video {
		qcom,mdss-dsi-panel-name = "HX8389b qhd video mode dsi panel";
		qcom,mdss-dsi-panel-controller = <&mdss_dsi0>;
		qcom,mdss-dsi-panel-type = "dsi_video_mode";
		qcom,mdss-dsi-panel-destination = "display_1";
		qcom,mdss-dsi-panel-framerate = <60>;
		qcom,mdss-dsi-virtual-channel-id = <0>;
		qcom,mdss-dsi-stream = <0>;
		qcom,mdss-dsi-panel-width = <540>;
		qcom,mdss-dsi-panel-height = <960>;
		qcom,mdss-dsi-h-front-porch = <48>;
		qcom,mdss-dsi-h-back-porch = <96>;
		qcom,mdss-dsi-h-pulse-width = <96>;
		qcom,mdss-dsi-h-sync-skew = <0>;
		qcom,mdss-dsi-v-front-porch = <9>;
		qcom,mdss-dsi-v-pulse-width = <3>;
		qcom,mdss-dsi-v-back-porch = <13>;
		qcom,mdss-dsi-h-left-border = <0>;
		qcom,mdss-dsi-h-right-border = <0>;
		qcom,mdss-dsi-v-top-border = <0>;
		qcom,mdss-dsi-v-bottom-border = <0>;
		qcom,mdss-dsi-bpp = <24>;
		qcom,mdss-dsi-underflow-color = <0xff>;
		qcom,mdss-dsi-border-color = <0>;
		qcom,mdss-dsi-on-command = [
				39 01 00 00 00 00 04
					B9 FF 83 89
				39 01 00 00 00 00 08
					BA 41 93 00
					16 A4 10 18
				23 01 00 00 00 00 02
					C6 08
				39 01 00 00 00 00 03
					BC 02 00
				23 01 00 00 00 00 02
					CC 02
				39 01 00 00 00 00 14
					B1 00 00 07
					E8 50 10 11
					98 f8 21 29
					27 27 43 01
					58 F0 00 E6
				39 01 00 00 00 00 08
					B2 00 00 78
					0C 07 3F 80
				39 01 00 00 00 00 18
					b4 82 08 00
					32 10 04 32
					10 00 32 10
					00 37 0a 40
					08 37 0a 40
					14 46 50 0a
				39 01 00 00 00 00 39
					d5 00 00 00
					00 01 00 00
					00 60 00 99
					88 AA BB 88
					23 88 01 88
					67 88 45 01
					23 88 88 88
					88 88 88 99
					BB AA 88 54
					88 76 88 10
					88 32 32 10
					88 88 88 88
					88 00 04 00
					00 00 00 00
					00
				39 01 00 00 00 00 03
					CB 07 07
				39 01 00 00 00 00 05
					BB 00 00 FF
					80
				39 01 00 00 00 00 04
					DE 05 58 10
				39 01 00 00 00 00 05
					B6 00 8A 00
					8A
				39 01 00 00 00 00 23
					E0 01 08 0C
					1F 25 36 12
					35 05 09 0D
					10 11 0F 0F
					1C 1D 01 08
					0C 1F 25 36
					12 35 05 09
					0D 10 11 0F
					0F 1C 1D
				05 01 00 00 96 00 02
					11 00
				05 01 00 00 96 00 02
					29 00
		];
		qcom,mdss-dsi-off-command = [05 01 00 00 32 00 02 28 00
					05 01 00 00 78 00 02 10 00];
		qcom,mdss-dsi-on-command-state = "dsi_lp_mode";
		qcom,mdss-dsi-off-command-state = "dsi_lp_mode";
		qcom,mdss-dsi-h-sync-pulse = <1>;
		qcom,mdss-dsi-traffic-mode = "burst_mode";
		qcom,mdss-dsi-lane-map = "lane_map_3012";
		qcom,mdss-dsi-bllp-eof-power-mode;
		qcom,mdss-dsi-bllp-power-mode;
		qcom,mdss-dsi-lane-0-state;
		qcom,mdss-dsi-lane-1-state;
		qcom,mdss-dsi-panel-timings = [97 23 17 00 4B 53 1C 27 27 03 04 00];
		qcom,mdss-dsi-t-clk-post = <0x04>;
		qcom,mdss-dsi-t-clk-pre = <0x1b>;
		qcom,mdss-dsi-bl-min-level = <26>;
		qcom,mdss-dsi-bl-max-level = <255>;
		qcom,mdss-dsi-dma-trigger = "trigger_sw";
		qcom,mdss-dsi-mdp-trigger = "none";
		qcom,mdss-dsi-bl-pmic-control-type = "bl_ctrl_wled";
		qcom,mdss-dsi-reset-sequence = <1 20>, <0 2>, <1 20>;

	};
};
