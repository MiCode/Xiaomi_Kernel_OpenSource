/* Copyright (c) 2013, Linux Foundation. All rights reserved.
 *
 * This program is free software; you can redistribute it and/or modify
 * it under the terms of the GNU General Public License version 2 and
 * only version 2 as published by the Free Software Foundation.
 *
 * This program is distributed in the hope that it will be useful,
 * but WITHOUT ANY WARRANTY; without even the implied warranty of
 * MERCHANTABILITY or FITNESS FOR A PARTICULAR PURPOSE.  See the
 * GNU General Public License for more details.
 */

&soc {
	qti,ion {
		compatible = "qti,msm-ion";
		#address-cells = <1>;
		#size-cells = <0>;

		qti,ion-heap@25 {
			reg = <25>;
			qti,ion-heap-type = "SYSTEM";
		};

		qti,ion-heap@28 { /* AUDIO HEAP */
			compatible = "qti,msm-ion-reserve";
			reg = <28>;
			linux,contiguous-region = <&audio_mem>;
			qti,ion-heap-type = "DMA";
		};
	};
};
