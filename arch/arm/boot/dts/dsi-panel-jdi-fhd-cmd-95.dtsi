/* Copyright (c) 2012-2013, The Linux Foundation. All rights reserved.
 * Copyright (C) 2017 XiaoMi, Inc.
 *
 * This program is free software; you can redistribute it and/or modify
 * it under the terms of the GNU General Public License version 2 and
 * only version 2 as published by the Free Software Foundation.
 *
 * This program is distributed in the hope that it will be useful,
 * but WITHOUT ANY WARRANTY; without even the implied warranty of
 * MERCHANTABILITY or FITNESS FOR A PARTICULAR PURPOSE.  See the
 * GNU General Public License for more details.
 */

/*---------------------------------------------------------------------------
 * This file is autogenerated file using gcdb parser. Please do not edit it.
 * Update input XML file to add a new entry or update variable in this file
 * VERSION = "1.0"
 *---------------------------------------------------------------------------*/
&soc {
	dsi_jdi_fhd_cmd_95: qcom,mdss_dsi_jdi_fhd_cmd_95 {
		qcom,mdss-dsi-panel-name = "jdi fhd cmd mode dsi panel";
		qcom,mdss-dsi-panel-id = <5>;
		qcom,mdss-dsi-panel-controller = <&mdss_dsi0>;
		qcom,mdss-dsi-panel-type = "dsi_cmd_mode";
		qcom,mdss-dsi-panel-destination = "display_1";
		qcom,mdss-dsi-panel-framerate = <60>;
		qcom,mdss-dsi-virtual-channel-id = <0>;
		qcom,mdss-dsi-stream = <0>;
		qcom,mdss-dsi-panel-width = <1080>;
		qcom,mdss-dsi-panel-height = <1920>;
		qcom,mdss-dsi-h-front-porch = <80>;
		qcom,mdss-dsi-h-back-porch = <40>;
		qcom,mdss-dsi-h-pulse-width = <10>;
		qcom,mdss-dsi-h-sync-skew = <0>;
		qcom,mdss-dsi-v-back-porch = <4>;
		qcom,mdss-dsi-v-front-porch = <4>;
		qcom,mdss-dsi-v-pulse-width = <2>;
		qcom,mdss-dsi-h-left-border = <0>;
		qcom,mdss-dsi-h-right-border = <0>;
		qcom,mdss-dsi-v-top-border = <0>;
		qcom,mdss-dsi-v-bottom-border = <0>;
		qcom,mdss-dsi-bpp = <24>;
		qcom,mdss-dsi-color-order = <0>;
		qcom,mdss-dsi-underflow-color = <0xff>;
		qcom,mdss-dsi-border-color = <0>;
		qcom,mdss-dsi-on-command = [
				15 01 00 00 01 00 02 FF 10
				15 01 00 00 01 00 02 BB 10
				15 01 00 00 01 00 02 50 00
				15 00 00 00 01 00 02 FF 24
				15 00 00 00 01 00 02 E3 02
				15 00 00 00 01 00 02 C4 69
				15 00 00 00 01 00 02 C9 00
				15 01 00 00 01 00 02 FB 01
				15 00 00 00 01 00 02 FF 22
				15 00 00 00 01 00 02 FB 01
				15 00 00 00 01 00 02 00 28
				15 00 00 00 01 00 02 01 2C
				15 00 00 00 01 00 02 02 30
				15 00 00 00 01 00 02 03 34
				15 00 00 00 01 00 02 04 38
				15 00 00 00 01 00 02 05 3C
				15 00 00 00 01 00 02 06 40
				15 00 00 00 01 00 02 07 48
				15 00 00 00 01 00 02 08 4C
				15 00 00 00 01 00 02 09 50
				15 00 00 00 01 00 02 0A 58
				15 00 00 00 01 00 02 0B 60
				15 00 00 00 01 00 02 0C 60
				15 00 00 00 01 00 02 0D 58
				15 00 00 00 01 00 02 0E 50
				15 00 00 00 01 00 02 0F 48
				15 00 00 00 01 00 02 10 38
				15 00 00 00 01 00 02 11 28
				15 00 00 00 01 00 02 12 28
				15 00 00 00 01 00 02 13 28
				15 00 00 00 01 00 02 1B 00
				15 00 00 00 01 00 02 1C 00
				15 00 00 00 01 00 02 1D 00
				15 00 00 00 01 00 02 1E 00
				15 00 00 00 01 00 02 1F 00
				15 00 00 00 01 00 02 20 00
				15 00 00 00 01 00 02 21 00
				15 00 00 00 01 00 02 22 00
				15 00 00 00 01 00 02 23 00
				15 00 00 00 01 00 02 24 00
				15 00 00 00 01 00 02 25 00
				15 00 00 00 01 00 02 26 00
				15 00 00 00 01 00 02 27 00
				15 00 00 00 01 00 02 28 00
				15 00 00 00 01 00 02 29 00
				15 00 00 00 01 00 02 2A 00
				15 00 00 00 01 00 02 2B 00
				15 00 00 00 01 00 02 2F 00
				15 00 00 00 01 00 02 30 00
				15 00 00 00 01 00 02 31 00
				15 00 00 00 01 00 02 32 80
				15 00 00 00 01 00 02 33 80
				15 00 00 00 01 00 02 34 80
				15 00 00 00 01 00 02 35 82
				15 00 00 00 01 00 02 36 84
				15 00 00 00 01 00 02 37 86
				15 00 00 00 01 00 02 38 88
				15 00 00 00 01 00 02 39 8A
				15 00 00 00 01 00 02 3A 8C
				15 00 00 00 01 00 02 3B 8E
				15 00 00 00 01 00 02 3F 90
				15 00 00 00 01 00 02 40 92
				15 00 00 00 01 00 02 41 94
				15 00 00 00 01 00 02 42 94
				15 00 00 00 01 00 02 43 92
				15 00 00 00 01 00 02 44 90
				15 00 00 00 01 00 02 45 8E
				15 00 00 00 01 00 02 46 8C
				15 00 00 00 01 00 02 47 8A
				15 00 00 00 01 00 02 48 88
				15 00 00 00 01 00 02 49 86
				15 00 00 00 01 00 02 4A 84
				15 00 00 00 01 00 02 4B 82
				15 00 00 00 01 00 02 4C 80
				15 00 00 00 01 00 02 4D 08
				15 00 00 00 01 00 02 1A 00
				15 00 00 00 01 00 02 53 01
				15 00 00 00 01 00 02 54 01
				15 00 00 00 01 00 02 56 00
				15 00 00 00 01 00 02 64 2F
				15 01 00 00 01 00 02 68 00
				15 01 00 00 01 00 02 FF 10
				15 01 00 00 01 00 02 35 00
				39 01 00 00 01 00 05 2A 00 00 04 37
				39 01 00 00 01 00 05 2B 00 00 07 7F
				15 01 00 00 01 00 02 51 de
				15 01 00 00 01 00 02 53 2c
				15 01 00 00 01 00 02 55 80
				05 01 00 00 78 00 02 11 00
				15 01 00 00 01 00 02 FF 10
				05 01 00 00 64 00 02 29 00];
		qcom,mdss-dsi-off-command = [
				15 01 00 00 00 00 02 FF 10
				05 01 00 00 32 00 02 28 00
				05 01 00 00 78 00 02 10 00];
		qcom,mdss-dsi-on-command-state = "dsi_lp_mode";
		qcom,mdss-dsi-off-command-state = "dsi_hs_mode";
		qcom,mdss-dsi-h-sync-pulse = <0>;
		qcom,mdss-dsi-traffic-mode = "burst_mode";
		qcom,mdss-dsi-lane-map = "lane_map_0123";
		qcom,mdss-dsi-bllp-eof-power-mode;
		qcom,mdss-dsi-bllp-power-mode;
		qcom,mdss-dsi-lane-0-state;
		qcom,mdss-dsi-lane-1-state;
		qcom,mdss-dsi-lane-2-state;
		qcom,mdss-dsi-lane-3-state;
		qcom,mdss-dsi-te-pin-select = <1>;
		qcom,mdss-dsi-te-v-sync-rd-ptr-irq-line = <0x2c>;
		qcom,mdss-dsi-te-v-sync-continues-lines = <0x3c>;
		qcom,mdss-dsi-te-dcs-command = <1>;
		qcom,mdss-dsi-te-check-enable;
		qcom,mdss-dsi-te-using-te-pin;
		qcom,mdss-dsi-panel-timings = [e3 50 36 00 a9 a3 3a 50 3d 03 04 00];
		qcom,mdss-dsi-t-clk-post = <0x20>;
		qcom,mdss-dsi-t-clk-pre = <0x36>;
		qcom,mdss-dsi-bl-min-level = <8>;
		qcom,mdss-dsi-bl-max-level = <4095>;
		qcom,mdss-dsi-dma-trigger = "trigger_sw";
		qcom,mdss-dsi-mdp-trigger = "none";
		qcom,mdss-dsi-bl-pmic-control-type = "bl_ctrl_wled";
		qcom,mdss-dsi-reset-sequence = <1 20>, <0 20>, <1 20>;
		qcom,mdss-pan-physical-width-dimension = <61>;
		qcom,mdss-pan-physical-height-dimension = <109>;
		qcom,dispparam-enabled;
		qcom,mdss-dsi-dispparam-cabcon-command = [
				15 00 00 00 01 00 02 FF 10
				15 01 00 00 01 00 02 55 82
				];
		qcom,mdss-dsi-dispparam-cabcguion-command = [
				15 00 00 00 01 00 02 FF 10
				15 01 00 00 01 00 02 55 81
				];
		qcom,mdss-dsi-dispparam-cabcstillon-command = [
				15 00 00 00 01 00 02 FF 10
				15 01 00 00 01 00 02 55 82
				];
		qcom,mdss-dsi-dispparam-cabcmovieon-command = [
				15 00 00 00 01 00 02 FF 10
				15 01 00 00 01 00 02 55 83
				];
		qcom,mdss-dsi-dispparam-cabcon-command-state = "dsi_hs_mode";
		qcom,mdss-dsi-dispparam-cabcoff-command = [
				15 00 00 00 01 00 02 FF 10
				15 01 00 00 01 00 02 55 80
				];
		qcom,mdss-dsi-dispparam-cabcoff-command-state = "dsi_hs_mode";
		qcom,mdss-dsi-dispparam-warm-command = [
				15 00 00 00 01 00 02 FF 20
				15 00 00 00 01 00 02 75 00
				15 00 00 00 01 00 02 76 00
				15 00 00 00 01 00 02 77 00
				15 00 00 00 01 00 02 78 0B
				15 00 00 00 01 00 02 79 00
				15 00 00 00 01 00 02 7A 23
				15 00 00 00 01 00 02 7B 00
				15 00 00 00 01 00 02 7C 36
				15 00 00 00 01 00 02 7D 00
				15 00 00 00 01 00 02 7E 4A
				15 00 00 00 01 00 02 7F 00
				15 00 00 00 01 00 02 80 5B
				15 00 00 00 01 00 02 81 00
				15 00 00 00 01 00 02 82 6C
				15 00 00 00 01 00 02 83 00
				15 00 00 00 01 00 02 84 7A
				15 00 00 00 01 00 02 85 00
				15 00 00 00 01 00 02 86 88
				15 00 00 00 01 00 02 87 00
				15 00 00 00 01 00 02 88 BA
				15 00 00 00 01 00 02 89 00
				15 00 00 00 01 00 02 8A E4
				15 00 00 00 01 00 02 8B 01
				15 00 00 00 01 00 02 8C 2A
				15 00 00 00 01 00 02 8D 01
				15 00 00 00 01 00 02 8E 5F
				15 00 00 00 01 00 02 8F 01
				15 00 00 00 01 00 02 90 A9
				15 00 00 00 01 00 02 91 01
				15 00 00 00 01 00 02 92 E8
				15 00 00 00 01 00 02 93 01
				15 00 00 00 01 00 02 94 EA
				15 00 00 00 01 00 02 95 02
				15 00 00 00 01 00 02 96 22
				15 00 00 00 01 00 02 97 02
				15 00 00 00 01 00 02 98 61
				15 00 00 00 01 00 02 99 02
				15 00 00 00 01 00 02 9A 89
				15 00 00 00 01 00 02 9B 02
				15 00 00 00 01 00 02 9C C4
				15 00 00 00 01 00 02 9D 02
				15 00 00 00 01 00 02 9E F0
				15 00 00 00 01 00 02 9F 03
				15 00 00 00 01 00 02 A0 30
				15 00 00 00 01 00 02 A2 03
				15 00 00 00 01 00 02 A3 44
				15 00 00 00 01 00 02 A4 03
				15 00 00 00 01 00 02 A5 5A
				15 00 00 00 01 00 02 A6 03
				15 00 00 00 01 00 02 A7 73
				15 00 00 00 01 00 02 A9 03
				15 00 00 00 01 00 02 AA 8D
				15 00 00 00 01 00 02 AB 03
				15 00 00 00 01 00 02 AC AA
				15 00 00 00 01 00 02 AD 03
				15 00 00 00 01 00 02 AE CA
				15 00 00 00 01 00 02 AF 03
				15 00 00 00 01 00 02 B0 EE
				15 00 00 00 01 00 02 B1 03
				15 00 00 00 01 00 02 B2 FF
				15 00 00 00 01 00 02 B3 00
				15 00 00 00 01 00 02 B4 4A
				15 00 00 00 01 00 02 B5 00
				15 00 00 00 01 00 02 B6 54
				15 00 00 00 01 00 02 B7 00
				15 00 00 00 01 00 02 B8 69
				15 00 00 00 01 00 02 B9 00
				15 00 00 00 01 00 02 BA 7A
				15 00 00 00 01 00 02 BB 00
				15 00 00 00 01 00 02 BC 8B
				15 00 00 00 01 00 02 BD 00
				15 00 00 00 01 00 02 BE 99
				15 00 00 00 01 00 02 BF 00
				15 00 00 00 01 00 02 C0 A7
				15 00 00 00 01 00 02 C1 00
				15 00 00 00 01 00 02 C2 B3
				15 00 00 00 01 00 02 C3 00
				15 00 00 00 01 00 02 C4 BE
				15 00 00 00 01 00 02 C5 00
				15 00 00 00 01 00 02 C6 E5
				15 00 00 00 01 00 02 C7 01
				15 00 00 00 01 00 02 C8 04
				15 00 00 00 01 00 02 C9 01
				15 00 00 00 01 00 02 CA 34
				15 00 00 00 01 00 02 CB 01
				15 00 00 00 01 00 02 CC 5F
				15 00 00 00 01 00 02 CD 01
				15 00 00 00 01 00 02 CE A9
				15 00 00 00 01 00 02 CF 01
				15 00 00 00 01 00 02 D0 E8
				15 00 00 00 01 00 02 D1 01
				15 00 00 00 01 00 02 D2 EA
				15 00 00 00 01 00 02 D3 02
				15 00 00 00 01 00 02 D4 22
				15 00 00 00 01 00 02 D5 02
				15 00 00 00 01 00 02 D6 61
				15 00 00 00 01 00 02 D7 02
				15 00 00 00 01 00 02 D8 89
				15 00 00 00 01 00 02 D9 02
				15 00 00 00 01 00 02 DA C4
				15 00 00 00 01 00 02 DB 02
				15 00 00 00 01 00 02 DC F0
				15 00 00 00 01 00 02 DD 03
				15 00 00 00 01 00 02 DE 30
				15 00 00 00 01 00 02 DF 03
				15 00 00 00 01 00 02 E0 44
				15 00 00 00 01 00 02 E1 03
				15 00 00 00 01 00 02 E2 5A
				15 00 00 00 01 00 02 E3 03
				15 00 00 00 01 00 02 E4 73
				15 00 00 00 01 00 02 E5 03
				15 00 00 00 01 00 02 E6 8D
				15 00 00 00 01 00 02 E7 03
				15 00 00 00 01 00 02 E8 AA
				15 00 00 00 01 00 02 E9 03
				15 00 00 00 01 00 02 EA CA
				15 00 00 00 01 00 02 EB 03
				15 00 00 00 01 00 02 EC EE
				15 00 00 00 01 00 02 ED 03
				15 00 00 00 01 00 02 EE FF
				15 00 00 00 01 00 02 EF 00
				15 00 00 00 01 00 02 F0 91
				15 00 00 00 01 00 02 F1 00
				15 00 00 00 01 00 02 F2 97
				15 00 00 00 01 00 02 F3 00
				15 00 00 00 01 00 02 F4 A3
				15 00 00 00 01 00 02 F5 00
				15 00 00 00 01 00 02 F6 AC
				15 00 00 00 01 00 02 F7 00
				15 00 00 00 01 00 02 F8 B7
				15 00 00 00 01 00 02 F9 00
				15 00 00 00 01 00 02 FA C1
				15 00 00 00 01 00 02 FB 01
				15 00 00 00 01 00 02 FF 21
				15 00 00 00 01 00 02 00 00
				15 00 00 00 01 00 02 01 CB
				15 00 00 00 01 00 02 02 00
				15 00 00 00 01 00 02 03 D4
				15 00 00 00 01 00 02 04 00
				15 00 00 00 01 00 02 05 DD
				15 00 00 00 01 00 02 06 00
				15 00 00 00 01 00 02 07 FF
				15 00 00 00 01 00 02 08 01
				15 00 00 00 01 00 02 09 1D
				15 00 00 00 01 00 02 0A 01
				15 00 00 00 01 00 02 0B 53
				15 00 00 00 01 00 02 0C 01
				15 00 00 00 01 00 02 0D 7E
				15 00 00 00 01 00 02 0E 01
				15 00 00 00 01 00 02 0F BE
				15 00 00 00 01 00 02 10 01
				15 00 00 00 01 00 02 11 F5
				15 00 00 00 01 00 02 12 01
				15 00 00 00 01 00 02 13 F7
				15 00 00 00 01 00 02 14 02
				15 00 00 00 01 00 02 15 2B
				15 00 00 00 01 00 02 16 02
				15 00 00 00 01 00 02 17 68
				15 00 00 00 01 00 02 18 02
				15 00 00 00 01 00 02 19 91
				15 00 00 00 01 00 02 1A 02
				15 00 00 00 01 00 02 1B CB
				15 00 00 00 01 00 02 1C 02
				15 00 00 00 01 00 02 1D F5
				15 00 00 00 01 00 02 1E 03
				15 00 00 00 01 00 02 1F 36
				15 00 00 00 01 00 02 20 03
				15 00 00 00 01 00 02 21 49
				15 00 00 00 01 00 02 22 03
				15 00 00 00 01 00 02 23 5F
				15 00 00 00 01 00 02 24 03
				15 00 00 00 01 00 02 25 76
				15 00 00 00 01 00 02 26 03
				15 00 00 00 01 00 02 27 90
				15 00 00 00 01 00 02 28 03
				15 00 00 00 01 00 02 29 AC
				15 00 00 00 01 00 02 2A 03
				15 00 00 00 01 00 02 2B CB
				15 00 00 00 01 00 02 2D 03
				15 00 00 00 01 00 02 2F EE
				15 00 00 00 01 00 02 30 03
				15 00 00 00 01 00 02 31 FF
				15 00 00 00 01 00 02 32 00
				15 00 00 00 01 00 02 33 D0
				15 00 00 00 01 00 02 34 00
				15 00 00 00 01 00 02 35 D4
				15 00 00 00 01 00 02 36 00
				15 00 00 00 01 00 02 37 DE
				15 00 00 00 01 00 02 38 00
				15 00 00 00 01 00 02 39 E5
				15 00 00 00 01 00 02 3A 00
				15 00 00 00 01 00 02 3B EE
				15 00 00 00 01 00 02 3D 00
				15 00 00 00 01 00 02 3F F5
				15 00 00 00 01 00 02 40 00
				15 00 00 00 01 00 02 41 FD
				15 00 00 00 01 00 02 42 01
				15 00 00 00 01 00 02 43 04
				15 00 00 00 01 00 02 44 01
				15 00 00 00 01 00 02 45 0B
				15 00 00 00 01 00 02 46 01
				15 00 00 00 01 00 02 47 23
				15 00 00 00 01 00 02 48 01
				15 00 00 00 01 00 02 49 39
				15 00 00 00 01 00 02 4A 01
				15 00 00 00 01 00 02 4B 5C
				15 00 00 00 01 00 02 4C 01
				15 00 00 00 01 00 02 4D 7E
				15 00 00 00 01 00 02 4E 01
				15 00 00 00 01 00 02 4F BE
				15 00 00 00 01 00 02 50 01
				15 00 00 00 01 00 02 51 F5
				15 00 00 00 01 00 02 52 01
				15 00 00 00 01 00 02 53 F7
				15 00 00 00 01 00 02 54 02
				15 00 00 00 01 00 02 55 2B
				15 00 00 00 01 00 02 56 02
				15 00 00 00 01 00 02 58 68
				15 00 00 00 01 00 02 59 02
				15 00 00 00 01 00 02 5A 91
				15 00 00 00 01 00 02 5B 02
				15 00 00 00 01 00 02 5C CB
				15 00 00 00 01 00 02 5D 02
				15 00 00 00 01 00 02 5E F5
				15 00 00 00 01 00 02 5F 03
				15 00 00 00 01 00 02 60 36
				15 00 00 00 01 00 02 61 03
				15 00 00 00 01 00 02 62 49
				15 00 00 00 01 00 02 63 03
				15 00 00 00 01 00 02 64 5F
				15 00 00 00 01 00 02 65 03
				15 00 00 00 01 00 02 66 76
				15 00 00 00 01 00 02 67 03
				15 00 00 00 01 00 02 68 90
				15 00 00 00 01 00 02 69 03
				15 00 00 00 01 00 02 6A AC
				15 00 00 00 01 00 02 6B 03
				15 00 00 00 01 00 02 6C CB
				15 00 00 00 01 00 02 6D 03
				15 00 00 00 01 00 02 6E EE
				15 00 00 00 01 00 02 6F 03
				15 00 00 00 01 00 02 70 FF
				15 00 00 00 01 00 02 71 00
				15 00 00 00 01 00 02 72 D6
				15 00 00 00 01 00 02 73 00
				15 00 00 00 01 00 02 74 D9
				15 00 00 00 01 00 02 75 00
				15 00 00 00 01 00 02 76 E2
				15 00 00 00 01 00 02 77 00
				15 00 00 00 01 00 02 78 EA
				15 00 00 00 01 00 02 79 00
				15 00 00 00 01 00 02 7A F0
				15 00 00 00 01 00 02 7B 00
				15 00 00 00 01 00 02 7C F8
				15 00 00 00 01 00 02 7D 01
				15 00 00 00 01 00 02 7E 00
				15 00 00 00 01 00 02 7F 01
				15 00 00 00 01 00 02 80 07
				15 00 00 00 01 00 02 81 01
				15 00 00 00 01 00 02 82 0E
				15 00 00 00 01 00 02 83 01
				15 00 00 00 01 00 02 84 29
				15 00 00 00 01 00 02 85 01
				15 00 00 00 01 00 02 86 42
				15 00 00 00 01 00 02 87 01
				15 00 00 00 01 00 02 88 6F
				15 00 00 00 01 00 02 89 01
				15 00 00 00 01 00 02 8A 94
				15 00 00 00 01 00 02 8B 01
				15 00 00 00 01 00 02 8C CD
				15 00 00 00 01 00 02 8D 02
				15 00 00 00 01 00 02 8E 00
				15 00 00 00 01 00 02 8F 02
				15 00 00 00 01 00 02 90 02
				15 00 00 00 01 00 02 91 02
				15 00 00 00 01 00 02 92 33
				15 00 00 00 01 00 02 93 02
				15 00 00 00 01 00 02 94 70
				15 00 00 00 01 00 02 95 02
				15 00 00 00 01 00 02 96 98
				15 00 00 00 01 00 02 97 02
				15 00 00 00 01 00 02 98 D8
				15 00 00 00 01 00 02 99 03
				15 00 00 00 01 00 02 9A 03
				15 00 00 00 01 00 02 9B 03
				15 00 00 00 01 00 02 9C 2D
				15 00 00 00 01 00 02 9D 03
				15 00 00 00 01 00 02 9E 40
				15 00 00 00 01 00 02 9F 03
				15 00 00 00 01 00 02 A0 56
				15 00 00 00 01 00 02 A2 03
				15 00 00 00 01 00 02 A3 6E
				15 00 00 00 01 00 02 A4 03
				15 00 00 00 01 00 02 A5 88
				15 00 00 00 01 00 02 A6 03
				15 00 00 00 01 00 02 A7 A6
				15 00 00 00 01 00 02 A9 03
				15 00 00 00 01 00 02 AA C7
				15 00 00 00 01 00 02 AB 03
				15 00 00 00 01 00 02 AC ED
				15 00 00 00 01 00 02 AD 03
				15 00 00 00 01 00 02 AE FF
				15 00 00 00 01 00 02 AF 01
				15 00 00 00 01 00 02 B0 0D
				15 00 00 00 01 00 02 B1 01
				15 00 00 00 01 00 02 B2 0F
				15 00 00 00 01 00 02 B3 01
				15 00 00 00 01 00 02 B4 16
				15 00 00 00 01 00 02 B5 01
				15 00 00 00 01 00 02 B6 1C
				15 00 00 00 01 00 02 B7 01
				15 00 00 00 01 00 02 B8 21
				15 00 00 00 01 00 02 B9 01
				15 00 00 00 01 00 02 BA 26
				15 00 00 00 01 00 02 BB 01
				15 00 00 00 01 00 02 BC 2C
				15 00 00 00 01 00 02 BD 01
				15 00 00 00 01 00 02 BE 31
				15 00 00 00 01 00 02 BF 01
				15 00 00 00 01 00 02 C0 37
				15 00 00 00 01 00 02 C1 01
				15 00 00 00 01 00 02 C2 49
				15 00 00 00 01 00 02 C3 01
				15 00 00 00 01 00 02 C4 5A
				15 00 00 00 01 00 02 C5 01
				15 00 00 00 01 00 02 C6 77
				15 00 00 00 01 00 02 C7 01
				15 00 00 00 01 00 02 C8 94
				15 00 00 00 01 00 02 C9 01
				15 00 00 00 01 00 02 CA CD
				15 00 00 00 01 00 02 CB 02
				15 00 00 00 01 00 02 CC 00
				15 00 00 00 01 00 02 CD 02
				15 00 00 00 01 00 02 CE 02
				15 00 00 00 01 00 02 CF 02
				15 00 00 00 01 00 02 D0 33
				15 00 00 00 01 00 02 D1 02
				15 00 00 00 01 00 02 D2 70
				15 00 00 00 01 00 02 D3 02
				15 00 00 00 01 00 02 D4 98
				15 00 00 00 01 00 02 D5 02
				15 00 00 00 01 00 02 D6 D8
				15 00 00 00 01 00 02 D7 03
				15 00 00 00 01 00 02 D8 03
				15 00 00 00 01 00 02 D9 03
				15 00 00 00 01 00 02 DA 2D
				15 00 00 00 01 00 02 DB 03
				15 00 00 00 01 00 02 DC 40
				15 00 00 00 01 00 02 DD 03
				15 00 00 00 01 00 02 DE 56
				15 00 00 00 01 00 02 DF 03
				15 00 00 00 01 00 02 E0 6E
				15 00 00 00 01 00 02 E1 03
				15 00 00 00 01 00 02 E2 88
				15 00 00 00 01 00 02 E3 03
				15 00 00 00 01 00 02 E4 A6
				15 00 00 00 01 00 02 E5 03
				15 00 00 00 01 00 02 E6 C7
				15 00 00 00 01 00 02 E7 03
				15 00 00 00 01 00 02 E8 ED
				15 00 00 00 01 00 02 E9 03
				15 00 00 00 01 00 02 EA FF
				15 00 00 00 01 00 02 EB 30
				15 00 00 00 01 00 02 EC 17
				15 00 00 00 01 00 02 ED 20
				15 00 00 00 01 00 02 EE 0F
				15 00 00 00 01 00 02 EF 1F
				15 00 00 00 01 00 02 F0 0F
				15 00 00 00 01 00 02 F1 0F
				15 00 00 00 01 00 02 F2 07
				15 00 00 00 01 00 02 FB 01
				15 01 00 00 01 00 02 FF 10
				];
		qcom,mdss-dsi-dispparam-warm-command-state = "dsi_hs_mode";
		qcom,mdss-dsi-dispparam-default-command = [
				15 00 00 00 01 00 02 FF 20
				15 00 00 00 01 00 02 75 00
				15 00 00 00 01 00 02 76 00
				15 00 00 00 01 00 02 77 00
				15 00 00 00 01 00 02 78 0C
				15 00 00 00 01 00 02 79 00
				15 00 00 00 01 00 02 7A 26
				15 00 00 00 01 00 02 7B 00
				15 00 00 00 01 00 02 7C 3B
				15 00 00 00 01 00 02 7D 00
				15 00 00 00 01 00 02 7E 50
				15 00 00 00 01 00 02 7F 00
				15 00 00 00 01 00 02 80 61
				15 00 00 00 01 00 02 81 00
				15 00 00 00 01 00 02 82 72
				15 00 00 00 01 00 02 83 00
				15 00 00 00 01 00 02 84 81
				15 00 00 00 01 00 02 85 00
				15 00 00 00 01 00 02 86 90
				15 00 00 00 01 00 02 87 00
				15 00 00 00 01 00 02 88 C3
				15 00 00 00 01 00 02 89 00
				15 00 00 00 01 00 02 8A EE
				15 00 00 00 01 00 02 8B 01
				15 00 00 00 01 00 02 8C 35
				15 00 00 00 01 00 02 8D 01
				15 00 00 00 01 00 02 8E 6C
				15 00 00 00 01 00 02 8F 01
				15 00 00 00 01 00 02 90 B8
				15 00 00 00 01 00 02 91 01
				15 00 00 00 01 00 02 92 F4
				15 00 00 00 01 00 02 93 01
				15 00 00 00 01 00 02 94 F6
				15 00 00 00 01 00 02 95 02
				15 00 00 00 01 00 02 96 2E
				15 00 00 00 01 00 02 97 02
				15 00 00 00 01 00 02 98 70
				15 00 00 00 01 00 02 99 02
				15 00 00 00 01 00 02 9A 9C
				15 00 00 00 01 00 02 9B 02
				15 00 00 00 01 00 02 9C DA
				15 00 00 00 01 00 02 9D 03
				15 00 00 00 01 00 02 9E 08
				15 00 00 00 01 00 02 9F 03
				15 00 00 00 01 00 02 A0 46
				15 00 00 00 01 00 02 A2 03
				15 00 00 00 01 00 02 A3 59
				15 00 00 00 01 00 02 A4 03
				15 00 00 00 01 00 02 A5 6E
				15 00 00 00 01 00 02 A6 03
				15 00 00 00 01 00 02 A7 85
				15 00 00 00 01 00 02 A9 03
				15 00 00 00 01 00 02 AA 9C
				15 00 00 00 01 00 02 AB 03
				15 00 00 00 01 00 02 AC B6
				15 00 00 00 01 00 02 AD 03
				15 00 00 00 01 00 02 AE D2
				15 00 00 00 01 00 02 AF 03
				15 00 00 00 01 00 02 B0 F1
				15 00 00 00 01 00 02 B1 03
				15 00 00 00 01 00 02 B2 FF
				15 00 00 00 01 00 02 B3 00
				15 00 00 00 01 00 02 B4 4A
				15 00 00 00 01 00 02 B5 00
				15 00 00 00 01 00 02 B6 55
				15 00 00 00 01 00 02 B7 00
				15 00 00 00 01 00 02 B8 6C
				15 00 00 00 01 00 02 B9 00
				15 00 00 00 01 00 02 BA 7F
				15 00 00 00 01 00 02 BB 00
				15 00 00 00 01 00 02 BC 90
				15 00 00 00 01 00 02 BD 00
				15 00 00 00 01 00 02 BE 9F
				15 00 00 00 01 00 02 BF 00
				15 00 00 00 01 00 02 C0 AE
				15 00 00 00 01 00 02 C1 00
				15 00 00 00 01 00 02 C2 BA
				15 00 00 00 01 00 02 C3 00
				15 00 00 00 01 00 02 C4 C6
				15 00 00 00 01 00 02 C5 00
				15 00 00 00 01 00 02 C6 EE
				15 00 00 00 01 00 02 C7 01
				15 00 00 00 01 00 02 C8 0E
				15 00 00 00 01 00 02 C9 01
				15 00 00 00 01 00 02 CA 40
				15 00 00 00 01 00 02 CB 01
				15 00 00 00 01 00 02 CC 6C
				15 00 00 00 01 00 02 CD 01
				15 00 00 00 01 00 02 CE B8
				15 00 00 00 01 00 02 CF 01
				15 00 00 00 01 00 02 D0 F4
				15 00 00 00 01 00 02 D1 01
				15 00 00 00 01 00 02 D2 F6
				15 00 00 00 01 00 02 D3 02
				15 00 00 00 01 00 02 D4 2E
				15 00 00 00 01 00 02 D5 02
				15 00 00 00 01 00 02 D6 70
				15 00 00 00 01 00 02 D7 02
				15 00 00 00 01 00 02 D8 9C
				15 00 00 00 01 00 02 D9 02
				15 00 00 00 01 00 02 DA DA
				15 00 00 00 01 00 02 DB 03
				15 00 00 00 01 00 02 DC 08
				15 00 00 00 01 00 02 DD 03
				15 00 00 00 01 00 02 DE 46
				15 00 00 00 01 00 02 DF 03
				15 00 00 00 01 00 02 E0 59
				15 00 00 00 01 00 02 E1 03
				15 00 00 00 01 00 02 E2 6E
				15 00 00 00 01 00 02 E3 03
				15 00 00 00 01 00 02 E4 85
				15 00 00 00 01 00 02 E5 03
				15 00 00 00 01 00 02 E6 9C
				15 00 00 00 01 00 02 E7 03
				15 00 00 00 01 00 02 E8 B6
				15 00 00 00 01 00 02 E9 03
				15 00 00 00 01 00 02 EA D2
				15 00 00 00 01 00 02 EB 03
				15 00 00 00 01 00 02 EC F1
				15 00 00 00 01 00 02 ED 03
				15 00 00 00 01 00 02 EE FF
				15 00 00 00 01 00 02 EF 00
				15 00 00 00 01 00 02 F0 5D
				15 00 00 00 01 00 02 F1 00
				15 00 00 00 01 00 02 F2 64
				15 00 00 00 01 00 02 F3 00
				15 00 00 00 01 00 02 F4 74
				15 00 00 00 01 00 02 F5 00
				15 00 00 00 01 00 02 F6 82
				15 00 00 00 01 00 02 F7 00
				15 00 00 00 01 00 02 F8 90
				15 00 00 00 01 00 02 F9 00
				15 00 00 00 01 00 02 FA 9C
				15 00 00 00 01 00 02 FB 01
				15 00 00 00 01 00 02 FF 21
				15 00 00 00 01 00 02 00 00
				15 00 00 00 01 00 02 01 A9
				15 00 00 00 01 00 02 02 00
				15 00 00 00 01 00 02 03 B5
				15 00 00 00 01 00 02 04 00
				15 00 00 00 01 00 02 05 C0
				15 00 00 00 01 00 02 06 00
				15 00 00 00 01 00 02 07 E9
				15 00 00 00 01 00 02 08 01
				15 00 00 00 01 00 02 09 0D
				15 00 00 00 01 00 02 0A 01
				15 00 00 00 01 00 02 0B 4B
				15 00 00 00 01 00 02 0C 01
				15 00 00 00 01 00 02 0D 7B
				15 00 00 00 01 00 02 0E 01
				15 00 00 00 01 00 02 0F C1
				15 00 00 00 01 00 02 10 01
				15 00 00 00 01 00 02 11 FA
				15 00 00 00 01 00 02 12 01
				15 00 00 00 01 00 02 13 FC
				15 00 00 00 01 00 02 14 02
				15 00 00 00 01 00 02 15 33
				15 00 00 00 01 00 02 16 02
				15 00 00 00 01 00 02 17 75
				15 00 00 00 01 00 02 18 02
				15 00 00 00 01 00 02 19 A1
				15 00 00 00 01 00 02 1A 02
				15 00 00 00 01 00 02 1B DE
				15 00 00 00 01 00 02 1C 03
				15 00 00 00 01 00 02 1D 0A
				15 00 00 00 01 00 02 1E 03
				15 00 00 00 01 00 02 1F 47
				15 00 00 00 01 00 02 20 03
				15 00 00 00 01 00 02 21 59
				15 00 00 00 01 00 02 22 03
				15 00 00 00 01 00 02 23 6D
				15 00 00 00 01 00 02 24 03
				15 00 00 00 01 00 02 25 84
				15 00 00 00 01 00 02 26 03
				15 00 00 00 01 00 02 27 9B
				15 00 00 00 01 00 02 28 03
				15 00 00 00 01 00 02 29 B5
				15 00 00 00 01 00 02 2A 03
				15 00 00 00 01 00 02 2B D1
				15 00 00 00 01 00 02 2D 03
				15 00 00 00 01 00 02 2F F0
				15 00 00 00 01 00 02 30 03
				15 00 00 00 01 00 02 31 FF
				15 00 00 00 01 00 02 32 00
				15 00 00 00 01 00 02 33 A0
				15 00 00 00 01 00 02 34 00
				15 00 00 00 01 00 02 35 A7
				15 00 00 00 01 00 02 36 00
				15 00 00 00 01 00 02 37 B4
				15 00 00 00 01 00 02 38 00
				15 00 00 00 01 00 02 39 BF
				15 00 00 00 01 00 02 3A 00
				15 00 00 00 01 00 02 3B CB
				15 00 00 00 01 00 02 3D 00
				15 00 00 00 01 00 02 3F D5
				15 00 00 00 01 00 02 40 00
				15 00 00 00 01 00 02 41 DF
				15 00 00 00 01 00 02 42 00
				15 00 00 00 01 00 02 43 E8
				15 00 00 00 01 00 02 44 00
				15 00 00 00 01 00 02 45 F1
				15 00 00 00 01 00 02 46 01
				15 00 00 00 01 00 02 47 11
				15 00 00 00 01 00 02 48 01
				15 00 00 00 01 00 02 49 2B
				15 00 00 00 01 00 02 4A 01
				15 00 00 00 01 00 02 4B 55
				15 00 00 00 01 00 02 4C 01
				15 00 00 00 01 00 02 4D 7B
				15 00 00 00 01 00 02 4E 01
				15 00 00 00 01 00 02 4F C1
				15 00 00 00 01 00 02 50 01
				15 00 00 00 01 00 02 51 FA
				15 00 00 00 01 00 02 52 01
				15 00 00 00 01 00 02 53 FC
				15 00 00 00 01 00 02 54 02
				15 00 00 00 01 00 02 55 33
				15 00 00 00 01 00 02 56 02
				15 00 00 00 01 00 02 58 75
				15 00 00 00 01 00 02 59 02
				15 00 00 00 01 00 02 5A A1
				15 00 00 00 01 00 02 5B 02
				15 00 00 00 01 00 02 5C DE
				15 00 00 00 01 00 02 5D 03
				15 00 00 00 01 00 02 5E 0A
				15 00 00 00 01 00 02 5F 03
				15 00 00 00 01 00 02 60 47
				15 00 00 00 01 00 02 61 03
				15 00 00 00 01 00 02 62 59
				15 00 00 00 01 00 02 63 03
				15 00 00 00 01 00 02 64 6D
				15 00 00 00 01 00 02 65 03
				15 00 00 00 01 00 02 66 84
				15 00 00 00 01 00 02 67 03
				15 00 00 00 01 00 02 68 9B
				15 00 00 00 01 00 02 69 03
				15 00 00 00 01 00 02 6A B5
				15 00 00 00 01 00 02 6B 03
				15 00 00 00 01 00 02 6C D1
				15 00 00 00 01 00 02 6D 03
				15 00 00 00 01 00 02 6E F0
				15 00 00 00 01 00 02 6F 03
				15 00 00 00 01 00 02 70 FF
				15 00 00 00 01 00 02 71 00
				15 00 00 00 01 00 02 72 82
				15 00 00 00 01 00 02 73 00
				15 00 00 00 01 00 02 74 88
				15 00 00 00 01 00 02 75 00
				15 00 00 00 01 00 02 76 96
				15 00 00 00 01 00 02 77 00
				15 00 00 00 01 00 02 78 A2
				15 00 00 00 01 00 02 79 00
				15 00 00 00 01 00 02 7A AE
				15 00 00 00 01 00 02 7B 00
				15 00 00 00 01 00 02 7C B9
				15 00 00 00 01 00 02 7D 00
				15 00 00 00 01 00 02 7E C3
				15 00 00 00 01 00 02 7F 00
				15 00 00 00 01 00 02 80 CE
				15 00 00 00 01 00 02 81 00
				15 00 00 00 01 00 02 82 D8
				15 00 00 00 01 00 02 83 00
				15 00 00 00 01 00 02 84 FD
				15 00 00 00 01 00 02 85 01
				15 00 00 00 01 00 02 86 1E
				15 00 00 00 01 00 02 87 01
				15 00 00 00 01 00 02 88 58
				15 00 00 00 01 00 02 89 01
				15 00 00 00 01 00 02 8A 85
				15 00 00 00 01 00 02 8B 01
				15 00 00 00 01 00 02 8C C7
				15 00 00 00 01 00 02 8D 01
				15 00 00 00 01 00 02 8E FF
				15 00 00 00 01 00 02 8F 02
				15 00 00 00 01 00 02 90 01
				15 00 00 00 01 00 02 91 02
				15 00 00 00 01 00 02 92 36
				15 00 00 00 01 00 02 93 02
				15 00 00 00 01 00 02 94 76
				15 00 00 00 01 00 02 95 02
				15 00 00 00 01 00 02 96 A4
				15 00 00 00 01 00 02 97 02
				15 00 00 00 01 00 02 98 E0
				15 00 00 00 01 00 02 99 03
				15 00 00 00 01 00 02 9A 06
				15 00 00 00 01 00 02 9B 03
				15 00 00 00 01 00 02 9C 3E
				15 00 00 00 01 00 02 9D 03
				15 00 00 00 01 00 02 9E 50
				15 00 00 00 01 00 02 9F 03
				15 00 00 00 01 00 02 A0 64
				15 00 00 00 01 00 02 A2 03
				15 00 00 00 01 00 02 A3 7A
				15 00 00 00 01 00 02 A4 03
				15 00 00 00 01 00 02 A5 92
				15 00 00 00 01 00 02 A6 03
				15 00 00 00 01 00 02 A7 AD
				15 00 00 00 01 00 02 A9 03
				15 00 00 00 01 00 02 AA CC
				15 00 00 00 01 00 02 AB 03
				15 00 00 00 01 00 02 AC EE
				15 00 00 00 01 00 02 AD 03
				15 00 00 00 01 00 02 AE FF
				15 00 00 00 01 00 02 AF 00
				15 00 00 00 01 00 02 B0 C3
				15 00 00 00 01 00 02 B1 00
				15 00 00 00 01 00 02 B2 C8
				15 00 00 00 01 00 02 B3 00
				15 00 00 00 01 00 02 B4 D3
				15 00 00 00 01 00 02 B5 00
				15 00 00 00 01 00 02 B6 DD
				15 00 00 00 01 00 02 B7 00
				15 00 00 00 01 00 02 B8 E6
				15 00 00 00 01 00 02 B9 00
				15 00 00 00 01 00 02 BA EE
				15 00 00 00 01 00 02 BB 00
				15 00 00 00 01 00 02 BC F7
				15 00 00 00 01 00 02 BD 00
				15 00 00 00 01 00 02 BE FF
				15 00 00 00 01 00 02 BF 01
				15 00 00 00 01 00 02 C0 07
				15 00 00 00 01 00 02 C1 01
				15 00 00 00 01 00 02 C2 23
				15 00 00 00 01 00 02 C3 01
				15 00 00 00 01 00 02 C4 3A
				15 00 00 00 01 00 02 C5 01
				15 00 00 00 01 00 02 C6 61
				15 00 00 00 01 00 02 C7 01
				15 00 00 00 01 00 02 C8 85
				15 00 00 00 01 00 02 C9 01
				15 00 00 00 01 00 02 CA C7
				15 00 00 00 01 00 02 CB 01
				15 00 00 00 01 00 02 CC FF
				15 00 00 00 01 00 02 CD 02
				15 00 00 00 01 00 02 CE 01
				15 00 00 00 01 00 02 CF 02
				15 00 00 00 01 00 02 D0 36
				15 00 00 00 01 00 02 D1 02
				15 00 00 00 01 00 02 D2 76
				15 00 00 00 01 00 02 D3 02
				15 00 00 00 01 00 02 D4 A4
				15 00 00 00 01 00 02 D5 02
				15 00 00 00 01 00 02 D6 E0
				15 00 00 00 01 00 02 D7 03
				15 00 00 00 01 00 02 D8 06
				15 00 00 00 01 00 02 D9 03
				15 00 00 00 01 00 02 DA 3E
				15 00 00 00 01 00 02 DB 03
				15 00 00 00 01 00 02 DC 50
				15 00 00 00 01 00 02 DD 03
				15 00 00 00 01 00 02 DE 64
				15 00 00 00 01 00 02 DF 03
				15 00 00 00 01 00 02 E0 7A
				15 00 00 00 01 00 02 E1 03
				15 00 00 00 01 00 02 E2 92
				15 00 00 00 01 00 02 E3 03
				15 00 00 00 01 00 02 E4 AD
				15 00 00 00 01 00 02 E5 03
				15 00 00 00 01 00 02 E6 CC
				15 00 00 00 01 00 02 E7 03
				15 00 00 00 01 00 02 E8 EE
				15 00 00 00 01 00 02 E9 03
				15 00 00 00 01 00 02 EA FF
				15 00 00 00 01 00 02 EB 30
				15 00 00 00 01 00 02 EC 17
				15 00 00 00 01 00 02 ED 20
				15 00 00 00 01 00 02 EE 0F
				15 00 00 00 01 00 02 EF 1F
				15 00 00 00 01 00 02 F0 0F
				15 00 00 00 01 00 02 F1 0F
				15 00 00 00 01 00 02 F2 07
				15 00 00 00 01 00 02 FB 01
				15 01 00 00 01 00 02 FF 10
				];
		qcom,mdss-dsi-dispparam-default-command-state = "dsi_hs_mode";
		qcom,mdss-dsi-dispparam-cold-command = [
				15 00 00 00 01 00 02 FF 20
				15 00 00 00 01 00 02 75 00
				15 00 00 00 01 00 02 76 32
				15 00 00 00 01 00 02 77 00
				15 00 00 00 01 00 02 78 3C
				15 00 00 00 01 00 02 79 00
				15 00 00 00 01 00 02 7A 50
				15 00 00 00 01 00 02 7B 00
				15 00 00 00 01 00 02 7C 61
				15 00 00 00 01 00 02 7D 00
				15 00 00 00 01 00 02 7E 72
				15 00 00 00 01 00 02 7F 00
				15 00 00 00 01 00 02 80 81
				15 00 00 00 01 00 02 81 00
				15 00 00 00 01 00 02 82 8F
				15 00 00 00 01 00 02 83 00
				15 00 00 00 01 00 02 84 9D
				15 00 00 00 01 00 02 85 00
				15 00 00 00 01 00 02 86 AA
				15 00 00 00 01 00 02 87 00
				15 00 00 00 01 00 02 88 D8
				15 00 00 00 01 00 02 89 00
				15 00 00 00 01 00 02 8A FF
				15 00 00 00 01 00 02 8B 01
				15 00 00 00 01 00 02 8C 43
				15 00 00 00 01 00 02 8D 01
				15 00 00 00 01 00 02 8E 74
				15 00 00 00 01 00 02 8F 01
				15 00 00 00 01 00 02 90 BD
				15 00 00 00 01 00 02 91 01
				15 00 00 00 01 00 02 92 F8
				15 00 00 00 01 00 02 93 01
				15 00 00 00 01 00 02 94 F9
				15 00 00 00 01 00 02 95 02
				15 00 00 00 01 00 02 96 31
				15 00 00 00 01 00 02 97 02
				15 00 00 00 01 00 02 98 72
				15 00 00 00 01 00 02 99 02
				15 00 00 00 01 00 02 9A A0
				15 00 00 00 01 00 02 9B 02
				15 00 00 00 01 00 02 9C DD
				15 00 00 00 01 00 02 9D 03
				15 00 00 00 01 00 02 9E 08
				15 00 00 00 01 00 02 9F 03
				15 00 00 00 01 00 02 A0 46
				15 00 00 00 01 00 02 A2 03
				15 00 00 00 01 00 02 A3 58
				15 00 00 00 01 00 02 A4 03
				15 00 00 00 01 00 02 A5 6D
				15 00 00 00 01 00 02 A6 03
				15 00 00 00 01 00 02 A7 83
				15 00 00 00 01 00 02 A9 03
				15 00 00 00 01 00 02 AA 9A
				15 00 00 00 01 00 02 AB 03
				15 00 00 00 01 00 02 AC B4
				15 00 00 00 01 00 02 AD 03
				15 00 00 00 01 00 02 AE D1
				15 00 00 00 01 00 02 AF 03
				15 00 00 00 01 00 02 B0 F0
				15 00 00 00 01 00 02 B1 03
				15 00 00 00 01 00 02 B2 FF
				15 00 00 00 01 00 02 B3 00
				15 00 00 00 01 00 02 B4 79
				15 00 00 00 01 00 02 B5 00
				15 00 00 00 01 00 02 B6 82
				15 00 00 00 01 00 02 B7 00
				15 00 00 00 01 00 02 B8 93
				15 00 00 00 01 00 02 B9 00
				15 00 00 00 01 00 02 BA A2
				15 00 00 00 01 00 02 BB 00
				15 00 00 00 01 00 02 BC B0
				15 00 00 00 01 00 02 BD 00
				15 00 00 00 01 00 02 BE BC
				15 00 00 00 01 00 02 BF 00
				15 00 00 00 01 00 02 C0 C7
				15 00 00 00 01 00 02 C1 00
				15 00 00 00 01 00 02 C2 D4
				15 00 00 00 01 00 02 C3 00
				15 00 00 00 01 00 02 C4 DE
				15 00 00 00 01 00 02 C5 01
				15 00 00 00 01 00 02 C6 01
				15 00 00 00 01 00 02 C7 01
				15 00 00 00 01 00 02 C8 1E
				15 00 00 00 01 00 02 C9 01
				15 00 00 00 01 00 02 CA 4D
				15 00 00 00 01 00 02 CB 01
				15 00 00 00 01 00 02 CC 74
				15 00 00 00 01 00 02 CD 01
				15 00 00 00 01 00 02 CE BD
				15 00 00 00 01 00 02 CF 01
				15 00 00 00 01 00 02 D0 F8
				15 00 00 00 01 00 02 D1 01
				15 00 00 00 01 00 02 D2 F9
				15 00 00 00 01 00 02 D3 02
				15 00 00 00 01 00 02 D4 31
				15 00 00 00 01 00 02 D5 02
				15 00 00 00 01 00 02 D6 72
				15 00 00 00 01 00 02 D7 02
				15 00 00 00 01 00 02 D8 A0
				15 00 00 00 01 00 02 D9 02
				15 00 00 00 01 00 02 DA DD
				15 00 00 00 01 00 02 DB 03
				15 00 00 00 01 00 02 DC 08
				15 00 00 00 01 00 02 DD 03
				15 00 00 00 01 00 02 DE 46
				15 00 00 00 01 00 02 DF 03
				15 00 00 00 01 00 02 E0 58
				15 00 00 00 01 00 02 E1 03
				15 00 00 00 01 00 02 E2 6D
				15 00 00 00 01 00 02 E3 03
				15 00 00 00 01 00 02 E4 83
				15 00 00 00 01 00 02 E5 03
				15 00 00 00 01 00 02 E6 9A
				15 00 00 00 01 00 02 E7 03
				15 00 00 00 01 00 02 E8 B4
				15 00 00 00 01 00 02 E9 03
				15 00 00 00 01 00 02 EA D1
				15 00 00 00 01 00 02 EB 03
				15 00 00 00 01 00 02 EC F0
				15 00 00 00 01 00 02 ED 03
				15 00 00 00 01 00 02 EE FF
				15 00 00 00 01 00 02 EF 00
				15 00 00 00 01 00 02 F0 00
				15 00 00 00 01 00 02 F1 00
				15 00 00 00 01 00 02 F2 0E
				15 00 00 00 01 00 02 F3 00
				15 00 00 00 01 00 02 F4 28
				15 00 00 00 01 00 02 F5 00
				15 00 00 00 01 00 02 F6 3B
				15 00 00 00 01 00 02 F7 00
				15 00 00 00 01 00 02 F8 50
				15 00 00 00 01 00 02 F9 00
				15 00 00 00 01 00 02 FA 61
				15 00 00 00 01 00 02 FB 01
				15 00 00 00 01 00 02 FF 21
				15 00 00 00 01 00 02 00 00
				15 00 00 00 01 00 02 01 72
				15 00 00 00 01 00 02 02 00
				15 00 00 00 01 00 02 03 82
				15 00 00 00 01 00 02 04 00
				15 00 00 00 01 00 02 05 91
				15 00 00 00 01 00 02 06 00
				15 00 00 00 01 00 02 07 C4
				15 00 00 00 01 00 02 08 00
				15 00 00 00 01 00 02 09 EE
				15 00 00 00 01 00 02 0A 01
				15 00 00 00 01 00 02 0B 35
				15 00 00 00 01 00 02 0C 01
				15 00 00 00 01 00 02 0D 6B
				15 00 00 00 01 00 02 0E 01
				15 00 00 00 01 00 02 0F B6
				15 00 00 00 01 00 02 10 01
				15 00 00 00 01 00 02 11 F4
				15 00 00 00 01 00 02 12 01
				15 00 00 00 01 00 02 13 F5
				15 00 00 00 01 00 02 14 02
				15 00 00 00 01 00 02 15 2D
				15 00 00 00 01 00 02 16 02
				15 00 00 00 01 00 02 17 6E
				15 00 00 00 01 00 02 18 02
				15 00 00 00 01 00 02 19 9C
				15 00 00 00 01 00 02 1A 02
				15 00 00 00 01 00 02 1B D6
				15 00 00 00 01 00 02 1C 03
				15 00 00 00 01 00 02 1D 04
				15 00 00 00 01 00 02 1E 03
				15 00 00 00 01 00 02 1F 42
				15 00 00 00 01 00 02 20 03
				15 00 00 00 01 00 02 21 54
				15 00 00 00 01 00 02 22 03
				15 00 00 00 01 00 02 23 69
				15 00 00 00 01 00 02 24 03
				15 00 00 00 01 00 02 25 80
				15 00 00 00 01 00 02 26 03
				15 00 00 00 01 00 02 27 97
				15 00 00 00 01 00 02 28 03
				15 00 00 00 01 00 02 29 B2
				15 00 00 00 01 00 02 2A 03
				15 00 00 00 01 00 02 2B CF
				15 00 00 00 01 00 02 2D 03
				15 00 00 00 01 00 02 2F F0
				15 00 00 00 01 00 02 30 03
				15 00 00 00 01 00 02 31 FF
				15 00 00 00 01 00 02 32 00
				15 00 00 00 01 00 02 33 4A
				15 00 00 00 01 00 02 34 00
				15 00 00 00 01 00 02 35 57
				15 00 00 00 01 00 02 36 00
				15 00 00 00 01 00 02 37 6E
				15 00 00 00 01 00 02 38 00
				15 00 00 00 01 00 02 39 7F
				15 00 00 00 01 00 02 3A 00
				15 00 00 00 01 00 02 3B 90
				15 00 00 00 01 00 02 3D 00
				15 00 00 00 01 00 02 3F 9F
				15 00 00 00 01 00 02 40 00
				15 00 00 00 01 00 02 41 AE
				15 00 00 00 01 00 02 42 00
				15 00 00 00 01 00 02 43 BB
				15 00 00 00 01 00 02 44 00
				15 00 00 00 01 00 02 45 C7
				15 00 00 00 01 00 02 46 00
				15 00 00 00 01 00 02 47 EF
				15 00 00 00 01 00 02 48 01
				15 00 00 00 01 00 02 49 0E
				15 00 00 00 01 00 02 4A 01
				15 00 00 00 01 00 02 4B 40
				15 00 00 00 01 00 02 4C 01
				15 00 00 00 01 00 02 4D 6B
				15 00 00 00 01 00 02 4E 01
				15 00 00 00 01 00 02 4F B6
				15 00 00 00 01 00 02 50 01
				15 00 00 00 01 00 02 51 F4
				15 00 00 00 01 00 02 52 01
				15 00 00 00 01 00 02 53 F5
				15 00 00 00 01 00 02 54 02
				15 00 00 00 01 00 02 55 2D
				15 00 00 00 01 00 02 56 02
				15 00 00 00 01 00 02 58 6E
				15 00 00 00 01 00 02 59 02
				15 00 00 00 01 00 02 5A 9C
				15 00 00 00 01 00 02 5B 02
				15 00 00 00 01 00 02 5C D6
				15 00 00 00 01 00 02 5D 03
				15 00 00 00 01 00 02 5E 04
				15 00 00 00 01 00 02 5F 03
				15 00 00 00 01 00 02 60 42
				15 00 00 00 01 00 02 61 03
				15 00 00 00 01 00 02 62 54
				15 00 00 00 01 00 02 63 03
				15 00 00 00 01 00 02 64 69
				15 00 00 00 01 00 02 65 03
				15 00 00 00 01 00 02 66 80
				15 00 00 00 01 00 02 67 03
				15 00 00 00 01 00 02 68 97
				15 00 00 00 01 00 02 69 03
				15 00 00 00 01 00 02 6A B2
				15 00 00 00 01 00 02 6B 03
				15 00 00 00 01 00 02 6C CF
				15 00 00 00 01 00 02 6D 03
				15 00 00 00 01 00 02 6E F0
				15 00 00 00 01 00 02 6F 03
				15 00 00 00 01 00 02 70 FF
				15 00 00 00 01 00 02 71 00
				15 00 00 00 01 00 02 72 17
				15 00 00 00 01 00 02 73 00
				15 00 00 00 01 00 02 74 22
				15 00 00 00 01 00 02 75 00
				15 00 00 00 01 00 02 76 39
				15 00 00 00 01 00 02 77 00
				15 00 00 00 01 00 02 78 4B
				15 00 00 00 01 00 02 79 00
				15 00 00 00 01 00 02 7A 5F
				15 00 00 00 01 00 02 7B 00
				15 00 00 00 01 00 02 7C 6F
				15 00 00 00 01 00 02 7D 00
				15 00 00 00 01 00 02 7E 7E
				15 00 00 00 01 00 02 7F 00
				15 00 00 00 01 00 02 80 8C
				15 00 00 00 01 00 02 81 00
				15 00 00 00 01 00 02 82 9B
				15 00 00 00 01 00 02 83 00
				15 00 00 00 01 00 02 84 CB
				15 00 00 00 01 00 02 85 00
				15 00 00 00 01 00 02 86 F5
				15 00 00 00 01 00 02 87 01
				15 00 00 00 01 00 02 88 3A
				15 00 00 00 01 00 02 89 01
				15 00 00 00 01 00 02 8A 6F
				15 00 00 00 01 00 02 8B 01
				15 00 00 00 01 00 02 8C B9
				15 00 00 00 01 00 02 8D 01
				15 00 00 00 01 00 02 8E F6
				15 00 00 00 01 00 02 8F 01
				15 00 00 00 01 00 02 90 F7
				15 00 00 00 01 00 02 91 02
				15 00 00 00 01 00 02 92 2F
				15 00 00 00 01 00 02 93 02
				15 00 00 00 01 00 02 94 70
				15 00 00 00 01 00 02 95 02
				15 00 00 00 01 00 02 96 9F
				15 00 00 00 01 00 02 97 02
				15 00 00 00 01 00 02 98 E0
				15 00 00 00 01 00 02 99 03
				15 00 00 00 01 00 02 9A 06
				15 00 00 00 01 00 02 9B 03
				15 00 00 00 01 00 02 9C 38
				15 00 00 00 01 00 02 9D 03
				15 00 00 00 01 00 02 9E 4B
				15 00 00 00 01 00 02 9F 03
				15 00 00 00 01 00 02 A0 60
				15 00 00 00 01 00 02 A2 03
				15 00 00 00 01 00 02 A3 78
				15 00 00 00 01 00 02 A4 03
				15 00 00 00 01 00 02 A5 90
				15 00 00 00 01 00 02 A6 03
				15 00 00 00 01 00 02 A7 AC
				15 00 00 00 01 00 02 A9 03
				15 00 00 00 01 00 02 AA CC
				15 00 00 00 01 00 02 AB 03
				15 00 00 00 01 00 02 AC EE
				15 00 00 00 01 00 02 AD 03
				15 00 00 00 01 00 02 AE FF
				15 00 00 00 01 00 02 AF 00
				15 00 00 00 01 00 02 B0 60
				15 00 00 00 01 00 02 B1 00
				15 00 00 00 01 00 02 B2 69
				15 00 00 00 01 00 02 B3 00
				15 00 00 00 01 00 02 B4 7D
				15 00 00 00 01 00 02 B5 00
				15 00 00 00 01 00 02 B6 8D
				15 00 00 00 01 00 02 B7 00
				15 00 00 00 01 00 02 B8 9E
				15 00 00 00 01 00 02 B9 00
				15 00 00 00 01 00 02 BA AC
				15 00 00 00 01 00 02 BB 00
				15 00 00 00 01 00 02 BC B9
				15 00 00 00 01 00 02 BD 00
				15 00 00 00 01 00 02 BE C4
				15 00 00 00 01 00 02 BF 00
				15 00 00 00 01 00 02 C0 D0
				15 00 00 00 01 00 02 C1 00
				15 00 00 00 01 00 02 C2 F5
				15 00 00 00 01 00 02 C3 01
				15 00 00 00 01 00 02 C4 14
				15 00 00 00 01 00 02 C5 01
				15 00 00 00 01 00 02 C6 45
				15 00 00 00 01 00 02 C7 01
				15 00 00 00 01 00 02 C8 6F
				15 00 00 00 01 00 02 C9 01
				15 00 00 00 01 00 02 CA B9
				15 00 00 00 01 00 02 CB 01
				15 00 00 00 01 00 02 CC F6
				15 00 00 00 01 00 02 CD 01
				15 00 00 00 01 00 02 CE F7
				15 00 00 00 01 00 02 CF 02
				15 00 00 00 01 00 02 D0 2F
				15 00 00 00 01 00 02 D1 02
				15 00 00 00 01 00 02 D2 70
				15 00 00 00 01 00 02 D3 02
				15 00 00 00 01 00 02 D4 9F
				15 00 00 00 01 00 02 D5 02
				15 00 00 00 01 00 02 D6 E0
				15 00 00 00 01 00 02 D7 03
				15 00 00 00 01 00 02 D8 06
				15 00 00 00 01 00 02 D9 03
				15 00 00 00 01 00 02 DA 38
				15 00 00 00 01 00 02 DB 03
				15 00 00 00 01 00 02 DC 4B
				15 00 00 00 01 00 02 DD 03
				15 00 00 00 01 00 02 DE 60
				15 00 00 00 01 00 02 DF 03
				15 00 00 00 01 00 02 E0 78
				15 00 00 00 01 00 02 E1 03
				15 00 00 00 01 00 02 E2 90
				15 00 00 00 01 00 02 E3 03
				15 00 00 00 01 00 02 E4 AC
				15 00 00 00 01 00 02 E5 03
				15 00 00 00 01 00 02 E6 CC
				15 00 00 00 01 00 02 E7 03
				15 00 00 00 01 00 02 E8 EE
				15 00 00 00 01 00 02 E9 03
				15 00 00 00 01 00 02 EA FF
				15 00 00 00 01 00 02 EB 30
				15 00 00 00 01 00 02 EC 17
				15 00 00 00 01 00 02 ED 20
				15 00 00 00 01 00 02 EE 0F
				15 00 00 00 01 00 02 EF 1F
				15 00 00 00 01 00 02 F0 0F
				15 00 00 00 01 00 02 F1 0F
				15 00 00 00 01 00 02 F2 07
				15 00 00 00 01 00 02 FB 01
				15 01 00 00 01 00 02 FF 10
				];
		qcom,mdss-dsi-dispparam-cold-command-state = "dsi_hs_mode";
		qcom,mdss-dsi-dispparam-papermode-command = [
				15 01 00 00 78 00 02 FF 20
				15 00 00 00 01 00 02 FB 01
				15 00 00 00 01 00 02 75 01
				15 00 00 00 01 00 02 76 60
				15 00 00 00 01 00 02 77 01
				15 00 00 00 01 00 02 78 63
				15 00 00 00 01 00 02 79 01
				15 00 00 00 01 00 02 7A 68
				15 00 00 00 01 00 02 7B 01
				15 00 00 00 01 00 02 7C 6E
				15 00 00 00 01 00 02 7D 01
				15 00 00 00 01 00 02 7E 73
				15 00 00 00 01 00 02 7F 01
				15 00 00 00 01 00 02 80 78
				15 00 00 00 01 00 02 81 01
				15 00 00 00 01 00 02 82 7D
				15 00 00 00 01 00 02 83 01
				15 00 00 00 01 00 02 84 82
				15 00 00 00 01 00 02 85 01
				15 00 00 00 01 00 02 86 87
				15 00 00 00 01 00 02 87 01
				15 00 00 00 01 00 02 88 99
				15 00 00 00 01 00 02 89 01
				15 00 00 00 01 00 02 8A AA
				15 00 00 00 01 00 02 8B 01
				15 00 00 00 01 00 02 8C C9
				15 00 00 00 01 00 02 8D 01
				15 00 00 00 01 00 02 8E E5
				15 00 00 00 01 00 02 8F 02
				15 00 00 00 01 00 02 90 0C
				15 00 00 00 01 00 02 91 02
				15 00 00 00 01 00 02 92 31
				15 00 00 00 01 00 02 93 02
				15 00 00 00 01 00 02 94 33
				15 00 00 00 01 00 02 95 02
				15 00 00 00 01 00 02 96 60
				15 00 00 00 01 00 02 97 02
				15 00 00 00 01 00 02 98 9B
				15 00 00 00 01 00 02 99 02
				15 00 00 00 01 00 02 9A C4
				15 00 00 00 01 00 02 9B 02
				15 00 00 00 01 00 02 9C FA
				15 00 00 00 01 00 02 9D 03
				15 00 00 00 01 00 02 9E 17
				15 00 00 00 01 00 02 9F 03
				15 00 00 00 01 00 02 A0 4E
				15 00 00 00 01 00 02 A2 03
				15 00 00 00 01 00 02 A3 60
				15 00 00 00 01 00 02 A4 03
				15 00 00 00 01 00 02 A5 73
				15 00 00 00 01 00 02 A6 03
				15 00 00 00 01 00 02 A7 86
				15 00 00 00 01 00 02 A9 03
				15 00 00 00 01 00 02 AA 98
				15 00 00 00 01 00 02 AB 03
				15 00 00 00 01 00 02 AC A7
				15 00 00 00 01 00 02 AD 03
				15 00 00 00 01 00 02 AE B1
				15 00 00 00 01 00 02 AF 03
				15 00 00 00 01 00 02 B0 B6
				15 00 00 00 01 00 02 B1 03
				15 00 00 00 01 00 02 B2 FF
				15 00 00 00 01 00 02 B3 01
				15 00 00 00 01 00 02 B4 60
				15 00 00 00 01 00 02 B5 01
				15 00 00 00 01 00 02 B6 63
				15 00 00 00 01 00 02 B7 01
				15 00 00 00 01 00 02 B8 68
				15 00 00 00 01 00 02 B9 01
				15 00 00 00 01 00 02 BA 6E
				15 00 00 00 01 00 02 BB 01
				15 00 00 00 01 00 02 BC 73
				15 00 00 00 01 00 02 BD 01
				15 00 00 00 01 00 02 BE 78
				15 00 00 00 01 00 02 BF 01
				15 00 00 00 01 00 02 C0 7D
				15 00 00 00 01 00 02 C1 01
				15 00 00 00 01 00 02 C2 82
				15 00 00 00 01 00 02 C3 01
				15 00 00 00 01 00 02 C4 87
				15 00 00 00 01 00 02 C5 01
				15 00 00 00 01 00 02 C6 99
				15 00 00 00 01 00 02 C7 01
				15 00 00 00 01 00 02 C8 AA
				15 00 00 00 01 00 02 C9 01
				15 00 00 00 01 00 02 CA C9
				15 00 00 00 01 00 02 CB 01
				15 00 00 00 01 00 02 CC E5
				15 00 00 00 01 00 02 CD 02
				15 00 00 00 01 00 02 CE 0C
				15 00 00 00 01 00 02 CF 02
				15 00 00 00 01 00 02 D0 31
				15 00 00 00 01 00 02 D1 02
				15 00 00 00 01 00 02 D2 33
				15 00 00 00 01 00 02 D3 02
				15 00 00 00 01 00 02 D4 60
				15 00 00 00 01 00 02 D5 02
				15 00 00 00 01 00 02 D6 9B
				15 00 00 00 01 00 02 D7 02
				15 00 00 00 01 00 02 D8 C4
				15 00 00 00 01 00 02 D9 02
				15 00 00 00 01 00 02 DA FA
				15 00 00 00 01 00 02 DB 03
				15 00 00 00 01 00 02 DC 17
				15 00 00 00 01 00 02 DD 03
				15 00 00 00 01 00 02 DE 4E
				15 00 00 00 01 00 02 DF 03
				15 00 00 00 01 00 02 E0 60
				15 00 00 00 01 00 02 E1 03
				15 00 00 00 01 00 02 E2 73
				15 00 00 00 01 00 02 E3 03
				15 00 00 00 01 00 02 E4 86
				15 00 00 00 01 00 02 E5 03
				15 00 00 00 01 00 02 E6 98
				15 00 00 00 01 00 02 E7 03
				15 00 00 00 01 00 02 E8 A7
				15 00 00 00 01 00 02 E9 03
				15 00 00 00 01 00 02 EA B1
				15 00 00 00 01 00 02 EB 03
				15 00 00 00 01 00 02 EC B6
				15 00 00 00 01 00 02 ED 03
				15 00 00 00 01 00 02 EE FF
				15 00 00 00 01 00 02 EF 01
				15 00 00 00 01 00 02 F0 6A
				15 00 00 00 01 00 02 F1 01
				15 00 00 00 01 00 02 F2 6D
				15 00 00 00 01 00 02 F3 01
				15 00 00 00 01 00 02 F4 72
				15 00 00 00 01 00 02 F5 01
				15 00 00 00 01 00 02 F6 77
				15 00 00 00 01 00 02 F7 01
				15 00 00 00 01 00 02 F8 7C
				15 00 00 00 01 00 02 F9 01
				15 00 00 00 01 00 02 FA 81
				15 00 00 00 01 00 02 FF 21
				15 00 00 00 01 00 02 FB 01
				15 00 00 00 01 00 02 00 01
				15 00 00 00 01 00 02 01 86
				15 00 00 00 01 00 02 02 01
				15 00 00 00 01 00 02 03 8A
				15 00 00 00 01 00 02 04 01
				15 00 00 00 01 00 02 05 8F
				15 00 00 00 01 00 02 06 01
				15 00 00 00 01 00 02 07 A0
				15 00 00 00 01 00 02 08 01
				15 00 00 00 01 00 02 09 B0
				15 00 00 00 01 00 02 0A 01
				15 00 00 00 01 00 02 0B CE
				15 00 00 00 01 00 02 0C 01
				15 00 00 00 01 00 02 0D EA
				15 00 00 00 01 00 02 0E 02
				15 00 00 00 01 00 02 0F 0F
				15 00 00 00 01 00 02 10 02
				15 00 00 00 01 00 02 11 34
				15 00 00 00 01 00 02 12 02
				15 00 00 00 01 00 02 13 35
				15 00 00 00 01 00 02 14 02
				15 00 00 00 01 00 02 15 62
				15 00 00 00 01 00 02 16 02
				15 00 00 00 01 00 02 17 9E
				15 00 00 00 01 00 02 18 02
				15 00 00 00 01 00 02 19 C6
				15 00 00 00 01 00 02 1A 02
				15 00 00 00 01 00 02 1B FA
				15 00 00 00 01 00 02 1C 03
				15 00 00 00 01 00 02 1D 16
				15 00 00 00 01 00 02 1E 03
				15 00 00 00 01 00 02 1F 48
				15 00 00 00 01 00 02 20 03
				15 00 00 00 01 00 02 21 57
				15 00 00 00 01 00 02 22 03
				15 00 00 00 01 00 02 23 68
				15 00 00 00 01 00 02 24 03
				15 00 00 00 01 00 02 25 7B
				15 00 00 00 01 00 02 26 03
				15 00 00 00 01 00 02 27 91
				15 00 00 00 01 00 02 28 03
				15 00 00 00 01 00 02 29 A9
				15 00 00 00 01 00 02 2A 03
				15 00 00 00 01 00 02 2B BF
				15 00 00 00 01 00 02 2D 03
				15 00 00 00 01 00 02 2F CC
				15 00 00 00 01 00 02 30 03
				15 00 00 00 01 00 02 31 FF
				15 00 00 00 01 00 02 32 01
				15 00 00 00 01 00 02 33 6A
				15 00 00 00 01 00 02 34 01
				15 00 00 00 01 00 02 35 6D
				15 00 00 00 01 00 02 36 01
				15 00 00 00 01 00 02 37 72
				15 00 00 00 01 00 02 38 01
				15 00 00 00 01 00 02 39 77
				15 00 00 00 01 00 02 3A 01
				15 00 00 00 01 00 02 3B 7C
				15 00 00 00 01 00 02 3D 01
				15 00 00 00 01 00 02 3F 81
				15 00 00 00 01 00 02 40 01
				15 00 00 00 01 00 02 41 86
				15 00 00 00 01 00 02 42 01
				15 00 00 00 01 00 02 43 8A
				15 00 00 00 01 00 02 44 01
				15 00 00 00 01 00 02 45 8F
				15 00 00 00 01 00 02 46 01
				15 00 00 00 01 00 02 47 A0
				15 00 00 00 01 00 02 48 01
				15 00 00 00 01 00 02 49 B0
				15 00 00 00 01 00 02 4A 01
				15 00 00 00 01 00 02 4B CE
				15 00 00 00 01 00 02 4C 01
				15 00 00 00 01 00 02 4D EA
				15 00 00 00 01 00 02 4E 02
				15 00 00 00 01 00 02 4F 0F
				15 00 00 00 01 00 02 50 02
				15 00 00 00 01 00 02 51 34
				15 00 00 00 01 00 02 52 02
				15 00 00 00 01 00 02 53 35
				15 00 00 00 01 00 02 54 02
				15 00 00 00 01 00 02 55 62
				15 00 00 00 01 00 02 56 02
				15 00 00 00 01 00 02 58 9E
				15 00 00 00 01 00 02 59 02
				15 00 00 00 01 00 02 5A C6
				15 00 00 00 01 00 02 5B 02
				15 00 00 00 01 00 02 5C FA
				15 00 00 00 01 00 02 5D 03
				15 00 00 00 01 00 02 5E 16
				15 00 00 00 01 00 02 5F 03
				15 00 00 00 01 00 02 60 48
				15 00 00 00 01 00 02 61 03
				15 00 00 00 01 00 02 62 57
				15 00 00 00 01 00 02 63 03
				15 00 00 00 01 00 02 64 68
				15 00 00 00 01 00 02 65 03
				15 00 00 00 01 00 02 66 7B
				15 00 00 00 01 00 02 67 03
				15 00 00 00 01 00 02 68 91
				15 00 00 00 01 00 02 69 03
				15 00 00 00 01 00 02 6A A9
				15 00 00 00 01 00 02 6B 03
				15 00 00 00 01 00 02 6C BF
				15 00 00 00 01 00 02 6D 03
				15 00 00 00 01 00 02 6E CC
				15 00 00 00 01 00 02 6F 03
				15 00 00 00 01 00 02 70 FF
				15 00 00 00 01 00 02 71 02
				15 00 00 00 01 00 02 72 15
				15 00 00 00 01 00 02 73 02
				15 00 00 00 01 00 02 74 16
				15 00 00 00 01 00 02 75 02
				15 00 00 00 01 00 02 76 17
				15 00 00 00 01 00 02 77 02
				15 00 00 00 01 00 02 78 18
				15 00 00 00 01 00 02 79 02
				15 00 00 00 01 00 02 7A 1A
				15 00 00 00 01 00 02 7B 02
				15 00 00 00 01 00 02 7C 1B
				15 00 00 00 01 00 02 7D 02
				15 00 00 00 01 00 02 7E 1C
				15 00 00 00 01 00 02 7F 02
				15 00 00 00 01 00 02 80 1E
				15 00 00 00 01 00 02 81 02
				15 00 00 00 01 00 02 82 1F
				15 00 00 00 01 00 02 83 02
				15 00 00 00 01 00 02 84 25
				15 00 00 00 01 00 02 85 02
				15 00 00 00 01 00 02 86 2B
				15 00 00 00 01 00 02 87 02
				15 00 00 00 01 00 02 88 37
				15 00 00 00 01 00 02 89 02
				15 00 00 00 01 00 02 8A 43
				15 00 00 00 01 00 02 8B 02
				15 00 00 00 01 00 02 8C 5F
				15 00 00 00 01 00 02 8D 02
				15 00 00 00 01 00 02 8E 7F
				15 00 00 00 01 00 02 8F 02
				15 00 00 00 01 00 02 90 80
				15 00 00 00 01 00 02 91 02
				15 00 00 00 01 00 02 92 A9
				15 00 00 00 01 00 02 93 02
				15 00 00 00 01 00 02 94 E0
				15 00 00 00 01 00 02 95 03
				15 00 00 00 01 00 02 96 03
				15 00 00 00 01 00 02 97 03
				15 00 00 00 01 00 02 98 35
				15 00 00 00 01 00 02 99 03
				15 00 00 00 01 00 02 9A 5D
				15 00 00 00 01 00 02 9B 03
				15 00 00 00 01 00 02 9C 89
				15 00 00 00 01 00 02 9D 03
				15 00 00 00 01 00 02 9E 93
				15 00 00 00 01 00 02 9F 03
				15 00 00 00 01 00 02 A0 9D
				15 00 00 00 01 00 02 A2 03
				15 00 00 00 01 00 02 A3 A5
				15 00 00 00 01 00 02 A4 03
				15 00 00 00 01 00 02 A5 AC
				15 00 00 00 01 00 02 A6 03
				15 00 00 00 01 00 02 A7 B1
				15 00 00 00 01 00 02 A9 03
				15 00 00 00 01 00 02 AA B5
				15 00 00 00 01 00 02 AB 03
				15 00 00 00 01 00 02 AC B6
				15 00 00 00 01 00 02 AD 03
				15 00 00 00 01 00 02 AE FF
				15 00 00 00 01 00 02 AF 02
				15 00 00 00 01 00 02 B0 15
				15 00 00 00 01 00 02 B1 02
				15 00 00 00 01 00 02 B2 16
				15 00 00 00 01 00 02 B3 02
				15 00 00 00 01 00 02 B4 17
				15 00 00 00 01 00 02 B5 02
				15 00 00 00 01 00 02 B6 18
				15 00 00 00 01 00 02 B7 02
				15 00 00 00 01 00 02 B8 1A
				15 00 00 00 01 00 02 B9 02
				15 00 00 00 01 00 02 BA 1B
				15 00 00 00 01 00 02 BB 02
				15 00 00 00 01 00 02 BC 1C
				15 00 00 00 01 00 02 BD 02
				15 00 00 00 01 00 02 BE 1E
				15 00 00 00 01 00 02 BF 02
				15 00 00 00 01 00 02 C0 1F
				15 00 00 00 01 00 02 C1 02
				15 00 00 00 01 00 02 C2 25
				15 00 00 00 01 00 02 C3 02
				15 00 00 00 01 00 02 C4 2B
				15 00 00 00 01 00 02 C5 02
				15 00 00 00 01 00 02 C6 37
				15 00 00 00 01 00 02 C7 02
				15 00 00 00 01 00 02 C8 43
				15 00 00 00 01 00 02 C9 02
				15 00 00 00 01 00 02 CA 5F
				15 00 00 00 01 00 02 CB 02
				15 00 00 00 01 00 02 CC 7F
				15 00 00 00 01 00 02 CD 02
				15 00 00 00 01 00 02 CE 80
				15 00 00 00 01 00 02 CF 02
				15 00 00 00 01 00 02 D0 A9
				15 00 00 00 01 00 02 D1 02
				15 00 00 00 01 00 02 D2 E0
				15 00 00 00 01 00 02 D3 03
				15 00 00 00 01 00 02 D4 03
				15 00 00 00 01 00 02 D5 03
				15 00 00 00 01 00 02 D6 35
				15 00 00 00 01 00 02 D7 03
				15 00 00 00 01 00 02 D8 5D
				15 00 00 00 01 00 02 D9 03
				15 00 00 00 01 00 02 DA 89
				15 00 00 00 01 00 02 DB 03
				15 00 00 00 01 00 02 DC 93
				15 00 00 00 01 00 02 DD 03
				15 00 00 00 01 00 02 DE 9D
				15 00 00 00 01 00 02 DF 03
				15 00 00 00 01 00 02 E0 A5
				15 00 00 00 01 00 02 E1 03
				15 00 00 00 01 00 02 E2 AC
				15 00 00 00 01 00 02 E3 03
				15 00 00 00 01 00 02 E4 B1
				15 00 00 00 01 00 02 E5 03
				15 00 00 00 01 00 02 E6 B5
				15 00 00 00 01 00 02 E7 03
				15 00 00 00 01 00 02 E8 B6
				15 00 00 00 01 00 02 E9 03
				15 00 00 00 01 00 02 EA FF
				15 00 00 00 01 00 02 FB 01
				15 01 00 00 01 00 02 FF 10
				];
		qcom,mdss-dsi-dispparam-papermode-state = "dsi_hs_mode";
		qcom,mdss-dsi-dispparam-papermode1-command = [
				15 01 00 00 78 00 02 FF 20
				15 00 00 00 01 00 02 FB 01
				15 00 00 00 01 00 02 75 00
				15 00 00 00 01 00 02 76 DF
				15 00 00 00 01 00 02 77 00
				15 00 00 00 01 00 02 78 E0
				15 00 00 00 01 00 02 79 00
				15 00 00 00 01 00 02 7A ED
				15 00 00 00 01 00 02 7B 00
				15 00 00 00 01 00 02 7C F8
				15 00 00 00 01 00 02 7D 01
				15 00 00 00 01 00 02 7E 03
				15 00 00 00 01 00 02 7F 01
				15 00 00 00 01 00 02 80 0D
				15 00 00 00 01 00 02 81 01
				15 00 00 00 01 00 02 82 17
				15 00 00 00 01 00 02 83 01
				15 00 00 00 01 00 02 84 20
				15 00 00 00 01 00 02 85 01
				15 00 00 00 01 00 02 86 29
				15 00 00 00 01 00 02 87 01
				15 00 00 00 01 00 02 88 49
				15 00 00 00 01 00 02 89 01
				15 00 00 00 01 00 02 8A 65
				15 00 00 00 01 00 02 8B 01
				15 00 00 00 01 00 02 8C 92
				15 00 00 00 01 00 02 8D 01
				15 00 00 00 01 00 02 8E B8
				15 00 00 00 01 00 02 8F 01
				15 00 00 00 01 00 02 90 F6
				15 00 00 00 01 00 02 91 02
				15 00 00 00 01 00 02 92 1D
				15 00 00 00 01 00 02 93 02
				15 00 00 00 01 00 02 94 1F
				15 00 00 00 01 00 02 95 02
				15 00 00 00 01 00 02 96 4D
				15 00 00 00 01 00 02 97 02
				15 00 00 00 01 00 02 98 8A
				15 00 00 00 01 00 02 99 02
				15 00 00 00 01 00 02 9A B3
				15 00 00 00 01 00 02 9B 02
				15 00 00 00 01 00 02 9C EB
				15 00 00 00 01 00 02 9D 03
				15 00 00 00 01 00 02 9E 0C
				15 00 00 00 01 00 02 9F 03
				15 00 00 00 01 00 02 A0 3E
				15 00 00 00 01 00 02 A2 03
				15 00 00 00 01 00 02 A3 51
				15 00 00 00 01 00 02 A4 03
				15 00 00 00 01 00 02 A5 65
				15 00 00 00 01 00 02 A6 03
				15 00 00 00 01 00 02 A7 7A
				15 00 00 00 01 00 02 A9 03
				15 00 00 00 01 00 02 AA 90
				15 00 00 00 01 00 02 AB 03
				15 00 00 00 01 00 02 AC A3
				15 00 00 00 01 00 02 AD 03
				15 00 00 00 01 00 02 AE B0
				15 00 00 00 01 00 02 AF 03
				15 00 00 00 01 00 02 B0 B6
				15 00 00 00 01 00 02 B1 03
				15 00 00 00 01 00 02 B2 FF
				15 00 00 00 01 00 02 B3 00
				15 00 00 00 01 00 02 B4 DF
				15 00 00 00 01 00 02 B5 00
				15 00 00 00 01 00 02 B6 E0
				15 00 00 00 01 00 02 B7 00
				15 00 00 00 01 00 02 B8 ED
				15 00 00 00 01 00 02 B9 00
				15 00 00 00 01 00 02 BA F8
				15 00 00 00 01 00 02 BB 01
				15 00 00 00 01 00 02 BC 03
				15 00 00 00 01 00 02 BD 01
				15 00 00 00 01 00 02 BE 0D
				15 00 00 00 01 00 02 BF 01
				15 00 00 00 01 00 02 C0 17
				15 00 00 00 01 00 02 C1 01
				15 00 00 00 01 00 02 C2 20
				15 00 00 00 01 00 02 C3 01
				15 00 00 00 01 00 02 C4 29
				15 00 00 00 01 00 02 C5 01
				15 00 00 00 01 00 02 C6 49
				15 00 00 00 01 00 02 C7 01
				15 00 00 00 01 00 02 C8 65
				15 00 00 00 01 00 02 C9 01
				15 00 00 00 01 00 02 CA 92
				15 00 00 00 01 00 02 CB 01
				15 00 00 00 01 00 02 CC B8
				15 00 00 00 01 00 02 CD 01
				15 00 00 00 01 00 02 CE F6
				15 00 00 00 01 00 02 CF 02
				15 00 00 00 01 00 02 D0 1D
				15 00 00 00 01 00 02 D1 02
				15 00 00 00 01 00 02 D2 1F
				15 00 00 00 01 00 02 D3 02
				15 00 00 00 01 00 02 D4 4D
				15 00 00 00 01 00 02 D5 02
				15 00 00 00 01 00 02 D6 8A
				15 00 00 00 01 00 02 D7 02
				15 00 00 00 01 00 02 D8 B3
				15 00 00 00 01 00 02 D9 02
				15 00 00 00 01 00 02 DA EB
				15 00 00 00 01 00 02 DB 03
				15 00 00 00 01 00 02 DC 0C
				15 00 00 00 01 00 02 DD 03
				15 00 00 00 01 00 02 DE 3E
				15 00 00 00 01 00 02 DF 03
				15 00 00 00 01 00 02 E0 51
				15 00 00 00 01 00 02 E1 03
				15 00 00 00 01 00 02 E2 65
				15 00 00 00 01 00 02 E3 03
				15 00 00 00 01 00 02 E4 7A
				15 00 00 00 01 00 02 E5 03
				15 00 00 00 01 00 02 E6 90
				15 00 00 00 01 00 02 E7 03
				15 00 00 00 01 00 02 E8 A3
				15 00 00 00 01 00 02 E9 03
				15 00 00 00 01 00 02 EA B0
				15 00 00 00 01 00 02 EB 03
				15 00 00 00 01 00 02 EC B6
				15 00 00 00 01 00 02 ED 03
				15 00 00 00 01 00 02 EE FF
				15 00 00 00 01 00 02 EF 00
				15 00 00 00 01 00 02 F0 DF
				15 00 00 00 01 00 02 F1 00
				15 00 00 00 01 00 02 F2 E0
				15 00 00 00 01 00 02 F3 00
				15 00 00 00 01 00 02 F4 ED
				15 00 00 00 01 00 02 F5 00
				15 00 00 00 01 00 02 F6 F9
				15 00 00 00 01 00 02 F7 01
				15 00 00 00 01 00 02 F8 03
				15 00 00 00 01 00 02 F9 01
				15 00 00 00 01 00 02 FA 0E
				15 00 00 00 01 00 02 FF 21
				15 00 00 00 01 00 02 FB 01
				15 00 00 00 01 00 02 00 01
				15 00 00 00 01 00 02 01 17
				15 00 00 00 01 00 02 02 01
				15 00 00 00 01 00 02 03 21
				15 00 00 00 01 00 02 04 01
				15 00 00 00 01 00 02 05 2A
				15 00 00 00 01 00 02 06 01
				15 00 00 00 01 00 02 07 4A
				15 00 00 00 01 00 02 08 01
				15 00 00 00 01 00 02 09 65
				15 00 00 00 01 00 02 0A 01
				15 00 00 00 01 00 02 0B 92
				15 00 00 00 01 00 02 0C 01
				15 00 00 00 01 00 02 0D B8
				15 00 00 00 01 00 02 0E 01
				15 00 00 00 01 00 02 0F F7
				15 00 00 00 01 00 02 10 02
				15 00 00 00 01 00 02 11 1E
				15 00 00 00 01 00 02 12 02
				15 00 00 00 01 00 02 13 1F
				15 00 00 00 01 00 02 14 02
				15 00 00 00 01 00 02 15 4E
				15 00 00 00 01 00 02 16 02
				15 00 00 00 01 00 02 17 8A
				15 00 00 00 01 00 02 18 02
				15 00 00 00 01 00 02 19 B4
				15 00 00 00 01 00 02 1A 02
				15 00 00 00 01 00 02 1B EA
				15 00 00 00 01 00 02 1C 03
				15 00 00 00 01 00 02 1D 0A
				15 00 00 00 01 00 02 1E 03
				15 00 00 00 01 00 02 1F 39
				15 00 00 00 01 00 02 20 03
				15 00 00 00 01 00 02 21 49
				15 00 00 00 01 00 02 22 03
				15 00 00 00 01 00 02 23 5B
				15 00 00 00 01 00 02 24 03
				15 00 00 00 01 00 02 25 6E
				15 00 00 00 01 00 02 26 03
				15 00 00 00 01 00 02 27 85
				15 00 00 00 01 00 02 28 03
				15 00 00 00 01 00 02 29 A0
				15 00 00 00 01 00 02 2A 03
				15 00 00 00 01 00 02 2B BA
				15 00 00 00 01 00 02 2D 03
				15 00 00 00 01 00 02 2F CB
				15 00 00 00 01 00 02 30 03
				15 00 00 00 01 00 02 31 FF
				15 00 00 00 01 00 02 32 00
				15 00 00 00 01 00 02 33 DF
				15 00 00 00 01 00 02 34 00
				15 00 00 00 01 00 02 35 E0
				15 00 00 00 01 00 02 36 00
				15 00 00 00 01 00 02 37 ED
				15 00 00 00 01 00 02 38 00
				15 00 00 00 01 00 02 39 F9
				15 00 00 00 01 00 02 3A 01
				15 00 00 00 01 00 02 3B 03
				15 00 00 00 01 00 02 3D 01
				15 00 00 00 01 00 02 3F 0E
				15 00 00 00 01 00 02 40 01
				15 00 00 00 01 00 02 41 17
				15 00 00 00 01 00 02 42 01
				15 00 00 00 01 00 02 43 21
				15 00 00 00 01 00 02 44 01
				15 00 00 00 01 00 02 45 2A
				15 00 00 00 01 00 02 46 01
				15 00 00 00 01 00 02 47 4A
				15 00 00 00 01 00 02 48 01
				15 00 00 00 01 00 02 49 65
				15 00 00 00 01 00 02 4A 01
				15 00 00 00 01 00 02 4B 92
				15 00 00 00 01 00 02 4C 01
				15 00 00 00 01 00 02 4D B8
				15 00 00 00 01 00 02 4E 01
				15 00 00 00 01 00 02 4F F7
				15 00 00 00 01 00 02 50 02
				15 00 00 00 01 00 02 51 1E
				15 00 00 00 01 00 02 52 02
				15 00 00 00 01 00 02 53 1F
				15 00 00 00 01 00 02 54 02
				15 00 00 00 01 00 02 55 4E
				15 00 00 00 01 00 02 56 02
				15 00 00 00 01 00 02 58 8A
				15 00 00 00 01 00 02 59 02
				15 00 00 00 01 00 02 5A B4
				15 00 00 00 01 00 02 5B 02
				15 00 00 00 01 00 02 5C EA
				15 00 00 00 01 00 02 5D 03
				15 00 00 00 01 00 02 5E 0A
				15 00 00 00 01 00 02 5F 03
				15 00 00 00 01 00 02 60 39
				15 00 00 00 01 00 02 61 03
				15 00 00 00 01 00 02 62 49
				15 00 00 00 01 00 02 63 03
				15 00 00 00 01 00 02 64 5B
				15 00 00 00 01 00 02 65 03
				15 00 00 00 01 00 02 66 6E
				15 00 00 00 01 00 02 67 03
				15 00 00 00 01 00 02 68 85
				15 00 00 00 01 00 02 69 03
				15 00 00 00 01 00 02 6A A0
				15 00 00 00 01 00 02 6B 03
				15 00 00 00 01 00 02 6C BA
				15 00 00 00 01 00 02 6D 03
				15 00 00 00 01 00 02 6E CB
				15 00 00 00 01 00 02 6F 03
				15 00 00 00 01 00 02 70 FF
				15 00 00 00 01 00 02 71 01
				15 00 00 00 01 00 02 72 4E
				15 00 00 00 01 00 02 73 01
				15 00 00 00 01 00 02 74 4F
				15 00 00 00 01 00 02 75 01
				15 00 00 00 01 00 02 76 50
				15 00 00 00 01 00 02 77 01
				15 00 00 00 01 00 02 78 53
				15 00 00 00 01 00 02 79 01
				15 00 00 00 01 00 02 7A 59
				15 00 00 00 01 00 02 7B 01
				15 00 00 00 01 00 02 7C 5F
				15 00 00 00 01 00 02 7D 01
				15 00 00 00 01 00 02 7E 65
				15 00 00 00 01 00 02 7F 01
				15 00 00 00 01 00 02 80 6B
				15 00 00 00 01 00 02 81 01
				15 00 00 00 01 00 02 82 70
				15 00 00 00 01 00 02 83 01
				15 00 00 00 01 00 02 84 85
				15 00 00 00 01 00 02 85 01
				15 00 00 00 01 00 02 86 98
				15 00 00 00 01 00 02 87 01
				15 00 00 00 01 00 02 88 BA
				15 00 00 00 01 00 02 89 01
				15 00 00 00 01 00 02 8A D9
				15 00 00 00 01 00 02 8B 02
				15 00 00 00 01 00 02 8C 06
				15 00 00 00 01 00 02 8D 02
				15 00 00 00 01 00 02 8E 2B
				15 00 00 00 01 00 02 8F 02
				15 00 00 00 01 00 02 90 2D
				15 00 00 00 01 00 02 91 02
				15 00 00 00 01 00 02 92 5A
				15 00 00 00 01 00 02 93 02
				15 00 00 00 01 00 02 94 95
				15 00 00 00 01 00 02 95 02
				15 00 00 00 01 00 02 96 BD
				15 00 00 00 01 00 02 97 02
				15 00 00 00 01 00 02 98 F4
				15 00 00 00 01 00 02 99 03
				15 00 00 00 01 00 02 9A 13
				15 00 00 00 01 00 02 9B 03
				15 00 00 00 01 00 02 9C 4D
				15 00 00 00 01 00 02 9D 03
				15 00 00 00 01 00 02 9E 5F
				15 00 00 00 01 00 02 9F 03
				15 00 00 00 01 00 02 A0 72
				15 00 00 00 01 00 02 A2 03
				15 00 00 00 01 00 02 A3 85
				15 00 00 00 01 00 02 A4 03
				15 00 00 00 01 00 02 A5 97
				15 00 00 00 01 00 02 A6 03
				15 00 00 00 01 00 02 A7 A6
				15 00 00 00 01 00 02 A9 03
				15 00 00 00 01 00 02 AA B1
				15 00 00 00 01 00 02 AB 03
				15 00 00 00 01 00 02 AC B6
				15 00 00 00 01 00 02 AD 03
				15 00 00 00 01 00 02 AE FF
				15 00 00 00 01 00 02 AF 01
				15 00 00 00 01 00 02 B0 4E
				15 00 00 00 01 00 02 B1 01
				15 00 00 00 01 00 02 B2 4F
				15 00 00 00 01 00 02 B3 01
				15 00 00 00 01 00 02 B4 50
				15 00 00 00 01 00 02 B5 01
				15 00 00 00 01 00 02 B6 53
				15 00 00 00 01 00 02 B7 01
				15 00 00 00 01 00 02 B8 59
				15 00 00 00 01 00 02 B9 01
				15 00 00 00 01 00 02 BA 5F
				15 00 00 00 01 00 02 BB 01
				15 00 00 00 01 00 02 BC 65
				15 00 00 00 01 00 02 BD 01
				15 00 00 00 01 00 02 BE 6B
				15 00 00 00 01 00 02 BF 01
				15 00 00 00 01 00 02 C0 70
				15 00 00 00 01 00 02 C1 01
				15 00 00 00 01 00 02 C2 85
				15 00 00 00 01 00 02 C3 01
				15 00 00 00 01 00 02 C4 98
				15 00 00 00 01 00 02 C5 01
				15 00 00 00 01 00 02 C6 BA
				15 00 00 00 01 00 02 C7 01
				15 00 00 00 01 00 02 C8 D9
				15 00 00 00 01 00 02 C9 02
				15 00 00 00 01 00 02 CA 06
				15 00 00 00 01 00 02 CB 02
				15 00 00 00 01 00 02 CC 2B
				15 00 00 00 01 00 02 CD 02
				15 00 00 00 01 00 02 CE 2D
				15 00 00 00 01 00 02 CF 02
				15 00 00 00 01 00 02 D0 5A
				15 00 00 00 01 00 02 D1 02
				15 00 00 00 01 00 02 D2 95
				15 00 00 00 01 00 02 D3 02
				15 00 00 00 01 00 02 D4 BD
				15 00 00 00 01 00 02 D5 02
				15 00 00 00 01 00 02 D6 F4
				15 00 00 00 01 00 02 D7 03
				15 00 00 00 01 00 02 D8 13
				15 00 00 00 01 00 02 D9 03
				15 00 00 00 01 00 02 DA 4D
				15 00 00 00 01 00 02 DB 03
				15 00 00 00 01 00 02 DC 5F
				15 00 00 00 01 00 02 DD 03
				15 00 00 00 01 00 02 DE 72
				15 00 00 00 01 00 02 DF 03
				15 00 00 00 01 00 02 E0 85
				15 00 00 00 01 00 02 E1 03
				15 00 00 00 01 00 02 E2 97
				15 00 00 00 01 00 02 E3 03
				15 00 00 00 01 00 02 E4 A6
				15 00 00 00 01 00 02 E5 03
				15 00 00 00 01 00 02 E6 B1
				15 00 00 00 01 00 02 E7 03
				15 00 00 00 01 00 02 E8 B6
				15 00 00 00 01 00 02 E9 03
				15 00 00 00 01 00 02 EA FF
				15 00 00 00 01 00 02 FB 01
				15 01 00 00 01 00 02 FF 10
				];
		qcom,mdss-dsi-dispparam-papermode1-state = "dsi_hs_mode";
		qcom,mdss-dsi-dispparam-papermode2-command = [
				15 01 00 00 78 00 02 FF 20
				15 00 00 00 01 00 02 FB 01
				15 00 00 00 01 00 02 75 01
				15 00 00 00 01 00 02 76 13
				15 00 00 00 01 00 02 77 01
				15 00 00 00 01 00 02 78 18
				15 00 00 00 01 00 02 79 01
				15 00 00 00 01 00 02 7A 21
				15 00 00 00 01 00 02 7B 01
				15 00 00 00 01 00 02 7C 29
				15 00 00 00 01 00 02 7D 01
				15 00 00 00 01 00 02 7E 31
				15 00 00 00 01 00 02 7F 01
				15 00 00 00 01 00 02 80 39
				15 00 00 00 01 00 02 81 01
				15 00 00 00 01 00 02 82 41
				15 00 00 00 01 00 02 83 01
				15 00 00 00 01 00 02 84 48
				15 00 00 00 01 00 02 85 01
				15 00 00 00 01 00 02 86 4F
				15 00 00 00 01 00 02 87 01
				15 00 00 00 01 00 02 88 68
				15 00 00 00 01 00 02 89 01
				15 00 00 00 01 00 02 8A 7F
				15 00 00 00 01 00 02 8B 01
				15 00 00 00 01 00 02 8C A6
				15 00 00 00 01 00 02 8D 01
				15 00 00 00 01 00 02 8E C8
				15 00 00 00 01 00 02 8F 01
				15 00 00 00 01 00 02 90 FE
				15 00 00 00 01 00 02 91 02
				15 00 00 00 01 00 02 92 24
				15 00 00 00 01 00 02 93 02
				15 00 00 00 01 00 02 94 25
				15 00 00 00 01 00 02 95 02
				15 00 00 00 01 00 02 96 53
				15 00 00 00 01 00 02 97 02
				15 00 00 00 01 00 02 98 8F
				15 00 00 00 01 00 02 99 02
				15 00 00 00 01 00 02 9A B9
				15 00 00 00 01 00 02 9B 02
				15 00 00 00 01 00 02 9C F0
				15 00 00 00 01 00 02 9D 03
				15 00 00 00 01 00 02 9E 10
				15 00 00 00 01 00 02 9F 03
				15 00 00 00 01 00 02 A0 44
				15 00 00 00 01 00 02 A2 03
				15 00 00 00 01 00 02 A3 56
				15 00 00 00 01 00 02 A4 03
				15 00 00 00 01 00 02 A5 69
				15 00 00 00 01 00 02 A6 03
				15 00 00 00 01 00 02 A7 7E
				15 00 00 00 01 00 02 A9 03
				15 00 00 00 01 00 02 AA 93
				15 00 00 00 01 00 02 AB 03
				15 00 00 00 01 00 02 AC A4
				15 00 00 00 01 00 02 AD 03
				15 00 00 00 01 00 02 AE B0
				15 00 00 00 01 00 02 AF 03
				15 00 00 00 01 00 02 B0 B6
				15 00 00 00 01 00 02 B1 03
				15 00 00 00 01 00 02 B2 FF
				15 00 00 00 01 00 02 B3 01
				15 00 00 00 01 00 02 B4 13
				15 00 00 00 01 00 02 B5 01
				15 00 00 00 01 00 02 B6 18
				15 00 00 00 01 00 02 B7 01
				15 00 00 00 01 00 02 B8 21
				15 00 00 00 01 00 02 B9 01
				15 00 00 00 01 00 02 BA 29
				15 00 00 00 01 00 02 BB 01
				15 00 00 00 01 00 02 BC 31
				15 00 00 00 01 00 02 BD 01
				15 00 00 00 01 00 02 BE 39
				15 00 00 00 01 00 02 BF 01
				15 00 00 00 01 00 02 C0 41
				15 00 00 00 01 00 02 C1 01
				15 00 00 00 01 00 02 C2 48
				15 00 00 00 01 00 02 C3 01
				15 00 00 00 01 00 02 C4 4F
				15 00 00 00 01 00 02 C5 01
				15 00 00 00 01 00 02 C6 68
				15 00 00 00 01 00 02 C7 01
				15 00 00 00 01 00 02 C8 7F
				15 00 00 00 01 00 02 C9 01
				15 00 00 00 01 00 02 CA A6
				15 00 00 00 01 00 02 CB 01
				15 00 00 00 01 00 02 CC C8
				15 00 00 00 01 00 02 CD 01
				15 00 00 00 01 00 02 CE FE
				15 00 00 00 01 00 02 CF 02
				15 00 00 00 01 00 02 D0 24
				15 00 00 00 01 00 02 D1 02
				15 00 00 00 01 00 02 D2 25
				15 00 00 00 01 00 02 D3 02
				15 00 00 00 01 00 02 D4 53
				15 00 00 00 01 00 02 D5 02
				15 00 00 00 01 00 02 D6 8F
				15 00 00 00 01 00 02 D7 02
				15 00 00 00 01 00 02 D8 B9
				15 00 00 00 01 00 02 D9 02
				15 00 00 00 01 00 02 DA F0
				15 00 00 00 01 00 02 DB 03
				15 00 00 00 01 00 02 DC 10
				15 00 00 00 01 00 02 DD 03
				15 00 00 00 01 00 02 DE 44
				15 00 00 00 01 00 02 DF 03
				15 00 00 00 01 00 02 E0 56
				15 00 00 00 01 00 02 E1 03
				15 00 00 00 01 00 02 E2 69
				15 00 00 00 01 00 02 E3 03
				15 00 00 00 01 00 02 E4 7E
				15 00 00 00 01 00 02 E5 03
				15 00 00 00 01 00 02 E6 93
				15 00 00 00 01 00 02 E7 03
				15 00 00 00 01 00 02 E8 A4
				15 00 00 00 01 00 02 E9 03
				15 00 00 00 01 00 02 EA B0
				15 00 00 00 01 00 02 EB 03
				15 00 00 00 01 00 02 EC B6
				15 00 00 00 01 00 02 ED 03
				15 00 00 00 01 00 02 EE FF
				15 00 00 00 01 00 02 EF 01
				15 00 00 00 01 00 02 F0 13
				15 00 00 00 01 00 02 F1 01
				15 00 00 00 01 00 02 F2 18
				15 00 00 00 01 00 02 F3 01
				15 00 00 00 01 00 02 F4 21
				15 00 00 00 01 00 02 F5 01
				15 00 00 00 01 00 02 F6 29
				15 00 00 00 01 00 02 F7 01
				15 00 00 00 01 00 02 F8 31
				15 00 00 00 01 00 02 F9 01
				15 00 00 00 01 00 02 FA 39
				15 00 00 00 01 00 02 FF 21
				15 00 00 00 01 00 02 FB 01
				15 00 00 00 01 00 02 00 01
				15 00 00 00 01 00 02 01 41
				15 00 00 00 01 00 02 02 01
				15 00 00 00 01 00 02 03 48
				15 00 00 00 01 00 02 04 01
				15 00 00 00 01 00 02 05 4F
				15 00 00 00 01 00 02 06 01
				15 00 00 00 01 00 02 07 69
				15 00 00 00 01 00 02 08 01
				15 00 00 00 01 00 02 09 7F
				15 00 00 00 01 00 02 0A 01
				15 00 00 00 01 00 02 0B A6
				15 00 00 00 01 00 02 0C 01
				15 00 00 00 01 00 02 0D C8
				15 00 00 00 01 00 02 0E 01
				15 00 00 00 01 00 02 0F FE
				15 00 00 00 01 00 02 10 02
				15 00 00 00 01 00 02 11 24
				15 00 00 00 01 00 02 12 02
				15 00 00 00 01 00 02 13 26
				15 00 00 00 01 00 02 14 02
				15 00 00 00 01 00 02 15 54
				15 00 00 00 01 00 02 16 02
				15 00 00 00 01 00 02 17 90
				15 00 00 00 01 00 02 18 02
				15 00 00 00 01 00 02 19 B9
				15 00 00 00 01 00 02 1A 02
				15 00 00 00 01 00 02 1B EF
				15 00 00 00 01 00 02 1C 03
				15 00 00 00 01 00 02 1D 0E
				15 00 00 00 01 00 02 1E 03
				15 00 00 00 01 00 02 1F 3E
				15 00 00 00 01 00 02 20 03
				15 00 00 00 01 00 02 21 4D
				15 00 00 00 01 00 02 22 03
				15 00 00 00 01 00 02 23 5F
				15 00 00 00 01 00 02 24 03
				15 00 00 00 01 00 02 25 72
				15 00 00 00 01 00 02 26 03
				15 00 00 00 01 00 02 27 89
				15 00 00 00 01 00 02 28 03
				15 00 00 00 01 00 02 29 A2
				15 00 00 00 01 00 02 2A 03
				15 00 00 00 01 00 02 2B BC
				15 00 00 00 01 00 02 2D 03
				15 00 00 00 01 00 02 2F CB
				15 00 00 00 01 00 02 30 03
				15 00 00 00 01 00 02 31 FF
				15 00 00 00 01 00 02 32 01
				15 00 00 00 01 00 02 33 13
				15 00 00 00 01 00 02 34 01
				15 00 00 00 01 00 02 35 18
				15 00 00 00 01 00 02 36 01
				15 00 00 00 01 00 02 37 21
				15 00 00 00 01 00 02 38 01
				15 00 00 00 01 00 02 39 29
				15 00 00 00 01 00 02 3A 01
				15 00 00 00 01 00 02 3B 31
				15 00 00 00 01 00 02 3D 01
				15 00 00 00 01 00 02 3F 39
				15 00 00 00 01 00 02 40 01
				15 00 00 00 01 00 02 41 41
				15 00 00 00 01 00 02 42 01
				15 00 00 00 01 00 02 43 48
				15 00 00 00 01 00 02 44 01
				15 00 00 00 01 00 02 45 4F
				15 00 00 00 01 00 02 46 01
				15 00 00 00 01 00 02 47 69
				15 00 00 00 01 00 02 48 01
				15 00 00 00 01 00 02 49 7F
				15 00 00 00 01 00 02 4A 01
				15 00 00 00 01 00 02 4B A6
				15 00 00 00 01 00 02 4C 01
				15 00 00 00 01 00 02 4D C8
				15 00 00 00 01 00 02 4E 01
				15 00 00 00 01 00 02 4F FE
				15 00 00 00 01 00 02 50 02
				15 00 00 00 01 00 02 51 24
				15 00 00 00 01 00 02 52 02
				15 00 00 00 01 00 02 53 26
				15 00 00 00 01 00 02 54 02
				15 00 00 00 01 00 02 55 54
				15 00 00 00 01 00 02 56 02
				15 00 00 00 01 00 02 58 90
				15 00 00 00 01 00 02 59 02
				15 00 00 00 01 00 02 5A B9
				15 00 00 00 01 00 02 5B 02
				15 00 00 00 01 00 02 5C EF
				15 00 00 00 01 00 02 5D 03
				15 00 00 00 01 00 02 5E 0E
				15 00 00 00 01 00 02 5F 03
				15 00 00 00 01 00 02 60 3E
				15 00 00 00 01 00 02 61 03
				15 00 00 00 01 00 02 62 4D
				15 00 00 00 01 00 02 63 03
				15 00 00 00 01 00 02 64 5F
				15 00 00 00 01 00 02 65 03
				15 00 00 00 01 00 02 66 72
				15 00 00 00 01 00 02 67 03
				15 00 00 00 01 00 02 68 89
				15 00 00 00 01 00 02 69 03
				15 00 00 00 01 00 02 6A A2
				15 00 00 00 01 00 02 6B 03
				15 00 00 00 01 00 02 6C BC
				15 00 00 00 01 00 02 6D 03
				15 00 00 00 01 00 02 6E CB
				15 00 00 00 01 00 02 6F 03
				15 00 00 00 01 00 02 70 FF
				15 00 00 00 01 00 02 71 01
				15 00 00 00 01 00 02 72 83
				15 00 00 00 01 00 02 73 01
				15 00 00 00 01 00 02 74 85
				15 00 00 00 01 00 02 75 01
				15 00 00 00 01 00 02 76 8A
				15 00 00 00 01 00 02 77 01
				15 00 00 00 01 00 02 78 8E
				15 00 00 00 01 00 02 79 01
				15 00 00 00 01 00 02 7A 92
				15 00 00 00 01 00 02 7B 01
				15 00 00 00 01 00 02 7C 97
				15 00 00 00 01 00 02 7D 01
				15 00 00 00 01 00 02 7E 9B
				15 00 00 00 01 00 02 7F 01
				15 00 00 00 01 00 02 80 9F
				15 00 00 00 01 00 02 81 01
				15 00 00 00 01 00 02 82 A3
				15 00 00 00 01 00 02 83 01
				15 00 00 00 01 00 02 84 B2
				15 00 00 00 01 00 02 85 01
				15 00 00 00 01 00 02 86 C1
				15 00 00 00 01 00 02 87 01
				15 00 00 00 01 00 02 88 DC
				15 00 00 00 01 00 02 89 01
				15 00 00 00 01 00 02 8A F5
				15 00 00 00 01 00 02 8B 02
				15 00 00 00 01 00 02 8C 15
				15 00 00 00 01 00 02 8D 02
				15 00 00 00 01 00 02 8E 3A
				15 00 00 00 01 00 02 8F 02
				15 00 00 00 01 00 02 90 3B
				15 00 00 00 01 00 02 91 02
				15 00 00 00 01 00 02 92 67
				15 00 00 00 01 00 02 93 02
				15 00 00 00 01 00 02 94 A2
				15 00 00 00 01 00 02 95 02
				15 00 00 00 01 00 02 96 CA
				15 00 00 00 01 00 02 97 02
				15 00 00 00 01 00 02 98 FE
				15 00 00 00 01 00 02 99 03
				15 00 00 00 01 00 02 9A 1B
				15 00 00 00 01 00 02 9B 03
				15 00 00 00 01 00 02 9C 58
				15 00 00 00 01 00 02 9D 03
				15 00 00 00 01 00 02 9E 6A
				15 00 00 00 01 00 02 9F 03
				15 00 00 00 01 00 02 A0 7B
				15 00 00 00 01 00 02 A2 03
				15 00 00 00 01 00 02 A3 8C
				15 00 00 00 01 00 02 A4 03
				15 00 00 00 01 00 02 A5 9C
				15 00 00 00 01 00 02 A6 03
				15 00 00 00 01 00 02 A7 A9
				15 00 00 00 01 00 02 A9 03
				15 00 00 00 01 00 02 AA B2
				15 00 00 00 01 00 02 AB 03
				15 00 00 00 01 00 02 AC B6
				15 00 00 00 01 00 02 AD 03
				15 00 00 00 01 00 02 AE FF
				15 00 00 00 01 00 02 AF 01
				15 00 00 00 01 00 02 B0 83
				15 00 00 00 01 00 02 B1 01
				15 00 00 00 01 00 02 B2 85
				15 00 00 00 01 00 02 B3 01
				15 00 00 00 01 00 02 B4 8A
				15 00 00 00 01 00 02 B5 01
				15 00 00 00 01 00 02 B6 8E
				15 00 00 00 01 00 02 B7 01
				15 00 00 00 01 00 02 B8 92
				15 00 00 00 01 00 02 B9 01
				15 00 00 00 01 00 02 BA 97
				15 00 00 00 01 00 02 BB 01
				15 00 00 00 01 00 02 BC 9B
				15 00 00 00 01 00 02 BD 01
				15 00 00 00 01 00 02 BE 9F
				15 00 00 00 01 00 02 BF 01
				15 00 00 00 01 00 02 C0 A3
				15 00 00 00 01 00 02 C1 01
				15 00 00 00 01 00 02 C2 B2
				15 00 00 00 01 00 02 C3 01
				15 00 00 00 01 00 02 C4 C1
				15 00 00 00 01 00 02 C5 01
				15 00 00 00 01 00 02 C6 DC
				15 00 00 00 01 00 02 C7 01
				15 00 00 00 01 00 02 C8 F5
				15 00 00 00 01 00 02 C9 02
				15 00 00 00 01 00 02 CA 15
				15 00 00 00 01 00 02 CB 02
				15 00 00 00 01 00 02 CC 3A
				15 00 00 00 01 00 02 CD 02
				15 00 00 00 01 00 02 CE 3B
				15 00 00 00 01 00 02 CF 02
				15 00 00 00 01 00 02 D0 67
				15 00 00 00 01 00 02 D1 02
				15 00 00 00 01 00 02 D2 A2
				15 00 00 00 01 00 02 D3 02
				15 00 00 00 01 00 02 D4 CA
				15 00 00 00 01 00 02 D5 02
				15 00 00 00 01 00 02 D6 FE
				15 00 00 00 01 00 02 D7 03
				15 00 00 00 01 00 02 D8 1B
				15 00 00 00 01 00 02 D9 03
				15 00 00 00 01 00 02 DA 58
				15 00 00 00 01 00 02 DB 03
				15 00 00 00 01 00 02 DC 6A
				15 00 00 00 01 00 02 DD 03
				15 00 00 00 01 00 02 DE 7B
				15 00 00 00 01 00 02 DF 03
				15 00 00 00 01 00 02 E0 8C
				15 00 00 00 01 00 02 E1 03
				15 00 00 00 01 00 02 E2 9C
				15 00 00 00 01 00 02 E3 03
				15 00 00 00 01 00 02 E4 A9
				15 00 00 00 01 00 02 E5 03
				15 00 00 00 01 00 02 E6 B2
				15 00 00 00 01 00 02 E7 03
				15 00 00 00 01 00 02 E8 B6
				15 00 00 00 01 00 02 E9 03
				15 00 00 00 01 00 02 EA FF
				15 00 00 00 01 00 02 FB 01
				15 01 00 00 01 00 02 FF 10
				];
		qcom,mdss-dsi-dispparam-papermode2-state = "dsi_hs_mode";
		qcom,mdss-dsi-dispparam-papermode3-command = [
				15 01 00 00 78 00 02 FF 20
				15 00 00 00 01 00 02 FB 01
				15 00 00 00 01 00 02 75 01
				15 00 00 00 01 00 02 76 37
				15 00 00 00 01 00 02 77 01
				15 00 00 00 01 00 02 78 3B
				15 00 00 00 01 00 02 79 01
				15 00 00 00 01 00 02 7A 42
				15 00 00 00 01 00 02 7B 01
				15 00 00 00 01 00 02 7C 49
				15 00 00 00 01 00 02 7D 01
				15 00 00 00 01 00 02 7E 50
				15 00 00 00 01 00 02 7F 01
				15 00 00 00 01 00 02 80 56
				15 00 00 00 01 00 02 81 01
				15 00 00 00 01 00 02 82 5C
				15 00 00 00 01 00 02 83 01
				15 00 00 00 01 00 02 84 62
				15 00 00 00 01 00 02 85 01
				15 00 00 00 01 00 02 86 68
				15 00 00 00 01 00 02 87 01
				15 00 00 00 01 00 02 88 7E
				15 00 00 00 01 00 02 89 01
				15 00 00 00 01 00 02 8A 92
				15 00 00 00 01 00 02 8B 01
				15 00 00 00 01 00 02 8C B5
				15 00 00 00 01 00 02 8D 01
				15 00 00 00 01 00 02 8E D4
				15 00 00 00 01 00 02 8F 02
				15 00 00 00 01 00 02 90 04
				15 00 00 00 01 00 02 91 02
				15 00 00 00 01 00 02 92 2A
				15 00 00 00 01 00 02 93 02
				15 00 00 00 01 00 02 94 2B
				15 00 00 00 01 00 02 95 02
				15 00 00 00 01 00 02 96 58
				15 00 00 00 01 00 02 97 02
				15 00 00 00 01 00 02 98 94
				15 00 00 00 01 00 02 99 02
				15 00 00 00 01 00 02 9A BE
				15 00 00 00 01 00 02 9B 02
				15 00 00 00 01 00 02 9C F4
				15 00 00 00 01 00 02 9D 03
				15 00 00 00 01 00 02 9E 12
				15 00 00 00 01 00 02 9F 03
				15 00 00 00 01 00 02 A0 48
				15 00 00 00 01 00 02 A2 03
				15 00 00 00 01 00 02 A3 5A
				15 00 00 00 01 00 02 A4 03
				15 00 00 00 01 00 02 A5 6D
				15 00 00 00 01 00 02 A6 03
				15 00 00 00 01 00 02 A7 82
				15 00 00 00 01 00 02 A9 03
				15 00 00 00 01 00 02 AA 95
				15 00 00 00 01 00 02 AB 03
				15 00 00 00 01 00 02 AC A6
				15 00 00 00 01 00 02 AD 03
				15 00 00 00 01 00 02 AE B1
				15 00 00 00 01 00 02 AF 03
				15 00 00 00 01 00 02 B0 B6
				15 00 00 00 01 00 02 B1 03
				15 00 00 00 01 00 02 B2 FF
				15 00 00 00 01 00 02 B3 01
				15 00 00 00 01 00 02 B4 37
				15 00 00 00 01 00 02 B5 01
				15 00 00 00 01 00 02 B6 3B
				15 00 00 00 01 00 02 B7 01
				15 00 00 00 01 00 02 B8 42
				15 00 00 00 01 00 02 B9 01
				15 00 00 00 01 00 02 BA 49
				15 00 00 00 01 00 02 BB 01
				15 00 00 00 01 00 02 BC 50
				15 00 00 00 01 00 02 BD 01
				15 00 00 00 01 00 02 BE 56
				15 00 00 00 01 00 02 BF 01
				15 00 00 00 01 00 02 C0 5C
				15 00 00 00 01 00 02 C1 01
				15 00 00 00 01 00 02 C2 62
				15 00 00 00 01 00 02 C3 01
				15 00 00 00 01 00 02 C4 68
				15 00 00 00 01 00 02 C5 01
				15 00 00 00 01 00 02 C6 7E
				15 00 00 00 01 00 02 C7 01
				15 00 00 00 01 00 02 C8 92
				15 00 00 00 01 00 02 C9 01
				15 00 00 00 01 00 02 CA B5
				15 00 00 00 01 00 02 CB 01
				15 00 00 00 01 00 02 CC D4
				15 00 00 00 01 00 02 CD 02
				15 00 00 00 01 00 02 CE 04
				15 00 00 00 01 00 02 CF 02
				15 00 00 00 01 00 02 D0 2A
				15 00 00 00 01 00 02 D1 02
				15 00 00 00 01 00 02 D2 2B
				15 00 00 00 01 00 02 D3 02
				15 00 00 00 01 00 02 D4 58
				15 00 00 00 01 00 02 D5 02
				15 00 00 00 01 00 02 D6 94
				15 00 00 00 01 00 02 D7 02
				15 00 00 00 01 00 02 D8 BE
				15 00 00 00 01 00 02 D9 02
				15 00 00 00 01 00 02 DA F4
				15 00 00 00 01 00 02 DB 03
				15 00 00 00 01 00 02 DC 12
				15 00 00 00 01 00 02 DD 03
				15 00 00 00 01 00 02 DE 48
				15 00 00 00 01 00 02 DF 03
				15 00 00 00 01 00 02 E0 5A
				15 00 00 00 01 00 02 E1 03
				15 00 00 00 01 00 02 E2 6D
				15 00 00 00 01 00 02 E3 03
				15 00 00 00 01 00 02 E4 82
				15 00 00 00 01 00 02 E5 03
				15 00 00 00 01 00 02 E6 95
				15 00 00 00 01 00 02 E7 03
				15 00 00 00 01 00 02 E8 A6
				15 00 00 00 01 00 02 E9 03
				15 00 00 00 01 00 02 EA B1
				15 00 00 00 01 00 02 EB 03
				15 00 00 00 01 00 02 EC B6
				15 00 00 00 01 00 02 ED 03
				15 00 00 00 01 00 02 EE FF
				15 00 00 00 01 00 02 EF 01
				15 00 00 00 01 00 02 F0 37
				15 00 00 00 01 00 02 F1 01
				15 00 00 00 01 00 02 F2 3B
				15 00 00 00 01 00 02 F3 01
				15 00 00 00 01 00 02 F4 42
				15 00 00 00 01 00 02 F5 01
				15 00 00 00 01 00 02 F6 49
				15 00 00 00 01 00 02 F7 01
				15 00 00 00 01 00 02 F8 50
				15 00 00 00 01 00 02 F9 01
				15 00 00 00 01 00 02 FA 56
				15 00 00 00 01 00 02 FF 21
				15 00 00 00 01 00 02 FB 01
				15 00 00 00 01 00 02 00 01
				15 00 00 00 01 00 02 01 5C
				15 00 00 00 01 00 02 02 01
				15 00 00 00 01 00 02 03 63
				15 00 00 00 01 00 02 04 01
				15 00 00 00 01 00 02 05 68
				15 00 00 00 01 00 02 06 01
				15 00 00 00 01 00 02 07 7E
				15 00 00 00 01 00 02 08 01
				15 00 00 00 01 00 02 09 92
				15 00 00 00 01 00 02 0A 01
				15 00 00 00 01 00 02 0B B5
				15 00 00 00 01 00 02 0C 01
				15 00 00 00 01 00 02 0D D4
				15 00 00 00 01 00 02 0E 02
				15 00 00 00 01 00 02 0F 04
				15 00 00 00 01 00 02 10 02
				15 00 00 00 01 00 02 11 2A
				15 00 00 00 01 00 02 12 02
				15 00 00 00 01 00 02 13 2B
				15 00 00 00 01 00 02 14 02
				15 00 00 00 01 00 02 15 59
				15 00 00 00 01 00 02 16 02
				15 00 00 00 01 00 02 17 95
				15 00 00 00 01 00 02 18 02
				15 00 00 00 01 00 02 19 BE
				15 00 00 00 01 00 02 1A 02
				15 00 00 00 01 00 02 1B F3
				15 00 00 00 01 00 02 1C 03
				15 00 00 00 01 00 02 1D 11
				15 00 00 00 01 00 02 1E 03
				15 00 00 00 01 00 02 1F 41
				15 00 00 00 01 00 02 20 03
				15 00 00 00 01 00 02 21 51
				15 00 00 00 01 00 02 22 03
				15 00 00 00 01 00 02 23 62
				15 00 00 00 01 00 02 24 03
				15 00 00 00 01 00 02 25 75
				15 00 00 00 01 00 02 26 03
				15 00 00 00 01 00 02 27 8B
				15 00 00 00 01 00 02 28 03
				15 00 00 00 01 00 02 29 A5
				15 00 00 00 01 00 02 2A 03
				15 00 00 00 01 00 02 2B BD
				15 00 00 00 01 00 02 2D 03
				15 00 00 00 01 00 02 2F CB
				15 00 00 00 01 00 02 30 03
				15 00 00 00 01 00 02 31 FF
				15 00 00 00 01 00 02 32 01
				15 00 00 00 01 00 02 33 37
				15 00 00 00 01 00 02 34 01
				15 00 00 00 01 00 02 35 3B
				15 00 00 00 01 00 02 36 01
				15 00 00 00 01 00 02 37 42
				15 00 00 00 01 00 02 38 01
				15 00 00 00 01 00 02 39 49
				15 00 00 00 01 00 02 3A 01
				15 00 00 00 01 00 02 3B 50
				15 00 00 00 01 00 02 3D 01
				15 00 00 00 01 00 02 3F 56
				15 00 00 00 01 00 02 40 01
				15 00 00 00 01 00 02 41 5C
				15 00 00 00 01 00 02 42 01
				15 00 00 00 01 00 02 43 63
				15 00 00 00 01 00 02 44 01
				15 00 00 00 01 00 02 45 68
				15 00 00 00 01 00 02 46 01
				15 00 00 00 01 00 02 47 7E
				15 00 00 00 01 00 02 48 01
				15 00 00 00 01 00 02 49 92
				15 00 00 00 01 00 02 4A 01
				15 00 00 00 01 00 02 4B B5
				15 00 00 00 01 00 02 4C 01
				15 00 00 00 01 00 02 4D D4
				15 00 00 00 01 00 02 4E 02
				15 00 00 00 01 00 02 4F 04
				15 00 00 00 01 00 02 50 02
				15 00 00 00 01 00 02 51 2A
				15 00 00 00 01 00 02 52 02
				15 00 00 00 01 00 02 53 2B
				15 00 00 00 01 00 02 54 02
				15 00 00 00 01 00 02 55 59
				15 00 00 00 01 00 02 56 02
				15 00 00 00 01 00 02 58 95
				15 00 00 00 01 00 02 59 02
				15 00 00 00 01 00 02 5A BE
				15 00 00 00 01 00 02 5B 02
				15 00 00 00 01 00 02 5C F3
				15 00 00 00 01 00 02 5D 03
				15 00 00 00 01 00 02 5E 11
				15 00 00 00 01 00 02 5F 03
				15 00 00 00 01 00 02 60 41
				15 00 00 00 01 00 02 61 03
				15 00 00 00 01 00 02 62 51
				15 00 00 00 01 00 02 63 03
				15 00 00 00 01 00 02 64 62
				15 00 00 00 01 00 02 65 03
				15 00 00 00 01 00 02 66 75
				15 00 00 00 01 00 02 67 03
				15 00 00 00 01 00 02 68 8B
				15 00 00 00 01 00 02 69 03
				15 00 00 00 01 00 02 6A A5
				15 00 00 00 01 00 02 6B 03
				15 00 00 00 01 00 02 6C BD
				15 00 00 00 01 00 02 6D 03
				15 00 00 00 01 00 02 6E CB
				15 00 00 00 01 00 02 6F 03
				15 00 00 00 01 00 02 70 FF
				15 00 00 00 01 00 02 71 01
				15 00 00 00 01 00 02 72 B0
				15 00 00 00 01 00 02 73 01
				15 00 00 00 01 00 02 74 B2
				15 00 00 00 01 00 02 75 01
				15 00 00 00 01 00 02 76 B5
				15 00 00 00 01 00 02 77 01
				15 00 00 00 01 00 02 78 B8
				15 00 00 00 01 00 02 79 01
				15 00 00 00 01 00 02 7A BC
				15 00 00 00 01 00 02 7B 01
				15 00 00 00 01 00 02 7C BF
				15 00 00 00 01 00 02 7D 01
				15 00 00 00 01 00 02 7E C2
				15 00 00 00 01 00 02 7F 01
				15 00 00 00 01 00 02 80 C6
				15 00 00 00 01 00 02 81 01
				15 00 00 00 01 00 02 82 C9
				15 00 00 00 01 00 02 83 01
				15 00 00 00 01 00 02 84 D5
				15 00 00 00 01 00 02 85 01
				15 00 00 00 01 00 02 86 E1
				15 00 00 00 01 00 02 87 01
				15 00 00 00 01 00 02 88 F7
				15 00 00 00 01 00 02 89 02
				15 00 00 00 01 00 02 8A 05
				15 00 00 00 01 00 02 8B 02
				15 00 00 00 01 00 02 8C 24
				15 00 00 00 01 00 02 8D 02
				15 00 00 00 01 00 02 8E 48
				15 00 00 00 01 00 02 8F 02
				15 00 00 00 01 00 02 90 49
				15 00 00 00 01 00 02 91 02
				15 00 00 00 01 00 02 92 74
				15 00 00 00 01 00 02 93 02
				15 00 00 00 01 00 02 94 AE
				15 00 00 00 01 00 02 95 02
				15 00 00 00 01 00 02 96 D6
				15 00 00 00 01 00 02 97 03
				15 00 00 00 01 00 02 98 08
				15 00 00 00 01 00 02 99 03
				15 00 00 00 01 00 02 9A 2A
				15 00 00 00 01 00 02 9B 03
				15 00 00 00 01 00 02 9C 63
				15 00 00 00 01 00 02 9D 03
				15 00 00 00 01 00 02 9E 73
				15 00 00 00 01 00 02 9F 03
				15 00 00 00 01 00 02 A0 83
				15 00 00 00 01 00 02 A2 03
				15 00 00 00 01 00 02 A3 93
				15 00 00 00 01 00 02 A4 03
				15 00 00 00 01 00 02 A5 A0
				15 00 00 00 01 00 02 A6 03
				15 00 00 00 01 00 02 A7 AB
				15 00 00 00 01 00 02 A9 03
				15 00 00 00 01 00 02 AA B3
				15 00 00 00 01 00 02 AB 03
				15 00 00 00 01 00 02 AC B6
				15 00 00 00 01 00 02 AD 03
				15 00 00 00 01 00 02 AE FF
				15 00 00 00 01 00 02 AF 01
				15 00 00 00 01 00 02 B0 B0
				15 00 00 00 01 00 02 B1 01
				15 00 00 00 01 00 02 B2 B2
				15 00 00 00 01 00 02 B3 01
				15 00 00 00 01 00 02 B4 B5
				15 00 00 00 01 00 02 B5 01
				15 00 00 00 01 00 02 B6 B8
				15 00 00 00 01 00 02 B7 01
				15 00 00 00 01 00 02 B8 BC
				15 00 00 00 01 00 02 B9 01
				15 00 00 00 01 00 02 BA BF
				15 00 00 00 01 00 02 BB 01
				15 00 00 00 01 00 02 BC C2
				15 00 00 00 01 00 02 BD 01
				15 00 00 00 01 00 02 BE C6
				15 00 00 00 01 00 02 BF 01
				15 00 00 00 01 00 02 C0 C9
				15 00 00 00 01 00 02 C1 01
				15 00 00 00 01 00 02 C2 D5
				15 00 00 00 01 00 02 C3 01
				15 00 00 00 01 00 02 C4 E1
				15 00 00 00 01 00 02 C5 01
				15 00 00 00 01 00 02 C6 F7
				15 00 00 00 01 00 02 C7 02
				15 00 00 00 01 00 02 C8 05
				15 00 00 00 01 00 02 C9 02
				15 00 00 00 01 00 02 CA 24
				15 00 00 00 01 00 02 CB 02
				15 00 00 00 01 00 02 CC 48
				15 00 00 00 01 00 02 CD 02
				15 00 00 00 01 00 02 CE 49
				15 00 00 00 01 00 02 CF 02
				15 00 00 00 01 00 02 D0 74
				15 00 00 00 01 00 02 D1 02
				15 00 00 00 01 00 02 D2 AE
				15 00 00 00 01 00 02 D3 02
				15 00 00 00 01 00 02 D4 D6
				15 00 00 00 01 00 02 D5 03
				15 00 00 00 01 00 02 D6 08
				15 00 00 00 01 00 02 D7 03
				15 00 00 00 01 00 02 D8 2A
				15 00 00 00 01 00 02 D9 03
				15 00 00 00 01 00 02 DA 63
				15 00 00 00 01 00 02 DB 03
				15 00 00 00 01 00 02 DC 73
				15 00 00 00 01 00 02 DD 03
				15 00 00 00 01 00 02 DE 83
				15 00 00 00 01 00 02 DF 03
				15 00 00 00 01 00 02 E0 93
				15 00 00 00 01 00 02 E1 03
				15 00 00 00 01 00 02 E2 A0
				15 00 00 00 01 00 02 E3 03
				15 00 00 00 01 00 02 E4 AB
				15 00 00 00 01 00 02 E5 03
				15 00 00 00 01 00 02 E6 B3
				15 00 00 00 01 00 02 E7 03
				15 00 00 00 01 00 02 E8 B6
				15 00 00 00 01 00 02 E9 03
				15 00 00 00 01 00 02 EA FF
				15 00 00 00 01 00 02 FB 01
				15 01 00 00 01 00 02 FF 10
				];
		qcom,mdss-dsi-dispparam-papermode3-state = "dsi_hs_mode";
		qcom,mdss-dsi-dispparam-papermode4-command = [
				15 01 00 00 78 00 02 FF 20
				15 00 00 00 01 00 02 FB 01
				15 00 00 00 01 00 02 75 01
				15 00 00 00 01 00 02 76 4F
				15 00 00 00 01 00 02 77 01
				15 00 00 00 01 00 02 78 52
				15 00 00 00 01 00 02 79 01
				15 00 00 00 01 00 02 7A 58
				15 00 00 00 01 00 02 7B 01
				15 00 00 00 01 00 02 7C 5E
				15 00 00 00 01 00 02 7D 01
				15 00 00 00 01 00 02 7E 64
				15 00 00 00 01 00 02 7F 01
				15 00 00 00 01 00 02 80 6A
				15 00 00 00 01 00 02 81 01
				15 00 00 00 01 00 02 82 6F
				15 00 00 00 01 00 02 83 01
				15 00 00 00 01 00 02 84 75
				15 00 00 00 01 00 02 85 01
				15 00 00 00 01 00 02 86 7A
				15 00 00 00 01 00 02 87 01
				15 00 00 00 01 00 02 88 8E
				15 00 00 00 01 00 02 89 01
				15 00 00 00 01 00 02 8A A0
				15 00 00 00 01 00 02 8B 01
				15 00 00 00 01 00 02 8C C0
				15 00 00 00 01 00 02 8D 01
				15 00 00 00 01 00 02 8E DE
				15 00 00 00 01 00 02 8F 02
				15 00 00 00 01 00 02 90 08
				15 00 00 00 01 00 02 91 02
				15 00 00 00 01 00 02 92 2E
				15 00 00 00 01 00 02 93 02
				15 00 00 00 01 00 02 94 2F
				15 00 00 00 01 00 02 95 02
				15 00 00 00 01 00 02 96 5C
				15 00 00 00 01 00 02 97 02
				15 00 00 00 01 00 02 98 98
				15 00 00 00 01 00 02 99 02
				15 00 00 00 01 00 02 9A C1
				15 00 00 00 01 00 02 9B 02
				15 00 00 00 01 00 02 9C F7
				15 00 00 00 01 00 02 9D 03
				15 00 00 00 01 00 02 9E 15
				15 00 00 00 01 00 02 9F 03
				15 00 00 00 01 00 02 A0 4B
				15 00 00 00 01 00 02 A2 03
				15 00 00 00 01 00 02 A3 5D
				15 00 00 00 01 00 02 A4 03
				15 00 00 00 01 00 02 A5 70
				15 00 00 00 01 00 02 A6 03
				15 00 00 00 01 00 02 A7 84
				15 00 00 00 01 00 02 A9 03
				15 00 00 00 01 00 02 AA 97
				15 00 00 00 01 00 02 AB 03
				15 00 00 00 01 00 02 AC A7
				15 00 00 00 01 00 02 AD 03
				15 00 00 00 01 00 02 AE B1
				15 00 00 00 01 00 02 AF 03
				15 00 00 00 01 00 02 B0 B6
				15 00 00 00 01 00 02 B1 03
				15 00 00 00 01 00 02 B2 FF
				15 00 00 00 01 00 02 B3 01
				15 00 00 00 01 00 02 B4 4F
				15 00 00 00 01 00 02 B5 01
				15 00 00 00 01 00 02 B6 52
				15 00 00 00 01 00 02 B7 01
				15 00 00 00 01 00 02 B8 58
				15 00 00 00 01 00 02 B9 01
				15 00 00 00 01 00 02 BA 5E
				15 00 00 00 01 00 02 BB 01
				15 00 00 00 01 00 02 BC 64
				15 00 00 00 01 00 02 BD 01
				15 00 00 00 01 00 02 BE 6A
				15 00 00 00 01 00 02 BF 01
				15 00 00 00 01 00 02 C0 6F
				15 00 00 00 01 00 02 C1 01
				15 00 00 00 01 00 02 C2 75
				15 00 00 00 01 00 02 C3 01
				15 00 00 00 01 00 02 C4 7A
				15 00 00 00 01 00 02 C5 01
				15 00 00 00 01 00 02 C6 8E
				15 00 00 00 01 00 02 C7 01
				15 00 00 00 01 00 02 C8 A0
				15 00 00 00 01 00 02 C9 01
				15 00 00 00 01 00 02 CA C0
				15 00 00 00 01 00 02 CB 01
				15 00 00 00 01 00 02 CC DE
				15 00 00 00 01 00 02 CD 02
				15 00 00 00 01 00 02 CE 08
				15 00 00 00 01 00 02 CF 02
				15 00 00 00 01 00 02 D0 2E
				15 00 00 00 01 00 02 D1 02
				15 00 00 00 01 00 02 D2 2F
				15 00 00 00 01 00 02 D3 02
				15 00 00 00 01 00 02 D4 5C
				15 00 00 00 01 00 02 D5 02
				15 00 00 00 01 00 02 D6 98
				15 00 00 00 01 00 02 D7 02
				15 00 00 00 01 00 02 D8 C1
				15 00 00 00 01 00 02 D9 02
				15 00 00 00 01 00 02 DA F7
				15 00 00 00 01 00 02 DB 03
				15 00 00 00 01 00 02 DC 15
				15 00 00 00 01 00 02 DD 03
				15 00 00 00 01 00 02 DE 4B
				15 00 00 00 01 00 02 DF 03
				15 00 00 00 01 00 02 E0 5D
				15 00 00 00 01 00 02 E1 03
				15 00 00 00 01 00 02 E2 70
				15 00 00 00 01 00 02 E3 03
				15 00 00 00 01 00 02 E4 84
				15 00 00 00 01 00 02 E5 03
				15 00 00 00 01 00 02 E6 97
				15 00 00 00 01 00 02 E7 03
				15 00 00 00 01 00 02 E8 A7
				15 00 00 00 01 00 02 E9 03
				15 00 00 00 01 00 02 EA B1
				15 00 00 00 01 00 02 EB 03
				15 00 00 00 01 00 02 EC B6
				15 00 00 00 01 00 02 ED 03
				15 00 00 00 01 00 02 EE FF
				15 00 00 00 01 00 02 EF 01
				15 00 00 00 01 00 02 F0 4F
				15 00 00 00 01 00 02 F1 01
				15 00 00 00 01 00 02 F2 52
				15 00 00 00 01 00 02 F3 01
				15 00 00 00 01 00 02 F4 58
				15 00 00 00 01 00 02 F5 01
				15 00 00 00 01 00 02 F6 5E
				15 00 00 00 01 00 02 F7 01
				15 00 00 00 01 00 02 F8 64
				15 00 00 00 01 00 02 F9 01
				15 00 00 00 01 00 02 FA 6A
				15 00 00 00 01 00 02 FF 21
				15 00 00 00 01 00 02 FB 01
				15 00 00 00 01 00 02 00 01
				15 00 00 00 01 00 02 01 70
				15 00 00 00 01 00 02 02 01
				15 00 00 00 01 00 02 03 75
				15 00 00 00 01 00 02 04 01
				15 00 00 00 01 00 02 05 7A
				15 00 00 00 01 00 02 06 01
				15 00 00 00 01 00 02 07 8E
				15 00 00 00 01 00 02 08 01
				15 00 00 00 01 00 02 09 A0
				15 00 00 00 01 00 02 0A 01
				15 00 00 00 01 00 02 0B C0
				15 00 00 00 01 00 02 0C 01
				15 00 00 00 01 00 02 0D DE
				15 00 00 00 01 00 02 0E 02
				15 00 00 00 01 00 02 0F 09
				15 00 00 00 01 00 02 10 02
				15 00 00 00 01 00 02 11 2E
				15 00 00 00 01 00 02 12 02
				15 00 00 00 01 00 02 13 30
				15 00 00 00 01 00 02 14 02
				15 00 00 00 01 00 02 15 5D
				15 00 00 00 01 00 02 16 02
				15 00 00 00 01 00 02 17 99
				15 00 00 00 01 00 02 18 02
				15 00 00 00 01 00 02 19 C2
				15 00 00 00 01 00 02 1A 02
				15 00 00 00 01 00 02 1B F6
				15 00 00 00 01 00 02 1C 03
				15 00 00 00 01 00 02 1D 13
				15 00 00 00 01 00 02 1E 03
				15 00 00 00 01 00 02 1F 44
				15 00 00 00 01 00 02 20 03
				15 00 00 00 01 00 02 21 54
				15 00 00 00 01 00 02 22 03
				15 00 00 00 01 00 02 23 65
				15 00 00 00 01 00 02 24 03
				15 00 00 00 01 00 02 25 78
				15 00 00 00 01 00 02 26 03
				15 00 00 00 01 00 02 27 8E
				15 00 00 00 01 00 02 28 03
				15 00 00 00 01 00 02 29 A6
				15 00 00 00 01 00 02 2A 03
				15 00 00 00 01 00 02 2B BE
				15 00 00 00 01 00 02 2D 03
				15 00 00 00 01 00 02 2F CB
				15 00 00 00 01 00 02 30 03
				15 00 00 00 01 00 02 31 FF
				15 00 00 00 01 00 02 32 01
				15 00 00 00 01 00 02 33 4F
				15 00 00 00 01 00 02 34 01
				15 00 00 00 01 00 02 35 52
				15 00 00 00 01 00 02 36 01
				15 00 00 00 01 00 02 37 58
				15 00 00 00 01 00 02 38 01
				15 00 00 00 01 00 02 39 5E
				15 00 00 00 01 00 02 3A 01
				15 00 00 00 01 00 02 3B 64
				15 00 00 00 01 00 02 3D 01
				15 00 00 00 01 00 02 3F 6A
				15 00 00 00 01 00 02 40 01
				15 00 00 00 01 00 02 41 70
				15 00 00 00 01 00 02 42 01
				15 00 00 00 01 00 02 43 75
				15 00 00 00 01 00 02 44 01
				15 00 00 00 01 00 02 45 7A
				15 00 00 00 01 00 02 46 01
				15 00 00 00 01 00 02 47 8E
				15 00 00 00 01 00 02 48 01
				15 00 00 00 01 00 02 49 A0
				15 00 00 00 01 00 02 4A 01
				15 00 00 00 01 00 02 4B C0
				15 00 00 00 01 00 02 4C 01
				15 00 00 00 01 00 02 4D DE
				15 00 00 00 01 00 02 4E 02
				15 00 00 00 01 00 02 4F 09
				15 00 00 00 01 00 02 50 02
				15 00 00 00 01 00 02 51 2E
				15 00 00 00 01 00 02 52 02
				15 00 00 00 01 00 02 53 30
				15 00 00 00 01 00 02 54 02
				15 00 00 00 01 00 02 55 5D
				15 00 00 00 01 00 02 56 02
				15 00 00 00 01 00 02 58 99
				15 00 00 00 01 00 02 59 02
				15 00 00 00 01 00 02 5A C2
				15 00 00 00 01 00 02 5B 02
				15 00 00 00 01 00 02 5C F6
				15 00 00 00 01 00 02 5D 03
				15 00 00 00 01 00 02 5E 13
				15 00 00 00 01 00 02 5F 03
				15 00 00 00 01 00 02 60 44
				15 00 00 00 01 00 02 61 03
				15 00 00 00 01 00 02 62 54
				15 00 00 00 01 00 02 63 03
				15 00 00 00 01 00 02 64 65
				15 00 00 00 01 00 02 65 03
				15 00 00 00 01 00 02 66 78
				15 00 00 00 01 00 02 67 03
				15 00 00 00 01 00 02 68 8E
				15 00 00 00 01 00 02 69 03
				15 00 00 00 01 00 02 6A A6
				15 00 00 00 01 00 02 6B 03
				15 00 00 00 01 00 02 6C BE
				15 00 00 00 01 00 02 6D 03
				15 00 00 00 01 00 02 6E CB
				15 00 00 00 01 00 02 6F 03
				15 00 00 00 01 00 02 70 FF
				15 00 00 00 01 00 02 71 01
				15 00 00 00 01 00 02 72 D2
				15 00 00 00 01 00 02 73 01
				15 00 00 00 01 00 02 74 D3
				15 00 00 00 01 00 02 75 01
				15 00 00 00 01 00 02 76 D6
				15 00 00 00 01 00 02 77 01
				15 00 00 00 01 00 02 78 D9
				15 00 00 00 01 00 02 79 01
				15 00 00 00 01 00 02 7A DC
				15 00 00 00 01 00 02 7B 01
				15 00 00 00 01 00 02 7C DF
				15 00 00 00 01 00 02 7D 01
				15 00 00 00 01 00 02 7E E1
				15 00 00 00 01 00 02 7F 01
				15 00 00 00 01 00 02 80 E4
				15 00 00 00 01 00 02 81 01
				15 00 00 00 01 00 02 82 E7
				15 00 00 00 01 00 02 83 01
				15 00 00 00 01 00 02 84 F2
				15 00 00 00 01 00 02 85 01
				15 00 00 00 01 00 02 86 F9
				15 00 00 00 01 00 02 87 02
				15 00 00 00 01 00 02 88 06
				15 00 00 00 01 00 02 89 02
				15 00 00 00 01 00 02 8A 14
				15 00 00 00 01 00 02 8B 02
				15 00 00 00 01 00 02 8C 32
				15 00 00 00 01 00 02 8D 02
				15 00 00 00 01 00 02 8E 55
				15 00 00 00 01 00 02 8F 02
				15 00 00 00 01 00 02 90 56
				15 00 00 00 01 00 02 91 02
				15 00 00 00 01 00 02 92 80
				15 00 00 00 01 00 02 93 02
				15 00 00 00 01 00 02 94 BA
				15 00 00 00 01 00 02 95 02
				15 00 00 00 01 00 02 96 E1
				15 00 00 00 01 00 02 97 03
				15 00 00 00 01 00 02 98 10
				15 00 00 00 01 00 02 99 03
				15 00 00 00 01 00 02 9A 36
				15 00 00 00 01 00 02 9B 03
				15 00 00 00 01 00 02 9C 6D
				15 00 00 00 01 00 02 9D 03
				15 00 00 00 01 00 02 9E 7C
				15 00 00 00 01 00 02 9F 03
				15 00 00 00 01 00 02 A0 8A
				15 00 00 00 01 00 02 A2 03
				15 00 00 00 01 00 02 A3 98
				15 00 00 00 01 00 02 A4 03
				15 00 00 00 01 00 02 A5 A4
				15 00 00 00 01 00 02 A6 03
				15 00 00 00 01 00 02 A7 AD
				15 00 00 00 01 00 02 A9 03
				15 00 00 00 01 00 02 AA B3
				15 00 00 00 01 00 02 AB 03
				15 00 00 00 01 00 02 AC B6
				15 00 00 00 01 00 02 AD 03
				15 00 00 00 01 00 02 AE FF
				15 00 00 00 01 00 02 AF 01
				15 00 00 00 01 00 02 B0 D2
				15 00 00 00 01 00 02 B1 01
				15 00 00 00 01 00 02 B2 D3
				15 00 00 00 01 00 02 B3 01
				15 00 00 00 01 00 02 B4 D6
				15 00 00 00 01 00 02 B5 01
				15 00 00 00 01 00 02 B6 D9
				15 00 00 00 01 00 02 B7 01
				15 00 00 00 01 00 02 B8 DC
				15 00 00 00 01 00 02 B9 01
				15 00 00 00 01 00 02 BA DF
				15 00 00 00 01 00 02 BB 01
				15 00 00 00 01 00 02 BC E1
				15 00 00 00 01 00 02 BD 01
				15 00 00 00 01 00 02 BE E4
				15 00 00 00 01 00 02 BF 01
				15 00 00 00 01 00 02 C0 E7
				15 00 00 00 01 00 02 C1 01
				15 00 00 00 01 00 02 C2 F2
				15 00 00 00 01 00 02 C3 01
				15 00 00 00 01 00 02 C4 F9
				15 00 00 00 01 00 02 C5 02
				15 00 00 00 01 00 02 C6 06
				15 00 00 00 01 00 02 C7 02
				15 00 00 00 01 00 02 C8 14
				15 00 00 00 01 00 02 C9 02
				15 00 00 00 01 00 02 CA 32
				15 00 00 00 01 00 02 CB 02
				15 00 00 00 01 00 02 CC 55
				15 00 00 00 01 00 02 CD 02
				15 00 00 00 01 00 02 CE 56
				15 00 00 00 01 00 02 CF 02
				15 00 00 00 01 00 02 D0 80
				15 00 00 00 01 00 02 D1 02
				15 00 00 00 01 00 02 D2 BA
				15 00 00 00 01 00 02 D3 02
				15 00 00 00 01 00 02 D4 E1
				15 00 00 00 01 00 02 D5 03
				15 00 00 00 01 00 02 D6 10
				15 00 00 00 01 00 02 D7 03
				15 00 00 00 01 00 02 D8 36
				15 00 00 00 01 00 02 D9 03
				15 00 00 00 01 00 02 DA 6D
				15 00 00 00 01 00 02 DB 03
				15 00 00 00 01 00 02 DC 7C
				15 00 00 00 01 00 02 DD 03
				15 00 00 00 01 00 02 DE 8A
				15 00 00 00 01 00 02 DF 03
				15 00 00 00 01 00 02 E0 98
				15 00 00 00 01 00 02 E1 03
				15 00 00 00 01 00 02 E2 A4
				15 00 00 00 01 00 02 E3 03
				15 00 00 00 01 00 02 E4 AD
				15 00 00 00 01 00 02 E5 03
				15 00 00 00 01 00 02 E6 B3
				15 00 00 00 01 00 02 E7 03
				15 00 00 00 01 00 02 E8 B6
				15 00 00 00 01 00 02 E9 03
				15 00 00 00 01 00 02 EA FF
				15 00 00 00 01 00 02 FB 01
				15 01 00 00 01 00 02 FF 10
				];
		qcom,mdss-dsi-dispparam-papermode4-state = "dsi_hs_mode";
		qcom,mdss-dsi-dispparam-papermode5-command = [
				15 01 00 00 78 00 02 FF 20
				15 00 00 00 01 00 02 FB 01
				15 00 00 00 01 00 02 75 01
				15 00 00 00 01 00 02 76 5F
				15 00 00 00 01 00 02 77 01
				15 00 00 00 01 00 02 78 62
				15 00 00 00 01 00 02 79 01
				15 00 00 00 01 00 02 7A 68
				15 00 00 00 01 00 02 7B 01
				15 00 00 00 01 00 02 7C 6D
				15 00 00 00 01 00 02 7D 01
				15 00 00 00 01 00 02 7E 72
				15 00 00 00 01 00 02 7F 01
				15 00 00 00 01 00 02 80 77
				15 00 00 00 01 00 02 81 01
				15 00 00 00 01 00 02 82 7D
				15 00 00 00 01 00 02 83 01
				15 00 00 00 01 00 02 84 81
				15 00 00 00 01 00 02 85 01
				15 00 00 00 01 00 02 86 86
				15 00 00 00 01 00 02 87 01
				15 00 00 00 01 00 02 88 99
				15 00 00 00 01 00 02 89 01
				15 00 00 00 01 00 02 8A A9
				15 00 00 00 01 00 02 8B 01
				15 00 00 00 01 00 02 8C C8
				15 00 00 00 01 00 02 8D 01
				15 00 00 00 01 00 02 8E E5
				15 00 00 00 01 00 02 8F 02
				15 00 00 00 01 00 02 90 0C
				15 00 00 00 01 00 02 91 02
				15 00 00 00 01 00 02 92 31
				15 00 00 00 01 00 02 93 02
				15 00 00 00 01 00 02 94 33
				15 00 00 00 01 00 02 95 02
				15 00 00 00 01 00 02 96 5F
				15 00 00 00 01 00 02 97 02
				15 00 00 00 01 00 02 98 9B
				15 00 00 00 01 00 02 99 02
				15 00 00 00 01 00 02 9A C4
				15 00 00 00 01 00 02 9B 02
				15 00 00 00 01 00 02 9C FA
				15 00 00 00 01 00 02 9D 03
				15 00 00 00 01 00 02 9E 16
				15 00 00 00 01 00 02 9F 03
				15 00 00 00 01 00 02 A0 4E
				15 00 00 00 01 00 02 A2 03
				15 00 00 00 01 00 02 A3 5F
				15 00 00 00 01 00 02 A4 03
				15 00 00 00 01 00 02 A5 72
				15 00 00 00 01 00 02 A6 03
				15 00 00 00 01 00 02 A7 86
				15 00 00 00 01 00 02 A9 03
				15 00 00 00 01 00 02 AA 98
				15 00 00 00 01 00 02 AB 03
				15 00 00 00 01 00 02 AC A7
				15 00 00 00 01 00 02 AD 03
				15 00 00 00 01 00 02 AE B1
				15 00 00 00 01 00 02 AF 03
				15 00 00 00 01 00 02 B0 B6
				15 00 00 00 01 00 02 B1 03
				15 00 00 00 01 00 02 B2 FF
				15 00 00 00 01 00 02 B3 01
				15 00 00 00 01 00 02 B4 5F
				15 00 00 00 01 00 02 B5 01
				15 00 00 00 01 00 02 B6 62
				15 00 00 00 01 00 02 B7 01
				15 00 00 00 01 00 02 B8 68
				15 00 00 00 01 00 02 B9 01
				15 00 00 00 01 00 02 BA 6D
				15 00 00 00 01 00 02 BB 01
				15 00 00 00 01 00 02 BC 72
				15 00 00 00 01 00 02 BD 01
				15 00 00 00 01 00 02 BE 77
				15 00 00 00 01 00 02 BF 01
				15 00 00 00 01 00 02 C0 7D
				15 00 00 00 01 00 02 C1 01
				15 00 00 00 01 00 02 C2 81
				15 00 00 00 01 00 02 C3 01
				15 00 00 00 01 00 02 C4 86
				15 00 00 00 01 00 02 C5 01
				15 00 00 00 01 00 02 C6 99
				15 00 00 00 01 00 02 C7 01
				15 00 00 00 01 00 02 C8 A9
				15 00 00 00 01 00 02 C9 01
				15 00 00 00 01 00 02 CA C8
				15 00 00 00 01 00 02 CB 01
				15 00 00 00 01 00 02 CC E5
				15 00 00 00 01 00 02 CD 02
				15 00 00 00 01 00 02 CE 0C
				15 00 00 00 01 00 02 CF 02
				15 00 00 00 01 00 02 D0 31
				15 00 00 00 01 00 02 D1 02
				15 00 00 00 01 00 02 D2 33
				15 00 00 00 01 00 02 D3 02
				15 00 00 00 01 00 02 D4 5F
				15 00 00 00 01 00 02 D5 02
				15 00 00 00 01 00 02 D6 9B
				15 00 00 00 01 00 02 D7 02
				15 00 00 00 01 00 02 D8 C4
				15 00 00 00 01 00 02 D9 02
				15 00 00 00 01 00 02 DA FA
				15 00 00 00 01 00 02 DB 03
				15 00 00 00 01 00 02 DC 16
				15 00 00 00 01 00 02 DD 03
				15 00 00 00 01 00 02 DE 4E
				15 00 00 00 01 00 02 DF 03
				15 00 00 00 01 00 02 E0 5F
				15 00 00 00 01 00 02 E1 03
				15 00 00 00 01 00 02 E2 72
				15 00 00 00 01 00 02 E3 03
				15 00 00 00 01 00 02 E4 86
				15 00 00 00 01 00 02 E5 03
				15 00 00 00 01 00 02 E6 98
				15 00 00 00 01 00 02 E7 03
				15 00 00 00 01 00 02 E8 A7
				15 00 00 00 01 00 02 E9 03
				15 00 00 00 01 00 02 EA B1
				15 00 00 00 01 00 02 EB 03
				15 00 00 00 01 00 02 EC B6
				15 00 00 00 01 00 02 ED 03
				15 00 00 00 01 00 02 EE FF
				15 00 00 00 01 00 02 EF 01
				15 00 00 00 01 00 02 F0 5F
				15 00 00 00 01 00 02 F1 01
				15 00 00 00 01 00 02 F2 62
				15 00 00 00 01 00 02 F3 01
				15 00 00 00 01 00 02 F4 68
				15 00 00 00 01 00 02 F5 01
				15 00 00 00 01 00 02 F6 6D
				15 00 00 00 01 00 02 F7 01
				15 00 00 00 01 00 02 F8 72
				15 00 00 00 01 00 02 F9 01
				15 00 00 00 01 00 02 FA 78
				15 00 00 00 01 00 02 FF 21
				15 00 00 00 01 00 02 FB 01
				15 00 00 00 01 00 02 00 01
				15 00 00 00 01 00 02 01 7D
				15 00 00 00 01 00 02 02 01
				15 00 00 00 01 00 02 03 82
				15 00 00 00 01 00 02 04 01
				15 00 00 00 01 00 02 05 86
				15 00 00 00 01 00 02 06 01
				15 00 00 00 01 00 02 07 99
				15 00 00 00 01 00 02 08 01
				15 00 00 00 01 00 02 09 A9
				15 00 00 00 01 00 02 0A 01
				15 00 00 00 01 00 02 0B C8
				15 00 00 00 01 00 02 0C 01
				15 00 00 00 01 00 02 0D E5
				15 00 00 00 01 00 02 0E 02
				15 00 00 00 01 00 02 0F 0C
				15 00 00 00 01 00 02 10 02
				15 00 00 00 01 00 02 11 32
				15 00 00 00 01 00 02 12 02
				15 00 00 00 01 00 02 13 33
				15 00 00 00 01 00 02 14 02
				15 00 00 00 01 00 02 15 60
				15 00 00 00 01 00 02 16 02
				15 00 00 00 01 00 02 17 9C
				15 00 00 00 01 00 02 18 02
				15 00 00 00 01 00 02 19 C4
				15 00 00 00 01 00 02 1A 02
				15 00 00 00 01 00 02 1B F8
				15 00 00 00 01 00 02 1C 03
				15 00 00 00 01 00 02 1D 14
				15 00 00 00 01 00 02 1E 03
				15 00 00 00 01 00 02 1F 47
				15 00 00 00 01 00 02 20 03
				15 00 00 00 01 00 02 21 56
				15 00 00 00 01 00 02 22 03
				15 00 00 00 01 00 02 23 67
				15 00 00 00 01 00 02 24 03
				15 00 00 00 01 00 02 25 7A
				15 00 00 00 01 00 02 26 03
				15 00 00 00 01 00 02 27 8F
				15 00 00 00 01 00 02 28 03
				15 00 00 00 01 00 02 29 A8
				15 00 00 00 01 00 02 2A 03
				15 00 00 00 01 00 02 2B BE
				15 00 00 00 01 00 02 2D 03
				15 00 00 00 01 00 02 2F CC
				15 00 00 00 01 00 02 30 03
				15 00 00 00 01 00 02 31 FF
				15 00 00 00 01 00 02 32 01
				15 00 00 00 01 00 02 33 5F
				15 00 00 00 01 00 02 34 01
				15 00 00 00 01 00 02 35 62
				15 00 00 00 01 00 02 36 01
				15 00 00 00 01 00 02 37 68
				15 00 00 00 01 00 02 38 01
				15 00 00 00 01 00 02 39 6D
				15 00 00 00 01 00 02 3A 01
				15 00 00 00 01 00 02 3B 72
				15 00 00 00 01 00 02 3D 01
				15 00 00 00 01 00 02 3F 78
				15 00 00 00 01 00 02 40 01
				15 00 00 00 01 00 02 41 7D
				15 00 00 00 01 00 02 42 01
				15 00 00 00 01 00 02 43 82
				15 00 00 00 01 00 02 44 01
				15 00 00 00 01 00 02 45 86
				15 00 00 00 01 00 02 46 01
				15 00 00 00 01 00 02 47 99
				15 00 00 00 01 00 02 48 01
				15 00 00 00 01 00 02 49 A9
				15 00 00 00 01 00 02 4A 01
				15 00 00 00 01 00 02 4B C8
				15 00 00 00 01 00 02 4C 01
				15 00 00 00 01 00 02 4D E5
				15 00 00 00 01 00 02 4E 02
				15 00 00 00 01 00 02 4F 0C
				15 00 00 00 01 00 02 50 02
				15 00 00 00 01 00 02 51 32
				15 00 00 00 01 00 02 52 02
				15 00 00 00 01 00 02 53 33
				15 00 00 00 01 00 02 54 02
				15 00 00 00 01 00 02 55 60
				15 00 00 00 01 00 02 56 02
				15 00 00 00 01 00 02 58 9C
				15 00 00 00 01 00 02 59 02
				15 00 00 00 01 00 02 5A C4
				15 00 00 00 01 00 02 5B 02
				15 00 00 00 01 00 02 5C F8
				15 00 00 00 01 00 02 5D 03
				15 00 00 00 01 00 02 5E 14
				15 00 00 00 01 00 02 5F 03
				15 00 00 00 01 00 02 60 47
				15 00 00 00 01 00 02 61 03
				15 00 00 00 01 00 02 62 56
				15 00 00 00 01 00 02 63 03
				15 00 00 00 01 00 02 64 67
				15 00 00 00 01 00 02 65 03
				15 00 00 00 01 00 02 66 7A
				15 00 00 00 01 00 02 67 03
				15 00 00 00 01 00 02 68 8F
				15 00 00 00 01 00 02 69 03
				15 00 00 00 01 00 02 6A A8
				15 00 00 00 01 00 02 6B 03
				15 00 00 00 01 00 02 6C BE
				15 00 00 00 01 00 02 6D 03
				15 00 00 00 01 00 02 6E CC
				15 00 00 00 01 00 02 6F 03
				15 00 00 00 01 00 02 70 FF
				15 00 00 00 01 00 02 71 01
				15 00 00 00 01 00 02 72 E5
				15 00 00 00 01 00 02 73 01
				15 00 00 00 01 00 02 74 E6
				15 00 00 00 01 00 02 75 01
				15 00 00 00 01 00 02 76 E9
				15 00 00 00 01 00 02 77 01
				15 00 00 00 01 00 02 78 EC
				15 00 00 00 01 00 02 79 01
				15 00 00 00 01 00 02 7A EE
				15 00 00 00 01 00 02 7B 01
				15 00 00 00 01 00 02 7C F1
				15 00 00 00 01 00 02 7D 01
				15 00 00 00 01 00 02 7E F3
				15 00 00 00 01 00 02 7F 01
				15 00 00 00 01 00 02 80 F5
				15 00 00 00 01 00 02 81 01
				15 00 00 00 01 00 02 82 F6
				15 00 00 00 01 00 02 83 01
				15 00 00 00 01 00 02 84 FD
				15 00 00 00 01 00 02 85 02
				15 00 00 00 01 00 02 86 03
				15 00 00 00 01 00 02 87 02
				15 00 00 00 01 00 02 88 10
				15 00 00 00 01 00 02 89 02
				15 00 00 00 01 00 02 8A 1D
				15 00 00 00 01 00 02 8B 02
				15 00 00 00 01 00 02 8C 3B
				15 00 00 00 01 00 02 8D 02
				15 00 00 00 01 00 02 8E 5D
				15 00 00 00 01 00 02 8F 02
				15 00 00 00 01 00 02 90 5E
				15 00 00 00 01 00 02 91 02
				15 00 00 00 01 00 02 92 88
				15 00 00 00 01 00 02 93 02
				15 00 00 00 01 00 02 94 C1
				15 00 00 00 01 00 02 95 02
				15 00 00 00 01 00 02 96 E8
				15 00 00 00 01 00 02 97 03
				15 00 00 00 01 00 02 98 15
				15 00 00 00 01 00 02 99 03
				15 00 00 00 01 00 02 9A 3E
				15 00 00 00 01 00 02 9B 03
				15 00 00 00 01 00 02 9C 73
				15 00 00 00 01 00 02 9D 03
				15 00 00 00 01 00 02 9E 81
				15 00 00 00 01 00 02 9F 03
				15 00 00 00 01 00 02 A0 8E
				15 00 00 00 01 00 02 A2 03
				15 00 00 00 01 00 02 A3 9B
				15 00 00 00 01 00 02 A4 03
				15 00 00 00 01 00 02 A5 A6
				15 00 00 00 01 00 02 A6 03
				15 00 00 00 01 00 02 A7 AE
				15 00 00 00 01 00 02 A9 03
				15 00 00 00 01 00 02 AA B4
				15 00 00 00 01 00 02 AB 03
				15 00 00 00 01 00 02 AC B6
				15 00 00 00 01 00 02 AD 03
				15 00 00 00 01 00 02 AE FF
				15 00 00 00 01 00 02 AF 01
				15 00 00 00 01 00 02 B0 E5
				15 00 00 00 01 00 02 B1 01
				15 00 00 00 01 00 02 B2 E6
				15 00 00 00 01 00 02 B3 01
				15 00 00 00 01 00 02 B4 E9
				15 00 00 00 01 00 02 B5 01
				15 00 00 00 01 00 02 B6 EC
				15 00 00 00 01 00 02 B7 01
				15 00 00 00 01 00 02 B8 EE
				15 00 00 00 01 00 02 B9 01
				15 00 00 00 01 00 02 BA F1
				15 00 00 00 01 00 02 BB 01
				15 00 00 00 01 00 02 BC F3
				15 00 00 00 01 00 02 BD 01
				15 00 00 00 01 00 02 BE F5
				15 00 00 00 01 00 02 BF 01
				15 00 00 00 01 00 02 C0 F6
				15 00 00 00 01 00 02 C1 01
				15 00 00 00 01 00 02 C2 FD
				15 00 00 00 01 00 02 C3 02
				15 00 00 00 01 00 02 C4 03
				15 00 00 00 01 00 02 C5 02
				15 00 00 00 01 00 02 C6 10
				15 00 00 00 01 00 02 C7 02
				15 00 00 00 01 00 02 C8 1D
				15 00 00 00 01 00 02 C9 02
				15 00 00 00 01 00 02 CA 3B
				15 00 00 00 01 00 02 CB 02
				15 00 00 00 01 00 02 CC 5D
				15 00 00 00 01 00 02 CD 02
				15 00 00 00 01 00 02 CE 5E
				15 00 00 00 01 00 02 CF 02
				15 00 00 00 01 00 02 D0 88
				15 00 00 00 01 00 02 D1 02
				15 00 00 00 01 00 02 D2 C1
				15 00 00 00 01 00 02 D3 02
				15 00 00 00 01 00 02 D4 E8
				15 00 00 00 01 00 02 D5 03
				15 00 00 00 01 00 02 D6 15
				15 00 00 00 01 00 02 D7 03
				15 00 00 00 01 00 02 D8 3E
				15 00 00 00 01 00 02 D9 03
				15 00 00 00 01 00 02 DA 73
				15 00 00 00 01 00 02 DB 03
				15 00 00 00 01 00 02 DC 81
				15 00 00 00 01 00 02 DD 03
				15 00 00 00 01 00 02 DE 8E
				15 00 00 00 01 00 02 DF 03
				15 00 00 00 01 00 02 E0 9B
				15 00 00 00 01 00 02 E1 03
				15 00 00 00 01 00 02 E2 A6
				15 00 00 00 01 00 02 E3 03
				15 00 00 00 01 00 02 E4 AE
				15 00 00 00 01 00 02 E5 03
				15 00 00 00 01 00 02 E6 B4
				15 00 00 00 01 00 02 E7 03
				15 00 00 00 01 00 02 E8 B6
				15 00 00 00 01 00 02 E9 03
				15 00 00 00 01 00 02 EA FF
				15 00 00 00 01 00 02 FB 01
				15 01 00 00 01 00 02 FF 10
				];
		qcom,mdss-dsi-dispparam-papermode5-state = "dsi_hs_mode";
		qcom,mdss-dsi-dispparam-papermode6-command = [
				15 01 00 00 78 00 02 FF 20
				15 00 00 00 01 00 02 FB 01
				15 00 00 00 01 00 02 75 01
				15 00 00 00 01 00 02 76 60
				15 00 00 00 01 00 02 77 01
				15 00 00 00 01 00 02 78 63
				15 00 00 00 01 00 02 79 01
				15 00 00 00 01 00 02 7A 68
				15 00 00 00 01 00 02 7B 01
				15 00 00 00 01 00 02 7C 6E
				15 00 00 00 01 00 02 7D 01
				15 00 00 00 01 00 02 7E 73
				15 00 00 00 01 00 02 7F 01
				15 00 00 00 01 00 02 80 78
				15 00 00 00 01 00 02 81 01
				15 00 00 00 01 00 02 82 7D
				15 00 00 00 01 00 02 83 01
				15 00 00 00 01 00 02 84 82
				15 00 00 00 01 00 02 85 01
				15 00 00 00 01 00 02 86 87
				15 00 00 00 01 00 02 87 01
				15 00 00 00 01 00 02 88 99
				15 00 00 00 01 00 02 89 01
				15 00 00 00 01 00 02 8A AA
				15 00 00 00 01 00 02 8B 01
				15 00 00 00 01 00 02 8C C9
				15 00 00 00 01 00 02 8D 01
				15 00 00 00 01 00 02 8E E5
				15 00 00 00 01 00 02 8F 02
				15 00 00 00 01 00 02 90 0C
				15 00 00 00 01 00 02 91 02
				15 00 00 00 01 00 02 92 31
				15 00 00 00 01 00 02 93 02
				15 00 00 00 01 00 02 94 33
				15 00 00 00 01 00 02 95 02
				15 00 00 00 01 00 02 96 60
				15 00 00 00 01 00 02 97 02
				15 00 00 00 01 00 02 98 9B
				15 00 00 00 01 00 02 99 02
				15 00 00 00 01 00 02 9A C4
				15 00 00 00 01 00 02 9B 02
				15 00 00 00 01 00 02 9C FA
				15 00 00 00 01 00 02 9D 03
				15 00 00 00 01 00 02 9E 17
				15 00 00 00 01 00 02 9F 03
				15 00 00 00 01 00 02 A0 4E
				15 00 00 00 01 00 02 A2 03
				15 00 00 00 01 00 02 A3 60
				15 00 00 00 01 00 02 A4 03
				15 00 00 00 01 00 02 A5 73
				15 00 00 00 01 00 02 A6 03
				15 00 00 00 01 00 02 A7 86
				15 00 00 00 01 00 02 A9 03
				15 00 00 00 01 00 02 AA 98
				15 00 00 00 01 00 02 AB 03
				15 00 00 00 01 00 02 AC A7
				15 00 00 00 01 00 02 AD 03
				15 00 00 00 01 00 02 AE B1
				15 00 00 00 01 00 02 AF 03
				15 00 00 00 01 00 02 B0 B6
				15 00 00 00 01 00 02 B1 03
				15 00 00 00 01 00 02 B2 FF
				15 00 00 00 01 00 02 B3 01
				15 00 00 00 01 00 02 B4 60
				15 00 00 00 01 00 02 B5 01
				15 00 00 00 01 00 02 B6 63
				15 00 00 00 01 00 02 B7 01
				15 00 00 00 01 00 02 B8 68
				15 00 00 00 01 00 02 B9 01
				15 00 00 00 01 00 02 BA 6E
				15 00 00 00 01 00 02 BB 01
				15 00 00 00 01 00 02 BC 73
				15 00 00 00 01 00 02 BD 01
				15 00 00 00 01 00 02 BE 78
				15 00 00 00 01 00 02 BF 01
				15 00 00 00 01 00 02 C0 7D
				15 00 00 00 01 00 02 C1 01
				15 00 00 00 01 00 02 C2 82
				15 00 00 00 01 00 02 C3 01
				15 00 00 00 01 00 02 C4 87
				15 00 00 00 01 00 02 C5 01
				15 00 00 00 01 00 02 C6 99
				15 00 00 00 01 00 02 C7 01
				15 00 00 00 01 00 02 C8 AA
				15 00 00 00 01 00 02 C9 01
				15 00 00 00 01 00 02 CA C9
				15 00 00 00 01 00 02 CB 01
				15 00 00 00 01 00 02 CC E5
				15 00 00 00 01 00 02 CD 02
				15 00 00 00 01 00 02 CE 0C
				15 00 00 00 01 00 02 CF 02
				15 00 00 00 01 00 02 D0 31
				15 00 00 00 01 00 02 D1 02
				15 00 00 00 01 00 02 D2 33
				15 00 00 00 01 00 02 D3 02
				15 00 00 00 01 00 02 D4 60
				15 00 00 00 01 00 02 D5 02
				15 00 00 00 01 00 02 D6 9B
				15 00 00 00 01 00 02 D7 02
				15 00 00 00 01 00 02 D8 C4
				15 00 00 00 01 00 02 D9 02
				15 00 00 00 01 00 02 DA FA
				15 00 00 00 01 00 02 DB 03
				15 00 00 00 01 00 02 DC 17
				15 00 00 00 01 00 02 DD 03
				15 00 00 00 01 00 02 DE 4E
				15 00 00 00 01 00 02 DF 03
				15 00 00 00 01 00 02 E0 60
				15 00 00 00 01 00 02 E1 03
				15 00 00 00 01 00 02 E2 73
				15 00 00 00 01 00 02 E3 03
				15 00 00 00 01 00 02 E4 86
				15 00 00 00 01 00 02 E5 03
				15 00 00 00 01 00 02 E6 98
				15 00 00 00 01 00 02 E7 03
				15 00 00 00 01 00 02 E8 A7
				15 00 00 00 01 00 02 E9 03
				15 00 00 00 01 00 02 EA B1
				15 00 00 00 01 00 02 EB 03
				15 00 00 00 01 00 02 EC B6
				15 00 00 00 01 00 02 ED 03
				15 00 00 00 01 00 02 EE FF
				15 00 00 00 01 00 02 EF 01
				15 00 00 00 01 00 02 F0 6A
				15 00 00 00 01 00 02 F1 01
				15 00 00 00 01 00 02 F2 6D
				15 00 00 00 01 00 02 F3 01
				15 00 00 00 01 00 02 F4 72
				15 00 00 00 01 00 02 F5 01
				15 00 00 00 01 00 02 F6 77
				15 00 00 00 01 00 02 F7 01
				15 00 00 00 01 00 02 F8 7C
				15 00 00 00 01 00 02 F9 01
				15 00 00 00 01 00 02 FA 81
				15 00 00 00 01 00 02 FF 21
				15 00 00 00 01 00 02 FB 01
				15 00 00 00 01 00 02 00 01
				15 00 00 00 01 00 02 01 86
				15 00 00 00 01 00 02 02 01
				15 00 00 00 01 00 02 03 8A
				15 00 00 00 01 00 02 04 01
				15 00 00 00 01 00 02 05 8F
				15 00 00 00 01 00 02 06 01
				15 00 00 00 01 00 02 07 A0
				15 00 00 00 01 00 02 08 01
				15 00 00 00 01 00 02 09 B0
				15 00 00 00 01 00 02 0A 01
				15 00 00 00 01 00 02 0B CE
				15 00 00 00 01 00 02 0C 01
				15 00 00 00 01 00 02 0D EA
				15 00 00 00 01 00 02 0E 02
				15 00 00 00 01 00 02 0F 0F
				15 00 00 00 01 00 02 10 02
				15 00 00 00 01 00 02 11 34
				15 00 00 00 01 00 02 12 02
				15 00 00 00 01 00 02 13 35
				15 00 00 00 01 00 02 14 02
				15 00 00 00 01 00 02 15 62
				15 00 00 00 01 00 02 16 02
				15 00 00 00 01 00 02 17 9E
				15 00 00 00 01 00 02 18 02
				15 00 00 00 01 00 02 19 C6
				15 00 00 00 01 00 02 1A 02
				15 00 00 00 01 00 02 1B FA
				15 00 00 00 01 00 02 1C 03
				15 00 00 00 01 00 02 1D 16
				15 00 00 00 01 00 02 1E 03
				15 00 00 00 01 00 02 1F 48
				15 00 00 00 01 00 02 20 03
				15 00 00 00 01 00 02 21 57
				15 00 00 00 01 00 02 22 03
				15 00 00 00 01 00 02 23 68
				15 00 00 00 01 00 02 24 03
				15 00 00 00 01 00 02 25 7B
				15 00 00 00 01 00 02 26 03
				15 00 00 00 01 00 02 27 91
				15 00 00 00 01 00 02 28 03
				15 00 00 00 01 00 02 29 A9
				15 00 00 00 01 00 02 2A 03
				15 00 00 00 01 00 02 2B BF
				15 00 00 00 01 00 02 2D 03
				15 00 00 00 01 00 02 2F CC
				15 00 00 00 01 00 02 30 03
				15 00 00 00 01 00 02 31 FF
				15 00 00 00 01 00 02 32 01
				15 00 00 00 01 00 02 33 6A
				15 00 00 00 01 00 02 34 01
				15 00 00 00 01 00 02 35 6D
				15 00 00 00 01 00 02 36 01
				15 00 00 00 01 00 02 37 72
				15 00 00 00 01 00 02 38 01
				15 00 00 00 01 00 02 39 77
				15 00 00 00 01 00 02 3A 01
				15 00 00 00 01 00 02 3B 7C
				15 00 00 00 01 00 02 3D 01
				15 00 00 00 01 00 02 3F 81
				15 00 00 00 01 00 02 40 01
				15 00 00 00 01 00 02 41 86
				15 00 00 00 01 00 02 42 01
				15 00 00 00 01 00 02 43 8A
				15 00 00 00 01 00 02 44 01
				15 00 00 00 01 00 02 45 8F
				15 00 00 00 01 00 02 46 01
				15 00 00 00 01 00 02 47 A0
				15 00 00 00 01 00 02 48 01
				15 00 00 00 01 00 02 49 B0
				15 00 00 00 01 00 02 4A 01
				15 00 00 00 01 00 02 4B CE
				15 00 00 00 01 00 02 4C 01
				15 00 00 00 01 00 02 4D EA
				15 00 00 00 01 00 02 4E 02
				15 00 00 00 01 00 02 4F 0F
				15 00 00 00 01 00 02 50 02
				15 00 00 00 01 00 02 51 34
				15 00 00 00 01 00 02 52 02
				15 00 00 00 01 00 02 53 35
				15 00 00 00 01 00 02 54 02
				15 00 00 00 01 00 02 55 62
				15 00 00 00 01 00 02 56 02
				15 00 00 00 01 00 02 58 9E
				15 00 00 00 01 00 02 59 02
				15 00 00 00 01 00 02 5A C6
				15 00 00 00 01 00 02 5B 02
				15 00 00 00 01 00 02 5C FA
				15 00 00 00 01 00 02 5D 03
				15 00 00 00 01 00 02 5E 16
				15 00 00 00 01 00 02 5F 03
				15 00 00 00 01 00 02 60 48
				15 00 00 00 01 00 02 61 03
				15 00 00 00 01 00 02 62 57
				15 00 00 00 01 00 02 63 03
				15 00 00 00 01 00 02 64 68
				15 00 00 00 01 00 02 65 03
				15 00 00 00 01 00 02 66 7B
				15 00 00 00 01 00 02 67 03
				15 00 00 00 01 00 02 68 91
				15 00 00 00 01 00 02 69 03
				15 00 00 00 01 00 02 6A A9
				15 00 00 00 01 00 02 6B 03
				15 00 00 00 01 00 02 6C BF
				15 00 00 00 01 00 02 6D 03
				15 00 00 00 01 00 02 6E CC
				15 00 00 00 01 00 02 6F 03
				15 00 00 00 01 00 02 70 FF
				15 00 00 00 01 00 02 71 01
				15 00 00 00 01 00 02 72 F4
				15 00 00 00 01 00 02 73 01
				15 00 00 00 01 00 02 74 F5
				15 00 00 00 01 00 02 75 01
				15 00 00 00 01 00 02 76 F6
				15 00 00 00 01 00 02 77 01
				15 00 00 00 01 00 02 78 F7
				15 00 00 00 01 00 02 79 01
				15 00 00 00 01 00 02 7A F8
				15 00 00 00 01 00 02 7B 01
				15 00 00 00 01 00 02 7C F9
				15 00 00 00 01 00 02 7D 01
				15 00 00 00 01 00 02 7E FA
				15 00 00 00 01 00 02 7F 01
				15 00 00 00 01 00 02 80 FC
				15 00 00 00 01 00 02 81 01
				15 00 00 00 01 00 02 82 FD
				15 00 00 00 01 00 02 83 02
				15 00 00 00 01 00 02 84 03
				15 00 00 00 01 00 02 85 02
				15 00 00 00 01 00 02 86 09
				15 00 00 00 01 00 02 87 02
				15 00 00 00 01 00 02 88 16
				15 00 00 00 01 00 02 89 02
				15 00 00 00 01 00 02 8A 23
				15 00 00 00 01 00 02 8B 02
				15 00 00 00 01 00 02 8C 41
				15 00 00 00 01 00 02 8D 02
				15 00 00 00 01 00 02 8E 62
				15 00 00 00 01 00 02 8F 02
				15 00 00 00 01 00 02 90 64
				15 00 00 00 01 00 02 91 02
				15 00 00 00 01 00 02 92 8D
				15 00 00 00 01 00 02 93 02
				15 00 00 00 01 00 02 94 C6
				15 00 00 00 01 00 02 95 02
				15 00 00 00 01 00 02 96 EC
				15 00 00 00 01 00 02 97 03
				15 00 00 00 01 00 02 98 18
				15 00 00 00 01 00 02 99 03
				15 00 00 00 01 00 02 9A 43
				15 00 00 00 01 00 02 9B 03
				15 00 00 00 01 00 02 9C 77
				15 00 00 00 01 00 02 9D 03
				15 00 00 00 01 00 02 9E 84
				15 00 00 00 01 00 02 9F 03
				15 00 00 00 01 00 02 A0 91
				15 00 00 00 01 00 02 A2 03
				15 00 00 00 01 00 02 A3 9D
				15 00 00 00 01 00 02 A4 03
				15 00 00 00 01 00 02 A5 A7
				15 00 00 00 01 00 02 A6 03
				15 00 00 00 01 00 02 A7 AF
				15 00 00 00 01 00 02 A9 03
				15 00 00 00 01 00 02 AA B4
				15 00 00 00 01 00 02 AB 03
				15 00 00 00 01 00 02 AC B6
				15 00 00 00 01 00 02 AD 03
				15 00 00 00 01 00 02 AE FF
				15 00 00 00 01 00 02 AF 01
				15 00 00 00 01 00 02 B0 F4
				15 00 00 00 01 00 02 B1 01
				15 00 00 00 01 00 02 B2 F5
				15 00 00 00 01 00 02 B3 01
				15 00 00 00 01 00 02 B4 F6
				15 00 00 00 01 00 02 B5 01
				15 00 00 00 01 00 02 B6 F7
				15 00 00 00 01 00 02 B7 01
				15 00 00 00 01 00 02 B8 F8
				15 00 00 00 01 00 02 B9 01
				15 00 00 00 01 00 02 BA F9
				15 00 00 00 01 00 02 BB 01
				15 00 00 00 01 00 02 BC FA
				15 00 00 00 01 00 02 BD 01
				15 00 00 00 01 00 02 BE FC
				15 00 00 00 01 00 02 BF 01
				15 00 00 00 01 00 02 C0 FD
				15 00 00 00 01 00 02 C1 02
				15 00 00 00 01 00 02 C2 03
				15 00 00 00 01 00 02 C3 02
				15 00 00 00 01 00 02 C4 09
				15 00 00 00 01 00 02 C5 02
				15 00 00 00 01 00 02 C6 16
				15 00 00 00 01 00 02 C7 02
				15 00 00 00 01 00 02 C8 23
				15 00 00 00 01 00 02 C9 02
				15 00 00 00 01 00 02 CA 41
				15 00 00 00 01 00 02 CB 02
				15 00 00 00 01 00 02 CC 62
				15 00 00 00 01 00 02 CD 02
				15 00 00 00 01 00 02 CE 64
				15 00 00 00 01 00 02 CF 02
				15 00 00 00 01 00 02 D0 8D
				15 00 00 00 01 00 02 D1 02
				15 00 00 00 01 00 02 D2 C6
				15 00 00 00 01 00 02 D3 02
				15 00 00 00 01 00 02 D4 EC
				15 00 00 00 01 00 02 D5 03
				15 00 00 00 01 00 02 D6 18
				15 00 00 00 01 00 02 D7 03
				15 00 00 00 01 00 02 D8 43
				15 00 00 00 01 00 02 D9 03
				15 00 00 00 01 00 02 DA 77
				15 00 00 00 01 00 02 DB 03
				15 00 00 00 01 00 02 DC 84
				15 00 00 00 01 00 02 DD 03
				15 00 00 00 01 00 02 DE 91
				15 00 00 00 01 00 02 DF 03
				15 00 00 00 01 00 02 E0 9D
				15 00 00 00 01 00 02 E1 03
				15 00 00 00 01 00 02 E2 A7
				15 00 00 00 01 00 02 E3 03
				15 00 00 00 01 00 02 E4 AF
				15 00 00 00 01 00 02 E5 03
				15 00 00 00 01 00 02 E6 B4
				15 00 00 00 01 00 02 E7 03
				15 00 00 00 01 00 02 E8 B6
				15 00 00 00 01 00 02 E9 03
				15 00 00 00 01 00 02 EA FF
				15 00 00 00 01 00 02 FB 01
				15 01 00 00 01 00 02 FF 10
				];
		qcom,mdss-dsi-dispparam-papermode6-state = "dsi_hs_mode";
		qcom,mdss-dsi-dispparam-papermode7-command = [
				15 01 00 00 78 00 02 FF 20
				15 00 00 00 01 00 02 FB 01
				15 00 00 00 01 00 02 75 01
				15 00 00 00 01 00 02 76 60
				15 00 00 00 01 00 02 77 01
				15 00 00 00 01 00 02 78 63
				15 00 00 00 01 00 02 79 01
				15 00 00 00 01 00 02 7A 68
				15 00 00 00 01 00 02 7B 01
				15 00 00 00 01 00 02 7C 6E
				15 00 00 00 01 00 02 7D 01
				15 00 00 00 01 00 02 7E 73
				15 00 00 00 01 00 02 7F 01
				15 00 00 00 01 00 02 80 78
				15 00 00 00 01 00 02 81 01
				15 00 00 00 01 00 02 82 7D
				15 00 00 00 01 00 02 83 01
				15 00 00 00 01 00 02 84 82
				15 00 00 00 01 00 02 85 01
				15 00 00 00 01 00 02 86 87
				15 00 00 00 01 00 02 87 01
				15 00 00 00 01 00 02 88 99
				15 00 00 00 01 00 02 89 01
				15 00 00 00 01 00 02 8A AA
				15 00 00 00 01 00 02 8B 01
				15 00 00 00 01 00 02 8C C9
				15 00 00 00 01 00 02 8D 01
				15 00 00 00 01 00 02 8E E5
				15 00 00 00 01 00 02 8F 02
				15 00 00 00 01 00 02 90 0C
				15 00 00 00 01 00 02 91 02
				15 00 00 00 01 00 02 92 31
				15 00 00 00 01 00 02 93 02
				15 00 00 00 01 00 02 94 33
				15 00 00 00 01 00 02 95 02
				15 00 00 00 01 00 02 96 60
				15 00 00 00 01 00 02 97 02
				15 00 00 00 01 00 02 98 9B
				15 00 00 00 01 00 02 99 02
				15 00 00 00 01 00 02 9A C4
				15 00 00 00 01 00 02 9B 02
				15 00 00 00 01 00 02 9C FA
				15 00 00 00 01 00 02 9D 03
				15 00 00 00 01 00 02 9E 17
				15 00 00 00 01 00 02 9F 03
				15 00 00 00 01 00 02 A0 4E
				15 00 00 00 01 00 02 A2 03
				15 00 00 00 01 00 02 A3 60
				15 00 00 00 01 00 02 A4 03
				15 00 00 00 01 00 02 A5 73
				15 00 00 00 01 00 02 A6 03
				15 00 00 00 01 00 02 A7 86
				15 00 00 00 01 00 02 A9 03
				15 00 00 00 01 00 02 AA 98
				15 00 00 00 01 00 02 AB 03
				15 00 00 00 01 00 02 AC A7
				15 00 00 00 01 00 02 AD 03
				15 00 00 00 01 00 02 AE B1
				15 00 00 00 01 00 02 AF 03
				15 00 00 00 01 00 02 B0 B6
				15 00 00 00 01 00 02 B1 03
				15 00 00 00 01 00 02 B2 FF
				15 00 00 00 01 00 02 B3 01
				15 00 00 00 01 00 02 B4 60
				15 00 00 00 01 00 02 B5 01
				15 00 00 00 01 00 02 B6 63
				15 00 00 00 01 00 02 B7 01
				15 00 00 00 01 00 02 B8 68
				15 00 00 00 01 00 02 B9 01
				15 00 00 00 01 00 02 BA 6E
				15 00 00 00 01 00 02 BB 01
				15 00 00 00 01 00 02 BC 73
				15 00 00 00 01 00 02 BD 01
				15 00 00 00 01 00 02 BE 78
				15 00 00 00 01 00 02 BF 01
				15 00 00 00 01 00 02 C0 7D
				15 00 00 00 01 00 02 C1 01
				15 00 00 00 01 00 02 C2 82
				15 00 00 00 01 00 02 C3 01
				15 00 00 00 01 00 02 C4 87
				15 00 00 00 01 00 02 C5 01
				15 00 00 00 01 00 02 C6 99
				15 00 00 00 01 00 02 C7 01
				15 00 00 00 01 00 02 C8 AA
				15 00 00 00 01 00 02 C9 01
				15 00 00 00 01 00 02 CA C9
				15 00 00 00 01 00 02 CB 01
				15 00 00 00 01 00 02 CC E5
				15 00 00 00 01 00 02 CD 02
				15 00 00 00 01 00 02 CE 0C
				15 00 00 00 01 00 02 CF 02
				15 00 00 00 01 00 02 D0 31
				15 00 00 00 01 00 02 D1 02
				15 00 00 00 01 00 02 D2 33
				15 00 00 00 01 00 02 D3 02
				15 00 00 00 01 00 02 D4 60
				15 00 00 00 01 00 02 D5 02
				15 00 00 00 01 00 02 D6 9B
				15 00 00 00 01 00 02 D7 02
				15 00 00 00 01 00 02 D8 C4
				15 00 00 00 01 00 02 D9 02
				15 00 00 00 01 00 02 DA FA
				15 00 00 00 01 00 02 DB 03
				15 00 00 00 01 00 02 DC 17
				15 00 00 00 01 00 02 DD 03
				15 00 00 00 01 00 02 DE 4E
				15 00 00 00 01 00 02 DF 03
				15 00 00 00 01 00 02 E0 60
				15 00 00 00 01 00 02 E1 03
				15 00 00 00 01 00 02 E2 73
				15 00 00 00 01 00 02 E3 03
				15 00 00 00 01 00 02 E4 86
				15 00 00 00 01 00 02 E5 03
				15 00 00 00 01 00 02 E6 98
				15 00 00 00 01 00 02 E7 03
				15 00 00 00 01 00 02 E8 A7
				15 00 00 00 01 00 02 E9 03
				15 00 00 00 01 00 02 EA B1
				15 00 00 00 01 00 02 EB 03
				15 00 00 00 01 00 02 EC B6
				15 00 00 00 01 00 02 ED 03
				15 00 00 00 01 00 02 EE FF
				15 00 00 00 01 00 02 EF 01
				15 00 00 00 01 00 02 F0 6A
				15 00 00 00 01 00 02 F1 01
				15 00 00 00 01 00 02 F2 6D
				15 00 00 00 01 00 02 F3 01
				15 00 00 00 01 00 02 F4 72
				15 00 00 00 01 00 02 F5 01
				15 00 00 00 01 00 02 F6 77
				15 00 00 00 01 00 02 F7 01
				15 00 00 00 01 00 02 F8 7C
				15 00 00 00 01 00 02 F9 01
				15 00 00 00 01 00 02 FA 81
				15 00 00 00 01 00 02 FF 21
				15 00 00 00 01 00 02 FB 01
				15 00 00 00 01 00 02 00 01
				15 00 00 00 01 00 02 01 86
				15 00 00 00 01 00 02 02 01
				15 00 00 00 01 00 02 03 8A
				15 00 00 00 01 00 02 04 01
				15 00 00 00 01 00 02 05 8F
				15 00 00 00 01 00 02 06 01
				15 00 00 00 01 00 02 07 A0
				15 00 00 00 01 00 02 08 01
				15 00 00 00 01 00 02 09 B0
				15 00 00 00 01 00 02 0A 01
				15 00 00 00 01 00 02 0B CE
				15 00 00 00 01 00 02 0C 01
				15 00 00 00 01 00 02 0D EA
				15 00 00 00 01 00 02 0E 02
				15 00 00 00 01 00 02 0F 0F
				15 00 00 00 01 00 02 10 02
				15 00 00 00 01 00 02 11 34
				15 00 00 00 01 00 02 12 02
				15 00 00 00 01 00 02 13 35
				15 00 00 00 01 00 02 14 02
				15 00 00 00 01 00 02 15 62
				15 00 00 00 01 00 02 16 02
				15 00 00 00 01 00 02 17 9E
				15 00 00 00 01 00 02 18 02
				15 00 00 00 01 00 02 19 C6
				15 00 00 00 01 00 02 1A 02
				15 00 00 00 01 00 02 1B FA
				15 00 00 00 01 00 02 1C 03
				15 00 00 00 01 00 02 1D 16
				15 00 00 00 01 00 02 1E 03
				15 00 00 00 01 00 02 1F 48
				15 00 00 00 01 00 02 20 03
				15 00 00 00 01 00 02 21 57
				15 00 00 00 01 00 02 22 03
				15 00 00 00 01 00 02 23 68
				15 00 00 00 01 00 02 24 03
				15 00 00 00 01 00 02 25 7B
				15 00 00 00 01 00 02 26 03
				15 00 00 00 01 00 02 27 91
				15 00 00 00 01 00 02 28 03
				15 00 00 00 01 00 02 29 A9
				15 00 00 00 01 00 02 2A 03
				15 00 00 00 01 00 02 2B BF
				15 00 00 00 01 00 02 2D 03
				15 00 00 00 01 00 02 2F CC
				15 00 00 00 01 00 02 30 03
				15 00 00 00 01 00 02 31 FF
				15 00 00 00 01 00 02 32 01
				15 00 00 00 01 00 02 33 6A
				15 00 00 00 01 00 02 34 01
				15 00 00 00 01 00 02 35 6D
				15 00 00 00 01 00 02 36 01
				15 00 00 00 01 00 02 37 72
				15 00 00 00 01 00 02 38 01
				15 00 00 00 01 00 02 39 77
				15 00 00 00 01 00 02 3A 01
				15 00 00 00 01 00 02 3B 7C
				15 00 00 00 01 00 02 3D 01
				15 00 00 00 01 00 02 3F 81
				15 00 00 00 01 00 02 40 01
				15 00 00 00 01 00 02 41 86
				15 00 00 00 01 00 02 42 01
				15 00 00 00 01 00 02 43 8A
				15 00 00 00 01 00 02 44 01
				15 00 00 00 01 00 02 45 8F
				15 00 00 00 01 00 02 46 01
				15 00 00 00 01 00 02 47 A0
				15 00 00 00 01 00 02 48 01
				15 00 00 00 01 00 02 49 B0
				15 00 00 00 01 00 02 4A 01
				15 00 00 00 01 00 02 4B CE
				15 00 00 00 01 00 02 4C 01
				15 00 00 00 01 00 02 4D EA
				15 00 00 00 01 00 02 4E 02
				15 00 00 00 01 00 02 4F 0F
				15 00 00 00 01 00 02 50 02
				15 00 00 00 01 00 02 51 34
				15 00 00 00 01 00 02 52 02
				15 00 00 00 01 00 02 53 35
				15 00 00 00 01 00 02 54 02
				15 00 00 00 01 00 02 55 62
				15 00 00 00 01 00 02 56 02
				15 00 00 00 01 00 02 58 9E
				15 00 00 00 01 00 02 59 02
				15 00 00 00 01 00 02 5A C6
				15 00 00 00 01 00 02 5B 02
				15 00 00 00 01 00 02 5C FA
				15 00 00 00 01 00 02 5D 03
				15 00 00 00 01 00 02 5E 16
				15 00 00 00 01 00 02 5F 03
				15 00 00 00 01 00 02 60 48
				15 00 00 00 01 00 02 61 03
				15 00 00 00 01 00 02 62 57
				15 00 00 00 01 00 02 63 03
				15 00 00 00 01 00 02 64 68
				15 00 00 00 01 00 02 65 03
				15 00 00 00 01 00 02 66 7B
				15 00 00 00 01 00 02 67 03
				15 00 00 00 01 00 02 68 91
				15 00 00 00 01 00 02 69 03
				15 00 00 00 01 00 02 6A A9
				15 00 00 00 01 00 02 6B 03
				15 00 00 00 01 00 02 6C BF
				15 00 00 00 01 00 02 6D 03
				15 00 00 00 01 00 02 6E CC
				15 00 00 00 01 00 02 6F 03
				15 00 00 00 01 00 02 70 FF
				15 00 00 00 01 00 02 71 02
				15 00 00 00 01 00 02 72 01
				15 00 00 00 01 00 02 73 02
				15 00 00 00 01 00 02 74 02
				15 00 00 00 01 00 02 75 02
				15 00 00 00 01 00 02 76 03
				15 00 00 00 01 00 02 77 02
				15 00 00 00 01 00 02 78 04
				15 00 00 00 01 00 02 79 02
				15 00 00 00 01 00 02 7A 06
				15 00 00 00 01 00 02 7B 02
				15 00 00 00 01 00 02 7C 07
				15 00 00 00 01 00 02 7D 02
				15 00 00 00 01 00 02 7E 09
				15 00 00 00 01 00 02 7F 02
				15 00 00 00 01 00 02 80 0A
				15 00 00 00 01 00 02 81 02
				15 00 00 00 01 00 02 82 0C
				15 00 00 00 01 00 02 83 02
				15 00 00 00 01 00 02 84 11
				15 00 00 00 01 00 02 85 02
				15 00 00 00 01 00 02 86 17
				15 00 00 00 01 00 02 87 02
				15 00 00 00 01 00 02 88 24
				15 00 00 00 01 00 02 89 02
				15 00 00 00 01 00 02 8A 31
				15 00 00 00 01 00 02 8B 02
				15 00 00 00 01 00 02 8C 4E
				15 00 00 00 01 00 02 8D 02
				15 00 00 00 01 00 02 8E 6F
				15 00 00 00 01 00 02 8F 02
				15 00 00 00 01 00 02 90 70
				15 00 00 00 01 00 02 91 02
				15 00 00 00 01 00 02 92 9A
				15 00 00 00 01 00 02 93 02
				15 00 00 00 01 00 02 94 D3
				15 00 00 00 01 00 02 95 02
				15 00 00 00 01 00 02 96 F8
				15 00 00 00 01 00 02 97 03
				15 00 00 00 01 00 02 98 24
				15 00 00 00 01 00 02 99 03
				15 00 00 00 01 00 02 9A 4B
				15 00 00 00 01 00 02 9B 03
				15 00 00 00 01 00 02 9C 7C
				15 00 00 00 01 00 02 9D 03
				15 00 00 00 01 00 02 9E 89
				15 00 00 00 01 00 02 9F 03
				15 00 00 00 01 00 02 A0 95
				15 00 00 00 01 00 02 A2 03
				15 00 00 00 01 00 02 A3 A0
				15 00 00 00 01 00 02 A4 03
				15 00 00 00 01 00 02 A5 A9
				15 00 00 00 01 00 02 A6 03
				15 00 00 00 01 00 02 A7 B0
				15 00 00 00 01 00 02 A9 03
				15 00 00 00 01 00 02 AA B4
				15 00 00 00 01 00 02 AB 03
				15 00 00 00 01 00 02 AC B6
				15 00 00 00 01 00 02 AD 03
				15 00 00 00 01 00 02 AE FF
				15 00 00 00 01 00 02 AF 02
				15 00 00 00 01 00 02 B0 01
				15 00 00 00 01 00 02 B1 02
				15 00 00 00 01 00 02 B2 02
				15 00 00 00 01 00 02 B3 02
				15 00 00 00 01 00 02 B4 03
				15 00 00 00 01 00 02 B5 02
				15 00 00 00 01 00 02 B6 04
				15 00 00 00 01 00 02 B7 02
				15 00 00 00 01 00 02 B8 06
				15 00 00 00 01 00 02 B9 02
				15 00 00 00 01 00 02 BA 07
				15 00 00 00 01 00 02 BB 02
				15 00 00 00 01 00 02 BC 09
				15 00 00 00 01 00 02 BD 02
				15 00 00 00 01 00 02 BE 0A
				15 00 00 00 01 00 02 BF 02
				15 00 00 00 01 00 02 C0 0C
				15 00 00 00 01 00 02 C1 02
				15 00 00 00 01 00 02 C2 11
				15 00 00 00 01 00 02 C3 02
				15 00 00 00 01 00 02 C4 17
				15 00 00 00 01 00 02 C5 02
				15 00 00 00 01 00 02 C6 24
				15 00 00 00 01 00 02 C7 02
				15 00 00 00 01 00 02 C8 31
				15 00 00 00 01 00 02 C9 02
				15 00 00 00 01 00 02 CA 4E
				15 00 00 00 01 00 02 CB 02
				15 00 00 00 01 00 02 CC 6F
				15 00 00 00 01 00 02 CD 02
				15 00 00 00 01 00 02 CE 70
				15 00 00 00 01 00 02 CF 02
				15 00 00 00 01 00 02 D0 9A
				15 00 00 00 01 00 02 D1 02
				15 00 00 00 01 00 02 D2 D3
				15 00 00 00 01 00 02 D3 02
				15 00 00 00 01 00 02 D4 F8
				15 00 00 00 01 00 02 D5 03
				15 00 00 00 01 00 02 D6 24
				15 00 00 00 01 00 02 D7 03
				15 00 00 00 01 00 02 D8 4B
				15 00 00 00 01 00 02 D9 03
				15 00 00 00 01 00 02 DA 7C
				15 00 00 00 01 00 02 DB 03
				15 00 00 00 01 00 02 DC 89
				15 00 00 00 01 00 02 DD 03
				15 00 00 00 01 00 02 DE 95
				15 00 00 00 01 00 02 DF 03
				15 00 00 00 01 00 02 E0 A0
				15 00 00 00 01 00 02 E1 03
				15 00 00 00 01 00 02 E2 A9
				15 00 00 00 01 00 02 E3 03
				15 00 00 00 01 00 02 E4 B0
				15 00 00 00 01 00 02 E5 03
				15 00 00 00 01 00 02 E6 B4
				15 00 00 00 01 00 02 E7 03
				15 00 00 00 01 00 02 E8 B6
				15 00 00 00 01 00 02 E9 03
				15 00 00 00 01 00 02 EA FF
				15 00 00 00 01 00 02 FB 01
				15 01 00 00 01 00 02 FF 10
				];
		qcom,mdss-dsi-dispparam-papermode7-state = "dsi_hs_mode";
		qcom,mdss-dsi-dispparam-level0-command = [
				15 01 00 00 10 00 02 FF 22
				15 01 00 00 10 00 02 56 00
				15 01 00 00 10 00 02 FF 10
				];
		qcom,mdss-dsi-dispparam-level1-command = [
				15 01 00 00 10 00 02 FF 22
				15 01 00 00 10 00 02 58 12
				15 01 00 00 10 00 02 59 0E
				15 01 00 00 10 00 02 56 01
				15 01 00 00 10 00 02 FF 10
				];
		qcom,mdss-dsi-dispparam-level2-command = [
				15 01 00 00 10 00 02 FF 22
				15 01 00 00 10 00 02 58 14
				15 01 00 00 10 00 02 59 0E
				15 01 00 00 10 00 02 56 01
				15 01 00 00 10 00 02 FF 10
				];
		qcom,mdss-dsi-dispparam-level3-command = [
				15 01 00 00 10 00 02 FF 22
				15 01 00 00 10 00 02 58 16
				15 01 00 00 10 00 02 59 0E
				15 01 00 00 10 00 02 56 01
				15 01 00 00 10 00 02 FF 10
				];
		qcom,mdss-dsi-dispparam-level4-command = [
				15 01 00 00 10 00 02 FF 22
				15 01 00 00 10 00 02 58 18
				15 01 00 00 10 00 02 59 0E
				15 01 00 00 10 00 02 56 01
				15 01 00 00 10 00 02 FF 10
				];
		qcom,mdss-dsi-dispparam-level5-command = [
				15 01 00 00 10 00 02 FF 22
				15 01 00 00 10 00 02 58 1A
				15 01 00 00 10 00 02 59 0E
				15 01 00 00 10 00 02 56 01
				15 01 00 00 10 00 02 FF 10
				];
		qcom,mdss-dsi-dispparam-level6-command = [
				15 01 00 00 10 00 02 FF 22
				15 01 00 00 10 00 02 58 1C
				15 01 00 00 10 00 02 59 0E
				15 01 00 00 10 00 02 56 01
				15 01 00 00 10 00 02 FF 10
				];
		qcom,mdss-dsi-dispparam-idleon-command = [
				15 01 00 00 10 00 02 FF 10
				15 01 00 00 10 00 02 39 00
				];
		qcom,mdss-dsi-dispparam-idleoff-command = [
				15 01 00 00 10 00 02 FF 10
				15 01 00 00 10 00 02 38 00
				];
		qcom,mdss-dsi-dispparam-test-command = [
				15 01 00 00 10 00 02 FF 20
				];
		qcom,mdss-dsi-dispparam-test-command-state = "dsi_hs_mode";
	};
};
