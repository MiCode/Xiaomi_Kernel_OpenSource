/* Copyright (c) 2013, The Linux Foundation. All rights reserved.
 * Copyright (C) 2015 XiaoMi, Inc.
 *
 * This program is free software; you can redistribute it and/or modify
 * it under the terms of the GNU General Public License version 2 and
 * only version 2 as published by the Free Software Foundation.
 *
 * This program is distributed in the hope that it will be useful,
 * but WITHOUT ANY WARRANTY; without even the implied warranty of
 * MERCHANTABILITY or FITNESS FOR A PARTICULAR PURPOSE.  See the
 * GNU General Public License for more details.
 */

/include/ "dsi-panel-hx8394a-720p-video.dtsi"
/include/ "dsi-panel-nt35590-720p-video.dtsi"
/include/ "dsi-panel-auo-nt35521-720p-video.dtsi"
/include/ "dsi-panel-boe-nt35521-720p-video.dtsi"
/include/ "dsi-panel-lgd-nt35521-720p-video.dtsi"
/include/ "dsi-panel-ebbg-nt35521-720p-video.dtsi"
/include/ "dsi-panel-sharp-r69339-720p-video.dtsi"
/include/ "dsi-panel-nt35596-1080p-video.dtsi"
/include/ "dsi-panel-nt35590-720p-cmd.dtsi"
/include/ "dsi-panel-ssd2080m-720p-video.dtsi"
/include/ "dsi-panel-auo-720p-video.dtsi"
/include/ "dsi-panel-jdi-1080p-video.dtsi"
/include/ "dsi-panel-sharp-R69431-720p-video.dtsi"
