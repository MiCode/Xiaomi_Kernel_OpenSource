/* Copyright (c) 2012-2013, The Linux Foundation. All rights reserved.
 * Copyright (C) 2017 XiaoMi, Inc.
 *
 * This program is free software; you can redistribute it and/or modify
 * it under the terms of the GNU General Public License version 2 and
 * only version 2 as published by the Free Software Foundation.
 *
 * This program is distributed in the hope that it will be useful,
 * but WITHOUT ANY WARRANTY; without even the implied warranty of
 * MERCHANTABILITY or FITNESS FOR A PARTICULAR PURPOSE.  See the
 * GNU General Public License for more details.
 */

/*---------------------------------------------------------------------------
 * This file is autogenerated file using gcdb parser. Please do not edit it.
 * Update input XML file to add a new entry or update variable in this file
 * VERSION = "1.0"
 *---------------------------------------------------------------------------*/
&soc {
	dsi_jdi_fhd_cmd: qcom,mdss_dsi_jdi_fhd_cmd {
		qcom,mdss-dsi-panel-name = "jdi fhd cmd mode dsi panel";
		qcom,mdss-dsi-panel-id = <2>;
		qcom,mdss-dsi-panel-controller = <&mdss_dsi0>;
		qcom,mdss-dsi-panel-type = "dsi_cmd_mode";
		qcom,mdss-dsi-panel-destination = "display_1";
		qcom,mdss-dsi-panel-framerate = <60>;
		qcom,mdss-dsi-virtual-channel-id = <0>;
		qcom,mdss-dsi-stream = <0>;
		qcom,mdss-dsi-panel-width = <1080>;
		qcom,mdss-dsi-panel-height = <1920>;
		qcom,mdss-dsi-h-front-porch = <80>;
		qcom,mdss-dsi-h-back-porch = <40>;
		qcom,mdss-dsi-h-pulse-width = <10>;
		qcom,mdss-dsi-h-sync-skew = <0>;
		qcom,mdss-dsi-v-back-porch = <4>;
		qcom,mdss-dsi-v-front-porch = <4>;
		qcom,mdss-dsi-v-pulse-width = <2>;
		qcom,mdss-dsi-h-left-border = <0>;
		qcom,mdss-dsi-h-right-border = <0>;
		qcom,mdss-dsi-v-top-border = <0>;
		qcom,mdss-dsi-v-bottom-border = <0>;
		qcom,mdss-dsi-bpp = <24>;
		qcom,mdss-dsi-color-order = <0>;
		qcom,mdss-dsi-underflow-color = <0xff>;
		qcom,mdss-dsi-border-color = <0>;
		qcom,mdss-dsi-on-command = [
				15 01 00 00 01 00 02 FF 10
				15 01 00 00 01 00 02 BB 10
				15 01 00 00 01 00 02 50 00
				15 00 00 00 01 00 02 FF 24
				15 00 00 00 01 00 02 E3 02
				15 00 00 00 01 00 02 C4 69
				15 00 00 00 01 00 02 C9 00
				15 01 00 00 01 00 02 FB 01
				15 00 00 00 01 00 02 FF 22
				15 00 00 00 01 00 02 FB 01
				15 00 00 00 01 00 02 00 28
				15 00 00 00 01 00 02 01 2C
				15 00 00 00 01 00 02 02 30
				15 00 00 00 01 00 02 03 34
				15 00 00 00 01 00 02 04 38
				15 00 00 00 01 00 02 05 3C
				15 00 00 00 01 00 02 06 40
				15 00 00 00 01 00 02 07 48
				15 00 00 00 01 00 02 08 4C
				15 00 00 00 01 00 02 09 50
				15 00 00 00 01 00 02 0A 58
				15 00 00 00 01 00 02 0B 60
				15 00 00 00 01 00 02 0C 60
				15 00 00 00 01 00 02 0D 58
				15 00 00 00 01 00 02 0E 50
				15 00 00 00 01 00 02 0F 48
				15 00 00 00 01 00 02 10 38
				15 00 00 00 01 00 02 11 28
				15 00 00 00 01 00 02 12 28
				15 00 00 00 01 00 02 13 28
				15 00 00 00 01 00 02 1B 00
				15 00 00 00 01 00 02 1C 00
				15 00 00 00 01 00 02 1D 00
				15 00 00 00 01 00 02 1E 00
				15 00 00 00 01 00 02 1F 00
				15 00 00 00 01 00 02 20 00
				15 00 00 00 01 00 02 21 00
				15 00 00 00 01 00 02 22 00
				15 00 00 00 01 00 02 23 00
				15 00 00 00 01 00 02 24 00
				15 00 00 00 01 00 02 25 00
				15 00 00 00 01 00 02 26 00
				15 00 00 00 01 00 02 27 00
				15 00 00 00 01 00 02 28 00
				15 00 00 00 01 00 02 29 00
				15 00 00 00 01 00 02 2A 00
				15 00 00 00 01 00 02 2B 00
				15 00 00 00 01 00 02 2F 00
				15 00 00 00 01 00 02 30 00
				15 00 00 00 01 00 02 31 00
				15 00 00 00 01 00 02 32 80
				15 00 00 00 01 00 02 33 80
				15 00 00 00 01 00 02 34 80
				15 00 00 00 01 00 02 35 82
				15 00 00 00 01 00 02 36 84
				15 00 00 00 01 00 02 37 86
				15 00 00 00 01 00 02 38 88
				15 00 00 00 01 00 02 39 8A
				15 00 00 00 01 00 02 3A 8C
				15 00 00 00 01 00 02 3B 8E
				15 00 00 00 01 00 02 3F 90
				15 00 00 00 01 00 02 40 92
				15 00 00 00 01 00 02 41 94
				15 00 00 00 01 00 02 42 94
				15 00 00 00 01 00 02 43 92
				15 00 00 00 01 00 02 44 90
				15 00 00 00 01 00 02 45 8E
				15 00 00 00 01 00 02 46 8C
				15 00 00 00 01 00 02 47 8A
				15 00 00 00 01 00 02 48 88
				15 00 00 00 01 00 02 49 86
				15 00 00 00 01 00 02 4A 84
				15 00 00 00 01 00 02 4B 82
				15 00 00 00 01 00 02 4C 80
				15 00 00 00 01 00 02 4D 08
				15 00 00 00 01 00 02 1A 00
				15 00 00 00 01 00 02 53 01
				15 00 00 00 01 00 02 54 01
				15 00 00 00 01 00 02 56 00
				15 00 00 00 01 00 02 64 2F
				15 01 00 00 01 00 02 68 00
				15 01 00 00 01 00 02 FF 10
				15 01 00 00 01 00 02 35 00
				39 01 00 00 01 00 05 2A 00 00 04 37
				39 01 00 00 01 00 05 2B 00 00 07 7F
				15 01 00 00 01 00 02 51 de
				15 01 00 00 01 00 02 53 2c
				15 01 00 00 01 00 02 55 80
				05 01 00 00 78 00 02 11 00
				15 01 00 00 01 00 02 FF 10
				05 01 00 00 64 00 02 29 00];
		qcom,mdss-dsi-off-command = [
				15 01 00 00 00 00 02 FF 10
				05 01 00 00 32 00 02 28 00
				05 01 00 00 78 00 02 10 00];
		qcom,mdss-dsi-on-command-state = "dsi_lp_mode";
		qcom,mdss-dsi-off-command-state = "dsi_hs_mode";
		qcom,mdss-dsi-h-sync-pulse = <0>;
		qcom,mdss-dsi-traffic-mode = "burst_mode";
		qcom,mdss-dsi-lane-map = "lane_map_0123";
		qcom,mdss-dsi-bllp-eof-power-mode;
		qcom,mdss-dsi-bllp-power-mode;
		qcom,mdss-dsi-lane-0-state;
		qcom,mdss-dsi-lane-1-state;
		qcom,mdss-dsi-lane-2-state;
		qcom,mdss-dsi-lane-3-state;
		qcom,mdss-dsi-te-pin-select = <1>;
		qcom,mdss-dsi-te-v-sync-rd-ptr-irq-line = <0x2c>;
		qcom,mdss-dsi-te-v-sync-continues-lines = <0x3c>;
		qcom,mdss-dsi-te-dcs-command = <1>;
		qcom,mdss-dsi-te-check-enable;
		qcom,mdss-dsi-te-using-te-pin;
		qcom,mdss-dsi-panel-timings = [e3 50 36 00 a9 a3 3a 50 3d 03 04 00];
		qcom,mdss-dsi-t-clk-post = <0x20>;
		qcom,mdss-dsi-t-clk-pre = <0x36>;
		qcom,mdss-dsi-bl-min-level = <8>;
		qcom,mdss-dsi-bl-max-level = <4095>;
		qcom,mdss-dsi-dma-trigger = "trigger_sw";
		qcom,mdss-dsi-mdp-trigger = "none";
		qcom,mdss-dsi-bl-pmic-control-type = "bl_ctrl_wled";
		qcom,mdss-dsi-reset-sequence = <1 20>, <0 20>, <1 20>;
		qcom,mdss-pan-physical-width-dimension = <61>;
		qcom,mdss-pan-physical-height-dimension = <109>;
		qcom,dispparam-enabled;
		qcom,mdss-dsi-dispparam-cabcon-command = [
				15 00 00 00 01 00 02 FF 10
				15 01 00 00 01 00 02 55 82
				];
		qcom,mdss-dsi-dispparam-cabcguion-command = [
				15 00 00 00 01 00 02 FF 10
				15 01 00 00 01 00 02 55 81
				];
		qcom,mdss-dsi-dispparam-cabcstillon-command = [
				15 00 00 00 01 00 02 FF 10
				15 01 00 00 01 00 02 55 82
				];
		qcom,mdss-dsi-dispparam-cabcmovieon-command = [
				15 00 00 00 01 00 02 FF 10
				15 01 00 00 01 00 02 55 83
				];
		qcom,mdss-dsi-dispparam-cabcon-command-state = "dsi_hs_mode";
		qcom,mdss-dsi-dispparam-cabcoff-command = [
				15 00 00 00 01 00 02 FF 10
				15 01 00 00 01 00 02 55 80
				];
		qcom,mdss-dsi-dispparam-cabcoff-command-state = "dsi_hs_mode";
		qcom,mdss-dsi-dispparam-warm-command = [
				15 00 00 00 01 00 02 FF 20
				15 00 00 00 01 00 02 75 00
				15 00 00 00 01 00 02 76 00
				15 00 00 00 01 00 02 77 00
				15 00 00 00 01 00 02 78 0F
				15 00 00 00 01 00 02 79 00
				15 00 00 00 01 00 02 7A 2E
				15 00 00 00 01 00 02 7B 00
				15 00 00 00 01 00 02 7C 46
				15 00 00 00 01 00 02 7D 00
				15 00 00 00 01 00 02 7E 5B
				15 00 00 00 01 00 02 7F 00
				15 00 00 00 01 00 02 80 6E
				15 00 00 00 01 00 02 81 00
				15 00 00 00 01 00 02 82 80
				15 00 00 00 01 00 02 83 00
				15 00 00 00 01 00 02 84 8F
				15 00 00 00 01 00 02 85 00
				15 00 00 00 01 00 02 86 9F
				15 00 00 00 01 00 02 87 00
				15 00 00 00 01 00 02 88 D1
				15 00 00 00 01 00 02 89 00
				15 00 00 00 01 00 02 8A FA
				15 00 00 00 01 00 02 8B 01
				15 00 00 00 01 00 02 8C 3E
				15 00 00 00 01 00 02 8D 01
				15 00 00 00 01 00 02 8E 71
				15 00 00 00 01 00 02 8F 01
				15 00 00 00 01 00 02 90 B7
				15 00 00 00 01 00 02 91 01
				15 00 00 00 01 00 02 92 F1
				15 00 00 00 01 00 02 93 01
				15 00 00 00 01 00 02 94 F3
				15 00 00 00 01 00 02 95 02
				15 00 00 00 01 00 02 96 27
				15 00 00 00 01 00 02 97 02
				15 00 00 00 01 00 02 98 63
				15 00 00 00 01 00 02 99 02
				15 00 00 00 01 00 02 9A 8A
				15 00 00 00 01 00 02 9B 02
				15 00 00 00 01 00 02 9C C2
				15 00 00 00 01 00 02 9D 02
				15 00 00 00 01 00 02 9E EE
				15 00 00 00 01 00 02 9F 03
				15 00 00 00 01 00 02 A0 2D
				15 00 00 00 01 00 02 A2 03
				15 00 00 00 01 00 02 A3 41
				15 00 00 00 01 00 02 A4 03
				15 00 00 00 01 00 02 A5 57
				15 00 00 00 01 00 02 A6 03
				15 00 00 00 01 00 02 A7 70
				15 00 00 00 01 00 02 A9 03
				15 00 00 00 01 00 02 AA 8A
				15 00 00 00 01 00 02 AB 03
				15 00 00 00 01 00 02 AC A8
				15 00 00 00 01 00 02 AD 03
				15 00 00 00 01 00 02 AE C9
				15 00 00 00 01 00 02 AF 03
				15 00 00 00 01 00 02 B0 ED
				15 00 00 00 01 00 02 B1 03
				15 00 00 00 01 00 02 B2 FF
				15 00 00 00 01 00 02 B3 00
				15 00 00 00 01 00 02 B4 4A
				15 00 00 00 01 00 02 B5 00
				15 00 00 00 01 00 02 B6 58
				15 00 00 00 01 00 02 B7 00
				15 00 00 00 01 00 02 B8 74
				15 00 00 00 01 00 02 B9 00
				15 00 00 00 01 00 02 BA 89
				15 00 00 00 01 00 02 BB 00
				15 00 00 00 01 00 02 BC 9C
				15 00 00 00 01 00 02 BD 00
				15 00 00 00 01 00 02 BE AC
				15 00 00 00 01 00 02 BF 00
				15 00 00 00 01 00 02 C0 BB
				15 00 00 00 01 00 02 C1 00
				15 00 00 00 01 00 02 C2 C7
				15 00 00 00 01 00 02 C3 00
				15 00 00 00 01 00 02 C4 D5
				15 00 00 00 01 00 02 C5 00
				15 00 00 00 01 00 02 C6 FC
				15 00 00 00 01 00 02 C7 01
				15 00 00 00 01 00 02 C8 1B
				15 00 00 00 01 00 02 C9 01
				15 00 00 00 01 00 02 CA 49
				15 00 00 00 01 00 02 CB 01
				15 00 00 00 01 00 02 CC 71
				15 00 00 00 01 00 02 CD 01
				15 00 00 00 01 00 02 CE B7
				15 00 00 00 01 00 02 CF 01
				15 00 00 00 01 00 02 D0 F1
				15 00 00 00 01 00 02 D1 01
				15 00 00 00 01 00 02 D2 F3
				15 00 00 00 01 00 02 D3 02
				15 00 00 00 01 00 02 D4 27
				15 00 00 00 01 00 02 D5 02
				15 00 00 00 01 00 02 D6 63
				15 00 00 00 01 00 02 D7 02
				15 00 00 00 01 00 02 D8 8A
				15 00 00 00 01 00 02 D9 02
				15 00 00 00 01 00 02 DA C2
				15 00 00 00 01 00 02 DB 02
				15 00 00 00 01 00 02 DC EE
				15 00 00 00 01 00 02 DD 03
				15 00 00 00 01 00 02 DE 2D
				15 00 00 00 01 00 02 DF 03
				15 00 00 00 01 00 02 E0 41
				15 00 00 00 01 00 02 E1 03
				15 00 00 00 01 00 02 E2 57
				15 00 00 00 01 00 02 E3 03
				15 00 00 00 01 00 02 E4 70
				15 00 00 00 01 00 02 E5 03
				15 00 00 00 01 00 02 E6 8A
				15 00 00 00 01 00 02 E7 03
				15 00 00 00 01 00 02 E8 A8
				15 00 00 00 01 00 02 E9 03
				15 00 00 00 01 00 02 EA C9
				15 00 00 00 01 00 02 EB 03
				15 00 00 00 01 00 02 EC ED
				15 00 00 00 01 00 02 ED 03
				15 00 00 00 01 00 02 EE FF
				15 00 00 00 01 00 02 EF 00
				15 00 00 00 01 00 02 F0 B5
				15 00 00 00 01 00 02 F1 00
				15 00 00 00 01 00 02 F2 BB
				15 00 00 00 01 00 02 F3 00
				15 00 00 00 01 00 02 F4 C5
				15 00 00 00 01 00 02 F5 00
				15 00 00 00 01 00 02 F6 D0
				15 00 00 00 01 00 02 F7 00
				15 00 00 00 01 00 02 F8 D9
				15 00 00 00 01 00 02 F9 00
				15 00 00 00 01 00 02 FA E3
				15 00 00 00 01 00 02 FB 01
				15 00 00 00 01 00 02 FF 21
				15 00 00 00 01 00 02 00 00
				15 00 00 00 01 00 02 01 EB
				15 00 00 00 01 00 02 02 00
				15 00 00 00 01 00 02 03 F5
				15 00 00 00 01 00 02 04 00
				15 00 00 00 01 00 02 05 FE
				15 00 00 00 01 00 02 06 01
				15 00 00 00 01 00 02 07 1D
				15 00 00 00 01 00 02 08 01
				15 00 00 00 01 00 02 09 3A
				15 00 00 00 01 00 02 0A 01
				15 00 00 00 01 00 02 0B 6C
				15 00 00 00 01 00 02 0C 01
				15 00 00 00 01 00 02 0D 93
				15 00 00 00 01 00 02 0E 01
				15 00 00 00 01 00 02 0F CE
				15 00 00 00 01 00 02 10 02
				15 00 00 00 01 00 02 11 01
				15 00 00 00 01 00 02 12 02
				15 00 00 00 01 00 02 13 02
				15 00 00 00 01 00 02 14 02
				15 00 00 00 01 00 02 15 33
				15 00 00 00 01 00 02 16 02
				15 00 00 00 01 00 02 17 6E
				15 00 00 00 01 00 02 18 02
				15 00 00 00 01 00 02 19 94
				15 00 00 00 01 00 02 1A 02
				15 00 00 00 01 00 02 1B CB
				15 00 00 00 01 00 02 1C 02
				15 00 00 00 01 00 02 1D F7
				15 00 00 00 01 00 02 1E 03
				15 00 00 00 01 00 02 1F 35
				15 00 00 00 01 00 02 20 03
				15 00 00 00 01 00 02 21 48
				15 00 00 00 01 00 02 22 03
				15 00 00 00 01 00 02 23 5E
				15 00 00 00 01 00 02 24 03
				15 00 00 00 01 00 02 25 75
				15 00 00 00 01 00 02 26 03
				15 00 00 00 01 00 02 27 8F
				15 00 00 00 01 00 02 28 03
				15 00 00 00 01 00 02 29 AB
				15 00 00 00 01 00 02 2A 03
				15 00 00 00 01 00 02 2B CB
				15 00 00 00 01 00 02 2D 03
				15 00 00 00 01 00 02 2F EE
				15 00 00 00 01 00 02 30 03
				15 00 00 00 01 00 02 31 FF
				15 00 00 00 01 00 02 32 00
				15 00 00 00 01 00 02 33 F2
				15 00 00 00 01 00 02 34 00
				15 00 00 00 01 00 02 35 F8
				15 00 00 00 01 00 02 36 00
				15 00 00 00 01 00 02 37 FF
				15 00 00 00 01 00 02 38 01
				15 00 00 00 01 00 02 39 08
				15 00 00 00 01 00 02 3A 01
				15 00 00 00 01 00 02 3B 0F
				15 00 00 00 01 00 02 3D 01
				15 00 00 00 01 00 02 3F 17
				15 00 00 00 01 00 02 40 01
				15 00 00 00 01 00 02 41 1C
				15 00 00 00 01 00 02 42 01
				15 00 00 00 01 00 02 43 24
				15 00 00 00 01 00 02 44 01
				15 00 00 00 01 00 02 45 2A
				15 00 00 00 01 00 02 46 01
				15 00 00 00 01 00 02 47 41
				15 00 00 00 01 00 02 48 01
				15 00 00 00 01 00 02 49 55
				15 00 00 00 01 00 02 4A 01
				15 00 00 00 01 00 02 4B 75
				15 00 00 00 01 00 02 4C 01
				15 00 00 00 01 00 02 4D 93
				15 00 00 00 01 00 02 4E 01
				15 00 00 00 01 00 02 4F CE
				15 00 00 00 01 00 02 50 02
				15 00 00 00 01 00 02 51 01
				15 00 00 00 01 00 02 52 02
				15 00 00 00 01 00 02 53 02
				15 00 00 00 01 00 02 54 02
				15 00 00 00 01 00 02 55 33
				15 00 00 00 01 00 02 56 02
				15 00 00 00 01 00 02 58 6E
				15 00 00 00 01 00 02 59 02
				15 00 00 00 01 00 02 5A 94
				15 00 00 00 01 00 02 5B 02
				15 00 00 00 01 00 02 5C CB
				15 00 00 00 01 00 02 5D 02
				15 00 00 00 01 00 02 5E F7
				15 00 00 00 01 00 02 5F 03
				15 00 00 00 01 00 02 60 35
				15 00 00 00 01 00 02 61 03
				15 00 00 00 01 00 02 62 48
				15 00 00 00 01 00 02 63 03
				15 00 00 00 01 00 02 64 5E
				15 00 00 00 01 00 02 65 03
				15 00 00 00 01 00 02 66 75
				15 00 00 00 01 00 02 67 03
				15 00 00 00 01 00 02 68 8F
				15 00 00 00 01 00 02 69 03
				15 00 00 00 01 00 02 6A AB
				15 00 00 00 01 00 02 6B 03
				15 00 00 00 01 00 02 6C CB
				15 00 00 00 01 00 02 6D 03
				15 00 00 00 01 00 02 6E EE
				15 00 00 00 01 00 02 6F 03
				15 00 00 00 01 00 02 70 FF
				15 00 00 00 01 00 02 71 00
				15 00 00 00 01 00 02 72 E0
				15 00 00 00 01 00 02 73 00
				15 00 00 00 01 00 02 74 E3
				15 00 00 00 01 00 02 75 00
				15 00 00 00 01 00 02 76 EC
				15 00 00 00 01 00 02 77 00
				15 00 00 00 01 00 02 78 F4
				15 00 00 00 01 00 02 79 00
				15 00 00 00 01 00 02 7A FB
				15 00 00 00 01 00 02 7B 01
				15 00 00 00 01 00 02 7C 02
				15 00 00 00 01 00 02 7D 01
				15 00 00 00 01 00 02 7E 0A
				15 00 00 00 01 00 02 7F 01
				15 00 00 00 01 00 02 80 12
				15 00 00 00 01 00 02 81 01
				15 00 00 00 01 00 02 82 1A
				15 00 00 00 01 00 02 83 01
				15 00 00 00 01 00 02 84 35
				15 00 00 00 01 00 02 85 01
				15 00 00 00 01 00 02 86 4D
				15 00 00 00 01 00 02 87 01
				15 00 00 00 01 00 02 88 7B
				15 00 00 00 01 00 02 89 01
				15 00 00 00 01 00 02 8A 9F
				15 00 00 00 01 00 02 8B 01
				15 00 00 00 01 00 02 8C D6
				15 00 00 00 01 00 02 8D 02
				15 00 00 00 01 00 02 8E 07
				15 00 00 00 01 00 02 8F 02
				15 00 00 00 01 00 02 90 08
				15 00 00 00 01 00 02 91 02
				15 00 00 00 01 00 02 92 38
				15 00 00 00 01 00 02 93 02
				15 00 00 00 01 00 02 94 72
				15 00 00 00 01 00 02 95 02
				15 00 00 00 01 00 02 96 99
				15 00 00 00 01 00 02 97 02
				15 00 00 00 01 00 02 98 D3
				15 00 00 00 01 00 02 99 02
				15 00 00 00 01 00 02 9A F8
				15 00 00 00 01 00 02 9B 03
				15 00 00 00 01 00 02 9C 33
				15 00 00 00 01 00 02 9D 03
				15 00 00 00 01 00 02 9E 46
				15 00 00 00 01 00 02 9F 03
				15 00 00 00 01 00 02 A0 5C
				15 00 00 00 01 00 02 A2 03
				15 00 00 00 01 00 02 A3 73
				15 00 00 00 01 00 02 A4 03
				15 00 00 00 01 00 02 A5 8D
				15 00 00 00 01 00 02 A6 03
				15 00 00 00 01 00 02 A7 A9
				15 00 00 00 01 00 02 A9 03
				15 00 00 00 01 00 02 AA CA
				15 00 00 00 01 00 02 AB 03
				15 00 00 00 01 00 02 AC EE
				15 00 00 00 01 00 02 AD 03
				15 00 00 00 01 00 02 AE FF
				15 00 00 00 01 00 02 AF 01
				15 00 00 00 01 00 02 B0 18
				15 00 00 00 01 00 02 B1 01
				15 00 00 00 01 00 02 B2 1B
				15 00 00 00 01 00 02 B3 01
				15 00 00 00 01 00 02 B4 21
				15 00 00 00 01 00 02 B5 01
				15 00 00 00 01 00 02 B6 27
				15 00 00 00 01 00 02 B7 01
				15 00 00 00 01 00 02 B8 2D
				15 00 00 00 01 00 02 B9 01
				15 00 00 00 01 00 02 BA 31
				15 00 00 00 01 00 02 BB 01
				15 00 00 00 01 00 02 BC 37
				15 00 00 00 01 00 02 BD 01
				15 00 00 00 01 00 02 BE 3D
				15 00 00 00 01 00 02 BF 01
				15 00 00 00 01 00 02 C0 43
				15 00 00 00 01 00 02 C1 01
				15 00 00 00 01 00 02 C2 56
				15 00 00 00 01 00 02 C3 01
				15 00 00 00 01 00 02 C4 66
				15 00 00 00 01 00 02 C5 01
				15 00 00 00 01 00 02 C6 83
				15 00 00 00 01 00 02 C7 01
				15 00 00 00 01 00 02 C8 9F
				15 00 00 00 01 00 02 C9 01
				15 00 00 00 01 00 02 CA D6
				15 00 00 00 01 00 02 CB 02
				15 00 00 00 01 00 02 CC 07
				15 00 00 00 01 00 02 CD 02
				15 00 00 00 01 00 02 CE 08
				15 00 00 00 01 00 02 CF 02
				15 00 00 00 01 00 02 D0 38
				15 00 00 00 01 00 02 D1 02
				15 00 00 00 01 00 02 D2 72
				15 00 00 00 01 00 02 D3 02
				15 00 00 00 01 00 02 D4 99
				15 00 00 00 01 00 02 D5 02
				15 00 00 00 01 00 02 D6 D3
				15 00 00 00 01 00 02 D7 02
				15 00 00 00 01 00 02 D8 F8
				15 00 00 00 01 00 02 D9 03
				15 00 00 00 01 00 02 DA 33
				15 00 00 00 01 00 02 DB 03
				15 00 00 00 01 00 02 DC 46
				15 00 00 00 01 00 02 DD 03
				15 00 00 00 01 00 02 DE 5C
				15 00 00 00 01 00 02 DF 03
				15 00 00 00 01 00 02 E0 73
				15 00 00 00 01 00 02 E1 03
				15 00 00 00 01 00 02 E2 8D
				15 00 00 00 01 00 02 E3 03
				15 00 00 00 01 00 02 E4 A9
				15 00 00 00 01 00 02 E5 03
				15 00 00 00 01 00 02 E6 CA
				15 00 00 00 01 00 02 E7 03
				15 00 00 00 01 00 02 E8 EE
				15 00 00 00 01 00 02 E9 03
				15 00 00 00 01 00 02 EA FF
				15 00 00 00 01 00 02 EB 30
				15 00 00 00 01 00 02 EC 17
				15 00 00 00 01 00 02 ED 20
				15 00 00 00 01 00 02 EE 0F
				15 00 00 00 01 00 02 EF 1F
				15 00 00 00 01 00 02 F0 0F
				15 00 00 00 01 00 02 F1 0F
				15 00 00 00 01 00 02 F2 07
				15 00 00 00 01 00 02 FB 01
				15 01 00 00 01 00 02 FF 10
				];
		qcom,mdss-dsi-dispparam-warm-command-state = "dsi_hs_mode";
		qcom,mdss-dsi-dispparam-default-command = [
				15 00 00 00 01 00 02 FF 20
				15 00 00 00 01 00 02 FB 00
				15 00 00 00 01 00 02 FF 21
				15 00 00 00 01 00 02 FB 00
				15 00 00 00 01 00 02 FF 10
				05 01 00 00 10 00 02 11 00
				];
		qcom,mdss-dsi-dispparam-default-command-state = "dsi_hs_mode";
		qcom,mdss-dsi-dispparam-cold-command = [
				15 00 00 00 01 00 02 FF 20
				15 00 00 00 01 00 02 75 00
				15 00 00 00 01 00 02 76 41
				15 00 00 00 01 00 02 77 00
				15 00 00 00 01 00 02 78 4C
				15 00 00 00 01 00 02 79 00
				15 00 00 00 01 00 02 7A 63
				15 00 00 00 01 00 02 7B 00
				15 00 00 00 01 00 02 7C 76
				15 00 00 00 01 00 02 7D 00
				15 00 00 00 01 00 02 7E 87
				15 00 00 00 01 00 02 7F 00
				15 00 00 00 01 00 02 80 96
				15 00 00 00 01 00 02 81 00
				15 00 00 00 01 00 02 82 A6
				15 00 00 00 01 00 02 83 00
				15 00 00 00 01 00 02 84 B3
				15 00 00 00 01 00 02 85 00
				15 00 00 00 01 00 02 86 BF
				15 00 00 00 01 00 02 87 00
				15 00 00 00 01 00 02 88 ED
				15 00 00 00 01 00 02 89 01
				15 00 00 00 01 00 02 8A 13
				15 00 00 00 01 00 02 8B 01
				15 00 00 00 01 00 02 8C 53
				15 00 00 00 01 00 02 8D 01
				15 00 00 00 01 00 02 8E 84
				15 00 00 00 01 00 02 8F 01
				15 00 00 00 01 00 02 90 C8
				15 00 00 00 01 00 02 91 02
				15 00 00 00 01 00 02 92 00
				15 00 00 00 01 00 02 93 02
				15 00 00 00 01 00 02 94 02
				15 00 00 00 01 00 02 95 02
				15 00 00 00 01 00 02 96 37
				15 00 00 00 01 00 02 97 02
				15 00 00 00 01 00 02 98 76
				15 00 00 00 01 00 02 99 02
				15 00 00 00 01 00 02 9A 9E
				15 00 00 00 01 00 02 9B 02
				15 00 00 00 01 00 02 9C DC
				15 00 00 00 01 00 02 9D 03
				15 00 00 00 01 00 02 9E 06
				15 00 00 00 01 00 02 9F 03
				15 00 00 00 01 00 02 A0 43
				15 00 00 00 01 00 02 A2 03
				15 00 00 00 01 00 02 A3 55
				15 00 00 00 01 00 02 A4 03
				15 00 00 00 01 00 02 A5 6A
				15 00 00 00 01 00 02 A6 03
				15 00 00 00 01 00 02 A7 81
				15 00 00 00 01 00 02 A9 03
				15 00 00 00 01 00 02 AA 98
				15 00 00 00 01 00 02 AB 03
				15 00 00 00 01 00 02 AC B3
				15 00 00 00 01 00 02 AD 03
				15 00 00 00 01 00 02 AE D0
				15 00 00 00 01 00 02 AF 03
				15 00 00 00 01 00 02 B0 F0
				15 00 00 00 01 00 02 B1 03
				15 00 00 00 01 00 02 B2 FF
				15 00 00 00 01 00 02 B3 00
				15 00 00 00 01 00 02 B4 88
				15 00 00 00 01 00 02 B5 00
				15 00 00 00 01 00 02 B6 92
				15 00 00 00 01 00 02 B7 00
				15 00 00 00 01 00 02 B8 A6
				15 00 00 00 01 00 02 B9 00
				15 00 00 00 01 00 02 BA B6
				15 00 00 00 01 00 02 BB 00
				15 00 00 00 01 00 02 BC C5
				15 00 00 00 01 00 02 BD 00
				15 00 00 00 01 00 02 BE D1
				15 00 00 00 01 00 02 BF 00
				15 00 00 00 01 00 02 C0 DF
				15 00 00 00 01 00 02 C1 00
				15 00 00 00 01 00 02 C2 E9
				15 00 00 00 01 00 02 C3 00
				15 00 00 00 01 00 02 C4 F3
				15 00 00 00 01 00 02 C5 01
				15 00 00 00 01 00 02 C6 16
				15 00 00 00 01 00 02 C7 01
				15 00 00 00 01 00 02 C8 32
				15 00 00 00 01 00 02 C9 01
				15 00 00 00 01 00 02 CA 5E
				15 00 00 00 01 00 02 CB 01
				15 00 00 00 01 00 02 CC 84
				15 00 00 00 01 00 02 CD 01
				15 00 00 00 01 00 02 CE C8
				15 00 00 00 01 00 02 CF 02
				15 00 00 00 01 00 02 D0 00
				15 00 00 00 01 00 02 D1 02
				15 00 00 00 01 00 02 D2 02
				15 00 00 00 01 00 02 D3 02
				15 00 00 00 01 00 02 D4 37
				15 00 00 00 01 00 02 D5 02
				15 00 00 00 01 00 02 D6 76
				15 00 00 00 01 00 02 D7 02
				15 00 00 00 01 00 02 D8 9E
				15 00 00 00 01 00 02 D9 02
				15 00 00 00 01 00 02 DA DC
				15 00 00 00 01 00 02 DB 03
				15 00 00 00 01 00 02 DC 06
				15 00 00 00 01 00 02 DD 03
				15 00 00 00 01 00 02 DE 43
				15 00 00 00 01 00 02 DF 03
				15 00 00 00 01 00 02 E0 55
				15 00 00 00 01 00 02 E1 03
				15 00 00 00 01 00 02 E2 6A
				15 00 00 00 01 00 02 E3 03
				15 00 00 00 01 00 02 E4 81
				15 00 00 00 01 00 02 E5 03
				15 00 00 00 01 00 02 E6 98
				15 00 00 00 01 00 02 E7 03
				15 00 00 00 01 00 02 E8 B3
				15 00 00 00 01 00 02 E9 03
				15 00 00 00 01 00 02 EA D0
				15 00 00 00 01 00 02 EB 03
				15 00 00 00 01 00 02 EC F0
				15 00 00 00 01 00 02 ED 03
				15 00 00 00 01 00 02 EE FF
				15 00 00 00 01 00 02 EF 00
				15 00 00 00 01 00 02 F0 68
				15 00 00 00 01 00 02 F1 00
				15 00 00 00 01 00 02 F2 70
				15 00 00 00 01 00 02 F3 00
				15 00 00 00 01 00 02 F4 82
				15 00 00 00 01 00 02 F5 00
				15 00 00 00 01 00 02 F6 92
				15 00 00 00 01 00 02 F7 00
				15 00 00 00 01 00 02 F8 A1
				15 00 00 00 01 00 02 F9 00
				15 00 00 00 01 00 02 FA AE
				15 00 00 00 01 00 02 FB 01
				15 00 00 00 01 00 02 FF 21
				15 00 00 00 01 00 02 00 00
				15 00 00 00 01 00 02 01 BB
				15 00 00 00 01 00 02 02 00
				15 00 00 00 01 00 02 03 C7
				15 00 00 00 01 00 02 04 00
				15 00 00 00 01 00 02 05 D3
				15 00 00 00 01 00 02 06 00
				15 00 00 00 01 00 02 07 FC
				15 00 00 00 01 00 02 08 01
				15 00 00 00 01 00 02 09 20
				15 00 00 00 01 00 02 0A 01
				15 00 00 00 01 00 02 0B 5D
				15 00 00 00 01 00 02 0C 01
				15 00 00 00 01 00 02 0D 8B
				15 00 00 00 01 00 02 0E 01
				15 00 00 00 01 00 02 0F CD
				15 00 00 00 01 00 02 10 02
				15 00 00 00 01 00 02 11 04
				15 00 00 00 01 00 02 12 02
				15 00 00 00 01 00 02 13 05
				15 00 00 00 01 00 02 14 02
				15 00 00 00 01 00 02 15 3A
				15 00 00 00 01 00 02 16 02
				15 00 00 00 01 00 02 17 79
				15 00 00 00 01 00 02 18 02
				15 00 00 00 01 00 02 19 A1
				15 00 00 00 01 00 02 1A 02
				15 00 00 00 01 00 02 1B E0
				15 00 00 00 01 00 02 1C 03
				15 00 00 00 01 00 02 1D 0B
				15 00 00 00 01 00 02 1E 03
				15 00 00 00 01 00 02 1F 47
				15 00 00 00 01 00 02 20 03
				15 00 00 00 01 00 02 21 59
				15 00 00 00 01 00 02 22 03
				15 00 00 00 01 00 02 23 6D
				15 00 00 00 01 00 02 24 03
				15 00 00 00 01 00 02 25 84
				15 00 00 00 01 00 02 26 03
				15 00 00 00 01 00 02 27 9B
				15 00 00 00 01 00 02 28 03
				15 00 00 00 01 00 02 29 B5
				15 00 00 00 01 00 02 2A 03
				15 00 00 00 01 00 02 2B D1
				15 00 00 00 01 00 02 2D 03
				15 00 00 00 01 00 02 2F F0
				15 00 00 00 01 00 02 30 03
				15 00 00 00 01 00 02 31 FF
				15 00 00 00 01 00 02 32 00
				15 00 00 00 01 00 02 33 AC
				15 00 00 00 01 00 02 34 00
				15 00 00 00 01 00 02 35 B4
				15 00 00 00 01 00 02 36 00
				15 00 00 00 01 00 02 37 C3
				15 00 00 00 01 00 02 38 00
				15 00 00 00 01 00 02 39 D0
				15 00 00 00 01 00 02 3A 00
				15 00 00 00 01 00 02 3B DD
				15 00 00 00 01 00 02 3D 00
				15 00 00 00 01 00 02 3F E7
				15 00 00 00 01 00 02 40 00
				15 00 00 00 01 00 02 41 F2
				15 00 00 00 01 00 02 42 00
				15 00 00 00 01 00 02 43 FB
				15 00 00 00 01 00 02 44 01
				15 00 00 00 01 00 02 45 04
				15 00 00 00 01 00 02 46 01
				15 00 00 00 01 00 02 47 24
				15 00 00 00 01 00 02 48 01
				15 00 00 00 01 00 02 49 3E
				15 00 00 00 01 00 02 4A 01
				15 00 00 00 01 00 02 4B 67
				15 00 00 00 01 00 02 4C 01
				15 00 00 00 01 00 02 4D 8B
				15 00 00 00 01 00 02 4E 01
				15 00 00 00 01 00 02 4F CD
				15 00 00 00 01 00 02 50 02
				15 00 00 00 01 00 02 51 04
				15 00 00 00 01 00 02 52 02
				15 00 00 00 01 00 02 53 05
				15 00 00 00 01 00 02 54 02
				15 00 00 00 01 00 02 55 3A
				15 00 00 00 01 00 02 56 02
				15 00 00 00 01 00 02 58 79
				15 00 00 00 01 00 02 59 02
				15 00 00 00 01 00 02 5A A1
				15 00 00 00 01 00 02 5B 02
				15 00 00 00 01 00 02 5C E0
				15 00 00 00 01 00 02 5D 03
				15 00 00 00 01 00 02 5E 0B
				15 00 00 00 01 00 02 5F 03
				15 00 00 00 01 00 02 60 47
				15 00 00 00 01 00 02 61 03
				15 00 00 00 01 00 02 62 59
				15 00 00 00 01 00 02 63 03
				15 00 00 00 01 00 02 64 6D
				15 00 00 00 01 00 02 65 03
				15 00 00 00 01 00 02 66 84
				15 00 00 00 01 00 02 67 03
				15 00 00 00 01 00 02 68 9B
				15 00 00 00 01 00 02 69 03
				15 00 00 00 01 00 02 6A B5
				15 00 00 00 01 00 02 6B 03
				15 00 00 00 01 00 02 6C D1
				15 00 00 00 01 00 02 6D 03
				15 00 00 00 01 00 02 6E F0
				15 00 00 00 01 00 02 6F 03
				15 00 00 00 01 00 02 70 FF
				15 00 00 00 01 00 02 71 00
				15 00 00 00 01 00 02 72 00
				15 00 00 00 01 00 02 73 00
				15 00 00 00 01 00 02 74 10
				15 00 00 00 01 00 02 75 00
				15 00 00 00 01 00 02 76 31
				15 00 00 00 01 00 02 77 00
				15 00 00 00 01 00 02 78 48
				15 00 00 00 01 00 02 79 00
				15 00 00 00 01 00 02 7A 5F
				15 00 00 00 01 00 02 7B 00
				15 00 00 00 01 00 02 7C 72
				15 00 00 00 01 00 02 7D 00
				15 00 00 00 01 00 02 7E 83
				15 00 00 00 01 00 02 7F 00
				15 00 00 00 01 00 02 80 93
				15 00 00 00 01 00 02 81 00
				15 00 00 00 01 00 02 82 A2
				15 00 00 00 01 00 02 83 00
				15 00 00 00 01 00 02 84 D6
				15 00 00 00 01 00 02 85 01
				15 00 00 00 01 00 02 86 00
				15 00 00 00 01 00 02 87 01
				15 00 00 00 01 00 02 88 46
				15 00 00 00 01 00 02 89 01
				15 00 00 00 01 00 02 8A 79
				15 00 00 00 01 00 02 8B 01
				15 00 00 00 01 00 02 8C C2
				15 00 00 00 01 00 02 8D 01
				15 00 00 00 01 00 02 8E FC
				15 00 00 00 01 00 02 8F 01
				15 00 00 00 01 00 02 90 FE
				15 00 00 00 01 00 02 91 02
				15 00 00 00 01 00 02 92 34
				15 00 00 00 01 00 02 93 02
				15 00 00 00 01 00 02 94 73
				15 00 00 00 01 00 02 95 02
				15 00 00 00 01 00 02 96 9C
				15 00 00 00 01 00 02 97 02
				15 00 00 00 01 00 02 98 DA
				15 00 00 00 01 00 02 99 03
				15 00 00 00 01 00 02 9A 07
				15 00 00 00 01 00 02 9B 03
				15 00 00 00 01 00 02 9C 46
				15 00 00 00 01 00 02 9D 03
				15 00 00 00 01 00 02 9E 58
				15 00 00 00 01 00 02 9F 03
				15 00 00 00 01 00 02 A0 6D
				15 00 00 00 01 00 02 A2 03
				15 00 00 00 01 00 02 A3 84
				15 00 00 00 01 00 02 A4 03
				15 00 00 00 01 00 02 A5 9C
				15 00 00 00 01 00 02 A6 03
				15 00 00 00 01 00 02 A7 B5
				15 00 00 00 01 00 02 A9 03
				15 00 00 00 01 00 02 AA D2
				15 00 00 00 01 00 02 AB 03
				15 00 00 00 01 00 02 AC F1
				15 00 00 00 01 00 02 AD 03
				15 00 00 00 01 00 02 AE FF
				15 00 00 00 01 00 02 AF 00
				15 00 00 00 01 00 02 B0 4A
				15 00 00 00 01 00 02 B1 00
				15 00 00 00 01 00 02 B2 59
				15 00 00 00 01 00 02 B3 00
				15 00 00 00 01 00 02 B4 77
				15 00 00 00 01 00 02 B5 00
				15 00 00 00 01 00 02 B6 8B
				15 00 00 00 01 00 02 B7 00
				15 00 00 00 01 00 02 B8 A0
				15 00 00 00 01 00 02 B9 00
				15 00 00 00 01 00 02 BA B0
				15 00 00 00 01 00 02 BB 00
				15 00 00 00 01 00 02 BC BE
				15 00 00 00 01 00 02 BD 00
				15 00 00 00 01 00 02 BE CB
				15 00 00 00 01 00 02 BF 00
				15 00 00 00 01 00 02 C0 D8
				15 00 00 00 01 00 02 C1 01
				15 00 00 00 01 00 02 C2 01
				15 00 00 00 01 00 02 C3 01
				15 00 00 00 01 00 02 C4 20
				15 00 00 00 01 00 02 C5 01
				15 00 00 00 01 00 02 C6 50
				15 00 00 00 01 00 02 C7 01
				15 00 00 00 01 00 02 C8 79
				15 00 00 00 01 00 02 C9 01
				15 00 00 00 01 00 02 CA C2
				15 00 00 00 01 00 02 CB 01
				15 00 00 00 01 00 02 CC FC
				15 00 00 00 01 00 02 CD 01
				15 00 00 00 01 00 02 CE FE
				15 00 00 00 01 00 02 CF 02
				15 00 00 00 01 00 02 D0 34
				15 00 00 00 01 00 02 D1 02
				15 00 00 00 01 00 02 D2 73
				15 00 00 00 01 00 02 D3 02
				15 00 00 00 01 00 02 D4 9C
				15 00 00 00 01 00 02 D5 02
				15 00 00 00 01 00 02 D6 DA
				15 00 00 00 01 00 02 D7 03
				15 00 00 00 01 00 02 D8 07
				15 00 00 00 01 00 02 D9 03
				15 00 00 00 01 00 02 DA 46
				15 00 00 00 01 00 02 DB 03
				15 00 00 00 01 00 02 DC 58
				15 00 00 00 01 00 02 DD 03
				15 00 00 00 01 00 02 DE 6D
				15 00 00 00 01 00 02 DF 03
				15 00 00 00 01 00 02 E0 84
				15 00 00 00 01 00 02 E1 03
				15 00 00 00 01 00 02 E2 9C
				15 00 00 00 01 00 02 E3 03
				15 00 00 00 01 00 02 E4 B5
				15 00 00 00 01 00 02 E5 03
				15 00 00 00 01 00 02 E6 D2
				15 00 00 00 01 00 02 E7 03
				15 00 00 00 01 00 02 E8 F1
				15 00 00 00 01 00 02 E9 03
				15 00 00 00 01 00 02 EA FF
				15 00 00 00 01 00 02 EB 30
				15 00 00 00 01 00 02 EC 17
				15 00 00 00 01 00 02 ED 20
				15 00 00 00 01 00 02 EE 0F
				15 00 00 00 01 00 02 EF 1F
				15 00 00 00 01 00 02 F0 0F
				15 00 00 00 01 00 02 F1 0F
				15 00 00 00 01 00 02 F2 07
				15 00 00 00 01 00 02 FB 01
				15 01 00 00 01 00 02 FF 10
				];
		qcom,mdss-dsi-dispparam-cold-command-state = "dsi_hs_mode";
		qcom,mdss-dsi-dispparam-papermode-command = [
				15 01 00 00 78 00 02 FF 20
				15 00 00 00 01 00 02 FB 01
				15 00 00 00 01 00 02 75 01
				15 00 00 00 01 00 02 76 31
				15 00 00 00 01 00 02 77 01
				15 00 00 00 01 00 02 78 35
				15 00 00 00 01 00 02 79 01
				15 00 00 00 01 00 02 7A 3C
				15 00 00 00 01 00 02 7B 01
				15 00 00 00 01 00 02 7C 43
				15 00 00 00 01 00 02 7D 01
				15 00 00 00 01 00 02 7E 4A
				15 00 00 00 01 00 02 7F 01
				15 00 00 00 01 00 02 80 51
				15 00 00 00 01 00 02 81 01
				15 00 00 00 01 00 02 82 58
				15 00 00 00 01 00 02 83 01
				15 00 00 00 01 00 02 84 5E
				15 00 00 00 01 00 02 85 01
				15 00 00 00 01 00 02 86 64
				15 00 00 00 01 00 02 87 01
				15 00 00 00 01 00 02 88 7A
				15 00 00 00 01 00 02 89 01
				15 00 00 00 01 00 02 8A 8F
				15 00 00 00 01 00 02 8B 01
				15 00 00 00 01 00 02 8C B3
				15 00 00 00 01 00 02 8D 01
				15 00 00 00 01 00 02 8E D2
				15 00 00 00 01 00 02 8F 02
				15 00 00 00 01 00 02 90 03
				15 00 00 00 01 00 02 91 02
				15 00 00 00 01 00 02 92 28
				15 00 00 00 01 00 02 93 02
				15 00 00 00 01 00 02 94 2A
				15 00 00 00 01 00 02 95 02
				15 00 00 00 01 00 02 96 57
				15 00 00 00 01 00 02 97 02
				15 00 00 00 01 00 02 98 92
				15 00 00 00 01 00 02 99 02
				15 00 00 00 01 00 02 9A BB
				15 00 00 00 01 00 02 9B 02
				15 00 00 00 01 00 02 9C F2
				15 00 00 00 01 00 02 9D 03
				15 00 00 00 01 00 02 9E 11
				15 00 00 00 01 00 02 9F 03
				15 00 00 00 01 00 02 A0 4A
				15 00 00 00 01 00 02 A2 03
				15 00 00 00 01 00 02 A3 5D
				15 00 00 00 01 00 02 A4 03
				15 00 00 00 01 00 02 A5 70
				15 00 00 00 01 00 02 A6 03
				15 00 00 00 01 00 02 A7 83
				15 00 00 00 01 00 02 A9 03
				15 00 00 00 01 00 02 AA 96
				15 00 00 00 01 00 02 AB 03
				15 00 00 00 01 00 02 AC A6
				15 00 00 00 01 00 02 AD 03
				15 00 00 00 01 00 02 AE B1
				15 00 00 00 01 00 02 AF 03
				15 00 00 00 01 00 02 B0 B6
				15 00 00 00 01 00 02 B1 03
				15 00 00 00 01 00 02 B2 FF
				15 00 00 00 01 00 02 B3 01
				15 00 00 00 01 00 02 B4 31
				15 00 00 00 01 00 02 B5 01
				15 00 00 00 01 00 02 B6 35
				15 00 00 00 01 00 02 B7 01
				15 00 00 00 01 00 02 B8 3C
				15 00 00 00 01 00 02 B9 01
				15 00 00 00 01 00 02 BA 43
				15 00 00 00 01 00 02 BB 01
				15 00 00 00 01 00 02 BC 4A
				15 00 00 00 01 00 02 BD 01
				15 00 00 00 01 00 02 BE 51
				15 00 00 00 01 00 02 BF 01
				15 00 00 00 01 00 02 C0 58
				15 00 00 00 01 00 02 C1 01
				15 00 00 00 01 00 02 C2 5E
				15 00 00 00 01 00 02 C3 01
				15 00 00 00 01 00 02 C4 64
				15 00 00 00 01 00 02 C5 01
				15 00 00 00 01 00 02 C6 7A
				15 00 00 00 01 00 02 C7 01
				15 00 00 00 01 00 02 C8 8F
				15 00 00 00 01 00 02 C9 01
				15 00 00 00 01 00 02 CA B3
				15 00 00 00 01 00 02 CB 01
				15 00 00 00 01 00 02 CC D2
				15 00 00 00 01 00 02 CD 02
				15 00 00 00 01 00 02 CE 03
				15 00 00 00 01 00 02 CF 02
				15 00 00 00 01 00 02 D0 28
				15 00 00 00 01 00 02 D1 02
				15 00 00 00 01 00 02 D2 2A
				15 00 00 00 01 00 02 D3 02
				15 00 00 00 01 00 02 D4 57
				15 00 00 00 01 00 02 D5 02
				15 00 00 00 01 00 02 D6 92
				15 00 00 00 01 00 02 D7 02
				15 00 00 00 01 00 02 D8 BB
				15 00 00 00 01 00 02 D9 02
				15 00 00 00 01 00 02 DA F2
				15 00 00 00 01 00 02 DB 03
				15 00 00 00 01 00 02 DC 11
				15 00 00 00 01 00 02 DD 03
				15 00 00 00 01 00 02 DE 4A
				15 00 00 00 01 00 02 DF 03
				15 00 00 00 01 00 02 E0 5D
				15 00 00 00 01 00 02 E1 03
				15 00 00 00 01 00 02 E2 70
				15 00 00 00 01 00 02 E3 03
				15 00 00 00 01 00 02 E4 83
				15 00 00 00 01 00 02 E5 03
				15 00 00 00 01 00 02 E6 96
				15 00 00 00 01 00 02 E7 03
				15 00 00 00 01 00 02 E8 A6
				15 00 00 00 01 00 02 E9 03
				15 00 00 00 01 00 02 EA B1
				15 00 00 00 01 00 02 EB 03
				15 00 00 00 01 00 02 EC B6
				15 00 00 00 01 00 02 ED 03
				15 00 00 00 01 00 02 EE FF
				15 00 00 00 01 00 02 EF 01
				15 00 00 00 01 00 02 F0 4A
				15 00 00 00 01 00 02 F1 01
				15 00 00 00 01 00 02 F2 4D
				15 00 00 00 01 00 02 F3 01
				15 00 00 00 01 00 02 F4 54
				15 00 00 00 01 00 02 F5 01
				15 00 00 00 01 00 02 F6 5A
				15 00 00 00 01 00 02 F7 01
				15 00 00 00 01 00 02 F8 60
				15 00 00 00 01 00 02 F9 01
				15 00 00 00 01 00 02 FA 66
				15 00 00 00 01 00 02 FF 21
				15 00 00 00 01 00 02 FB 01
				15 00 00 00 01 00 02 00 01
				15 00 00 00 01 00 02 01 6B
				15 00 00 00 01 00 02 02 01
				15 00 00 00 01 00 02 03 71
				15 00 00 00 01 00 02 04 01
				15 00 00 00 01 00 02 05 76
				15 00 00 00 01 00 02 06 01
				15 00 00 00 01 00 02 07 8A
				15 00 00 00 01 00 02 08 01
				15 00 00 00 01 00 02 09 9D
				15 00 00 00 01 00 02 0A 01
				15 00 00 00 01 00 02 0B BE
				15 00 00 00 01 00 02 0C 01
				15 00 00 00 01 00 02 0D DC
				15 00 00 00 01 00 02 0E 02
				15 00 00 00 01 00 02 0F 07
				15 00 00 00 01 00 02 10 02
				15 00 00 00 01 00 02 11 2D
				15 00 00 00 01 00 02 12 02
				15 00 00 00 01 00 02 13 2E
				15 00 00 00 01 00 02 14 02
				15 00 00 00 01 00 02 15 5C
				15 00 00 00 01 00 02 16 02
				15 00 00 00 01 00 02 17 97
				15 00 00 00 01 00 02 18 02
				15 00 00 00 01 00 02 19 C0
				15 00 00 00 01 00 02 1A 02
				15 00 00 00 01 00 02 1B F7
				15 00 00 00 01 00 02 1C 03
				15 00 00 00 01 00 02 1D 14
				15 00 00 00 01 00 02 1E 03
				15 00 00 00 01 00 02 1F 4B
				15 00 00 00 01 00 02 20 03
				15 00 00 00 01 00 02 21 5C
				15 00 00 00 01 00 02 22 03
				15 00 00 00 01 00 02 23 6F
				15 00 00 00 01 00 02 24 03
				15 00 00 00 01 00 02 25 83
				15 00 00 00 01 00 02 26 03
				15 00 00 00 01 00 02 27 97
				15 00 00 00 01 00 02 28 03
				15 00 00 00 01 00 02 29 A6
				15 00 00 00 01 00 02 2A 03
				15 00 00 00 01 00 02 2B B1
				15 00 00 00 01 00 02 2D 03
				15 00 00 00 01 00 02 2F B6
				15 00 00 00 01 00 02 30 03
				15 00 00 00 01 00 02 31 FF
				15 00 00 00 01 00 02 32 01
				15 00 00 00 01 00 02 33 4A
				15 00 00 00 01 00 02 34 01
				15 00 00 00 01 00 02 35 4D
				15 00 00 00 01 00 02 36 01
				15 00 00 00 01 00 02 37 54
				15 00 00 00 01 00 02 38 01
				15 00 00 00 01 00 02 39 5A
				15 00 00 00 01 00 02 3A 01
				15 00 00 00 01 00 02 3B 60
				15 00 00 00 01 00 02 3D 01
				15 00 00 00 01 00 02 3F 66
				15 00 00 00 01 00 02 40 01
				15 00 00 00 01 00 02 41 6B
				15 00 00 00 01 00 02 42 01
				15 00 00 00 01 00 02 43 71
				15 00 00 00 01 00 02 44 01
				15 00 00 00 01 00 02 45 76
				15 00 00 00 01 00 02 46 01
				15 00 00 00 01 00 02 47 8A
				15 00 00 00 01 00 02 48 01
				15 00 00 00 01 00 02 49 9D
				15 00 00 00 01 00 02 4A 01
				15 00 00 00 01 00 02 4B BE
				15 00 00 00 01 00 02 4C 01
				15 00 00 00 01 00 02 4D DC
				15 00 00 00 01 00 02 4E 02
				15 00 00 00 01 00 02 4F 07
				15 00 00 00 01 00 02 50 02
				15 00 00 00 01 00 02 51 2D
				15 00 00 00 01 00 02 52 02
				15 00 00 00 01 00 02 53 2E
				15 00 00 00 01 00 02 54 02
				15 00 00 00 01 00 02 55 5C
				15 00 00 00 01 00 02 56 02
				15 00 00 00 01 00 02 58 97
				15 00 00 00 01 00 02 59 02
				15 00 00 00 01 00 02 5A C0
				15 00 00 00 01 00 02 5B 02
				15 00 00 00 01 00 02 5C F7
				15 00 00 00 01 00 02 5D 03
				15 00 00 00 01 00 02 5E 14
				15 00 00 00 01 00 02 5F 03
				15 00 00 00 01 00 02 60 4B
				15 00 00 00 01 00 02 61 03
				15 00 00 00 01 00 02 62 5C
				15 00 00 00 01 00 02 63 03
				15 00 00 00 01 00 02 64 6F
				15 00 00 00 01 00 02 65 03
				15 00 00 00 01 00 02 66 83
				15 00 00 00 01 00 02 67 03
				15 00 00 00 01 00 02 68 97
				15 00 00 00 01 00 02 69 03
				15 00 00 00 01 00 02 6A A6
				15 00 00 00 01 00 02 6B 03
				15 00 00 00 01 00 02 6C B1
				15 00 00 00 01 00 02 6D 03
				15 00 00 00 01 00 02 6E B6
				15 00 00 00 01 00 02 6F 03
				15 00 00 00 01 00 02 70 FF
				15 00 00 00 01 00 02 71 02
				15 00 00 00 01 00 02 72 15
				15 00 00 00 01 00 02 73 02
				15 00 00 00 01 00 02 74 16
				15 00 00 00 01 00 02 75 02
				15 00 00 00 01 00 02 76 17
				15 00 00 00 01 00 02 77 02
				15 00 00 00 01 00 02 78 18
				15 00 00 00 01 00 02 79 02
				15 00 00 00 01 00 02 7A 1A
				15 00 00 00 01 00 02 7B 02
				15 00 00 00 01 00 02 7C 1B
				15 00 00 00 01 00 02 7D 02
				15 00 00 00 01 00 02 7E 1C
				15 00 00 00 01 00 02 7F 02
				15 00 00 00 01 00 02 80 1E
				15 00 00 00 01 00 02 81 02
				15 00 00 00 01 00 02 82 1F
				15 00 00 00 01 00 02 83 02
				15 00 00 00 01 00 02 84 25
				15 00 00 00 01 00 02 85 02
				15 00 00 00 01 00 02 86 2B
				15 00 00 00 01 00 02 87 02
				15 00 00 00 01 00 02 88 37
				15 00 00 00 01 00 02 89 02
				15 00 00 00 01 00 02 8A 43
				15 00 00 00 01 00 02 8B 02
				15 00 00 00 01 00 02 8C 5F
				15 00 00 00 01 00 02 8D 02
				15 00 00 00 01 00 02 8E 80
				15 00 00 00 01 00 02 8F 02
				15 00 00 00 01 00 02 90 81
				15 00 00 00 01 00 02 91 02
				15 00 00 00 01 00 02 92 AA
				15 00 00 00 01 00 02 93 02
				15 00 00 00 01 00 02 94 E2
				15 00 00 00 01 00 02 95 03
				15 00 00 00 01 00 02 96 05
				15 00 00 00 01 00 02 97 03
				15 00 00 00 01 00 02 98 33
				15 00 00 00 01 00 02 99 03
				15 00 00 00 01 00 02 9A 59
				15 00 00 00 01 00 02 9B 03
				15 00 00 00 01 00 02 9C 86
				15 00 00 00 01 00 02 9D 03
				15 00 00 00 01 00 02 9E 92
				15 00 00 00 01 00 02 9F 03
				15 00 00 00 01 00 02 A0 9C
				15 00 00 00 01 00 02 A2 03
				15 00 00 00 01 00 02 A3 A5
				15 00 00 00 01 00 02 A4 03
				15 00 00 00 01 00 02 A5 AC
				15 00 00 00 01 00 02 A6 03
				15 00 00 00 01 00 02 A7 B1
				15 00 00 00 01 00 02 A9 03
				15 00 00 00 01 00 02 AA B5
				15 00 00 00 01 00 02 AB 03
				15 00 00 00 01 00 02 AC B6
				15 00 00 00 01 00 02 AD 03
				15 00 00 00 01 00 02 AE FF
				15 00 00 00 01 00 02 AF 02
				15 00 00 00 01 00 02 B0 15
				15 00 00 00 01 00 02 B1 02
				15 00 00 00 01 00 02 B2 16
				15 00 00 00 01 00 02 B3 02
				15 00 00 00 01 00 02 B4 17
				15 00 00 00 01 00 02 B5 02
				15 00 00 00 01 00 02 B6 18
				15 00 00 00 01 00 02 B7 02
				15 00 00 00 01 00 02 B8 1A
				15 00 00 00 01 00 02 B9 02
				15 00 00 00 01 00 02 BA 1B
				15 00 00 00 01 00 02 BB 02
				15 00 00 00 01 00 02 BC 1C
				15 00 00 00 01 00 02 BD 02
				15 00 00 00 01 00 02 BE 1E
				15 00 00 00 01 00 02 BF 02
				15 00 00 00 01 00 02 C0 1F
				15 00 00 00 01 00 02 C1 02
				15 00 00 00 01 00 02 C2 25
				15 00 00 00 01 00 02 C3 02
				15 00 00 00 01 00 02 C4 2B
				15 00 00 00 01 00 02 C5 02
				15 00 00 00 01 00 02 C6 37
				15 00 00 00 01 00 02 C7 02
				15 00 00 00 01 00 02 C8 43
				15 00 00 00 01 00 02 C9 02
				15 00 00 00 01 00 02 CA 5F
				15 00 00 00 01 00 02 CB 02
				15 00 00 00 01 00 02 CC 80
				15 00 00 00 01 00 02 CD 02
				15 00 00 00 01 00 02 CE 81
				15 00 00 00 01 00 02 CF 02
				15 00 00 00 01 00 02 D0 AA
				15 00 00 00 01 00 02 D1 02
				15 00 00 00 01 00 02 D2 E2
				15 00 00 00 01 00 02 D3 03
				15 00 00 00 01 00 02 D4 05
				15 00 00 00 01 00 02 D5 03
				15 00 00 00 01 00 02 D6 33
				15 00 00 00 01 00 02 D7 03
				15 00 00 00 01 00 02 D8 59
				15 00 00 00 01 00 02 D9 03
				15 00 00 00 01 00 02 DA 86
				15 00 00 00 01 00 02 DB 03
				15 00 00 00 01 00 02 DC 92
				15 00 00 00 01 00 02 DD 03
				15 00 00 00 01 00 02 DE 9C
				15 00 00 00 01 00 02 DF 03
				15 00 00 00 01 00 02 E0 A5
				15 00 00 00 01 00 02 E1 03
				15 00 00 00 01 00 02 E2 AC
				15 00 00 00 01 00 02 E3 03
				15 00 00 00 01 00 02 E4 B1
				15 00 00 00 01 00 02 E5 03
				15 00 00 00 01 00 02 E6 B5
				15 00 00 00 01 00 02 E7 03
				15 00 00 00 01 00 02 E8 B6
				15 00 00 00 01 00 02 E9 03
				15 00 00 00 01 00 02 EA FF
				15 00 00 00 01 00 02 FB 01
				15 01 00 00 01 00 02 FF 10
				];
		qcom,mdss-dsi-dispparam-papermode-state = "dsi_hs_mode";
		qcom,mdss-dsi-dispparam-papermode1-command = [
				15 01 00 00 78 00 02 FF 20
				15 00 00 00 01 00 02 FB 01
				15 00 00 00 01 00 02 75 01
				15 00 00 00 01 00 02 76 31
				15 00 00 00 01 00 02 77 01
				15 00 00 00 01 00 02 78 35
				15 00 00 00 01 00 02 79 01
				15 00 00 00 01 00 02 7A 3C
				15 00 00 00 01 00 02 7B 01
				15 00 00 00 01 00 02 7C 43
				15 00 00 00 01 00 02 7D 01
				15 00 00 00 01 00 02 7E 4A
				15 00 00 00 01 00 02 7F 01
				15 00 00 00 01 00 02 80 51
				15 00 00 00 01 00 02 81 01
				15 00 00 00 01 00 02 82 58
				15 00 00 00 01 00 02 83 01
				15 00 00 00 01 00 02 84 5E
				15 00 00 00 01 00 02 85 01
				15 00 00 00 01 00 02 86 64
				15 00 00 00 01 00 02 87 01
				15 00 00 00 01 00 02 88 7A
				15 00 00 00 01 00 02 89 01
				15 00 00 00 01 00 02 8A 8F
				15 00 00 00 01 00 02 8B 01
				15 00 00 00 01 00 02 8C B3
				15 00 00 00 01 00 02 8D 01
				15 00 00 00 01 00 02 8E D2
				15 00 00 00 01 00 02 8F 02
				15 00 00 00 01 00 02 90 03
				15 00 00 00 01 00 02 91 02
				15 00 00 00 01 00 02 92 28
				15 00 00 00 01 00 02 93 02
				15 00 00 00 01 00 02 94 2A
				15 00 00 00 01 00 02 95 02
				15 00 00 00 01 00 02 96 57
				15 00 00 00 01 00 02 97 02
				15 00 00 00 01 00 02 98 92
				15 00 00 00 01 00 02 99 02
				15 00 00 00 01 00 02 9A BB
				15 00 00 00 01 00 02 9B 02
				15 00 00 00 01 00 02 9C F2
				15 00 00 00 01 00 02 9D 03
				15 00 00 00 01 00 02 9E 11
				15 00 00 00 01 00 02 9F 03
				15 00 00 00 01 00 02 A0 4A
				15 00 00 00 01 00 02 A2 03
				15 00 00 00 01 00 02 A3 5D
				15 00 00 00 01 00 02 A4 03
				15 00 00 00 01 00 02 A5 70
				15 00 00 00 01 00 02 A6 03
				15 00 00 00 01 00 02 A7 83
				15 00 00 00 01 00 02 A9 03
				15 00 00 00 01 00 02 AA 96
				15 00 00 00 01 00 02 AB 03
				15 00 00 00 01 00 02 AC A6
				15 00 00 00 01 00 02 AD 03
				15 00 00 00 01 00 02 AE B1
				15 00 00 00 01 00 02 AF 03
				15 00 00 00 01 00 02 B0 B6
				15 00 00 00 01 00 02 B1 03
				15 00 00 00 01 00 02 B2 FF
				15 00 00 00 01 00 02 B3 01
				15 00 00 00 01 00 02 B4 31
				15 00 00 00 01 00 02 B5 01
				15 00 00 00 01 00 02 B6 35
				15 00 00 00 01 00 02 B7 01
				15 00 00 00 01 00 02 B8 3C
				15 00 00 00 01 00 02 B9 01
				15 00 00 00 01 00 02 BA 43
				15 00 00 00 01 00 02 BB 01
				15 00 00 00 01 00 02 BC 4A
				15 00 00 00 01 00 02 BD 01
				15 00 00 00 01 00 02 BE 51
				15 00 00 00 01 00 02 BF 01
				15 00 00 00 01 00 02 C0 58
				15 00 00 00 01 00 02 C1 01
				15 00 00 00 01 00 02 C2 5E
				15 00 00 00 01 00 02 C3 01
				15 00 00 00 01 00 02 C4 64
				15 00 00 00 01 00 02 C5 01
				15 00 00 00 01 00 02 C6 7A
				15 00 00 00 01 00 02 C7 01
				15 00 00 00 01 00 02 C8 8F
				15 00 00 00 01 00 02 C9 01
				15 00 00 00 01 00 02 CA B3
				15 00 00 00 01 00 02 CB 01
				15 00 00 00 01 00 02 CC D2
				15 00 00 00 01 00 02 CD 02
				15 00 00 00 01 00 02 CE 03
				15 00 00 00 01 00 02 CF 02
				15 00 00 00 01 00 02 D0 28
				15 00 00 00 01 00 02 D1 02
				15 00 00 00 01 00 02 D2 2A
				15 00 00 00 01 00 02 D3 02
				15 00 00 00 01 00 02 D4 57
				15 00 00 00 01 00 02 D5 02
				15 00 00 00 01 00 02 D6 92
				15 00 00 00 01 00 02 D7 02
				15 00 00 00 01 00 02 D8 BB
				15 00 00 00 01 00 02 D9 02
				15 00 00 00 01 00 02 DA F2
				15 00 00 00 01 00 02 DB 03
				15 00 00 00 01 00 02 DC 11
				15 00 00 00 01 00 02 DD 03
				15 00 00 00 01 00 02 DE 4A
				15 00 00 00 01 00 02 DF 03
				15 00 00 00 01 00 02 E0 5D
				15 00 00 00 01 00 02 E1 03
				15 00 00 00 01 00 02 E2 70
				15 00 00 00 01 00 02 E3 03
				15 00 00 00 01 00 02 E4 83
				15 00 00 00 01 00 02 E5 03
				15 00 00 00 01 00 02 E6 96
				15 00 00 00 01 00 02 E7 03
				15 00 00 00 01 00 02 E8 A6
				15 00 00 00 01 00 02 E9 03
				15 00 00 00 01 00 02 EA B1
				15 00 00 00 01 00 02 EB 03
				15 00 00 00 01 00 02 EC B6
				15 00 00 00 01 00 02 ED 03
				15 00 00 00 01 00 02 EE FF
				15 00 00 00 01 00 02 EF 01
				15 00 00 00 01 00 02 F0 4A
				15 00 00 00 01 00 02 F1 01
				15 00 00 00 01 00 02 F2 4D
				15 00 00 00 01 00 02 F3 01
				15 00 00 00 01 00 02 F4 54
				15 00 00 00 01 00 02 F5 01
				15 00 00 00 01 00 02 F6 5A
				15 00 00 00 01 00 02 F7 01
				15 00 00 00 01 00 02 F8 60
				15 00 00 00 01 00 02 F9 01
				15 00 00 00 01 00 02 FA 66
				15 00 00 00 01 00 02 FF 21
				15 00 00 00 01 00 02 FB 01
				15 00 00 00 01 00 02 00 01
				15 00 00 00 01 00 02 01 6B
				15 00 00 00 01 00 02 02 01
				15 00 00 00 01 00 02 03 71
				15 00 00 00 01 00 02 04 01
				15 00 00 00 01 00 02 05 76
				15 00 00 00 01 00 02 06 01
				15 00 00 00 01 00 02 07 8A
				15 00 00 00 01 00 02 08 01
				15 00 00 00 01 00 02 09 9D
				15 00 00 00 01 00 02 0A 01
				15 00 00 00 01 00 02 0B BE
				15 00 00 00 01 00 02 0C 01
				15 00 00 00 01 00 02 0D DC
				15 00 00 00 01 00 02 0E 02
				15 00 00 00 01 00 02 0F 07
				15 00 00 00 01 00 02 10 02
				15 00 00 00 01 00 02 11 2D
				15 00 00 00 01 00 02 12 02
				15 00 00 00 01 00 02 13 2E
				15 00 00 00 01 00 02 14 02
				15 00 00 00 01 00 02 15 5C
				15 00 00 00 01 00 02 16 02
				15 00 00 00 01 00 02 17 97
				15 00 00 00 01 00 02 18 02
				15 00 00 00 01 00 02 19 C0
				15 00 00 00 01 00 02 1A 02
				15 00 00 00 01 00 02 1B F7
				15 00 00 00 01 00 02 1C 03
				15 00 00 00 01 00 02 1D 14
				15 00 00 00 01 00 02 1E 03
				15 00 00 00 01 00 02 1F 4B
				15 00 00 00 01 00 02 20 03
				15 00 00 00 01 00 02 21 5C
				15 00 00 00 01 00 02 22 03
				15 00 00 00 01 00 02 23 6F
				15 00 00 00 01 00 02 24 03
				15 00 00 00 01 00 02 25 83
				15 00 00 00 01 00 02 26 03
				15 00 00 00 01 00 02 27 97
				15 00 00 00 01 00 02 28 03
				15 00 00 00 01 00 02 29 A6
				15 00 00 00 01 00 02 2A 03
				15 00 00 00 01 00 02 2B B1
				15 00 00 00 01 00 02 2D 03
				15 00 00 00 01 00 02 2F B6
				15 00 00 00 01 00 02 30 03
				15 00 00 00 01 00 02 31 FF
				15 00 00 00 01 00 02 32 01
				15 00 00 00 01 00 02 33 4A
				15 00 00 00 01 00 02 34 01
				15 00 00 00 01 00 02 35 4D
				15 00 00 00 01 00 02 36 01
				15 00 00 00 01 00 02 37 54
				15 00 00 00 01 00 02 38 01
				15 00 00 00 01 00 02 39 5A
				15 00 00 00 01 00 02 3A 01
				15 00 00 00 01 00 02 3B 60
				15 00 00 00 01 00 02 3D 01
				15 00 00 00 01 00 02 3F 66
				15 00 00 00 01 00 02 40 01
				15 00 00 00 01 00 02 41 6B
				15 00 00 00 01 00 02 42 01
				15 00 00 00 01 00 02 43 71
				15 00 00 00 01 00 02 44 01
				15 00 00 00 01 00 02 45 76
				15 00 00 00 01 00 02 46 01
				15 00 00 00 01 00 02 47 8A
				15 00 00 00 01 00 02 48 01
				15 00 00 00 01 00 02 49 9D
				15 00 00 00 01 00 02 4A 01
				15 00 00 00 01 00 02 4B BE
				15 00 00 00 01 00 02 4C 01
				15 00 00 00 01 00 02 4D DC
				15 00 00 00 01 00 02 4E 02
				15 00 00 00 01 00 02 4F 07
				15 00 00 00 01 00 02 50 02
				15 00 00 00 01 00 02 51 2D
				15 00 00 00 01 00 02 52 02
				15 00 00 00 01 00 02 53 2E
				15 00 00 00 01 00 02 54 02
				15 00 00 00 01 00 02 55 5C
				15 00 00 00 01 00 02 56 02
				15 00 00 00 01 00 02 58 97
				15 00 00 00 01 00 02 59 02
				15 00 00 00 01 00 02 5A C0
				15 00 00 00 01 00 02 5B 02
				15 00 00 00 01 00 02 5C F7
				15 00 00 00 01 00 02 5D 03
				15 00 00 00 01 00 02 5E 14
				15 00 00 00 01 00 02 5F 03
				15 00 00 00 01 00 02 60 4B
				15 00 00 00 01 00 02 61 03
				15 00 00 00 01 00 02 62 5C
				15 00 00 00 01 00 02 63 03
				15 00 00 00 01 00 02 64 6F
				15 00 00 00 01 00 02 65 03
				15 00 00 00 01 00 02 66 83
				15 00 00 00 01 00 02 67 03
				15 00 00 00 01 00 02 68 97
				15 00 00 00 01 00 02 69 03
				15 00 00 00 01 00 02 6A A6
				15 00 00 00 01 00 02 6B 03
				15 00 00 00 01 00 02 6C B1
				15 00 00 00 01 00 02 6D 03
				15 00 00 00 01 00 02 6E B6
				15 00 00 00 01 00 02 6F 03
				15 00 00 00 01 00 02 70 FF
				15 00 00 00 01 00 02 71 01
				15 00 00 00 01 00 02 72 7A
				15 00 00 00 01 00 02 73 01
				15 00 00 00 01 00 02 74 7C
				15 00 00 00 01 00 02 75 01
				15 00 00 00 01 00 02 76 81
				15 00 00 00 01 00 02 77 01
				15 00 00 00 01 00 02 78 86
				15 00 00 00 01 00 02 79 01
				15 00 00 00 01 00 02 7A 8A
				15 00 00 00 01 00 02 7B 01
				15 00 00 00 01 00 02 7C 8F
				15 00 00 00 01 00 02 7D 01
				15 00 00 00 01 00 02 7E 93
				15 00 00 00 01 00 02 7F 01
				15 00 00 00 01 00 02 80 97
				15 00 00 00 01 00 02 81 01
				15 00 00 00 01 00 02 82 9C
				15 00 00 00 01 00 02 83 01
				15 00 00 00 01 00 02 84 AC
				15 00 00 00 01 00 02 85 01
				15 00 00 00 01 00 02 86 BB
				15 00 00 00 01 00 02 87 01
				15 00 00 00 01 00 02 88 D7
				15 00 00 00 01 00 02 89 01
				15 00 00 00 01 00 02 8A F2
				15 00 00 00 01 00 02 8B 02
				15 00 00 00 01 00 02 8C 13
				15 00 00 00 01 00 02 8D 02
				15 00 00 00 01 00 02 8E 38
				15 00 00 00 01 00 02 8F 02
				15 00 00 00 01 00 02 90 39
				15 00 00 00 01 00 02 91 02
				15 00 00 00 01 00 02 92 65
				15 00 00 00 01 00 02 93 02
				15 00 00 00 01 00 02 94 A1
				15 00 00 00 01 00 02 95 02
				15 00 00 00 01 00 02 96 CA
				15 00 00 00 01 00 02 97 02
				15 00 00 00 01 00 02 98 FE
				15 00 00 00 01 00 02 99 03
				15 00 00 00 01 00 02 9A 1A
				15 00 00 00 01 00 02 9B 03
				15 00 00 00 01 00 02 9C 53
				15 00 00 00 01 00 02 9D 03
				15 00 00 00 01 00 02 9E 64
				15 00 00 00 01 00 02 9F 03
				15 00 00 00 01 00 02 A0 77
				15 00 00 00 01 00 02 A2 03
				15 00 00 00 01 00 02 A3 89
				15 00 00 00 01 00 02 A4 03
				15 00 00 00 01 00 02 A5 9A
				15 00 00 00 01 00 02 A6 03
				15 00 00 00 01 00 02 A7 A8
				15 00 00 00 01 00 02 A9 03
				15 00 00 00 01 00 02 AA B2
				15 00 00 00 01 00 02 AB 03
				15 00 00 00 01 00 02 AC B6
				15 00 00 00 01 00 02 AD 03
				15 00 00 00 01 00 02 AE FF
				15 00 00 00 01 00 02 AF 01
				15 00 00 00 01 00 02 B0 7A
				15 00 00 00 01 00 02 B1 01
				15 00 00 00 01 00 02 B2 7C
				15 00 00 00 01 00 02 B3 01
				15 00 00 00 01 00 02 B4 81
				15 00 00 00 01 00 02 B5 01
				15 00 00 00 01 00 02 B6 86
				15 00 00 00 01 00 02 B7 01
				15 00 00 00 01 00 02 B8 8A
				15 00 00 00 01 00 02 B9 01
				15 00 00 00 01 00 02 BA 8F
				15 00 00 00 01 00 02 BB 01
				15 00 00 00 01 00 02 BC 93
				15 00 00 00 01 00 02 BD 01
				15 00 00 00 01 00 02 BE 97
				15 00 00 00 01 00 02 BF 01
				15 00 00 00 01 00 02 C0 9C
				15 00 00 00 01 00 02 C1 01
				15 00 00 00 01 00 02 C2 AC
				15 00 00 00 01 00 02 C3 01
				15 00 00 00 01 00 02 C4 BB
				15 00 00 00 01 00 02 C5 01
				15 00 00 00 01 00 02 C6 D7
				15 00 00 00 01 00 02 C7 01
				15 00 00 00 01 00 02 C8 F2
				15 00 00 00 01 00 02 C9 02
				15 00 00 00 01 00 02 CA 13
				15 00 00 00 01 00 02 CB 02
				15 00 00 00 01 00 02 CC 38
				15 00 00 00 01 00 02 CD 02
				15 00 00 00 01 00 02 CE 39
				15 00 00 00 01 00 02 CF 02
				15 00 00 00 01 00 02 D0 65
				15 00 00 00 01 00 02 D1 02
				15 00 00 00 01 00 02 D2 A1
				15 00 00 00 01 00 02 D3 02
				15 00 00 00 01 00 02 D4 CA
				15 00 00 00 01 00 02 D5 02
				15 00 00 00 01 00 02 D6 FE
				15 00 00 00 01 00 02 D7 03
				15 00 00 00 01 00 02 D8 1A
				15 00 00 00 01 00 02 D9 03
				15 00 00 00 01 00 02 DA 53
				15 00 00 00 01 00 02 DB 03
				15 00 00 00 01 00 02 DC 64
				15 00 00 00 01 00 02 DD 03
				15 00 00 00 01 00 02 DE 77
				15 00 00 00 01 00 02 DF 03
				15 00 00 00 01 00 02 E0 89
				15 00 00 00 01 00 02 E1 03
				15 00 00 00 01 00 02 E2 9A
				15 00 00 00 01 00 02 E3 03
				15 00 00 00 01 00 02 E4 A8
				15 00 00 00 01 00 02 E5 03
				15 00 00 00 01 00 02 E6 B2
				15 00 00 00 01 00 02 E7 03
				15 00 00 00 01 00 02 E8 B6
				15 00 00 00 01 00 02 E9 03
				15 00 00 00 01 00 02 EA FF
				15 00 00 00 01 00 02 FB 01
				15 01 00 00 01 00 02 FF 10
				];
		qcom,mdss-dsi-dispparam-papermode1-state = "dsi_hs_mode";
		qcom,mdss-dsi-dispparam-papermode2-command = [
				15 01 00 00 78 00 02 FF 20
				15 00 00 00 01 00 02 FB 01
				15 00 00 00 01 00 02 75 01
				15 00 00 00 01 00 02 76 31
				15 00 00 00 01 00 02 77 01
				15 00 00 00 01 00 02 78 35
				15 00 00 00 01 00 02 79 01
				15 00 00 00 01 00 02 7A 3C
				15 00 00 00 01 00 02 7B 01
				15 00 00 00 01 00 02 7C 43
				15 00 00 00 01 00 02 7D 01
				15 00 00 00 01 00 02 7E 4A
				15 00 00 00 01 00 02 7F 01
				15 00 00 00 01 00 02 80 51
				15 00 00 00 01 00 02 81 01
				15 00 00 00 01 00 02 82 58
				15 00 00 00 01 00 02 83 01
				15 00 00 00 01 00 02 84 5E
				15 00 00 00 01 00 02 85 01
				15 00 00 00 01 00 02 86 64
				15 00 00 00 01 00 02 87 01
				15 00 00 00 01 00 02 88 7A
				15 00 00 00 01 00 02 89 01
				15 00 00 00 01 00 02 8A 8F
				15 00 00 00 01 00 02 8B 01
				15 00 00 00 01 00 02 8C B3
				15 00 00 00 01 00 02 8D 01
				15 00 00 00 01 00 02 8E D2
				15 00 00 00 01 00 02 8F 02
				15 00 00 00 01 00 02 90 03
				15 00 00 00 01 00 02 91 02
				15 00 00 00 01 00 02 92 28
				15 00 00 00 01 00 02 93 02
				15 00 00 00 01 00 02 94 2A
				15 00 00 00 01 00 02 95 02
				15 00 00 00 01 00 02 96 57
				15 00 00 00 01 00 02 97 02
				15 00 00 00 01 00 02 98 92
				15 00 00 00 01 00 02 99 02
				15 00 00 00 01 00 02 9A BB
				15 00 00 00 01 00 02 9B 02
				15 00 00 00 01 00 02 9C F2
				15 00 00 00 01 00 02 9D 03
				15 00 00 00 01 00 02 9E 11
				15 00 00 00 01 00 02 9F 03
				15 00 00 00 01 00 02 A0 4A
				15 00 00 00 01 00 02 A2 03
				15 00 00 00 01 00 02 A3 5D
				15 00 00 00 01 00 02 A4 03
				15 00 00 00 01 00 02 A5 70
				15 00 00 00 01 00 02 A6 03
				15 00 00 00 01 00 02 A7 83
				15 00 00 00 01 00 02 A9 03
				15 00 00 00 01 00 02 AA 96
				15 00 00 00 01 00 02 AB 03
				15 00 00 00 01 00 02 AC A6
				15 00 00 00 01 00 02 AD 03
				15 00 00 00 01 00 02 AE B1
				15 00 00 00 01 00 02 AF 03
				15 00 00 00 01 00 02 B0 B6
				15 00 00 00 01 00 02 B1 03
				15 00 00 00 01 00 02 B2 FF
				15 00 00 00 01 00 02 B3 01
				15 00 00 00 01 00 02 B4 31
				15 00 00 00 01 00 02 B5 01
				15 00 00 00 01 00 02 B6 35
				15 00 00 00 01 00 02 B7 01
				15 00 00 00 01 00 02 B8 3C
				15 00 00 00 01 00 02 B9 01
				15 00 00 00 01 00 02 BA 43
				15 00 00 00 01 00 02 BB 01
				15 00 00 00 01 00 02 BC 4A
				15 00 00 00 01 00 02 BD 01
				15 00 00 00 01 00 02 BE 51
				15 00 00 00 01 00 02 BF 01
				15 00 00 00 01 00 02 C0 58
				15 00 00 00 01 00 02 C1 01
				15 00 00 00 01 00 02 C2 5E
				15 00 00 00 01 00 02 C3 01
				15 00 00 00 01 00 02 C4 64
				15 00 00 00 01 00 02 C5 01
				15 00 00 00 01 00 02 C6 7A
				15 00 00 00 01 00 02 C7 01
				15 00 00 00 01 00 02 C8 8F
				15 00 00 00 01 00 02 C9 01
				15 00 00 00 01 00 02 CA B3
				15 00 00 00 01 00 02 CB 01
				15 00 00 00 01 00 02 CC D2
				15 00 00 00 01 00 02 CD 02
				15 00 00 00 01 00 02 CE 03
				15 00 00 00 01 00 02 CF 02
				15 00 00 00 01 00 02 D0 28
				15 00 00 00 01 00 02 D1 02
				15 00 00 00 01 00 02 D2 2A
				15 00 00 00 01 00 02 D3 02
				15 00 00 00 01 00 02 D4 57
				15 00 00 00 01 00 02 D5 02
				15 00 00 00 01 00 02 D6 92
				15 00 00 00 01 00 02 D7 02
				15 00 00 00 01 00 02 D8 BB
				15 00 00 00 01 00 02 D9 02
				15 00 00 00 01 00 02 DA F2
				15 00 00 00 01 00 02 DB 03
				15 00 00 00 01 00 02 DC 11
				15 00 00 00 01 00 02 DD 03
				15 00 00 00 01 00 02 DE 4A
				15 00 00 00 01 00 02 DF 03
				15 00 00 00 01 00 02 E0 5D
				15 00 00 00 01 00 02 E1 03
				15 00 00 00 01 00 02 E2 70
				15 00 00 00 01 00 02 E3 03
				15 00 00 00 01 00 02 E4 83
				15 00 00 00 01 00 02 E5 03
				15 00 00 00 01 00 02 E6 96
				15 00 00 00 01 00 02 E7 03
				15 00 00 00 01 00 02 E8 A6
				15 00 00 00 01 00 02 E9 03
				15 00 00 00 01 00 02 EA B1
				15 00 00 00 01 00 02 EB 03
				15 00 00 00 01 00 02 EC B6
				15 00 00 00 01 00 02 ED 03
				15 00 00 00 01 00 02 EE FF
				15 00 00 00 01 00 02 EF 01
				15 00 00 00 01 00 02 F0 4A
				15 00 00 00 01 00 02 F1 01
				15 00 00 00 01 00 02 F2 4D
				15 00 00 00 01 00 02 F3 01
				15 00 00 00 01 00 02 F4 54
				15 00 00 00 01 00 02 F5 01
				15 00 00 00 01 00 02 F6 5A
				15 00 00 00 01 00 02 F7 01
				15 00 00 00 01 00 02 F8 60
				15 00 00 00 01 00 02 F9 01
				15 00 00 00 01 00 02 FA 66
				15 00 00 00 01 00 02 FF 21
				15 00 00 00 01 00 02 FB 01
				15 00 00 00 01 00 02 00 01
				15 00 00 00 01 00 02 01 6B
				15 00 00 00 01 00 02 02 01
				15 00 00 00 01 00 02 03 71
				15 00 00 00 01 00 02 04 01
				15 00 00 00 01 00 02 05 76
				15 00 00 00 01 00 02 06 01
				15 00 00 00 01 00 02 07 8A
				15 00 00 00 01 00 02 08 01
				15 00 00 00 01 00 02 09 9D
				15 00 00 00 01 00 02 0A 01
				15 00 00 00 01 00 02 0B BE
				15 00 00 00 01 00 02 0C 01
				15 00 00 00 01 00 02 0D DC
				15 00 00 00 01 00 02 0E 02
				15 00 00 00 01 00 02 0F 07
				15 00 00 00 01 00 02 10 02
				15 00 00 00 01 00 02 11 2D
				15 00 00 00 01 00 02 12 02
				15 00 00 00 01 00 02 13 2E
				15 00 00 00 01 00 02 14 02
				15 00 00 00 01 00 02 15 5C
				15 00 00 00 01 00 02 16 02
				15 00 00 00 01 00 02 17 97
				15 00 00 00 01 00 02 18 02
				15 00 00 00 01 00 02 19 C0
				15 00 00 00 01 00 02 1A 02
				15 00 00 00 01 00 02 1B F7
				15 00 00 00 01 00 02 1C 03
				15 00 00 00 01 00 02 1D 14
				15 00 00 00 01 00 02 1E 03
				15 00 00 00 01 00 02 1F 4B
				15 00 00 00 01 00 02 20 03
				15 00 00 00 01 00 02 21 5C
				15 00 00 00 01 00 02 22 03
				15 00 00 00 01 00 02 23 6F
				15 00 00 00 01 00 02 24 03
				15 00 00 00 01 00 02 25 83
				15 00 00 00 01 00 02 26 03
				15 00 00 00 01 00 02 27 97
				15 00 00 00 01 00 02 28 03
				15 00 00 00 01 00 02 29 A6
				15 00 00 00 01 00 02 2A 03
				15 00 00 00 01 00 02 2B B1
				15 00 00 00 01 00 02 2D 03
				15 00 00 00 01 00 02 2F B6
				15 00 00 00 01 00 02 30 03
				15 00 00 00 01 00 02 31 FF
				15 00 00 00 01 00 02 32 01
				15 00 00 00 01 00 02 33 4A
				15 00 00 00 01 00 02 34 01
				15 00 00 00 01 00 02 35 4D
				15 00 00 00 01 00 02 36 01
				15 00 00 00 01 00 02 37 54
				15 00 00 00 01 00 02 38 01
				15 00 00 00 01 00 02 39 5A
				15 00 00 00 01 00 02 3A 01
				15 00 00 00 01 00 02 3B 60
				15 00 00 00 01 00 02 3D 01
				15 00 00 00 01 00 02 3F 66
				15 00 00 00 01 00 02 40 01
				15 00 00 00 01 00 02 41 6B
				15 00 00 00 01 00 02 42 01
				15 00 00 00 01 00 02 43 71
				15 00 00 00 01 00 02 44 01
				15 00 00 00 01 00 02 45 76
				15 00 00 00 01 00 02 46 01
				15 00 00 00 01 00 02 47 8A
				15 00 00 00 01 00 02 48 01
				15 00 00 00 01 00 02 49 9D
				15 00 00 00 01 00 02 4A 01
				15 00 00 00 01 00 02 4B BE
				15 00 00 00 01 00 02 4C 01
				15 00 00 00 01 00 02 4D DC
				15 00 00 00 01 00 02 4E 02
				15 00 00 00 01 00 02 4F 07
				15 00 00 00 01 00 02 50 02
				15 00 00 00 01 00 02 51 2D
				15 00 00 00 01 00 02 52 02
				15 00 00 00 01 00 02 53 2E
				15 00 00 00 01 00 02 54 02
				15 00 00 00 01 00 02 55 5C
				15 00 00 00 01 00 02 56 02
				15 00 00 00 01 00 02 58 97
				15 00 00 00 01 00 02 59 02
				15 00 00 00 01 00 02 5A C0
				15 00 00 00 01 00 02 5B 02
				15 00 00 00 01 00 02 5C F7
				15 00 00 00 01 00 02 5D 03
				15 00 00 00 01 00 02 5E 14
				15 00 00 00 01 00 02 5F 03
				15 00 00 00 01 00 02 60 4B
				15 00 00 00 01 00 02 61 03
				15 00 00 00 01 00 02 62 5C
				15 00 00 00 01 00 02 63 03
				15 00 00 00 01 00 02 64 6F
				15 00 00 00 01 00 02 65 03
				15 00 00 00 01 00 02 66 83
				15 00 00 00 01 00 02 67 03
				15 00 00 00 01 00 02 68 97
				15 00 00 00 01 00 02 69 03
				15 00 00 00 01 00 02 6A A6
				15 00 00 00 01 00 02 6B 03
				15 00 00 00 01 00 02 6C B1
				15 00 00 00 01 00 02 6D 03
				15 00 00 00 01 00 02 6E B6
				15 00 00 00 01 00 02 6F 03
				15 00 00 00 01 00 02 70 FF
				15 00 00 00 01 00 02 71 01
				15 00 00 00 01 00 02 72 92
				15 00 00 00 01 00 02 73 01
				15 00 00 00 01 00 02 74 94
				15 00 00 00 01 00 02 75 01
				15 00 00 00 01 00 02 76 98
				15 00 00 00 01 00 02 77 01
				15 00 00 00 01 00 02 78 9C
				15 00 00 00 01 00 02 79 01
				15 00 00 00 01 00 02 7A A0
				15 00 00 00 01 00 02 7B 01
				15 00 00 00 01 00 02 7C A4
				15 00 00 00 01 00 02 7D 01
				15 00 00 00 01 00 02 7E A8
				15 00 00 00 01 00 02 7F 01
				15 00 00 00 01 00 02 80 AC
				15 00 00 00 01 00 02 81 01
				15 00 00 00 01 00 02 82 AF
				15 00 00 00 01 00 02 83 01
				15 00 00 00 01 00 02 84 BE
				15 00 00 00 01 00 02 85 01
				15 00 00 00 01 00 02 86 CB
				15 00 00 00 01 00 02 87 01
				15 00 00 00 01 00 02 88 E5
				15 00 00 00 01 00 02 89 01
				15 00 00 00 01 00 02 8A FA
				15 00 00 00 01 00 02 8B 02
				15 00 00 00 01 00 02 8C 1A
				15 00 00 00 01 00 02 8D 02
				15 00 00 00 01 00 02 8E 3E
				15 00 00 00 01 00 02 8F 02
				15 00 00 00 01 00 02 90 40
				15 00 00 00 01 00 02 91 02
				15 00 00 00 01 00 02 92 6C
				15 00 00 00 01 00 02 93 02
				15 00 00 00 01 00 02 94 A7
				15 00 00 00 01 00 02 95 02
				15 00 00 00 01 00 02 96 CF
				15 00 00 00 01 00 02 97 03
				15 00 00 00 01 00 02 98 02
				15 00 00 00 01 00 02 99 03
				15 00 00 00 01 00 02 9A 21
				15 00 00 00 01 00 02 9B 03
				15 00 00 00 01 00 02 9C 58
				15 00 00 00 01 00 02 9D 03
				15 00 00 00 01 00 02 9E 69
				15 00 00 00 01 00 02 9F 03
				15 00 00 00 01 00 02 A0 7B
				15 00 00 00 01 00 02 A2 03
				15 00 00 00 01 00 02 A3 8D
				15 00 00 00 01 00 02 A4 03
				15 00 00 00 01 00 02 A5 9D
				15 00 00 00 01 00 02 A6 03
				15 00 00 00 01 00 02 A7 AA
				15 00 00 00 01 00 02 A9 03
				15 00 00 00 01 00 02 AA B2
				15 00 00 00 01 00 02 AB 03
				15 00 00 00 01 00 02 AC B6
				15 00 00 00 01 00 02 AD 03
				15 00 00 00 01 00 02 AE FF
				15 00 00 00 01 00 02 AF 01
				15 00 00 00 01 00 02 B0 92
				15 00 00 00 01 00 02 B1 01
				15 00 00 00 01 00 02 B2 94
				15 00 00 00 01 00 02 B3 01
				15 00 00 00 01 00 02 B4 98
				15 00 00 00 01 00 02 B5 01
				15 00 00 00 01 00 02 B6 9C
				15 00 00 00 01 00 02 B7 01
				15 00 00 00 01 00 02 B8 A0
				15 00 00 00 01 00 02 B9 01
				15 00 00 00 01 00 02 BA A4
				15 00 00 00 01 00 02 BB 01
				15 00 00 00 01 00 02 BC A8
				15 00 00 00 01 00 02 BD 01
				15 00 00 00 01 00 02 BE AC
				15 00 00 00 01 00 02 BF 01
				15 00 00 00 01 00 02 C0 AF
				15 00 00 00 01 00 02 C1 01
				15 00 00 00 01 00 02 C2 BE
				15 00 00 00 01 00 02 C3 01
				15 00 00 00 01 00 02 C4 CB
				15 00 00 00 01 00 02 C5 01
				15 00 00 00 01 00 02 C6 E5
				15 00 00 00 01 00 02 C7 01
				15 00 00 00 01 00 02 C8 FA
				15 00 00 00 01 00 02 C9 02
				15 00 00 00 01 00 02 CA 1A
				15 00 00 00 01 00 02 CB 02
				15 00 00 00 01 00 02 CC 3E
				15 00 00 00 01 00 02 CD 02
				15 00 00 00 01 00 02 CE 40
				15 00 00 00 01 00 02 CF 02
				15 00 00 00 01 00 02 D0 6C
				15 00 00 00 01 00 02 D1 02
				15 00 00 00 01 00 02 D2 A7
				15 00 00 00 01 00 02 D3 02
				15 00 00 00 01 00 02 D4 CF
				15 00 00 00 01 00 02 D5 03
				15 00 00 00 01 00 02 D6 02
				15 00 00 00 01 00 02 D7 03
				15 00 00 00 01 00 02 D8 21
				15 00 00 00 01 00 02 D9 03
				15 00 00 00 01 00 02 DA 58
				15 00 00 00 01 00 02 DB 03
				15 00 00 00 01 00 02 DC 69
				15 00 00 00 01 00 02 DD 03
				15 00 00 00 01 00 02 DE 7B
				15 00 00 00 01 00 02 DF 03
				15 00 00 00 01 00 02 E0 8D
				15 00 00 00 01 00 02 E1 03
				15 00 00 00 01 00 02 E2 9D
				15 00 00 00 01 00 02 E3 03
				15 00 00 00 01 00 02 E4 AA
				15 00 00 00 01 00 02 E5 03
				15 00 00 00 01 00 02 E6 B2
				15 00 00 00 01 00 02 E7 03
				15 00 00 00 01 00 02 E8 B6
				15 00 00 00 01 00 02 E9 03
				15 00 00 00 01 00 02 EA FF
				15 00 00 00 01 00 02 FB 01
				15 01 00 00 01 00 02 FF 10
				];
		qcom,mdss-dsi-dispparam-papermode2-state = "dsi_hs_mode";
		qcom,mdss-dsi-dispparam-papermode3-command = [
				15 01 00 00 78 00 02 FF 20
				15 00 00 00 01 00 02 FB 01
				15 00 00 00 01 00 02 75 01
				15 00 00 00 01 00 02 76 31
				15 00 00 00 01 00 02 77 01
				15 00 00 00 01 00 02 78 35
				15 00 00 00 01 00 02 79 01
				15 00 00 00 01 00 02 7A 3C
				15 00 00 00 01 00 02 7B 01
				15 00 00 00 01 00 02 7C 43
				15 00 00 00 01 00 02 7D 01
				15 00 00 00 01 00 02 7E 4A
				15 00 00 00 01 00 02 7F 01
				15 00 00 00 01 00 02 80 51
				15 00 00 00 01 00 02 81 01
				15 00 00 00 01 00 02 82 58
				15 00 00 00 01 00 02 83 01
				15 00 00 00 01 00 02 84 5E
				15 00 00 00 01 00 02 85 01
				15 00 00 00 01 00 02 86 64
				15 00 00 00 01 00 02 87 01
				15 00 00 00 01 00 02 88 7A
				15 00 00 00 01 00 02 89 01
				15 00 00 00 01 00 02 8A 8F
				15 00 00 00 01 00 02 8B 01
				15 00 00 00 01 00 02 8C B3
				15 00 00 00 01 00 02 8D 01
				15 00 00 00 01 00 02 8E D2
				15 00 00 00 01 00 02 8F 02
				15 00 00 00 01 00 02 90 03
				15 00 00 00 01 00 02 91 02
				15 00 00 00 01 00 02 92 28
				15 00 00 00 01 00 02 93 02
				15 00 00 00 01 00 02 94 2A
				15 00 00 00 01 00 02 95 02
				15 00 00 00 01 00 02 96 57
				15 00 00 00 01 00 02 97 02
				15 00 00 00 01 00 02 98 92
				15 00 00 00 01 00 02 99 02
				15 00 00 00 01 00 02 9A BB
				15 00 00 00 01 00 02 9B 02
				15 00 00 00 01 00 02 9C F2
				15 00 00 00 01 00 02 9D 03
				15 00 00 00 01 00 02 9E 11
				15 00 00 00 01 00 02 9F 03
				15 00 00 00 01 00 02 A0 4A
				15 00 00 00 01 00 02 A2 03
				15 00 00 00 01 00 02 A3 5D
				15 00 00 00 01 00 02 A4 03
				15 00 00 00 01 00 02 A5 70
				15 00 00 00 01 00 02 A6 03
				15 00 00 00 01 00 02 A7 83
				15 00 00 00 01 00 02 A9 03
				15 00 00 00 01 00 02 AA 96
				15 00 00 00 01 00 02 AB 03
				15 00 00 00 01 00 02 AC A6
				15 00 00 00 01 00 02 AD 03
				15 00 00 00 01 00 02 AE B1
				15 00 00 00 01 00 02 AF 03
				15 00 00 00 01 00 02 B0 B6
				15 00 00 00 01 00 02 B1 03
				15 00 00 00 01 00 02 B2 FF
				15 00 00 00 01 00 02 B3 01
				15 00 00 00 01 00 02 B4 31
				15 00 00 00 01 00 02 B5 01
				15 00 00 00 01 00 02 B6 35
				15 00 00 00 01 00 02 B7 01
				15 00 00 00 01 00 02 B8 3C
				15 00 00 00 01 00 02 B9 01
				15 00 00 00 01 00 02 BA 43
				15 00 00 00 01 00 02 BB 01
				15 00 00 00 01 00 02 BC 4A
				15 00 00 00 01 00 02 BD 01
				15 00 00 00 01 00 02 BE 51
				15 00 00 00 01 00 02 BF 01
				15 00 00 00 01 00 02 C0 58
				15 00 00 00 01 00 02 C1 01
				15 00 00 00 01 00 02 C2 5E
				15 00 00 00 01 00 02 C3 01
				15 00 00 00 01 00 02 C4 64
				15 00 00 00 01 00 02 C5 01
				15 00 00 00 01 00 02 C6 7A
				15 00 00 00 01 00 02 C7 01
				15 00 00 00 01 00 02 C8 8F
				15 00 00 00 01 00 02 C9 01
				15 00 00 00 01 00 02 CA B3
				15 00 00 00 01 00 02 CB 01
				15 00 00 00 01 00 02 CC D2
				15 00 00 00 01 00 02 CD 02
				15 00 00 00 01 00 02 CE 03
				15 00 00 00 01 00 02 CF 02
				15 00 00 00 01 00 02 D0 28
				15 00 00 00 01 00 02 D1 02
				15 00 00 00 01 00 02 D2 2A
				15 00 00 00 01 00 02 D3 02
				15 00 00 00 01 00 02 D4 57
				15 00 00 00 01 00 02 D5 02
				15 00 00 00 01 00 02 D6 92
				15 00 00 00 01 00 02 D7 02
				15 00 00 00 01 00 02 D8 BB
				15 00 00 00 01 00 02 D9 02
				15 00 00 00 01 00 02 DA F2
				15 00 00 00 01 00 02 DB 03
				15 00 00 00 01 00 02 DC 11
				15 00 00 00 01 00 02 DD 03
				15 00 00 00 01 00 02 DE 4A
				15 00 00 00 01 00 02 DF 03
				15 00 00 00 01 00 02 E0 5D
				15 00 00 00 01 00 02 E1 03
				15 00 00 00 01 00 02 E2 70
				15 00 00 00 01 00 02 E3 03
				15 00 00 00 01 00 02 E4 83
				15 00 00 00 01 00 02 E5 03
				15 00 00 00 01 00 02 E6 96
				15 00 00 00 01 00 02 E7 03
				15 00 00 00 01 00 02 E8 A6
				15 00 00 00 01 00 02 E9 03
				15 00 00 00 01 00 02 EA B1
				15 00 00 00 01 00 02 EB 03
				15 00 00 00 01 00 02 EC B6
				15 00 00 00 01 00 02 ED 03
				15 00 00 00 01 00 02 EE FF
				15 00 00 00 01 00 02 EF 01
				15 00 00 00 01 00 02 F0 4A
				15 00 00 00 01 00 02 F1 01
				15 00 00 00 01 00 02 F2 4D
				15 00 00 00 01 00 02 F3 01
				15 00 00 00 01 00 02 F4 54
				15 00 00 00 01 00 02 F5 01
				15 00 00 00 01 00 02 F6 5A
				15 00 00 00 01 00 02 F7 01
				15 00 00 00 01 00 02 F8 60
				15 00 00 00 01 00 02 F9 01
				15 00 00 00 01 00 02 FA 66
				15 00 00 00 01 00 02 FF 21
				15 00 00 00 01 00 02 FB 01
				15 00 00 00 01 00 02 00 01
				15 00 00 00 01 00 02 01 6B
				15 00 00 00 01 00 02 02 01
				15 00 00 00 01 00 02 03 71
				15 00 00 00 01 00 02 04 01
				15 00 00 00 01 00 02 05 76
				15 00 00 00 01 00 02 06 01
				15 00 00 00 01 00 02 07 8A
				15 00 00 00 01 00 02 08 01
				15 00 00 00 01 00 02 09 9D
				15 00 00 00 01 00 02 0A 01
				15 00 00 00 01 00 02 0B BE
				15 00 00 00 01 00 02 0C 01
				15 00 00 00 01 00 02 0D DC
				15 00 00 00 01 00 02 0E 02
				15 00 00 00 01 00 02 0F 07
				15 00 00 00 01 00 02 10 02
				15 00 00 00 01 00 02 11 2D
				15 00 00 00 01 00 02 12 02
				15 00 00 00 01 00 02 13 2E
				15 00 00 00 01 00 02 14 02
				15 00 00 00 01 00 02 15 5C
				15 00 00 00 01 00 02 16 02
				15 00 00 00 01 00 02 17 97
				15 00 00 00 01 00 02 18 02
				15 00 00 00 01 00 02 19 C0
				15 00 00 00 01 00 02 1A 02
				15 00 00 00 01 00 02 1B F7
				15 00 00 00 01 00 02 1C 03
				15 00 00 00 01 00 02 1D 14
				15 00 00 00 01 00 02 1E 03
				15 00 00 00 01 00 02 1F 4B
				15 00 00 00 01 00 02 20 03
				15 00 00 00 01 00 02 21 5C
				15 00 00 00 01 00 02 22 03
				15 00 00 00 01 00 02 23 6F
				15 00 00 00 01 00 02 24 03
				15 00 00 00 01 00 02 25 83
				15 00 00 00 01 00 02 26 03
				15 00 00 00 01 00 02 27 97
				15 00 00 00 01 00 02 28 03
				15 00 00 00 01 00 02 29 A6
				15 00 00 00 01 00 02 2A 03
				15 00 00 00 01 00 02 2B B1
				15 00 00 00 01 00 02 2D 03
				15 00 00 00 01 00 02 2F B6
				15 00 00 00 01 00 02 30 03
				15 00 00 00 01 00 02 31 FF
				15 00 00 00 01 00 02 32 01
				15 00 00 00 01 00 02 33 4A
				15 00 00 00 01 00 02 34 01
				15 00 00 00 01 00 02 35 4D
				15 00 00 00 01 00 02 36 01
				15 00 00 00 01 00 02 37 54
				15 00 00 00 01 00 02 38 01
				15 00 00 00 01 00 02 39 5A
				15 00 00 00 01 00 02 3A 01
				15 00 00 00 01 00 02 3B 60
				15 00 00 00 01 00 02 3D 01
				15 00 00 00 01 00 02 3F 66
				15 00 00 00 01 00 02 40 01
				15 00 00 00 01 00 02 41 6B
				15 00 00 00 01 00 02 42 01
				15 00 00 00 01 00 02 43 71
				15 00 00 00 01 00 02 44 01
				15 00 00 00 01 00 02 45 76
				15 00 00 00 01 00 02 46 01
				15 00 00 00 01 00 02 47 8A
				15 00 00 00 01 00 02 48 01
				15 00 00 00 01 00 02 49 9D
				15 00 00 00 01 00 02 4A 01
				15 00 00 00 01 00 02 4B BE
				15 00 00 00 01 00 02 4C 01
				15 00 00 00 01 00 02 4D DC
				15 00 00 00 01 00 02 4E 02
				15 00 00 00 01 00 02 4F 07
				15 00 00 00 01 00 02 50 02
				15 00 00 00 01 00 02 51 2D
				15 00 00 00 01 00 02 52 02
				15 00 00 00 01 00 02 53 2E
				15 00 00 00 01 00 02 54 02
				15 00 00 00 01 00 02 55 5C
				15 00 00 00 01 00 02 56 02
				15 00 00 00 01 00 02 58 97
				15 00 00 00 01 00 02 59 02
				15 00 00 00 01 00 02 5A C0
				15 00 00 00 01 00 02 5B 02
				15 00 00 00 01 00 02 5C F7
				15 00 00 00 01 00 02 5D 03
				15 00 00 00 01 00 02 5E 14
				15 00 00 00 01 00 02 5F 03
				15 00 00 00 01 00 02 60 4B
				15 00 00 00 01 00 02 61 03
				15 00 00 00 01 00 02 62 5C
				15 00 00 00 01 00 02 63 03
				15 00 00 00 01 00 02 64 6F
				15 00 00 00 01 00 02 65 03
				15 00 00 00 01 00 02 66 83
				15 00 00 00 01 00 02 67 03
				15 00 00 00 01 00 02 68 97
				15 00 00 00 01 00 02 69 03
				15 00 00 00 01 00 02 6A A6
				15 00 00 00 01 00 02 6B 03
				15 00 00 00 01 00 02 6C B1
				15 00 00 00 01 00 02 6D 03
				15 00 00 00 01 00 02 6E B6
				15 00 00 00 01 00 02 6F 03
				15 00 00 00 01 00 02 70 FF
				15 00 00 00 01 00 02 71 01
				15 00 00 00 01 00 02 72 B1
				15 00 00 00 01 00 02 73 01
				15 00 00 00 01 00 02 74 B3
				15 00 00 00 01 00 02 75 01
				15 00 00 00 01 00 02 76 B6
				15 00 00 00 01 00 02 77 01
				15 00 00 00 01 00 02 78 B9
				15 00 00 00 01 00 02 79 01
				15 00 00 00 01 00 02 7A BD
				15 00 00 00 01 00 02 7B 01
				15 00 00 00 01 00 02 7C C0
				15 00 00 00 01 00 02 7D 01
				15 00 00 00 01 00 02 7E C3
				15 00 00 00 01 00 02 7F 01
				15 00 00 00 01 00 02 80 C6
				15 00 00 00 01 00 02 81 01
				15 00 00 00 01 00 02 82 CA
				15 00 00 00 01 00 02 83 01
				15 00 00 00 01 00 02 84 D6
				15 00 00 00 01 00 02 85 01
				15 00 00 00 01 00 02 86 E2
				15 00 00 00 01 00 02 87 01
				15 00 00 00 01 00 02 88 F7
				15 00 00 00 01 00 02 89 02
				15 00 00 00 01 00 02 8A 06
				15 00 00 00 01 00 02 8B 02
				15 00 00 00 01 00 02 8C 25
				15 00 00 00 01 00 02 8D 02
				15 00 00 00 01 00 02 8E 48
				15 00 00 00 01 00 02 8F 02
				15 00 00 00 01 00 02 90 4A
				15 00 00 00 01 00 02 91 02
				15 00 00 00 01 00 02 92 75
				15 00 00 00 01 00 02 93 02
				15 00 00 00 01 00 02 94 B0
				15 00 00 00 01 00 02 95 02
				15 00 00 00 01 00 02 96 D8
				15 00 00 00 01 00 02 97 03
				15 00 00 00 01 00 02 98 09
				15 00 00 00 01 00 02 99 03
				15 00 00 00 01 00 02 9A 29
				15 00 00 00 01 00 02 9B 03
				15 00 00 00 01 00 02 9C 60
				15 00 00 00 01 00 02 9D 03
				15 00 00 00 01 00 02 9E 70
				15 00 00 00 01 00 02 9F 03
				15 00 00 00 01 00 02 A0 81
				15 00 00 00 01 00 02 A2 03
				15 00 00 00 01 00 02 A3 91
				15 00 00 00 01 00 02 A4 03
				15 00 00 00 01 00 02 A5 A0
				15 00 00 00 01 00 02 A6 03
				15 00 00 00 01 00 02 A7 AB
				15 00 00 00 01 00 02 A9 03
				15 00 00 00 01 00 02 AA B3
				15 00 00 00 01 00 02 AB 03
				15 00 00 00 01 00 02 AC B6
				15 00 00 00 01 00 02 AD 03
				15 00 00 00 01 00 02 AE FF
				15 00 00 00 01 00 02 AF 01
				15 00 00 00 01 00 02 B0 B1
				15 00 00 00 01 00 02 B1 01
				15 00 00 00 01 00 02 B2 B3
				15 00 00 00 01 00 02 B3 01
				15 00 00 00 01 00 02 B4 B6
				15 00 00 00 01 00 02 B5 01
				15 00 00 00 01 00 02 B6 B9
				15 00 00 00 01 00 02 B7 01
				15 00 00 00 01 00 02 B8 BD
				15 00 00 00 01 00 02 B9 01
				15 00 00 00 01 00 02 BA C0
				15 00 00 00 01 00 02 BB 01
				15 00 00 00 01 00 02 BC C3
				15 00 00 00 01 00 02 BD 01
				15 00 00 00 01 00 02 BE C6
				15 00 00 00 01 00 02 BF 01
				15 00 00 00 01 00 02 C0 CA
				15 00 00 00 01 00 02 C1 01
				15 00 00 00 01 00 02 C2 D6
				15 00 00 00 01 00 02 C3 01
				15 00 00 00 01 00 02 C4 E2
				15 00 00 00 01 00 02 C5 01
				15 00 00 00 01 00 02 C6 F7
				15 00 00 00 01 00 02 C7 02
				15 00 00 00 01 00 02 C8 06
				15 00 00 00 01 00 02 C9 02
				15 00 00 00 01 00 02 CA 25
				15 00 00 00 01 00 02 CB 02
				15 00 00 00 01 00 02 CC 48
				15 00 00 00 01 00 02 CD 02
				15 00 00 00 01 00 02 CE 4A
				15 00 00 00 01 00 02 CF 02
				15 00 00 00 01 00 02 D0 75
				15 00 00 00 01 00 02 D1 02
				15 00 00 00 01 00 02 D2 B0
				15 00 00 00 01 00 02 D3 02
				15 00 00 00 01 00 02 D4 D8
				15 00 00 00 01 00 02 D5 03
				15 00 00 00 01 00 02 D6 09
				15 00 00 00 01 00 02 D7 03
				15 00 00 00 01 00 02 D8 29
				15 00 00 00 01 00 02 D9 03
				15 00 00 00 01 00 02 DA 60
				15 00 00 00 01 00 02 DB 03
				15 00 00 00 01 00 02 DC 70
				15 00 00 00 01 00 02 DD 03
				15 00 00 00 01 00 02 DE 81
				15 00 00 00 01 00 02 DF 03
				15 00 00 00 01 00 02 E0 91
				15 00 00 00 01 00 02 E1 03
				15 00 00 00 01 00 02 E2 A0
				15 00 00 00 01 00 02 E3 03
				15 00 00 00 01 00 02 E4 AB
				15 00 00 00 01 00 02 E5 03
				15 00 00 00 01 00 02 E6 B3
				15 00 00 00 01 00 02 E7 03
				15 00 00 00 01 00 02 E8 B6
				15 00 00 00 01 00 02 E9 03
				15 00 00 00 01 00 02 EA FF
				15 00 00 00 01 00 02 FB 01
				15 01 00 00 01 00 02 FF 10
				];
		qcom,mdss-dsi-dispparam-papermode3-state = "dsi_hs_mode";
		qcom,mdss-dsi-dispparam-papermode4-command = [
				15 01 00 00 78 00 02 FF 20
				15 00 00 00 01 00 02 FB 01
				15 00 00 00 01 00 02 75 01
				15 00 00 00 01 00 02 76 31
				15 00 00 00 01 00 02 77 01
				15 00 00 00 01 00 02 78 35
				15 00 00 00 01 00 02 79 01
				15 00 00 00 01 00 02 7A 3C
				15 00 00 00 01 00 02 7B 01
				15 00 00 00 01 00 02 7C 43
				15 00 00 00 01 00 02 7D 01
				15 00 00 00 01 00 02 7E 4A
				15 00 00 00 01 00 02 7F 01
				15 00 00 00 01 00 02 80 51
				15 00 00 00 01 00 02 81 01
				15 00 00 00 01 00 02 82 58
				15 00 00 00 01 00 02 83 01
				15 00 00 00 01 00 02 84 5E
				15 00 00 00 01 00 02 85 01
				15 00 00 00 01 00 02 86 64
				15 00 00 00 01 00 02 87 01
				15 00 00 00 01 00 02 88 7A
				15 00 00 00 01 00 02 89 01
				15 00 00 00 01 00 02 8A 8F
				15 00 00 00 01 00 02 8B 01
				15 00 00 00 01 00 02 8C B3
				15 00 00 00 01 00 02 8D 01
				15 00 00 00 01 00 02 8E D2
				15 00 00 00 01 00 02 8F 02
				15 00 00 00 01 00 02 90 03
				15 00 00 00 01 00 02 91 02
				15 00 00 00 01 00 02 92 28
				15 00 00 00 01 00 02 93 02
				15 00 00 00 01 00 02 94 2A
				15 00 00 00 01 00 02 95 02
				15 00 00 00 01 00 02 96 57
				15 00 00 00 01 00 02 97 02
				15 00 00 00 01 00 02 98 92
				15 00 00 00 01 00 02 99 02
				15 00 00 00 01 00 02 9A BB
				15 00 00 00 01 00 02 9B 02
				15 00 00 00 01 00 02 9C F2
				15 00 00 00 01 00 02 9D 03
				15 00 00 00 01 00 02 9E 11
				15 00 00 00 01 00 02 9F 03
				15 00 00 00 01 00 02 A0 4A
				15 00 00 00 01 00 02 A2 03
				15 00 00 00 01 00 02 A3 5D
				15 00 00 00 01 00 02 A4 03
				15 00 00 00 01 00 02 A5 70
				15 00 00 00 01 00 02 A6 03
				15 00 00 00 01 00 02 A7 83
				15 00 00 00 01 00 02 A9 03
				15 00 00 00 01 00 02 AA 96
				15 00 00 00 01 00 02 AB 03
				15 00 00 00 01 00 02 AC A6
				15 00 00 00 01 00 02 AD 03
				15 00 00 00 01 00 02 AE B1
				15 00 00 00 01 00 02 AF 03
				15 00 00 00 01 00 02 B0 B6
				15 00 00 00 01 00 02 B1 03
				15 00 00 00 01 00 02 B2 FF
				15 00 00 00 01 00 02 B3 01
				15 00 00 00 01 00 02 B4 31
				15 00 00 00 01 00 02 B5 01
				15 00 00 00 01 00 02 B6 35
				15 00 00 00 01 00 02 B7 01
				15 00 00 00 01 00 02 B8 3C
				15 00 00 00 01 00 02 B9 01
				15 00 00 00 01 00 02 BA 43
				15 00 00 00 01 00 02 BB 01
				15 00 00 00 01 00 02 BC 4A
				15 00 00 00 01 00 02 BD 01
				15 00 00 00 01 00 02 BE 51
				15 00 00 00 01 00 02 BF 01
				15 00 00 00 01 00 02 C0 58
				15 00 00 00 01 00 02 C1 01
				15 00 00 00 01 00 02 C2 5E
				15 00 00 00 01 00 02 C3 01
				15 00 00 00 01 00 02 C4 64
				15 00 00 00 01 00 02 C5 01
				15 00 00 00 01 00 02 C6 7A
				15 00 00 00 01 00 02 C7 01
				15 00 00 00 01 00 02 C8 8F
				15 00 00 00 01 00 02 C9 01
				15 00 00 00 01 00 02 CA B3
				15 00 00 00 01 00 02 CB 01
				15 00 00 00 01 00 02 CC D2
				15 00 00 00 01 00 02 CD 02
				15 00 00 00 01 00 02 CE 03
				15 00 00 00 01 00 02 CF 02
				15 00 00 00 01 00 02 D0 28
				15 00 00 00 01 00 02 D1 02
				15 00 00 00 01 00 02 D2 2A
				15 00 00 00 01 00 02 D3 02
				15 00 00 00 01 00 02 D4 57
				15 00 00 00 01 00 02 D5 02
				15 00 00 00 01 00 02 D6 92
				15 00 00 00 01 00 02 D7 02
				15 00 00 00 01 00 02 D8 BB
				15 00 00 00 01 00 02 D9 02
				15 00 00 00 01 00 02 DA F2
				15 00 00 00 01 00 02 DB 03
				15 00 00 00 01 00 02 DC 11
				15 00 00 00 01 00 02 DD 03
				15 00 00 00 01 00 02 DE 4A
				15 00 00 00 01 00 02 DF 03
				15 00 00 00 01 00 02 E0 5D
				15 00 00 00 01 00 02 E1 03
				15 00 00 00 01 00 02 E2 70
				15 00 00 00 01 00 02 E3 03
				15 00 00 00 01 00 02 E4 83
				15 00 00 00 01 00 02 E5 03
				15 00 00 00 01 00 02 E6 96
				15 00 00 00 01 00 02 E7 03
				15 00 00 00 01 00 02 E8 A6
				15 00 00 00 01 00 02 E9 03
				15 00 00 00 01 00 02 EA B1
				15 00 00 00 01 00 02 EB 03
				15 00 00 00 01 00 02 EC B6
				15 00 00 00 01 00 02 ED 03
				15 00 00 00 01 00 02 EE FF
				15 00 00 00 01 00 02 EF 01
				15 00 00 00 01 00 02 F0 4A
				15 00 00 00 01 00 02 F1 01
				15 00 00 00 01 00 02 F2 4D
				15 00 00 00 01 00 02 F3 01
				15 00 00 00 01 00 02 F4 54
				15 00 00 00 01 00 02 F5 01
				15 00 00 00 01 00 02 F6 5A
				15 00 00 00 01 00 02 F7 01
				15 00 00 00 01 00 02 F8 60
				15 00 00 00 01 00 02 F9 01
				15 00 00 00 01 00 02 FA 66
				15 00 00 00 01 00 02 FF 21
				15 00 00 00 01 00 02 FB 01
				15 00 00 00 01 00 02 00 01
				15 00 00 00 01 00 02 01 6B
				15 00 00 00 01 00 02 02 01
				15 00 00 00 01 00 02 03 71
				15 00 00 00 01 00 02 04 01
				15 00 00 00 01 00 02 05 76
				15 00 00 00 01 00 02 06 01
				15 00 00 00 01 00 02 07 8A
				15 00 00 00 01 00 02 08 01
				15 00 00 00 01 00 02 09 9D
				15 00 00 00 01 00 02 0A 01
				15 00 00 00 01 00 02 0B BE
				15 00 00 00 01 00 02 0C 01
				15 00 00 00 01 00 02 0D DC
				15 00 00 00 01 00 02 0E 02
				15 00 00 00 01 00 02 0F 07
				15 00 00 00 01 00 02 10 02
				15 00 00 00 01 00 02 11 2D
				15 00 00 00 01 00 02 12 02
				15 00 00 00 01 00 02 13 2E
				15 00 00 00 01 00 02 14 02
				15 00 00 00 01 00 02 15 5C
				15 00 00 00 01 00 02 16 02
				15 00 00 00 01 00 02 17 97
				15 00 00 00 01 00 02 18 02
				15 00 00 00 01 00 02 19 C0
				15 00 00 00 01 00 02 1A 02
				15 00 00 00 01 00 02 1B F7
				15 00 00 00 01 00 02 1C 03
				15 00 00 00 01 00 02 1D 14
				15 00 00 00 01 00 02 1E 03
				15 00 00 00 01 00 02 1F 4B
				15 00 00 00 01 00 02 20 03
				15 00 00 00 01 00 02 21 5C
				15 00 00 00 01 00 02 22 03
				15 00 00 00 01 00 02 23 6F
				15 00 00 00 01 00 02 24 03
				15 00 00 00 01 00 02 25 83
				15 00 00 00 01 00 02 26 03
				15 00 00 00 01 00 02 27 97
				15 00 00 00 01 00 02 28 03
				15 00 00 00 01 00 02 29 A6
				15 00 00 00 01 00 02 2A 03
				15 00 00 00 01 00 02 2B B1
				15 00 00 00 01 00 02 2D 03
				15 00 00 00 01 00 02 2F B6
				15 00 00 00 01 00 02 30 03
				15 00 00 00 01 00 02 31 FF
				15 00 00 00 01 00 02 32 01
				15 00 00 00 01 00 02 33 4A
				15 00 00 00 01 00 02 34 01
				15 00 00 00 01 00 02 35 4D
				15 00 00 00 01 00 02 36 01
				15 00 00 00 01 00 02 37 54
				15 00 00 00 01 00 02 38 01
				15 00 00 00 01 00 02 39 5A
				15 00 00 00 01 00 02 3A 01
				15 00 00 00 01 00 02 3B 60
				15 00 00 00 01 00 02 3D 01
				15 00 00 00 01 00 02 3F 66
				15 00 00 00 01 00 02 40 01
				15 00 00 00 01 00 02 41 6B
				15 00 00 00 01 00 02 42 01
				15 00 00 00 01 00 02 43 71
				15 00 00 00 01 00 02 44 01
				15 00 00 00 01 00 02 45 76
				15 00 00 00 01 00 02 46 01
				15 00 00 00 01 00 02 47 8A
				15 00 00 00 01 00 02 48 01
				15 00 00 00 01 00 02 49 9D
				15 00 00 00 01 00 02 4A 01
				15 00 00 00 01 00 02 4B BE
				15 00 00 00 01 00 02 4C 01
				15 00 00 00 01 00 02 4D DC
				15 00 00 00 01 00 02 4E 02
				15 00 00 00 01 00 02 4F 07
				15 00 00 00 01 00 02 50 02
				15 00 00 00 01 00 02 51 2D
				15 00 00 00 01 00 02 52 02
				15 00 00 00 01 00 02 53 2E
				15 00 00 00 01 00 02 54 02
				15 00 00 00 01 00 02 55 5C
				15 00 00 00 01 00 02 56 02
				15 00 00 00 01 00 02 58 97
				15 00 00 00 01 00 02 59 02
				15 00 00 00 01 00 02 5A C0
				15 00 00 00 01 00 02 5B 02
				15 00 00 00 01 00 02 5C F7
				15 00 00 00 01 00 02 5D 03
				15 00 00 00 01 00 02 5E 14
				15 00 00 00 01 00 02 5F 03
				15 00 00 00 01 00 02 60 4B
				15 00 00 00 01 00 02 61 03
				15 00 00 00 01 00 02 62 5C
				15 00 00 00 01 00 02 63 03
				15 00 00 00 01 00 02 64 6F
				15 00 00 00 01 00 02 65 03
				15 00 00 00 01 00 02 66 83
				15 00 00 00 01 00 02 67 03
				15 00 00 00 01 00 02 68 97
				15 00 00 00 01 00 02 69 03
				15 00 00 00 01 00 02 6A A6
				15 00 00 00 01 00 02 6B 03
				15 00 00 00 01 00 02 6C B1
				15 00 00 00 01 00 02 6D 03
				15 00 00 00 01 00 02 6E B6
				15 00 00 00 01 00 02 6F 03
				15 00 00 00 01 00 02 70 FF
				15 00 00 00 01 00 02 71 01
				15 00 00 00 01 00 02 72 C7
				15 00 00 00 01 00 02 73 01
				15 00 00 00 01 00 02 74 C9
				15 00 00 00 01 00 02 75 01
				15 00 00 00 01 00 02 76 CB
				15 00 00 00 01 00 02 77 01
				15 00 00 00 01 00 02 78 CE
				15 00 00 00 01 00 02 79 01
				15 00 00 00 01 00 02 7A D1
				15 00 00 00 01 00 02 7B 01
				15 00 00 00 01 00 02 7C D4
				15 00 00 00 01 00 02 7D 01
				15 00 00 00 01 00 02 7E D7
				15 00 00 00 01 00 02 7F 01
				15 00 00 00 01 00 02 80 DA
				15 00 00 00 01 00 02 81 01
				15 00 00 00 01 00 02 82 DD
				15 00 00 00 01 00 02 83 01
				15 00 00 00 01 00 02 84 E8
				15 00 00 00 01 00 02 85 01
				15 00 00 00 01 00 02 86 F4
				15 00 00 00 01 00 02 87 02
				15 00 00 00 01 00 02 88 01
				15 00 00 00 01 00 02 89 02
				15 00 00 00 01 00 02 8A 0F
				15 00 00 00 01 00 02 8B 02
				15 00 00 00 01 00 02 8C 2D
				15 00 00 00 01 00 02 8D 02
				15 00 00 00 01 00 02 8E 50
				15 00 00 00 01 00 02 8F 02
				15 00 00 00 01 00 02 90 52
				15 00 00 00 01 00 02 91 02
				15 00 00 00 01 00 02 92 7C
				15 00 00 00 01 00 02 93 02
				15 00 00 00 01 00 02 94 B6
				15 00 00 00 01 00 02 95 02
				15 00 00 00 01 00 02 96 DD
				15 00 00 00 01 00 02 97 03
				15 00 00 00 01 00 02 98 0D
				15 00 00 00 01 00 02 99 03
				15 00 00 00 01 00 02 9A 32
				15 00 00 00 01 00 02 9B 03
				15 00 00 00 01 00 02 9C 6A
				15 00 00 00 01 00 02 9D 03
				15 00 00 00 01 00 02 9E 79
				15 00 00 00 01 00 02 9F 03
				15 00 00 00 01 00 02 A0 88
				15 00 00 00 01 00 02 A2 03
				15 00 00 00 01 00 02 A3 96
				15 00 00 00 01 00 02 A4 03
				15 00 00 00 01 00 02 A5 A3
				15 00 00 00 01 00 02 A6 03
				15 00 00 00 01 00 02 A7 AD
				15 00 00 00 01 00 02 A9 03
				15 00 00 00 01 00 02 AA B3
				15 00 00 00 01 00 02 AB 03
				15 00 00 00 01 00 02 AC B6
				15 00 00 00 01 00 02 AD 03
				15 00 00 00 01 00 02 AE FF
				15 00 00 00 01 00 02 AF 01
				15 00 00 00 01 00 02 B0 C7
				15 00 00 00 01 00 02 B1 01
				15 00 00 00 01 00 02 B2 C9
				15 00 00 00 01 00 02 B3 01
				15 00 00 00 01 00 02 B4 CB
				15 00 00 00 01 00 02 B5 01
				15 00 00 00 01 00 02 B6 CE
				15 00 00 00 01 00 02 B7 01
				15 00 00 00 01 00 02 B8 D1
				15 00 00 00 01 00 02 B9 01
				15 00 00 00 01 00 02 BA D4
				15 00 00 00 01 00 02 BB 01
				15 00 00 00 01 00 02 BC D7
				15 00 00 00 01 00 02 BD 01
				15 00 00 00 01 00 02 BE DA
				15 00 00 00 01 00 02 BF 01
				15 00 00 00 01 00 02 C0 DD
				15 00 00 00 01 00 02 C1 01
				15 00 00 00 01 00 02 C2 E8
				15 00 00 00 01 00 02 C3 01
				15 00 00 00 01 00 02 C4 F4
				15 00 00 00 01 00 02 C5 02
				15 00 00 00 01 00 02 C6 01
				15 00 00 00 01 00 02 C7 02
				15 00 00 00 01 00 02 C8 0F
				15 00 00 00 01 00 02 C9 02
				15 00 00 00 01 00 02 CA 2D
				15 00 00 00 01 00 02 CB 02
				15 00 00 00 01 00 02 CC 50
				15 00 00 00 01 00 02 CD 02
				15 00 00 00 01 00 02 CE 52
				15 00 00 00 01 00 02 CF 02
				15 00 00 00 01 00 02 D0 7C
				15 00 00 00 01 00 02 D1 02
				15 00 00 00 01 00 02 D2 B6
				15 00 00 00 01 00 02 D3 02
				15 00 00 00 01 00 02 D4 DD
				15 00 00 00 01 00 02 D5 03
				15 00 00 00 01 00 02 D6 0D
				15 00 00 00 01 00 02 D7 03
				15 00 00 00 01 00 02 D8 32
				15 00 00 00 01 00 02 D9 03
				15 00 00 00 01 00 02 DA 6A
				15 00 00 00 01 00 02 DB 03
				15 00 00 00 01 00 02 DC 79
				15 00 00 00 01 00 02 DD 03
				15 00 00 00 01 00 02 DE 88
				15 00 00 00 01 00 02 DF 03
				15 00 00 00 01 00 02 E0 96
				15 00 00 00 01 00 02 E1 03
				15 00 00 00 01 00 02 E2 A3
				15 00 00 00 01 00 02 E3 03
				15 00 00 00 01 00 02 E4 AD
				15 00 00 00 01 00 02 E5 03
				15 00 00 00 01 00 02 E6 B3
				15 00 00 00 01 00 02 E7 03
				15 00 00 00 01 00 02 E8 B6
				15 00 00 00 01 00 02 E9 03
				15 00 00 00 01 00 02 EA FF
				15 00 00 00 01 00 02 FB 01
				15 01 00 00 01 00 02 FF 10
				];
		qcom,mdss-dsi-dispparam-papermode4-state = "dsi_hs_mode";
		qcom,mdss-dsi-dispparam-papermode5-command = [
				15 01 00 00 78 00 02 FF 20
				15 00 00 00 01 00 02 FB 01
				15 00 00 00 01 00 02 75 01
				15 00 00 00 01 00 02 76 31
				15 00 00 00 01 00 02 77 01
				15 00 00 00 01 00 02 78 35
				15 00 00 00 01 00 02 79 01
				15 00 00 00 01 00 02 7A 3C
				15 00 00 00 01 00 02 7B 01
				15 00 00 00 01 00 02 7C 43
				15 00 00 00 01 00 02 7D 01
				15 00 00 00 01 00 02 7E 4A
				15 00 00 00 01 00 02 7F 01
				15 00 00 00 01 00 02 80 51
				15 00 00 00 01 00 02 81 01
				15 00 00 00 01 00 02 82 58
				15 00 00 00 01 00 02 83 01
				15 00 00 00 01 00 02 84 5E
				15 00 00 00 01 00 02 85 01
				15 00 00 00 01 00 02 86 64
				15 00 00 00 01 00 02 87 01
				15 00 00 00 01 00 02 88 7A
				15 00 00 00 01 00 02 89 01
				15 00 00 00 01 00 02 8A 8F
				15 00 00 00 01 00 02 8B 01
				15 00 00 00 01 00 02 8C B3
				15 00 00 00 01 00 02 8D 01
				15 00 00 00 01 00 02 8E D2
				15 00 00 00 01 00 02 8F 02
				15 00 00 00 01 00 02 90 03
				15 00 00 00 01 00 02 91 02
				15 00 00 00 01 00 02 92 28
				15 00 00 00 01 00 02 93 02
				15 00 00 00 01 00 02 94 2A
				15 00 00 00 01 00 02 95 02
				15 00 00 00 01 00 02 96 57
				15 00 00 00 01 00 02 97 02
				15 00 00 00 01 00 02 98 92
				15 00 00 00 01 00 02 99 02
				15 00 00 00 01 00 02 9A BB
				15 00 00 00 01 00 02 9B 02
				15 00 00 00 01 00 02 9C F2
				15 00 00 00 01 00 02 9D 03
				15 00 00 00 01 00 02 9E 11
				15 00 00 00 01 00 02 9F 03
				15 00 00 00 01 00 02 A0 4A
				15 00 00 00 01 00 02 A2 03
				15 00 00 00 01 00 02 A3 5D
				15 00 00 00 01 00 02 A4 03
				15 00 00 00 01 00 02 A5 70
				15 00 00 00 01 00 02 A6 03
				15 00 00 00 01 00 02 A7 83
				15 00 00 00 01 00 02 A9 03
				15 00 00 00 01 00 02 AA 96
				15 00 00 00 01 00 02 AB 03
				15 00 00 00 01 00 02 AC A6
				15 00 00 00 01 00 02 AD 03
				15 00 00 00 01 00 02 AE B1
				15 00 00 00 01 00 02 AF 03
				15 00 00 00 01 00 02 B0 B6
				15 00 00 00 01 00 02 B1 03
				15 00 00 00 01 00 02 B2 FF
				15 00 00 00 01 00 02 B3 01
				15 00 00 00 01 00 02 B4 31
				15 00 00 00 01 00 02 B5 01
				15 00 00 00 01 00 02 B6 35
				15 00 00 00 01 00 02 B7 01
				15 00 00 00 01 00 02 B8 3C
				15 00 00 00 01 00 02 B9 01
				15 00 00 00 01 00 02 BA 43
				15 00 00 00 01 00 02 BB 01
				15 00 00 00 01 00 02 BC 4A
				15 00 00 00 01 00 02 BD 01
				15 00 00 00 01 00 02 BE 51
				15 00 00 00 01 00 02 BF 01
				15 00 00 00 01 00 02 C0 58
				15 00 00 00 01 00 02 C1 01
				15 00 00 00 01 00 02 C2 5E
				15 00 00 00 01 00 02 C3 01
				15 00 00 00 01 00 02 C4 64
				15 00 00 00 01 00 02 C5 01
				15 00 00 00 01 00 02 C6 7A
				15 00 00 00 01 00 02 C7 01
				15 00 00 00 01 00 02 C8 8F
				15 00 00 00 01 00 02 C9 01
				15 00 00 00 01 00 02 CA B3
				15 00 00 00 01 00 02 CB 01
				15 00 00 00 01 00 02 CC D2
				15 00 00 00 01 00 02 CD 02
				15 00 00 00 01 00 02 CE 03
				15 00 00 00 01 00 02 CF 02
				15 00 00 00 01 00 02 D0 28
				15 00 00 00 01 00 02 D1 02
				15 00 00 00 01 00 02 D2 2A
				15 00 00 00 01 00 02 D3 02
				15 00 00 00 01 00 02 D4 57
				15 00 00 00 01 00 02 D5 02
				15 00 00 00 01 00 02 D6 92
				15 00 00 00 01 00 02 D7 02
				15 00 00 00 01 00 02 D8 BB
				15 00 00 00 01 00 02 D9 02
				15 00 00 00 01 00 02 DA F2
				15 00 00 00 01 00 02 DB 03
				15 00 00 00 01 00 02 DC 11
				15 00 00 00 01 00 02 DD 03
				15 00 00 00 01 00 02 DE 4A
				15 00 00 00 01 00 02 DF 03
				15 00 00 00 01 00 02 E0 5D
				15 00 00 00 01 00 02 E1 03
				15 00 00 00 01 00 02 E2 70
				15 00 00 00 01 00 02 E3 03
				15 00 00 00 01 00 02 E4 83
				15 00 00 00 01 00 02 E5 03
				15 00 00 00 01 00 02 E6 96
				15 00 00 00 01 00 02 E7 03
				15 00 00 00 01 00 02 E8 A6
				15 00 00 00 01 00 02 E9 03
				15 00 00 00 01 00 02 EA B1
				15 00 00 00 01 00 02 EB 03
				15 00 00 00 01 00 02 EC B6
				15 00 00 00 01 00 02 ED 03
				15 00 00 00 01 00 02 EE FF
				15 00 00 00 01 00 02 EF 01
				15 00 00 00 01 00 02 F0 4A
				15 00 00 00 01 00 02 F1 01
				15 00 00 00 01 00 02 F2 4D
				15 00 00 00 01 00 02 F3 01
				15 00 00 00 01 00 02 F4 54
				15 00 00 00 01 00 02 F5 01
				15 00 00 00 01 00 02 F6 5A
				15 00 00 00 01 00 02 F7 01
				15 00 00 00 01 00 02 F8 60
				15 00 00 00 01 00 02 F9 01
				15 00 00 00 01 00 02 FA 66
				15 00 00 00 01 00 02 FF 21
				15 00 00 00 01 00 02 FB 01
				15 00 00 00 01 00 02 00 01
				15 00 00 00 01 00 02 01 6B
				15 00 00 00 01 00 02 02 01
				15 00 00 00 01 00 02 03 71
				15 00 00 00 01 00 02 04 01
				15 00 00 00 01 00 02 05 76
				15 00 00 00 01 00 02 06 01
				15 00 00 00 01 00 02 07 8A
				15 00 00 00 01 00 02 08 01
				15 00 00 00 01 00 02 09 9D
				15 00 00 00 01 00 02 0A 01
				15 00 00 00 01 00 02 0B BE
				15 00 00 00 01 00 02 0C 01
				15 00 00 00 01 00 02 0D DC
				15 00 00 00 01 00 02 0E 02
				15 00 00 00 01 00 02 0F 07
				15 00 00 00 01 00 02 10 02
				15 00 00 00 01 00 02 11 2D
				15 00 00 00 01 00 02 12 02
				15 00 00 00 01 00 02 13 2E
				15 00 00 00 01 00 02 14 02
				15 00 00 00 01 00 02 15 5C
				15 00 00 00 01 00 02 16 02
				15 00 00 00 01 00 02 17 97
				15 00 00 00 01 00 02 18 02
				15 00 00 00 01 00 02 19 C0
				15 00 00 00 01 00 02 1A 02
				15 00 00 00 01 00 02 1B F7
				15 00 00 00 01 00 02 1C 03
				15 00 00 00 01 00 02 1D 14
				15 00 00 00 01 00 02 1E 03
				15 00 00 00 01 00 02 1F 4B
				15 00 00 00 01 00 02 20 03
				15 00 00 00 01 00 02 21 5C
				15 00 00 00 01 00 02 22 03
				15 00 00 00 01 00 02 23 6F
				15 00 00 00 01 00 02 24 03
				15 00 00 00 01 00 02 25 83
				15 00 00 00 01 00 02 26 03
				15 00 00 00 01 00 02 27 97
				15 00 00 00 01 00 02 28 03
				15 00 00 00 01 00 02 29 A6
				15 00 00 00 01 00 02 2A 03
				15 00 00 00 01 00 02 2B B1
				15 00 00 00 01 00 02 2D 03
				15 00 00 00 01 00 02 2F B6
				15 00 00 00 01 00 02 30 03
				15 00 00 00 01 00 02 31 FF
				15 00 00 00 01 00 02 32 01
				15 00 00 00 01 00 02 33 4A
				15 00 00 00 01 00 02 34 01
				15 00 00 00 01 00 02 35 4D
				15 00 00 00 01 00 02 36 01
				15 00 00 00 01 00 02 37 54
				15 00 00 00 01 00 02 38 01
				15 00 00 00 01 00 02 39 5A
				15 00 00 00 01 00 02 3A 01
				15 00 00 00 01 00 02 3B 60
				15 00 00 00 01 00 02 3D 01
				15 00 00 00 01 00 02 3F 66
				15 00 00 00 01 00 02 40 01
				15 00 00 00 01 00 02 41 6B
				15 00 00 00 01 00 02 42 01
				15 00 00 00 01 00 02 43 71
				15 00 00 00 01 00 02 44 01
				15 00 00 00 01 00 02 45 76
				15 00 00 00 01 00 02 46 01
				15 00 00 00 01 00 02 47 8A
				15 00 00 00 01 00 02 48 01
				15 00 00 00 01 00 02 49 9D
				15 00 00 00 01 00 02 4A 01
				15 00 00 00 01 00 02 4B BE
				15 00 00 00 01 00 02 4C 01
				15 00 00 00 01 00 02 4D DC
				15 00 00 00 01 00 02 4E 02
				15 00 00 00 01 00 02 4F 07
				15 00 00 00 01 00 02 50 02
				15 00 00 00 01 00 02 51 2D
				15 00 00 00 01 00 02 52 02
				15 00 00 00 01 00 02 53 2E
				15 00 00 00 01 00 02 54 02
				15 00 00 00 01 00 02 55 5C
				15 00 00 00 01 00 02 56 02
				15 00 00 00 01 00 02 58 97
				15 00 00 00 01 00 02 59 02
				15 00 00 00 01 00 02 5A C0
				15 00 00 00 01 00 02 5B 02
				15 00 00 00 01 00 02 5C F7
				15 00 00 00 01 00 02 5D 03
				15 00 00 00 01 00 02 5E 14
				15 00 00 00 01 00 02 5F 03
				15 00 00 00 01 00 02 60 4B
				15 00 00 00 01 00 02 61 03
				15 00 00 00 01 00 02 62 5C
				15 00 00 00 01 00 02 63 03
				15 00 00 00 01 00 02 64 6F
				15 00 00 00 01 00 02 65 03
				15 00 00 00 01 00 02 66 83
				15 00 00 00 01 00 02 67 03
				15 00 00 00 01 00 02 68 97
				15 00 00 00 01 00 02 69 03
				15 00 00 00 01 00 02 6A A6
				15 00 00 00 01 00 02 6B 03
				15 00 00 00 01 00 02 6C B1
				15 00 00 00 01 00 02 6D 03
				15 00 00 00 01 00 02 6E B6
				15 00 00 00 01 00 02 6F 03
				15 00 00 00 01 00 02 70 FF
				15 00 00 00 01 00 02 71 01
				15 00 00 00 01 00 02 72 D7
				15 00 00 00 01 00 02 73 01
				15 00 00 00 01 00 02 74 D8
				15 00 00 00 01 00 02 75 01
				15 00 00 00 01 00 02 76 DB
				15 00 00 00 01 00 02 77 01
				15 00 00 00 01 00 02 78 DE
				15 00 00 00 01 00 02 79 01
				15 00 00 00 01 00 02 7A E1
				15 00 00 00 01 00 02 7B 01
				15 00 00 00 01 00 02 7C E3
				15 00 00 00 01 00 02 7D 01
				15 00 00 00 01 00 02 7E E6
				15 00 00 00 01 00 02 7F 01
				15 00 00 00 01 00 02 80 E9
				15 00 00 00 01 00 02 81 01
				15 00 00 00 01 00 02 82 EC
				15 00 00 00 01 00 02 83 01
				15 00 00 00 01 00 02 84 F5
				15 00 00 00 01 00 02 85 01
				15 00 00 00 01 00 02 86 FC
				15 00 00 00 01 00 02 87 02
				15 00 00 00 01 00 02 88 09
				15 00 00 00 01 00 02 89 02
				15 00 00 00 01 00 02 8A 17
				15 00 00 00 01 00 02 8B 02
				15 00 00 00 01 00 02 8C 35
				15 00 00 00 01 00 02 8D 02
				15 00 00 00 01 00 02 8E 58
				15 00 00 00 01 00 02 8F 02
				15 00 00 00 01 00 02 90 59
				15 00 00 00 01 00 02 91 02
				15 00 00 00 01 00 02 92 84
				15 00 00 00 01 00 02 93 02
				15 00 00 00 01 00 02 94 BE
				15 00 00 00 01 00 02 95 02
				15 00 00 00 01 00 02 96 E4
				15 00 00 00 01 00 02 97 03
				15 00 00 00 01 00 02 98 10
				15 00 00 00 01 00 02 99 03
				15 00 00 00 01 00 02 9A 32
				15 00 00 00 01 00 02 9B 03
				15 00 00 00 01 00 02 9C 60
				15 00 00 00 01 00 02 9D 03
				15 00 00 00 01 00 02 9E 6E
				15 00 00 00 01 00 02 9F 03
				15 00 00 00 01 00 02 A0 7D
				15 00 00 00 01 00 02 A2 03
				15 00 00 00 01 00 02 A3 8F
				15 00 00 00 01 00 02 A4 03
				15 00 00 00 01 00 02 A5 A2
				15 00 00 00 01 00 02 A6 03
				15 00 00 00 01 00 02 A7 B5
				15 00 00 00 01 00 02 A9 03
				15 00 00 00 01 00 02 AA C4
				15 00 00 00 01 00 02 AB 03
				15 00 00 00 01 00 02 AC CC
				15 00 00 00 01 00 02 AD 03
				15 00 00 00 01 00 02 AE FF
				15 00 00 00 01 00 02 AF 01
				15 00 00 00 01 00 02 B0 D7
				15 00 00 00 01 00 02 B1 01
				15 00 00 00 01 00 02 B2 D8
				15 00 00 00 01 00 02 B3 01
				15 00 00 00 01 00 02 B4 DB
				15 00 00 00 01 00 02 B5 01
				15 00 00 00 01 00 02 B6 DE
				15 00 00 00 01 00 02 B7 01
				15 00 00 00 01 00 02 B8 E1
				15 00 00 00 01 00 02 B9 01
				15 00 00 00 01 00 02 BA E3
				15 00 00 00 01 00 02 BB 01
				15 00 00 00 01 00 02 BC E6
				15 00 00 00 01 00 02 BD 01
				15 00 00 00 01 00 02 BE E9
				15 00 00 00 01 00 02 BF 01
				15 00 00 00 01 00 02 C0 EC
				15 00 00 00 01 00 02 C1 01
				15 00 00 00 01 00 02 C2 F5
				15 00 00 00 01 00 02 C3 01
				15 00 00 00 01 00 02 C4 FC
				15 00 00 00 01 00 02 C5 02
				15 00 00 00 01 00 02 C6 09
				15 00 00 00 01 00 02 C7 02
				15 00 00 00 01 00 02 C8 17
				15 00 00 00 01 00 02 C9 02
				15 00 00 00 01 00 02 CA 35
				15 00 00 00 01 00 02 CB 02
				15 00 00 00 01 00 02 CC 58
				15 00 00 00 01 00 02 CD 02
				15 00 00 00 01 00 02 CE 59
				15 00 00 00 01 00 02 CF 02
				15 00 00 00 01 00 02 D0 84
				15 00 00 00 01 00 02 D1 02
				15 00 00 00 01 00 02 D2 BE
				15 00 00 00 01 00 02 D3 02
				15 00 00 00 01 00 02 D4 E4
				15 00 00 00 01 00 02 D5 03
				15 00 00 00 01 00 02 D6 10
				15 00 00 00 01 00 02 D7 03
				15 00 00 00 01 00 02 D8 32
				15 00 00 00 01 00 02 D9 03
				15 00 00 00 01 00 02 DA 60
				15 00 00 00 01 00 02 DB 03
				15 00 00 00 01 00 02 DC 6E
				15 00 00 00 01 00 02 DD 03
				15 00 00 00 01 00 02 DE 7D
				15 00 00 00 01 00 02 DF 03
				15 00 00 00 01 00 02 E0 8F
				15 00 00 00 01 00 02 E1 03
				15 00 00 00 01 00 02 E2 A2
				15 00 00 00 01 00 02 E3 03
				15 00 00 00 01 00 02 E4 B5
				15 00 00 00 01 00 02 E5 03
				15 00 00 00 01 00 02 E6 C4
				15 00 00 00 01 00 02 E7 03
				15 00 00 00 01 00 02 E8 CC
				15 00 00 00 01 00 02 E9 03
				15 00 00 00 01 00 02 EA FF
				15 00 00 00 01 00 02 FB 01
				15 01 00 00 01 00 02 FF 10
				];
		qcom,mdss-dsi-dispparam-papermode5-state = "dsi_hs_mode";
		qcom,mdss-dsi-dispparam-papermode6-command = [
				15 01 00 00 78 00 02 FF 20
				15 00 00 00 01 00 02 FB 01
				15 00 00 00 01 00 02 75 01
				15 00 00 00 01 00 02 76 31
				15 00 00 00 01 00 02 77 01
				15 00 00 00 01 00 02 78 35
				15 00 00 00 01 00 02 79 01
				15 00 00 00 01 00 02 7A 3C
				15 00 00 00 01 00 02 7B 01
				15 00 00 00 01 00 02 7C 43
				15 00 00 00 01 00 02 7D 01
				15 00 00 00 01 00 02 7E 4A
				15 00 00 00 01 00 02 7F 01
				15 00 00 00 01 00 02 80 51
				15 00 00 00 01 00 02 81 01
				15 00 00 00 01 00 02 82 58
				15 00 00 00 01 00 02 83 01
				15 00 00 00 01 00 02 84 5E
				15 00 00 00 01 00 02 85 01
				15 00 00 00 01 00 02 86 64
				15 00 00 00 01 00 02 87 01
				15 00 00 00 01 00 02 88 7A
				15 00 00 00 01 00 02 89 01
				15 00 00 00 01 00 02 8A 8F
				15 00 00 00 01 00 02 8B 01
				15 00 00 00 01 00 02 8C B3
				15 00 00 00 01 00 02 8D 01
				15 00 00 00 01 00 02 8E D2
				15 00 00 00 01 00 02 8F 02
				15 00 00 00 01 00 02 90 03
				15 00 00 00 01 00 02 91 02
				15 00 00 00 01 00 02 92 28
				15 00 00 00 01 00 02 93 02
				15 00 00 00 01 00 02 94 2A
				15 00 00 00 01 00 02 95 02
				15 00 00 00 01 00 02 96 57
				15 00 00 00 01 00 02 97 02
				15 00 00 00 01 00 02 98 92
				15 00 00 00 01 00 02 99 02
				15 00 00 00 01 00 02 9A BB
				15 00 00 00 01 00 02 9B 02
				15 00 00 00 01 00 02 9C F2
				15 00 00 00 01 00 02 9D 03
				15 00 00 00 01 00 02 9E 11
				15 00 00 00 01 00 02 9F 03
				15 00 00 00 01 00 02 A0 4A
				15 00 00 00 01 00 02 A2 03
				15 00 00 00 01 00 02 A3 5D
				15 00 00 00 01 00 02 A4 03
				15 00 00 00 01 00 02 A5 70
				15 00 00 00 01 00 02 A6 03
				15 00 00 00 01 00 02 A7 83
				15 00 00 00 01 00 02 A9 03
				15 00 00 00 01 00 02 AA 96
				15 00 00 00 01 00 02 AB 03
				15 00 00 00 01 00 02 AC A6
				15 00 00 00 01 00 02 AD 03
				15 00 00 00 01 00 02 AE B1
				15 00 00 00 01 00 02 AF 03
				15 00 00 00 01 00 02 B0 B6
				15 00 00 00 01 00 02 B1 03
				15 00 00 00 01 00 02 B2 FF
				15 00 00 00 01 00 02 B3 01
				15 00 00 00 01 00 02 B4 31
				15 00 00 00 01 00 02 B5 01
				15 00 00 00 01 00 02 B6 35
				15 00 00 00 01 00 02 B7 01
				15 00 00 00 01 00 02 B8 3C
				15 00 00 00 01 00 02 B9 01
				15 00 00 00 01 00 02 BA 43
				15 00 00 00 01 00 02 BB 01
				15 00 00 00 01 00 02 BC 4A
				15 00 00 00 01 00 02 BD 01
				15 00 00 00 01 00 02 BE 51
				15 00 00 00 01 00 02 BF 01
				15 00 00 00 01 00 02 C0 58
				15 00 00 00 01 00 02 C1 01
				15 00 00 00 01 00 02 C2 5E
				15 00 00 00 01 00 02 C3 01
				15 00 00 00 01 00 02 C4 64
				15 00 00 00 01 00 02 C5 01
				15 00 00 00 01 00 02 C6 7A
				15 00 00 00 01 00 02 C7 01
				15 00 00 00 01 00 02 C8 8F
				15 00 00 00 01 00 02 C9 01
				15 00 00 00 01 00 02 CA B3
				15 00 00 00 01 00 02 CB 01
				15 00 00 00 01 00 02 CC D2
				15 00 00 00 01 00 02 CD 02
				15 00 00 00 01 00 02 CE 03
				15 00 00 00 01 00 02 CF 02
				15 00 00 00 01 00 02 D0 28
				15 00 00 00 01 00 02 D1 02
				15 00 00 00 01 00 02 D2 2A
				15 00 00 00 01 00 02 D3 02
				15 00 00 00 01 00 02 D4 57
				15 00 00 00 01 00 02 D5 02
				15 00 00 00 01 00 02 D6 92
				15 00 00 00 01 00 02 D7 02
				15 00 00 00 01 00 02 D8 BB
				15 00 00 00 01 00 02 D9 02
				15 00 00 00 01 00 02 DA F2
				15 00 00 00 01 00 02 DB 03
				15 00 00 00 01 00 02 DC 11
				15 00 00 00 01 00 02 DD 03
				15 00 00 00 01 00 02 DE 4A
				15 00 00 00 01 00 02 DF 03
				15 00 00 00 01 00 02 E0 5D
				15 00 00 00 01 00 02 E1 03
				15 00 00 00 01 00 02 E2 70
				15 00 00 00 01 00 02 E3 03
				15 00 00 00 01 00 02 E4 83
				15 00 00 00 01 00 02 E5 03
				15 00 00 00 01 00 02 E6 96
				15 00 00 00 01 00 02 E7 03
				15 00 00 00 01 00 02 E8 A6
				15 00 00 00 01 00 02 E9 03
				15 00 00 00 01 00 02 EA B1
				15 00 00 00 01 00 02 EB 03
				15 00 00 00 01 00 02 EC B6
				15 00 00 00 01 00 02 ED 03
				15 00 00 00 01 00 02 EE FF
				15 00 00 00 01 00 02 EF 01
				15 00 00 00 01 00 02 F0 4A
				15 00 00 00 01 00 02 F1 01
				15 00 00 00 01 00 02 F2 4D
				15 00 00 00 01 00 02 F3 01
				15 00 00 00 01 00 02 F4 54
				15 00 00 00 01 00 02 F5 01
				15 00 00 00 01 00 02 F6 5A
				15 00 00 00 01 00 02 F7 01
				15 00 00 00 01 00 02 F8 60
				15 00 00 00 01 00 02 F9 01
				15 00 00 00 01 00 02 FA 66
				15 00 00 00 01 00 02 FF 21
				15 00 00 00 01 00 02 FB 01
				15 00 00 00 01 00 02 00 01
				15 00 00 00 01 00 02 01 6B
				15 00 00 00 01 00 02 02 01
				15 00 00 00 01 00 02 03 71
				15 00 00 00 01 00 02 04 01
				15 00 00 00 01 00 02 05 76
				15 00 00 00 01 00 02 06 01
				15 00 00 00 01 00 02 07 8A
				15 00 00 00 01 00 02 08 01
				15 00 00 00 01 00 02 09 9D
				15 00 00 00 01 00 02 0A 01
				15 00 00 00 01 00 02 0B BE
				15 00 00 00 01 00 02 0C 01
				15 00 00 00 01 00 02 0D DC
				15 00 00 00 01 00 02 0E 02
				15 00 00 00 01 00 02 0F 07
				15 00 00 00 01 00 02 10 02
				15 00 00 00 01 00 02 11 2D
				15 00 00 00 01 00 02 12 02
				15 00 00 00 01 00 02 13 2E
				15 00 00 00 01 00 02 14 02
				15 00 00 00 01 00 02 15 5C
				15 00 00 00 01 00 02 16 02
				15 00 00 00 01 00 02 17 97
				15 00 00 00 01 00 02 18 02
				15 00 00 00 01 00 02 19 C0
				15 00 00 00 01 00 02 1A 02
				15 00 00 00 01 00 02 1B F7
				15 00 00 00 01 00 02 1C 03
				15 00 00 00 01 00 02 1D 14
				15 00 00 00 01 00 02 1E 03
				15 00 00 00 01 00 02 1F 4B
				15 00 00 00 01 00 02 20 03
				15 00 00 00 01 00 02 21 5C
				15 00 00 00 01 00 02 22 03
				15 00 00 00 01 00 02 23 6F
				15 00 00 00 01 00 02 24 03
				15 00 00 00 01 00 02 25 83
				15 00 00 00 01 00 02 26 03
				15 00 00 00 01 00 02 27 97
				15 00 00 00 01 00 02 28 03
				15 00 00 00 01 00 02 29 A6
				15 00 00 00 01 00 02 2A 03
				15 00 00 00 01 00 02 2B B1
				15 00 00 00 01 00 02 2D 03
				15 00 00 00 01 00 02 2F B6
				15 00 00 00 01 00 02 30 03
				15 00 00 00 01 00 02 31 FF
				15 00 00 00 01 00 02 32 01
				15 00 00 00 01 00 02 33 4A
				15 00 00 00 01 00 02 34 01
				15 00 00 00 01 00 02 35 4D
				15 00 00 00 01 00 02 36 01
				15 00 00 00 01 00 02 37 54
				15 00 00 00 01 00 02 38 01
				15 00 00 00 01 00 02 39 5A
				15 00 00 00 01 00 02 3A 01
				15 00 00 00 01 00 02 3B 60
				15 00 00 00 01 00 02 3D 01
				15 00 00 00 01 00 02 3F 66
				15 00 00 00 01 00 02 40 01
				15 00 00 00 01 00 02 41 6B
				15 00 00 00 01 00 02 42 01
				15 00 00 00 01 00 02 43 71
				15 00 00 00 01 00 02 44 01
				15 00 00 00 01 00 02 45 76
				15 00 00 00 01 00 02 46 01
				15 00 00 00 01 00 02 47 8A
				15 00 00 00 01 00 02 48 01
				15 00 00 00 01 00 02 49 9D
				15 00 00 00 01 00 02 4A 01
				15 00 00 00 01 00 02 4B BE
				15 00 00 00 01 00 02 4C 01
				15 00 00 00 01 00 02 4D DC
				15 00 00 00 01 00 02 4E 02
				15 00 00 00 01 00 02 4F 07
				15 00 00 00 01 00 02 50 02
				15 00 00 00 01 00 02 51 2D
				15 00 00 00 01 00 02 52 02
				15 00 00 00 01 00 02 53 2E
				15 00 00 00 01 00 02 54 02
				15 00 00 00 01 00 02 55 5C
				15 00 00 00 01 00 02 56 02
				15 00 00 00 01 00 02 58 97
				15 00 00 00 01 00 02 59 02
				15 00 00 00 01 00 02 5A C0
				15 00 00 00 01 00 02 5B 02
				15 00 00 00 01 00 02 5C F7
				15 00 00 00 01 00 02 5D 03
				15 00 00 00 01 00 02 5E 14
				15 00 00 00 01 00 02 5F 03
				15 00 00 00 01 00 02 60 4B
				15 00 00 00 01 00 02 61 03
				15 00 00 00 01 00 02 62 5C
				15 00 00 00 01 00 02 63 03
				15 00 00 00 01 00 02 64 6F
				15 00 00 00 01 00 02 65 03
				15 00 00 00 01 00 02 66 83
				15 00 00 00 01 00 02 67 03
				15 00 00 00 01 00 02 68 97
				15 00 00 00 01 00 02 69 03
				15 00 00 00 01 00 02 6A A6
				15 00 00 00 01 00 02 6B 03
				15 00 00 00 01 00 02 6C B1
				15 00 00 00 01 00 02 6D 03
				15 00 00 00 01 00 02 6E B6
				15 00 00 00 01 00 02 6F 03
				15 00 00 00 01 00 02 70 FF
				15 00 00 00 01 00 02 71 01
				15 00 00 00 01 00 02 72 EF
				15 00 00 00 01 00 02 73 01
				15 00 00 00 01 00 02 74 F0
				15 00 00 00 01 00 02 75 01
				15 00 00 00 01 00 02 76 F3
				15 00 00 00 01 00 02 77 01
				15 00 00 00 01 00 02 78 F5
				15 00 00 00 01 00 02 79 01
				15 00 00 00 01 00 02 7A F6
				15 00 00 00 01 00 02 7B 01
				15 00 00 00 01 00 02 7C F7
				15 00 00 00 01 00 02 7D 01
				15 00 00 00 01 00 02 7E F9
				15 00 00 00 01 00 02 7F 01
				15 00 00 00 01 00 02 80 FA
				15 00 00 00 01 00 02 81 01
				15 00 00 00 01 00 02 82 FC
				15 00 00 00 01 00 02 83 02
				15 00 00 00 01 00 02 84 02
				15 00 00 00 01 00 02 85 02
				15 00 00 00 01 00 02 86 08
				15 00 00 00 01 00 02 87 02
				15 00 00 00 01 00 02 88 15
				15 00 00 00 01 00 02 89 02
				15 00 00 00 01 00 02 8A 22
				15 00 00 00 01 00 02 8B 02
				15 00 00 00 01 00 02 8C 40
				15 00 00 00 01 00 02 8D 02
				15 00 00 00 01 00 02 8E 62
				15 00 00 00 01 00 02 8F 02
				15 00 00 00 01 00 02 90 63
				15 00 00 00 01 00 02 91 02
				15 00 00 00 01 00 02 92 8D
				15 00 00 00 01 00 02 93 02
				15 00 00 00 01 00 02 94 C7
				15 00 00 00 01 00 02 95 02
				15 00 00 00 01 00 02 96 EE
				15 00 00 00 01 00 02 97 03
				15 00 00 00 01 00 02 98 18
				15 00 00 00 01 00 02 99 03
				15 00 00 00 01 00 02 9A 40
				15 00 00 00 01 00 02 9B 03
				15 00 00 00 01 00 02 9C 73
				15 00 00 00 01 00 02 9D 03
				15 00 00 00 01 00 02 9E 81
				15 00 00 00 01 00 02 9F 03
				15 00 00 00 01 00 02 A0 8F
				15 00 00 00 01 00 02 A2 03
				15 00 00 00 01 00 02 A3 9C
				15 00 00 00 01 00 02 A4 03
				15 00 00 00 01 00 02 A5 A7
				15 00 00 00 01 00 02 A6 03
				15 00 00 00 01 00 02 A7 AF
				15 00 00 00 01 00 02 A9 03
				15 00 00 00 01 00 02 AA B4
				15 00 00 00 01 00 02 AB 03
				15 00 00 00 01 00 02 AC B6
				15 00 00 00 01 00 02 AD 03
				15 00 00 00 01 00 02 AE FF
				15 00 00 00 01 00 02 AF 01
				15 00 00 00 01 00 02 B0 EF
				15 00 00 00 01 00 02 B1 01
				15 00 00 00 01 00 02 B2 F0
				15 00 00 00 01 00 02 B3 01
				15 00 00 00 01 00 02 B4 F3
				15 00 00 00 01 00 02 B5 01
				15 00 00 00 01 00 02 B6 F5
				15 00 00 00 01 00 02 B7 01
				15 00 00 00 01 00 02 B8 F6
				15 00 00 00 01 00 02 B9 01
				15 00 00 00 01 00 02 BA F7
				15 00 00 00 01 00 02 BB 01
				15 00 00 00 01 00 02 BC F9
				15 00 00 00 01 00 02 BD 01
				15 00 00 00 01 00 02 BE FA
				15 00 00 00 01 00 02 BF 01
				15 00 00 00 01 00 02 C0 FC
				15 00 00 00 01 00 02 C1 02
				15 00 00 00 01 00 02 C2 02
				15 00 00 00 01 00 02 C3 02
				15 00 00 00 01 00 02 C4 08
				15 00 00 00 01 00 02 C5 02
				15 00 00 00 01 00 02 C6 15
				15 00 00 00 01 00 02 C7 02
				15 00 00 00 01 00 02 C8 22
				15 00 00 00 01 00 02 C9 02
				15 00 00 00 01 00 02 CA 40
				15 00 00 00 01 00 02 CB 02
				15 00 00 00 01 00 02 CC 62
				15 00 00 00 01 00 02 CD 02
				15 00 00 00 01 00 02 CE 63
				15 00 00 00 01 00 02 CF 02
				15 00 00 00 01 00 02 D0 8D
				15 00 00 00 01 00 02 D1 02
				15 00 00 00 01 00 02 D2 C7
				15 00 00 00 01 00 02 D3 02
				15 00 00 00 01 00 02 D4 EE
				15 00 00 00 01 00 02 D5 03
				15 00 00 00 01 00 02 D6 18
				15 00 00 00 01 00 02 D7 03
				15 00 00 00 01 00 02 D8 40
				15 00 00 00 01 00 02 D9 03
				15 00 00 00 01 00 02 DA 73
				15 00 00 00 01 00 02 DB 03
				15 00 00 00 01 00 02 DC 81
				15 00 00 00 01 00 02 DD 03
				15 00 00 00 01 00 02 DE 8F
				15 00 00 00 01 00 02 DF 03
				15 00 00 00 01 00 02 E0 9C
				15 00 00 00 01 00 02 E1 03
				15 00 00 00 01 00 02 E2 A7
				15 00 00 00 01 00 02 E3 03
				15 00 00 00 01 00 02 E4 AF
				15 00 00 00 01 00 02 E5 03
				15 00 00 00 01 00 02 E6 B4
				15 00 00 00 01 00 02 E7 03
				15 00 00 00 01 00 02 E8 B6
				15 00 00 00 01 00 02 E9 03
				15 00 00 00 01 00 02 EA FF
				15 00 00 00 01 00 02 FB 01
				15 01 00 00 01 00 02 FF 10
				];
		qcom,mdss-dsi-dispparam-papermode6-state = "dsi_hs_mode";
		qcom,mdss-dsi-dispparam-papermode7-command = [
				15 01 00 00 78 00 02 FF 20
				15 00 00 00 01 00 02 FB 01
				15 00 00 00 01 00 02 75 01
				15 00 00 00 01 00 02 76 31
				15 00 00 00 01 00 02 77 01
				15 00 00 00 01 00 02 78 35
				15 00 00 00 01 00 02 79 01
				15 00 00 00 01 00 02 7A 3C
				15 00 00 00 01 00 02 7B 01
				15 00 00 00 01 00 02 7C 43
				15 00 00 00 01 00 02 7D 01
				15 00 00 00 01 00 02 7E 4A
				15 00 00 00 01 00 02 7F 01
				15 00 00 00 01 00 02 80 51
				15 00 00 00 01 00 02 81 01
				15 00 00 00 01 00 02 82 58
				15 00 00 00 01 00 02 83 01
				15 00 00 00 01 00 02 84 5E
				15 00 00 00 01 00 02 85 01
				15 00 00 00 01 00 02 86 64
				15 00 00 00 01 00 02 87 01
				15 00 00 00 01 00 02 88 7A
				15 00 00 00 01 00 02 89 01
				15 00 00 00 01 00 02 8A 8F
				15 00 00 00 01 00 02 8B 01
				15 00 00 00 01 00 02 8C B3
				15 00 00 00 01 00 02 8D 01
				15 00 00 00 01 00 02 8E D2
				15 00 00 00 01 00 02 8F 02
				15 00 00 00 01 00 02 90 03
				15 00 00 00 01 00 02 91 02
				15 00 00 00 01 00 02 92 28
				15 00 00 00 01 00 02 93 02
				15 00 00 00 01 00 02 94 2A
				15 00 00 00 01 00 02 95 02
				15 00 00 00 01 00 02 96 57
				15 00 00 00 01 00 02 97 02
				15 00 00 00 01 00 02 98 92
				15 00 00 00 01 00 02 99 02
				15 00 00 00 01 00 02 9A BB
				15 00 00 00 01 00 02 9B 02
				15 00 00 00 01 00 02 9C F2
				15 00 00 00 01 00 02 9D 03
				15 00 00 00 01 00 02 9E 11
				15 00 00 00 01 00 02 9F 03
				15 00 00 00 01 00 02 A0 4A
				15 00 00 00 01 00 02 A2 03
				15 00 00 00 01 00 02 A3 5D
				15 00 00 00 01 00 02 A4 03
				15 00 00 00 01 00 02 A5 70
				15 00 00 00 01 00 02 A6 03
				15 00 00 00 01 00 02 A7 83
				15 00 00 00 01 00 02 A9 03
				15 00 00 00 01 00 02 AA 96
				15 00 00 00 01 00 02 AB 03
				15 00 00 00 01 00 02 AC A6
				15 00 00 00 01 00 02 AD 03
				15 00 00 00 01 00 02 AE B1
				15 00 00 00 01 00 02 AF 03
				15 00 00 00 01 00 02 B0 B6
				15 00 00 00 01 00 02 B1 03
				15 00 00 00 01 00 02 B2 FF
				15 00 00 00 01 00 02 B3 01
				15 00 00 00 01 00 02 B4 31
				15 00 00 00 01 00 02 B5 01
				15 00 00 00 01 00 02 B6 35
				15 00 00 00 01 00 02 B7 01
				15 00 00 00 01 00 02 B8 3C
				15 00 00 00 01 00 02 B9 01
				15 00 00 00 01 00 02 BA 43
				15 00 00 00 01 00 02 BB 01
				15 00 00 00 01 00 02 BC 4A
				15 00 00 00 01 00 02 BD 01
				15 00 00 00 01 00 02 BE 51
				15 00 00 00 01 00 02 BF 01
				15 00 00 00 01 00 02 C0 58
				15 00 00 00 01 00 02 C1 01
				15 00 00 00 01 00 02 C2 5E
				15 00 00 00 01 00 02 C3 01
				15 00 00 00 01 00 02 C4 64
				15 00 00 00 01 00 02 C5 01
				15 00 00 00 01 00 02 C6 7A
				15 00 00 00 01 00 02 C7 01
				15 00 00 00 01 00 02 C8 8F
				15 00 00 00 01 00 02 C9 01
				15 00 00 00 01 00 02 CA B3
				15 00 00 00 01 00 02 CB 01
				15 00 00 00 01 00 02 CC D2
				15 00 00 00 01 00 02 CD 02
				15 00 00 00 01 00 02 CE 03
				15 00 00 00 01 00 02 CF 02
				15 00 00 00 01 00 02 D0 28
				15 00 00 00 01 00 02 D1 02
				15 00 00 00 01 00 02 D2 2A
				15 00 00 00 01 00 02 D3 02
				15 00 00 00 01 00 02 D4 57
				15 00 00 00 01 00 02 D5 02
				15 00 00 00 01 00 02 D6 92
				15 00 00 00 01 00 02 D7 02
				15 00 00 00 01 00 02 D8 BB
				15 00 00 00 01 00 02 D9 02
				15 00 00 00 01 00 02 DA F2
				15 00 00 00 01 00 02 DB 03
				15 00 00 00 01 00 02 DC 11
				15 00 00 00 01 00 02 DD 03
				15 00 00 00 01 00 02 DE 4A
				15 00 00 00 01 00 02 DF 03
				15 00 00 00 01 00 02 E0 5D
				15 00 00 00 01 00 02 E1 03
				15 00 00 00 01 00 02 E2 70
				15 00 00 00 01 00 02 E3 03
				15 00 00 00 01 00 02 E4 83
				15 00 00 00 01 00 02 E5 03
				15 00 00 00 01 00 02 E6 96
				15 00 00 00 01 00 02 E7 03
				15 00 00 00 01 00 02 E8 A6
				15 00 00 00 01 00 02 E9 03
				15 00 00 00 01 00 02 EA B1
				15 00 00 00 01 00 02 EB 03
				15 00 00 00 01 00 02 EC B6
				15 00 00 00 01 00 02 ED 03
				15 00 00 00 01 00 02 EE FF
				15 00 00 00 01 00 02 EF 01
				15 00 00 00 01 00 02 F0 4A
				15 00 00 00 01 00 02 F1 01
				15 00 00 00 01 00 02 F2 4D
				15 00 00 00 01 00 02 F3 01
				15 00 00 00 01 00 02 F4 54
				15 00 00 00 01 00 02 F5 01
				15 00 00 00 01 00 02 F6 5A
				15 00 00 00 01 00 02 F7 01
				15 00 00 00 01 00 02 F8 60
				15 00 00 00 01 00 02 F9 01
				15 00 00 00 01 00 02 FA 66
				15 00 00 00 01 00 02 FF 21
				15 00 00 00 01 00 02 FB 01
				15 00 00 00 01 00 02 00 01
				15 00 00 00 01 00 02 01 6B
				15 00 00 00 01 00 02 02 01
				15 00 00 00 01 00 02 03 71
				15 00 00 00 01 00 02 04 01
				15 00 00 00 01 00 02 05 76
				15 00 00 00 01 00 02 06 01
				15 00 00 00 01 00 02 07 8A
				15 00 00 00 01 00 02 08 01
				15 00 00 00 01 00 02 09 9D
				15 00 00 00 01 00 02 0A 01
				15 00 00 00 01 00 02 0B BE
				15 00 00 00 01 00 02 0C 01
				15 00 00 00 01 00 02 0D DC
				15 00 00 00 01 00 02 0E 02
				15 00 00 00 01 00 02 0F 07
				15 00 00 00 01 00 02 10 02
				15 00 00 00 01 00 02 11 2D
				15 00 00 00 01 00 02 12 02
				15 00 00 00 01 00 02 13 2E
				15 00 00 00 01 00 02 14 02
				15 00 00 00 01 00 02 15 5C
				15 00 00 00 01 00 02 16 02
				15 00 00 00 01 00 02 17 97
				15 00 00 00 01 00 02 18 02
				15 00 00 00 01 00 02 19 C0
				15 00 00 00 01 00 02 1A 02
				15 00 00 00 01 00 02 1B F7
				15 00 00 00 01 00 02 1C 03
				15 00 00 00 01 00 02 1D 14
				15 00 00 00 01 00 02 1E 03
				15 00 00 00 01 00 02 1F 4B
				15 00 00 00 01 00 02 20 03
				15 00 00 00 01 00 02 21 5C
				15 00 00 00 01 00 02 22 03
				15 00 00 00 01 00 02 23 6F
				15 00 00 00 01 00 02 24 03
				15 00 00 00 01 00 02 25 83
				15 00 00 00 01 00 02 26 03
				15 00 00 00 01 00 02 27 97
				15 00 00 00 01 00 02 28 03
				15 00 00 00 01 00 02 29 A6
				15 00 00 00 01 00 02 2A 03
				15 00 00 00 01 00 02 2B B1
				15 00 00 00 01 00 02 2D 03
				15 00 00 00 01 00 02 2F B6
				15 00 00 00 01 00 02 30 03
				15 00 00 00 01 00 02 31 FF
				15 00 00 00 01 00 02 32 01
				15 00 00 00 01 00 02 33 4A
				15 00 00 00 01 00 02 34 01
				15 00 00 00 01 00 02 35 4D
				15 00 00 00 01 00 02 36 01
				15 00 00 00 01 00 02 37 54
				15 00 00 00 01 00 02 38 01
				15 00 00 00 01 00 02 39 5A
				15 00 00 00 01 00 02 3A 01
				15 00 00 00 01 00 02 3B 60
				15 00 00 00 01 00 02 3D 01
				15 00 00 00 01 00 02 3F 66
				15 00 00 00 01 00 02 40 01
				15 00 00 00 01 00 02 41 6B
				15 00 00 00 01 00 02 42 01
				15 00 00 00 01 00 02 43 71
				15 00 00 00 01 00 02 44 01
				15 00 00 00 01 00 02 45 76
				15 00 00 00 01 00 02 46 01
				15 00 00 00 01 00 02 47 8A
				15 00 00 00 01 00 02 48 01
				15 00 00 00 01 00 02 49 9D
				15 00 00 00 01 00 02 4A 01
				15 00 00 00 01 00 02 4B BE
				15 00 00 00 01 00 02 4C 01
				15 00 00 00 01 00 02 4D DC
				15 00 00 00 01 00 02 4E 02
				15 00 00 00 01 00 02 4F 07
				15 00 00 00 01 00 02 50 02
				15 00 00 00 01 00 02 51 2D
				15 00 00 00 01 00 02 52 02
				15 00 00 00 01 00 02 53 2E
				15 00 00 00 01 00 02 54 02
				15 00 00 00 01 00 02 55 5C
				15 00 00 00 01 00 02 56 02
				15 00 00 00 01 00 02 58 97
				15 00 00 00 01 00 02 59 02
				15 00 00 00 01 00 02 5A C0
				15 00 00 00 01 00 02 5B 02
				15 00 00 00 01 00 02 5C F7
				15 00 00 00 01 00 02 5D 03
				15 00 00 00 01 00 02 5E 14
				15 00 00 00 01 00 02 5F 03
				15 00 00 00 01 00 02 60 4B
				15 00 00 00 01 00 02 61 03
				15 00 00 00 01 00 02 62 5C
				15 00 00 00 01 00 02 63 03
				15 00 00 00 01 00 02 64 6F
				15 00 00 00 01 00 02 65 03
				15 00 00 00 01 00 02 66 83
				15 00 00 00 01 00 02 67 03
				15 00 00 00 01 00 02 68 97
				15 00 00 00 01 00 02 69 03
				15 00 00 00 01 00 02 6A A6
				15 00 00 00 01 00 02 6B 03
				15 00 00 00 01 00 02 6C B1
				15 00 00 00 01 00 02 6D 03
				15 00 00 00 01 00 02 6E B6
				15 00 00 00 01 00 02 6F 03
				15 00 00 00 01 00 02 70 FF
				15 00 00 00 01 00 02 71 01
				15 00 00 00 01 00 02 72 FF
				15 00 00 00 01 00 02 73 02
				15 00 00 00 01 00 02 74 00
				15 00 00 00 01 00 02 75 02
				15 00 00 00 01 00 02 76 01
				15 00 00 00 01 00 02 77 02
				15 00 00 00 01 00 02 78 03
				15 00 00 00 01 00 02 79 02
				15 00 00 00 01 00 02 7A 04
				15 00 00 00 01 00 02 7B 02
				15 00 00 00 01 00 02 7C 05
				15 00 00 00 01 00 02 7D 02
				15 00 00 00 01 00 02 7E 07
				15 00 00 00 01 00 02 7F 02
				15 00 00 00 01 00 02 80 08
				15 00 00 00 01 00 02 81 02
				15 00 00 00 01 00 02 82 0A
				15 00 00 00 01 00 02 83 02
				15 00 00 00 01 00 02 84 10
				15 00 00 00 01 00 02 85 02
				15 00 00 00 01 00 02 86 16
				15 00 00 00 01 00 02 87 02
				15 00 00 00 01 00 02 88 22
				15 00 00 00 01 00 02 89 02
				15 00 00 00 01 00 02 8A 2F
				15 00 00 00 01 00 02 8B 02
				15 00 00 00 01 00 02 8C 4C
				15 00 00 00 01 00 02 8D 02
				15 00 00 00 01 00 02 8E 6D
				15 00 00 00 01 00 02 8F 02
				15 00 00 00 01 00 02 90 6F
				15 00 00 00 01 00 02 91 02
				15 00 00 00 01 00 02 92 98
				15 00 00 00 01 00 02 93 02
				15 00 00 00 01 00 02 94 D2
				15 00 00 00 01 00 02 95 02
				15 00 00 00 01 00 02 96 F7
				15 00 00 00 01 00 02 97 03
				15 00 00 00 01 00 02 98 22
				15 00 00 00 01 00 02 99 03
				15 00 00 00 01 00 02 9A 4A
				15 00 00 00 01 00 02 9B 03
				15 00 00 00 01 00 02 9C 7B
				15 00 00 00 01 00 02 9D 03
				15 00 00 00 01 00 02 9E 88
				15 00 00 00 01 00 02 9F 03
				15 00 00 00 01 00 02 A0 94
				15 00 00 00 01 00 02 A2 03
				15 00 00 00 01 00 02 A3 A0
				15 00 00 00 01 00 02 A4 03
				15 00 00 00 01 00 02 A5 A9
				15 00 00 00 01 00 02 A6 03
				15 00 00 00 01 00 02 A7 B0
				15 00 00 00 01 00 02 A9 03
				15 00 00 00 01 00 02 AA B4
				15 00 00 00 01 00 02 AB 03
				15 00 00 00 01 00 02 AC B6
				15 00 00 00 01 00 02 AD 03
				15 00 00 00 01 00 02 AE FF
				15 00 00 00 01 00 02 AF 01
				15 00 00 00 01 00 02 B0 FF
				15 00 00 00 01 00 02 B1 02
				15 00 00 00 01 00 02 B2 00
				15 00 00 00 01 00 02 B3 02
				15 00 00 00 01 00 02 B4 01
				15 00 00 00 01 00 02 B5 02
				15 00 00 00 01 00 02 B6 03
				15 00 00 00 01 00 02 B7 02
				15 00 00 00 01 00 02 B8 04
				15 00 00 00 01 00 02 B9 02
				15 00 00 00 01 00 02 BA 05
				15 00 00 00 01 00 02 BB 02
				15 00 00 00 01 00 02 BC 07
				15 00 00 00 01 00 02 BD 02
				15 00 00 00 01 00 02 BE 08
				15 00 00 00 01 00 02 BF 02
				15 00 00 00 01 00 02 C0 0A
				15 00 00 00 01 00 02 C1 02
				15 00 00 00 01 00 02 C2 10
				15 00 00 00 01 00 02 C3 02
				15 00 00 00 01 00 02 C4 16
				15 00 00 00 01 00 02 C5 02
				15 00 00 00 01 00 02 C6 22
				15 00 00 00 01 00 02 C7 02
				15 00 00 00 01 00 02 C8 2F
				15 00 00 00 01 00 02 C9 02
				15 00 00 00 01 00 02 CA 4C
				15 00 00 00 01 00 02 CB 02
				15 00 00 00 01 00 02 CC 6D
				15 00 00 00 01 00 02 CD 02
				15 00 00 00 01 00 02 CE 6F
				15 00 00 00 01 00 02 CF 02
				15 00 00 00 01 00 02 D0 98
				15 00 00 00 01 00 02 D1 02
				15 00 00 00 01 00 02 D2 D2
				15 00 00 00 01 00 02 D3 02
				15 00 00 00 01 00 02 D4 F7
				15 00 00 00 01 00 02 D5 03
				15 00 00 00 01 00 02 D6 22
				15 00 00 00 01 00 02 D7 03
				15 00 00 00 01 00 02 D8 4A
				15 00 00 00 01 00 02 D9 03
				15 00 00 00 01 00 02 DA 7B
				15 00 00 00 01 00 02 DB 03
				15 00 00 00 01 00 02 DC 88
				15 00 00 00 01 00 02 DD 03
				15 00 00 00 01 00 02 DE 94
				15 00 00 00 01 00 02 DF 03
				15 00 00 00 01 00 02 E0 A0
				15 00 00 00 01 00 02 E1 03
				15 00 00 00 01 00 02 E2 A9
				15 00 00 00 01 00 02 E3 03
				15 00 00 00 01 00 02 E4 B0
				15 00 00 00 01 00 02 E5 03
				15 00 00 00 01 00 02 E6 B4
				15 00 00 00 01 00 02 E7 03
				15 00 00 00 01 00 02 E8 B6
				15 00 00 00 01 00 02 E9 03
				15 00 00 00 01 00 02 EA FF
				15 00 00 00 01 00 02 FB 01
				15 01 00 00 01 00 02 FF 10
				];
		qcom,mdss-dsi-dispparam-papermode7-state = "dsi_hs_mode";
		qcom,mdss-dsi-dispparam-level0-command = [
				15 01 00 00 10 00 02 FF 22
				15 01 00 00 10 00 02 56 00
				15 01 00 00 10 00 02 FF 10
				];
		qcom,mdss-dsi-dispparam-level1-command = [
				15 01 00 00 10 00 02 FF 22
				15 01 00 00 10 00 02 58 12
				15 01 00 00 10 00 02 59 0E
				15 01 00 00 10 00 02 56 01
				15 01 00 00 10 00 02 FF 10
				];
		qcom,mdss-dsi-dispparam-level2-command = [
				15 01 00 00 10 00 02 FF 22
				15 01 00 00 10 00 02 58 14
				15 01 00 00 10 00 02 59 0E
				15 01 00 00 10 00 02 56 01
				15 01 00 00 10 00 02 FF 10
				];
		qcom,mdss-dsi-dispparam-level3-command = [
				15 01 00 00 10 00 02 FF 22
				15 01 00 00 10 00 02 58 16
				15 01 00 00 10 00 02 59 0E
				15 01 00 00 10 00 02 56 01
				15 01 00 00 10 00 02 FF 10
				];
		qcom,mdss-dsi-dispparam-level4-command = [
				15 01 00 00 10 00 02 FF 22
				15 01 00 00 10 00 02 58 18
				15 01 00 00 10 00 02 59 0E
				15 01 00 00 10 00 02 56 01
				15 01 00 00 10 00 02 FF 10
				];
		qcom,mdss-dsi-dispparam-level5-command = [
				15 01 00 00 10 00 02 FF 22
				15 01 00 00 10 00 02 58 1A
				15 01 00 00 10 00 02 59 0E
				15 01 00 00 10 00 02 56 01
				15 01 00 00 10 00 02 FF 10
				];
		qcom,mdss-dsi-dispparam-level6-command = [
				15 01 00 00 10 00 02 FF 22
				15 01 00 00 10 00 02 58 1C
				15 01 00 00 10 00 02 59 0E
				15 01 00 00 10 00 02 56 01
				15 01 00 00 10 00 02 FF 10
				];
		qcom,mdss-dsi-dispparam-idleon-command = [
				15 01 00 00 10 00 02 FF 10
				15 01 00 00 10 00 02 39 00
				];
		qcom,mdss-dsi-dispparam-idleoff-command = [
				15 01 00 00 10 00 02 FF 10
				15 01 00 00 10 00 02 38 00
				];
		qcom,mdss-dsi-dispparam-test-command = [
				15 01 00 00 10 00 02 FF 20
				];
		qcom,mdss-dsi-dispparam-test-command-state = "dsi_hs_mode";
	};
};
