// SPDX-License-Identifier: GPL-2.0+
/*
 * Copyright (c) 2019 MediaTek Inc.
 *
 */
/dts-v1/;
#include <dt-bindings/interrupt-controller/arm-gic.h>
#include <dt-bindings/interrupt-controller/irq.h>
#include <dt-bindings/pinctrl/mt6761-pinfunc.h>
#include <dt-bindings/memory/mt6761-larb-port.h>
#include <dt-bindings/mmc/mt6761-msdc.h>
#include <dt-bindings/clock/mt6761-clk.h>
#include <dt-bindings/iio/mt635x-auxadc.h>
#include <dt-bindings/gce/mt6765-gce.h>
#include <dt-bindings/reset/ti-syscon.h>
#include <dt-bindings/soc/mediatek,boot-mode.h>
#include <dt-bindings/phy/phy.h>
#include <dt-bindings/power/mt6761-power.h>
#include <dt-bindings/interconnect/mtk,mt6873-emi.h>
#include <dt-bindings/interconnect/mtk,mmqos.h>

/ {
	model = "MT6761";
	compatible = "mediatek,MT6761";
	interrupt-parent = <&gic>;
	#address-cells = <2>;
	#size-cells = <2>;

aliases {
		ovl0  = &disp_ovl0;
		ovl3  = &disp_ovl0_2l;
		rdma0 = &disp_rdma0;
		wdma0 = &disp_wdma0;
		dsi0  = &dsi0;
		rsz0 = &disp_rsz0;
		color0 = &disp_color0;
		ccorr0 = &disp_ccorr0;
		aal0 = &disp_aal0;
		gamma0 = &disp_gamma0;
		dither0 = &disp_dither0;
		mmc0 = &mmc0;
		mmc1 = &mmc1;
	};

	soc {
		#address-cells = <2>;
		#size-cells = <2>;
		compatible = "simple-bus";
		ranges;

		mtk_leds: mtk_leds {
			backlight {
				label = "lcd-backlight";
				max-brightness = <255>;
				max-hw-brightness = <1023>;
			};
		};

		disp_pwm: disp_pwm0@1100e000 {
			compatible = "mediatek,disp_pwm0",
			"mediatek,mt6761-disp-pwm";
			reg = <0 0x1100e000 0 0x1000>;
			#pwm-cells = <2>;
			pwm_src_base = <&sleep>;
			pwm_src_addr = <0x458>;
			clocks = <&infracfg_ao CLK_IFR_DISP_PWM>,
				<&topckgen CLK_TOP_DISP_PWM_SEL>,
				<&topckgen CLK_TOP_ULPOSC1_D8>;
				clock-names = "main", "mm", "pwm_src";
		};

		dispsys_config: dispsys_config@14000000 {
			compatible = "mediatek,mt6761-mmsys";
			reg = <0 0x14000000 0 0x1000>;
			mediatek,larb = <&smi_larb0>;
			mediatek,smi-id = <0>;
			dma-ranges = <0x0 0x0 0x0 0x0 0x4 0x0>;
			iommus = <&iommu M4U_PORT_DISP_2L_OVL0_LARB0>;
			clocks = <&mmsys_config CLK_MM_F26M_HRTWT>;
			clock-num = <1>;
#if 0
			fake-engine = <&smi_larb0 M4U_LARB0_PORT4>,
				<&smi_larb1 M4U_LARB1_PORT4>;
#endif
			power-domains = <&scpsys MT6761_POWER_DOMAIN_DIS>;
			operating-points-v2 = <&opp_table_mm>;
			dvfsrc-vcore-supply = <&dvfsrc_vcore>;
			interconnects = <&dvfsrc MT6873_MASTER_MM_DISP
					&dvfsrc MT6873_SLAVE_DDR_EMI>;
			interconnect-names = "disp-perf-bw";
			required-opps = <&dvfsrc_freq_opp0>,
					<&dvfsrc_freq_opp1>,
					<&dvfsrc_freq_opp2>;

			/* define threads, see mt6765-gce.h */
			mediatek,mailbox-gce = <&gce_mbox>;
			mboxes = <&gce_mbox 0 0 CMDQ_THR_PRIO_4>,
				<&gce_mbox 3 0 CMDQ_THR_PRIO_4>,
				<&gce_mbox 4 0 CMDQ_THR_PRIO_4>,
				<&gce_mbox 7 CMDQ_NO_TIMEOUT CMDQ_THR_PRIO_2>,
				<&gce_mbox 2 0 CMDQ_THR_PRIO_4>,
				<&gce_mbox 6 0 CMDQ_THR_PRIO_3>;

			gce-client-names = "CLIENT_CFG0",
				"CLIENT_CFG1",
				"CLIENT_CFG2",
				"CLIENT_TRIG_LOOP0",
				"CLIENT_SUB_CFG0",
				"CLIENT_DSI_CFG0";

			gce-subsys = <&gce_mbox 0x14000000 SUBSYS_1400XXXX>,
				<&gce_mbox 0x14010000 SUBSYS_1401XXXX>,
				<&gce_mbox 0x14020000 SUBSYS_1402XXXX>;

			gce-event-names = "disp_mutex0_eof",
				"disp_token_stream_dirty0",
				"disp_wait_dsi0_te",
				"disp_token_stream_eof0",
				"disp_dsi0_eof",
				"disp_token_esd_eof0",
				"disp_rdma0_eof0",
				"disp_wdma0_eof0",
				"disp_token_stream_block0",
				"disp_token_cabc_eof0",
				"disp_wdma0_eof2",
				"disp_dsi0_sof0";

			gce-events =
				<&gce_mbox CMDQ_EVENT_MUTEX0_STREAM_EOF>,
				<&gce_mbox CMDQ_SYNC_TOKEN_CONFIG_DIRTY>,
				<&gce_mbox CMDQ_EVENT_DSI0_TE>,
				<&gce_mbox CMDQ_SYNC_TOKEN_STREAM_EOF>,
				<&gce_mbox CMDQ_EVENT_DISP_DSI0_EOF>,
				<&gce_mbox CMDQ_SYNC_TOKEN_ESD_EOF>,
				<&gce_mbox CMDQ_EVENT_DISP_RDMA0_EOF>,
				<&gce_mbox CMDQ_EVENT_DISP_WDMA0_EOF>,
				<&gce_mbox CMDQ_SYNC_TOKEN_STREAM_BLOCK>,
				<&gce_mbox CMDQ_SYNC_TOKEN_CABC_EOF>,
				<&gce_mbox CMDQ_EVENT_DISP_WDMA0_EOF>,
				<&gce_mbox CMDQ_EVENT_DISP_DSI0_SOF>;

			helper-name = "MTK_DRM_OPT_STAGE",
				"MTK_DRM_OPT_USE_CMDQ",
				"MTK_DRM_OPT_USE_M4U",
				"MTK_DRM_OPT_MMQOS_SUPPORT",
				"MTK_DRM_OPT_MMDVFS_SUPPORT",
				"MTK_DRM_OPT_SODI_SUPPORT",
				"MTK_DRM_OPT_IDLE_MGR",
				"MTK_DRM_OPT_IDLEMGR_SWTCH_DECOUPLE",
				"MTK_DRM_OPT_IDLEMGR_BY_REPAINT",
				"MTK_DRM_OPT_IDLEMGR_ENTER_ULPS",
				"MTK_DRM_OPT_IDLEMGR_KEEP_LP11",
				"MTK_DRM_OPT_DYNAMIC_RDMA_GOLDEN_SETTING",
				"MTK_DRM_OPT_IDLEMGR_DISABLE_ROUTINE_IRQ",
				"MTK_DRM_OPT_MET_LOG",
				"MTK_DRM_OPT_USE_PQ",
				"MTK_DRM_OPT_ESD_CHECK_RECOVERY",
				"MTK_DRM_OPT_ESD_CHECK_SWITCH",
				"MTK_DRM_OPT_PRESENT_FENCE",
				"MTK_DRM_OPT_RDMA_UNDERFLOW_AEE",
				"MTK_DRM_OPT_DSI_UNDERRUN_AEE",
				"MTK_DRM_OPT_HRT",
				"MTK_DRM_OPT_HRT_MODE",
				"MTK_DRM_OPT_DELAYED_TRIGGER",
				"MTK_DRM_OPT_OVL_EXT_LAYER",
				"MTK_DRM_OPT_AOD",
				"MTK_DRM_OPT_RPO",
				"MTK_DRM_OPT_DUAL_PIPE",
				"MTK_DRM_OPT_DC_BY_HRT",
				"MTK_DRM_OPT_OVL_WCG",
				"MTK_DRM_OPT_OVL_SBCH",
				"MTK_DRM_OPT_COMMIT_NO_WAIT_VBLANK",
				"MTK_DRM_OPT_MET",
				"MTK_DRM_OPT_REG_PARSER_RAW_DUMP",
				"MTK_DRM_OPT_VP_PQ",
				"MTK_DRM_OPT_GAME_PQ",
				"MTK_DRM_OPT_MMPATH",
				"MTK_DRM_OPT_HBM",
				"MTK_DRM_OPT_VDS_PATH_SWITCH",
				"MTK_DRM_OPT_LAYER_REC",
				"MTK_DRM_OPT_CLEAR_LAYER",
				"MTK_DRM_OPT_LFR",
				"MTK_DRM_OPT_SF_PF",
				"MTK_DRM_OPT_DYN_MIPI_CHANGE",
				"MTK_DRM_OPT_PRIM_DUAL_PIPE",
				"MTK_DRM_OPT_MSYNC2_0",
				"MTK_DRM_OPT_MML_PRIMARY",
				"MTK_DRM_OPT_DUAL_TE",
				"MTK_DRM_OPT_VIRTUAL_DISP",
				"MTK_DRM_OPT_RES_SWITCH",
				"MTK_DRM_OPT_SHARE_SRAM";

			helper-value = <0>, /*MTK_DRM_OPT_STAGE*/
				<1>, /*MTK_DRM_OPT_USE_CMDQ*/
				<1>, /*MTK_DRM_OPT_USE_M4U*/
				<1>, /*MTK_DRM_OPT_MMQOS_SUPPORT*/
				<1>, /*MTK_DRM_OPT_MMDVFS_SUPPORT*/
				<0>, /*MTK_DRM_OPT_SODI_SUPPORT*/
				<1>, /*MTK_DRM_OPT_IDLE_MGR*/
				<0>, /*MTK_DRM_OPT_IDLEMGR_SWTCH_DECOUPLE*/
				<1>, /*MTK_DRM_OPT_IDLEMGR_BY_REPAINT*/
				<0>, /*MTK_DRM_OPT_IDLEMGR_ENTER_ULPS*/
				<0>, /*MTK_DRM_OPT_IDLEMGR_KEEP_LP11*/
				<1>, /*MTK_DRM_OPT_DYNAMIC_RDMA_GOLDEN_SETTING*/
				<1>, /*MTK_DRM_OPT_IDLEMGR_DISABLE_ROUTINE_IRQ*/
				<0>, /*MTK_DRM_OPT_MET_LOG*/
				<1>, /*MTK_DRM_OPT_USE_PQ*/
				<1>, /*MTK_DRM_OPT_ESD_CHECK_RECOVERY*/
				<1>, /*MTK_DRM_OPT_ESD_CHECK_SWITCH*/
				<1>, /*MTK_DRM_OPT_PRESENT_FENCE*/
				<0>, /*MTK_DRM_OPT_RDMA_UNDERFLOW_AEE*/
				<1>, /*MTK_DRM_OPT_DSI_UNDERRUN_AEE*/
				<1>, /*MTK_DRM_OPT_HRT*/
				<1>, /*MTK_DRM_OPT_HRT_MODE*/
				<0>, /*MTK_DRM_OPT_DELAYED_TRIGGER*/
				<1>, /*MTK_DRM_OPT_OVL_EXT_LAYER*/
				<0>, /*MTK_DRM_OPT_AOD*/
				<1>, /*MTK_DRM_OPT_RPO*/
				<0>, /*MTK_DRM_OPT_DUAL_PIPE*/
				<0>, /*MTK_DRM_OPT_DC_BY_HRT*/
				<0>, /*MTK_DRM_OPT_OVL_WCG*/
				<0>, /*MTK_DRM_OPT_OVL_SBCH*/
				<1>, /*MTK_DRM_OPT_COMMIT_NO_WAIT_VBLANK*/
				<0>, /*MTK_DRM_OPT_MET*/
				<0>, /*MTK_DRM_OPT_REG_PARSER_RAW_DUMP*/
				<0>, /*MTK_DRM_OPT_VP_PQ*/
				<0>, /*MTK_DRM_OPT_GAME_PQ*/
				<0>, /*MTK_DRM_OPT_MMPATH*/
				<0>, /*MTK_DRM_OPT_HBM*/
				<0>, /*MTK_DRM_OPT_VDS_PATH_SWITCH*/
				<0>, /*MTK_DRM_OPT_LAYER_REC*/
				<1>, /*MTK_DRM_OPT_CLEAR_LAYER*/
				<0>, /*MTK_DRM_OPT_LFR*/
				<0>, /*MTK_DRM_OPT_SF_PF*/
				<1>, /*MTK_DRM_OPT_DYN_MIPI_CHANGE*/
				<0>, /*MTK_DRM_OPT_PRIM_DUAL_PIPE*/
				<0>, /*MTK_DRM_OPT_MSYNC2_0*/
				<0>, /*MTK_DRM_OPT_MML_PRIMARY*/
				<0>, /*MTK_DRM_OPT_DUAL_TE*/
				<0>, /*MTK_DRM_OPT_VIRTUAL_DISP*/
				<0>, /*MTK_DRM_OPT_RES_SWITCH*/
				<1>; /*MTK_DRM_OPT_SHARE_SRAM*/
		};

		disp_mutex0: disp_mutex0@14001000 {
			compatible = "mediatek,disp_mutex0",
					"mediatek,mt6761-disp-mutex";
			reg = <0 0x14001000 0 0x1000>;
			interrupts = <GIC_SPI 154 IRQ_TYPE_LEVEL_HIGH 0>;
		};

		disp_ovl0: disp_ovl0@1400b000 {
			compatible = "mediatek,disp_ovl0",
					"mediatek,mt6761-disp-ovl";
			reg = <0 0x1400b000 0 0x1000>;
			interrupts = <GIC_SPI 161 IRQ_TYPE_LEVEL_HIGH 0>;
			mediatek,larb = <&smi_larb0>;
			mediatek,smi-id = <0>;
			dma-ranges = <0x0 0x0 0x0 0x0 0x4 0x0>;
			clocks = <&mmsys_config CLK_MM_DISP_OVL0>;
			iommus = <&iommu M4U_PORT_DISP_OVL0>;
			interconnects =
				<&mmqos MASTER_LARB_PORT(M4U_PORT_DISP_OVL0)
						&mmqos SLAVE_COMMON(0)>,
				<&mmqos MASTER_LARB_PORT(M4U_PORT_DISP_OVL0)
						&mmqos SLAVE_COMMON(0)>,
				<&mmqos MASTER_LARB_PORT(M4U_PORT_DISP_OVL0)
						&mmqos SLAVE_COMMON(0)>;
			interconnect-names = "DDP_COMPONENT_OVL0_qos",
						"DDP_COMPONENT_OVL0_fbdc_qos",
						"DDP_COMPONENT_OVL0_hrt_qos";
		};

		disp_ovl0_2l: disp_ovl0_2l@1400c000 {
			compatible = "mediatek,disp_ovl0_2l",
					"mediatek,mt6761-disp-ovl";
			reg = <0 0x1400c000 0 0x1000>;
			interrupts = <GIC_SPI 173 IRQ_TYPE_LEVEL_HIGH 0>;
			mediatek,larb = <&smi_larb0>;
			mediatek,smi-id = <0>;
			dma-ranges = <0x0 0x0 0x0 0x0 0x4 0x0>;
			clocks = <&mmsys_config CLK_MM_DISP_OVL0_2L>;
			iommus = <&iommu M4U_PORT_DISP_2L_OVL0_LARB0>;
			interconnects =
				<&mmqos MASTER_LARB_PORT(M4U_PORT_DISP_2L_OVL0_LARB0)
						&mmqos SLAVE_COMMON(0)>,
				<&mmqos MASTER_LARB_PORT(M4U_PORT_DISP_2L_OVL0_LARB0)
						&mmqos SLAVE_COMMON(0)>,
				<&mmqos MASTER_LARB_PORT(M4U_PORT_DISP_2L_OVL0_LARB0)
						&mmqos SLAVE_COMMON(0)>;
			interconnect-names = "DDP_COMPONENT_OVL0_2L_qos",
						"DDP_COMPONENT_OVL0_2L_fbdc_qos",
						"DDP_COMPONENT_OVL0_2L_hrt_qos";
		};

		disp_rsz0: disp_rsz0@14015000 {
			compatible = "mediatek,disp_rsz0",
				"mediatek,mt6761-disp-rsz";
			reg = <0 0x14015000 0 0x1000>;
			interrupts = <GIC_SPI 220 IRQ_TYPE_LEVEL_HIGH 0>;
			clocks = <&mmsys_config CLK_MM_DISP_RSZ0>;
		};

		disp_rdma0: disp_rdma0@1400d000 {
			compatible = "mediatek,disp_rdma0",
				"mediatek,mt6761-disp-rdma";
			reg = <0 0x1400d000 0 0x1000>;
			interrupts = <GIC_SPI 162 IRQ_TYPE_LEVEL_HIGH 0>;
			mediatek,larb = <&smi_larb0>;
			mediatek,smi-id = <0>;
			dma-ranges = <0x0 0x0 0x0 0x0 0x4 0x0>;
			clocks = <&mmsys_config CLK_MM_DISP_RDMA0>;
			iommus = <&iommu M4U_PORT_DISP_RDMA0>;
			interconnects =
				<&mmqos MASTER_LARB_PORT(M4U_PORT_DISP_RDMA0)
						&mmqos SLAVE_COMMON(0)>,
				<&mmqos MASTER_LARB_PORT(M4U_PORT_DISP_RDMA0)
						&mmqos SLAVE_COMMON(0)>;
			interconnect-names = "DDP_COMPONENT_RDMA0_qos",
						"DDP_COMPONENT_RDMA0_hrt_qos";
		};

		disp_color0: disp_color0@1400f000 {
			compatible = "mediatek,disp_color0",
				"mediatek,mt6761-disp-color";
			reg = <0 0x1400f000 0 0x1000>;
			interrupts = <GIC_SPI 164 IRQ_TYPE_LEVEL_HIGH 0>;
			clocks = <&mmsys_config CLK_MM_DISP_COLOR0>;
		};

		disp_ccorr0: disp_ccorr0@14010000 {
			compatible = "mediatek,disp_ccorr0",
				"mediatek,mt6761-disp-ccorr";
			reg = <0 0x14010000 0 0x1000>;
			interrupts = <GIC_SPI 165 IRQ_TYPE_LEVEL_HIGH 0>;
			clocks = <&mmsys_config CLK_MM_DISP_CCORR0>;
			ccorr_bit = <12>;
			ccorr_num_per_pipe = <1>;
			ccorr_linear_per_pipe = <0x01>;
			ccorr_prim_force_linear = <0x0>;
		};

		disp_aal0: disp_aal0@14011000 {
			compatible = "mediatek,disp_aal0",
				"mediatek,mt6761-disp-aal";
			reg = <0 0x14011000 0 0x1000>;
			interrupts = <GIC_SPI 166 IRQ_TYPE_LEVEL_HIGH 0>;
			clocks = <&mmsys_config CLK_MM_DISP_AAL0>;
			mtk_aal_support = <1>;
			mtk_dre30_support = <0>;
		};

		disp_gamma0: disp_gamma0@14012000 {
			compatible = "mediatek,disp_gamma0",
				"mediatek,mt6761-disp-gamma";
			reg = <0 0x14012000 0 0x1000>;
			interrupts = <GIC_SPI 167 IRQ_TYPE_LEVEL_HIGH 0>;
			clocks = <&mmsys_config CLK_MM_DISP_GAMMA0>;
			gamma_data_mode = <0>;
			color_protect_red = <0>;
			color_protect_green = <0>;
			color_protect_blue = <0>;
			color_protect_white = <0>;
			color_protect_black = <0>;
			color_protect_lsb = <0>;
		};

		disp_dither0: disp_dither0@14013000 {
			compatible = "mediatek,disp_dither0",
				"mediatek,mt6761-disp-dither";
			reg = <0 0x14013000 0 0x1000>;
			interrupts = <GIC_SPI 168 IRQ_TYPE_LEVEL_HIGH 0>;
			clocks = <&mmsys_config CLK_MM_DISP_DITHER0>;
			pure_clr_det = <0>;
			pure_clr_num = <7>;
			pure_clr_rgb = <255 0 0
				0 255 0
				0 0 255
				255 255 0
				255 0 255
				0 255 255
				255 255 255>;
		};
#if 0
		gateic0: gateic@0 {
			compatible = "mediatek,mtk-drm-gateic-drv";
		};
#endif
		mipi_tx_config0: mipi_tx_config@11c80000 {
			compatible = "mediatek,mipi_tx_config0",
					"mediatek,mt6761-mipi-tx";
			reg = <0 0x11c80000 0 0x1000>;
			clocks = <&clk26m>;
			#clock-cells = <0>;
			#phy-cells = <0>;
			clock-output-names = "mipi_tx0_pll";
		};

		dsi0: dsi@14014000 {
			compatible = "mediatek,dsi0",
					"mediatek,mt6761-dsi";
			reg = <0 0x14014000 0 0x1000>;
			interrupts = <GIC_SPI 169 IRQ_TYPE_LEVEL_HIGH 0>;
			clocks = <&mmsys_config CLK_MM_DSI0>,
				<&mmsys_config CLK_MM_DIG_DSI>,
				<&mipi_tx_config0>;
			clock-names = "engine", "digital", "hs";
			phys = <&mipi_tx_config0>;
			phy-names = "dphy";
		};

		dsi_te: dsi_te {
			compatible = "mediatek, DSI_TE-eint";
			status = "disabled";
		};

		disp_wdma0: disp_wdma0@1400e000 {
			compatible = "mediatek,disp_wdma0",
					"mediatek,mt6761-disp-wdma";
			reg = <0 0x1400e000 0 0x1000>;
			interrupts = <GIC_SPI 163 IRQ_TYPE_LEVEL_HIGH 0>;
			dma-ranges = <0x0 0x0 0x0 0x0 0x4 0x0>;
			clocks = <&mmsys_config CLK_MM_DISP_WDMA0>;
			mediatek,larb = <&smi_larb0>;
			mediatek,smi-id = <0>;
			iommus = <&iommu M4U_PORT_DISP_WDMA0>;
		};
	};

	/* chosen */
	chosen: chosen {
		bootargs = "console=tty0 vmalloc=400M \
8250.nr_uarts=2 \
swiotlb=noforce \
cgroup.memory=nosocket,nokmem \
androidboot.hardware=mt6761 \
maxcpus=8 loop.max_part=7 initcall_debug=1 \
firmware_class.path=/vendor/firmware clk_ignore_unused=1";
		kaslr-seed = <0 0>;
	};

	cluster0_opp: opp_table0 {
		compatible = "operating-points-v2";
		opp-shared;
		opp0 {
			opp-hz = /bits/ 64 <850000000>;
			opp-microvolt = <650000>;
		};
		opp1 {
			opp-hz = /bits/ 64 <918000000>;
			opp-microvolt = <668750>;
		};
		opp2 {
			opp-hz = /bits/ 64 <987000000>;
			opp-microvolt = <687500>;
		};
		opp3 {
			opp-hz = /bits/ 64 <1056000000>;
			opp-microvolt = <706250>;
		};
		opp4 {
			opp-hz = /bits/ 64 <1125000000>;
			opp-microvolt = <725000>;
		};
		opp5 {
			opp-hz = /bits/ 64 <1216000000>;
			opp-microvolt = <750000>;
		};
		opp6 {
			opp-hz = /bits/ 64 <1308000000>;
			opp-microvolt = <775000>;
		};
		opp7 {
			opp-hz = /bits/ 64 <1400000000>;
			opp-microvolt = <800000>;
		};
		opp8 {
			opp-hz = /bits/ 64 <1466000000>;
			opp-microvolt = <825000>;
		};
		opp9 {
			opp-hz = /bits/ 64 <1533000000>;
			opp-microvolt = <850000>;
		};
		opp10 {
			opp-hz = /bits/ 64 <1633000000>;
			opp-microvolt = <887500>;
		};
		opp11 {
			opp-hz = /bits/ 64 <1700000000>;
			opp-microvolt = <912500>;
		};
		opp12 {
			opp-hz = /bits/ 64 <1767000000>;
			opp-microvolt = <937500>;
		};
		opp13 {
			opp-hz = /bits/ 64 <1834000000>;
			opp-microvolt = <962500>;
		};
		opp14 {
			opp-hz = /bits/ 64 <1917000000>;
			opp-microvolt = <993750>;
		};
		opp15 {
			opp-hz = /bits/ 64 <2001000000>;
			opp-microvolt = <1025000>;
		};
	};

	cpus {
		#address-cells = <1>;
		#size-cells = <0>;

		cpu0: cpu@000 {
			device_type = "cpu";
			compatible = "arm,cortex-a53";
			reg = <0x000>;
			enable-method = "psci";
			clock-frequency = <2340000000>;
			operating-points-v2 = <&cluster0_opp>;
			dynamic-power-coefficient = <275>;
			capacity-dmips-mhz = <1024>;
			cpu-idle-states = <&standby &MCDI_CPU &MCDI_CLUSTER>,
				<&SODI &SODI3 &DPIDLE &SUSPEND>;
		};

		cpu1: cpu@001 {
			device_type = "cpu";
			compatible = "arm,cortex-a53";
			reg = <0x001>;
			enable-method = "psci";
			clock-frequency = <2340000000>;
			operating-points-v2 = <&cluster0_opp>;
			dynamic-power-coefficient = <275>;
			capacity-dmips-mhz = <1024>;
			cpu-idle-states = <&standby &MCDI_CPU &MCDI_CLUSTER>,
				<&SODI &SODI3 &DPIDLE &SUSPEND>;
		};

		cpu2: cpu@002 {
			device_type = "cpu";
			compatible = "arm,cortex-a53";
			reg = <0x002>;
			enable-method = "psci";
			clock-frequency = <2340000000>;
			operating-points-v2 = <&cluster0_opp>;
			dynamic-power-coefficient = <275>;
			capacity-dmips-mhz = <1024>;
			cpu-idle-states = <&standby &MCDI_CPU &MCDI_CLUSTER>,
				<&SODI &SODI3 &DPIDLE &SUSPEND>;
		};

		cpu3: cpu@003 {
			device_type = "cpu";
			compatible = "arm,cortex-a53";
			reg = <0x003>;
			enable-method = "psci";
			clock-frequency = <2340000000>;
			operating-points-v2 = <&cluster0_opp>;
			dynamic-power-coefficient = <275>;
			capacity-dmips-mhz = <1024>;
			cpu-idle-states = <&standby &MCDI_CPU &MCDI_CLUSTER>,
				<&SODI &SODI3 &DPIDLE &SUSPEND>;
		};

		cpu-map {
			cluster0 {
				core0 {
					cpu = <&cpu0>;
				};
				core1 {
					cpu = <&cpu1>;
				};
				core2 {
					cpu = <&cpu2>;
				};
				core3 {
					cpu = <&cpu3>;
				};
			};
		};

		idle-states {
			entry-method = "arm,psci";

			standby: standby {
				compatible = "arm,idle-state";
				arm,psci-suspend-param = <0x00000001>;
				entry-latency-us = <3000000000>;
				exit-latency-us = <600>;
				min-residency-us = <1200>;
				local-timer-stop;
			};

			MCDI_CPU: mcdi-cpu {
				compatible = "arm,idle-state";
				arm,psci-suspend-param = <0x00010001>;
				entry-latency-us = <3000000000>;
				exit-latency-us = <600>;
				min-residency-us = <1200>;
				local-timer-stop;
			};

			MCDI_CLUSTER: mcdi-cluster {
				compatible = "arm,idle-state";
				arm,psci-suspend-param = <0x01010001>;
				entry-latency-us = <3000000000>;
				exit-latency-us = <600>;
				min-residency-us = <1200>;
				local-timer-stop;
			};

			SODI: sodi {
				compatible = "arm,idle-state";
				arm,psci-suspend-param = <0x01010002>;
				entry-latency-us = <3000000000>;
				exit-latency-us = <1000>;
				min-residency-us = <2000>;
				local-timer-stop;
			};

			SODI3: sodi3 {
				compatible = "arm,idle-state";
				arm,psci-suspend-param = <0x01010003>;
				entry-latency-us = <3000000000>;
				exit-latency-us = <1000>;
				min-residency-us = <2000>;
				local-timer-stop;
			};

			DPIDLE: dpidle {
				compatible = "arm,idle-state";
				arm,psci-suspend-param = <0x01010004>;
				entry-latency-us = <3000000000>;
				exit-latency-us = <1000>;
				min-residency-us = <2000>;
				local-timer-stop;
			};

			SUSPEND: suspend {
				compatible = "arm,idle-state";
				arm,psci-suspend-param = <0x01010005>;
				entry-latency-us = <3000000000>;
				exit-latency-us = <1000>;
				min-residency-us = <2000>;
				local-timer-stop;
			};
		};
	};

	psci {
		compatible      = "arm,psci-1.0";
		method          = "smc";
	};

	pmu {
		compatible = "arm,cortex-a7-pmu";
		interrupt-parent = <&gic>;
		interrupts = <GIC_PPI 7 IRQ_TYPE_LEVEL_LOW 0>;
	};

	l2c_parity {
		compatible = "mediatek,l2c_parity-v1";
		interrupts = <GIC_SPI 0 IRQ_TYPE_LEVEL_HIGH 0>;
	};

	memory {
		device_type = "memory";
		reg = <0 0x40000000 0 0x20000000>;
	};

	reserved_memory: reserved-memory {
		#address-cells = <2>;
		#size-cells = <2>;
		ranges;

		reserve-memory-sspm_share {
			compatible = "mediatek,reserve-memory-sspm_share";
			no-map;
			status = "okay";
			size = <0 0x510000>; /* 5M + 64K */
			alignment = <0 0x10000>;
			alloc-ranges = <0 0x40000000 0 0x60000000>;
		};

		reserve-memory-scp_share {
			compatible = "mediatek,reserve-memory-scp_share";
			no-map;
			size = <0 0x00300000>;
			alignment = <0 0x1000000>;
			alloc-ranges = <0 0x40000000 0 0x50000000>;
		};

		consys_mem: consys-reserve-memory {
			compatible = "mediatek,consys-reserve-memory";
			no-map;
			size = <0 0x400000>;
			alignment = <0 0x1000000>;
			alloc-ranges = <0 0x40000000 0 0x80000000>;
		};

		wifi_mem: wifi-reserve-memory {
			compatible = "shared-dma-pool";
			no-map;
			size = <0 0x300000>;
			alignment = <0 0x1000000>;
			alloc-ranges = <0 0x40000000 0 0x80000000>;
		};
	};

	/* Microtrust SW IRQ number 188(220) ~ 193(225) */
	utos {
		compatible = "microtrust,utos";
		interrupts = <GIC_SPI 188 IRQ_TYPE_EDGE_RISING 0>,
			<GIC_SPI 189 IRQ_TYPE_EDGE_RISING 0>;
	};
	utos_tester {
		compatible = "microtrust,tester-v1";
	};

	cpu_dbgapb: cpu_dbgapb@0d410000 {
		compatible = "mediatek,hw_dbg";
		num = <8>;
		reg =	<0 0x0d410000 0 0x1000>,
			<0 0x0d510000 0 0x1000>,
			<0 0x0d610000 0 0x1000>,
			<0 0x0d710000 0 0x1000>,
			<0 0x0d810000 0 0x1000>,
			<0 0x0d910000 0 0x1000>,
			<0 0x0da10000 0 0x1000>,
			<0 0x0db10000 0 0x1000>;
	};

	/* ATF logger SW IRQ number 110 = 32 + 78 */
	atf_logger {
		compatible = "mediatek,atf_logger";
		interrupts = <GIC_SPI 78 IRQ_TYPE_EDGE_RISING 0>;
	};

	/* AMMS SW IRQ number GIC:99 DTS:67*/
	amms_control {
		compatible = "mediatek,amms";
		interrupts = <GIC_SPI 67 IRQ_TYPE_EDGE_RISING 0>;
	};

	gic: interrupt-controller@0c000000 {
		compatible = "arm,gic-v3";
		#interrupt-cells = <4>;
		#address-cells = <2>;
		#size-cells = <2>;
		#redistributor-regions = <1>;
		interrupt-parent = <&gic>;
		interrupt-controller;
		reg = <0 0x0c000000 0 0x40000>, // distributor
		      <0 0x0c080000 0 0x200000>, // redistributor
		      <0 0x10200a80 0 0x50>; // intpol
		interrupts = <GIC_PPI 9 IRQ_TYPE_LEVEL_HIGH 0>;

		ppi-partitions {
			ppi_cluster0: interrupt-partition-0 {
				affinity = <&cpu0 &cpu1 &cpu2 &cpu3>;
			};
		};
	};

	sysirq: intpol-controller@10200a80 {
		compatible = "mediatek,mt6577-sysirq";
		interrupt-controller;
		#interrupt-cells = <3>;
		interrupt-parent = <&gic>;
		reg = <0 0x10200a80 0 0x50>;
	};

	infracfg_ao: infracfg_ao@10001000 {
		compatible = "mediatek,common-infracfg_ao",
			     "mediatek,infracfg_ao",
			     "mediatek,mt6761-infracfg", "syscon";
		reg = <0 0x10001000 0 0x1000>;
		interrupts = <GIC_SPI 91 IRQ_TYPE_EDGE_RISING 0>;
		#clock-cells = <1>;
	};

	mcdi@00110100 {
		compatible = "mediatek,mt6761-mcdi";
		reg = <0 0x00110100 0 0x800>;
	};

	scpsys: power-controller@10001000 {
		compatible = "mediatek,mt6761-scpsys", "syscon";
		reg = <0 0x10006000 0 0x1000>; /* spm */
		#power-domain-cells = <1>;
		infracfg = <&infracfg_ao>;
		smi_comm = <&smi_common>;
		clocks = <&topckgen CLK_TOP_MM_SEL>,
			<&topckgen CLK_TOP_MFG_SEL>,
			<&mmsys_config CLK_MM_SMI_COMM0>,
			<&mmsys_config CLK_MM_SMI_COMM1>,
			<&mmsys_config CLK_MM_SMI_COMMON>,
			<&mmsys_config CLK_MM_SMI_LARB0>,
			<&camsys CLK_CAM_LARB2>,
			<&camsys CLK_CAM>,
			<&mmsys_config CLK_MM_SMI_CAM>,
			<&mmsys_config CLK_MM_SMI_IMG>;
		clock-names = "mm", "mfg",
			"mm-0", "mm-1", "mm-2", "mm-3",
			"cam-0", "cam-1", "cam-2", "cam-3";
	};

	scpsys_clk: scpsys@10001000 {
		compatible = "mediatek,mt6761-scpsys-clk", "syscon";
		reg =   <0 0x10001000 0 0x1000>, /* infra_ao */
			<0 0x10006000 0 0x1000>, /* spm */
			<0 0x14002000 0 0x1000>, /* spi_common */
			<0 0x1020e000 0 0x1000>, /* infracfg */
			<0 0x18004000 0 0x1000>; /* connsys */
		clocks = <&topckgen CLK_TOP_MM_SEL>,
			<&topckgen CLK_TOP_MFG_SEL>,
			<&mmsys_config CLK_MM_SMI_COMM0>,
			<&mmsys_config CLK_MM_SMI_COMM1>,
			<&mmsys_config CLK_MM_SMI_COMMON>,
			<&mmsys_config CLK_MM_SMI_LARB0>,
			<&camsys CLK_CAM_LARB2>,
			<&camsys CLK_CAM>,
			<&mmsys_config CLK_MM_SMI_CAM>,
			<&mmsys_config CLK_MM_SMI_IMG>;
			clock-names = "mm", "mfg",
			"mm-0", "mm-1", "mm-2", "mm-3",
			"cam-0", "cam-1", "cam-2", "cam-3";
		#clock-cells = <1>;
	};

	scp_infra: scp_infra@10001000 {
		compatible = "mediatek,scpinfra";
		reg = <0 0x10001000 0 0x1000>;
	};

	topckgen: topckgen@10000000 {
		compatible = "mediatek,mt6761-topckgen", "syscon";
		reg = <0 0x10000000 0 0x1000>;
		#clock-cells = <1>;
	};

	dcm: dcm@10001000 {
		compatible = "mediatek,mt6761-dcm";
		reg = <0 0x10001000 0 0x1000>,
		      <0 0x10200000 0 0x4000>,
		      <0 0x10228000 0 0x2000>,
		      <0 0x1022a000 0 0x2000>,
		      <0 0x10230000 0 0x2000>,
		      <0 0x10232000 0 0x2000>,
		      <0 0x1022d000 0 0x1000>,
		      <0 0x10235000 0 0x1000>;
		reg-names = "infra_ao",
			"mcucfg",
			"ddrphy0_ao",
			"dramc0_ao",
			"ddrphy1_ao",
			"dramc1_ao",
			"emi_ch0",
			"emi_ch1";
	};

	iocfg_lt: iocfg_lt@10002000 {
		compatible = "mediatek,iocfg_lt";
		reg = <0 0x10002000 0 0x200>;
	};

	iocfg_lm: iocfg_lm@10002200 {
		compatible = "mediatek,iocfg_lm";
		reg = <0 0x10002200 0 0x200>;
	};

	iocfg_lb: iocfg_lb@10002400 {
		compatible = "mediatek,iocfg_lb";
		reg = <0 0x10002400 0 0x200>;
	};

	iocfg_bl: iocfg_bl@10002600 {
		compatible = "mediatek,iocfg_bl";
		reg = <0 0x10002600 0 0x200>;
	};

	iocfg_rr: iocfg_rr@10002800 {
		compatible = "mediatek,iocfg_rr";
		reg = <0 0x10002800 0 0x200>;
	};

	iocfg_rb: iocfg_rb@10002a00 {
		compatible = "mediatek,iocfg_rb";
		reg = <0 0x10002a00 0 0x200>;
	};

	iocfg_rt: iocfg_rt@10002c00 {
		compatible = "mediatek,iocfg_rt";
		reg = <0 0x10002c00 0 0x200>;
	};

	pericfg: pericfg@10003000 {
		compatible = "mediatek,pericfg", "syscon";
		reg = <0 0x10003000 0 0x1000>;
		#clock-cells = <1>;
	};

	efuse_dbg@10004000 {
		compatible = "mediatek,efuse_dbg";
		reg = <0 0x10004000 0 0x1000>;
	};

	smart_pa: smart_pa {

	};

	tcpc_pd: tcpc_pd {

	};
	gpio_usage_mapping:gpio {
		compatible = "mediatek,gpio_usage_mapping";
	};

	gpio: gpio@10005000 {
		compatible = "mediatek,gpio", "syscon";
		reg = <0 0x10005000 0 0x1000>;
	};

	syscfg_pctl_0: syscfg_pctl_0@10005000 {
		compatible = "mediatek,mt6761-pctl-0-syscfg", "syscon";
		reg = <0 0x10005000 0 0x1000>;
	};

	sleep: sleep@10006000 {
		compatible = "mediatek,sleep", "syscon";
		pmic = <&main_pmic>;
		mediatek,pwrap-regmap = <&pwrap>;
		reg = <0 0x10006000 0 0x1000>;
		interrupts = <GIC_SPI 125 IRQ_TYPE_LEVEL_HIGH 0>;
		wakeup-source = <&keypad 0 (1 << 2)>,
				<&consys 1 (1 << 5)>,
				<&mddriver 3 (1 << 25)>;
	};

	power_gs {
		compatible = "mediatek,power_gs";
		pmic = <&main_pmic>;
	};

	pio: pinctrl@10005000 {
		compatible = "mediatek,mt6761-pinctrl";
		reg = <0 0x10005000 0 0x1000>,
			<0 0x10002000 0 0x200>,
			<0 0x10002200 0 0x200>,
			<0 0x10002400 0 0x200>,
			<0 0x10002600 0 0x200>,
			<0 0x10002800 0 0x200>,
			<0 0x10002a00 0 0x200>,
			<0 0x10002c00 0 0x200>;
		reg-names = "gpio",
				"iocfg_lt",
				"iocfg_lm",
				"iocfg_lb",
				"iocfg_bl",
				"iocfg_rr",
				"iocfg_rb",
				"iocfg_rt";
		gpio-controller;
		#gpio-cells = <2>;
		gpio-ranges = <&pio 0 0 179>;
		interrupt-controller;
		#interrupt-cells = <4>;
		interrupt-parent = <&gic>;
		mediatek,eint = <&eint>;
	};

	toprgu: toprgu@10007000 {
		compatible = "mediatek,mt6761-wdt",
			      "mediatek,mt6589-wdt",
			      "mediatek,toprgu",
			      "syscon", "simple-mfd";
		reg = <0 0x10007000 0 0x1000>;
		interrupts = <GIC_SPI 83 IRQ_TYPE_NONE 0>;
		mediatek,rg_dfd_timeout = <0xa0>;
		#reset-cells = <1>;
		reboot-mode {
			compatible = "syscon-reboot-mode";
			offset = <0x24>;
			mask = <0xF>;
			mode-charger = <BOOT_CHARGER>;
			mode-recovery = <BOOT_RECOVERY>;
			mode-bootloader = <BOOT_BOOTLOADER>;
			mode-dm-verity-dev-corrupt = <BOOT_DM_VERITY>;
			mode-kpoc = <BOOT_KPOC>;
			mode-ddr-reserve = <BOOT_DDR_RSVD>;
			mode-meta = <BOOT_META>;
			mode-rpmbpk = <BOOT_RPMBPK>;
		};
	};

	chipid@08000000 {
		compatible = "mediatek,chipid";
		reg = <0 0x08000000 0 0x0004>,
		      <0 0x08000004 0 0x0004>,
		      <0 0x08000008 0 0x0004>,
		      <0 0x0800000c 0 0x0004>;
	};

	mobicore: mobicore {
		compatible = "trustonic,mobicore";
		interrupts = <GIC_SPI 194 IRQ_TYPE_EDGE_RISING 0>;
	};

	tkcore {
	    compatible = "trustkernel,tkcore";
	    interrupts = <GIC_SPI 196 IRQ_TYPE_EDGE_RISING 0>;
	};

	timer {
		compatible = "arm,armv8-timer";
		interrupt-parent = <&gic>;
		interrupts = <GIC_PPI 13 IRQ_TYPE_LEVEL_HIGH 0>,
			     <GIC_PPI 14 IRQ_TYPE_LEVEL_HIGH 0>,
			     <GIC_PPI 11 IRQ_TYPE_LEVEL_HIGH 0>,
			     <GIC_PPI 10 IRQ_TYPE_LEVEL_HIGH 0>;
		clock-frequency = <13000000>;
		/*used for fpga*/
		/*clock-frequency = <150000000>;*/
	};

	clocks {
		clk26m: clk26m {
			compatible = "fixed-clock";
			#clock-cells = <0>;
			clock-frequency = <26000000>;
		};

		clk13m: clk13m {
			compatible = "fixed-clock";
			#clock-cells = <0>;
			clock-frequency = <13000000>;
		};

		clk32k: clk32k {
			compatible = "fixed-clock";
			#clock-cells = <0>;
			clock-frequency = <32000>;
		};

		ulposc1: ulposc1 {
			compatible = "fixed-clock";
			#clock-cells = <0>;
			clock-frequency = <250000000>;
		};
	};

	hacc@1000a000 {
		compatible = "mediatek,hacc";
		reg = <0 0x1000a000 0 0x1000>;
		interrupts = <GIC_SPI 133 IRQ_TYPE_LEVEL_HIGH 0>;
	};

	eint: apirq@1000b000 {
		compatible = "mediatek,mt6983-eint";
		reg = <0 0x1000b000 0 0x1000>;
		reg-name = "eint";
		mediatek,total-pin-number = <160>;
		mediatek,instance-num = <1>;
		interrupts = <GIC_SPI 115 IRQ_TYPE_LEVEL_HIGH 0>;
	};

	regulator_vibrator {
		compatible = "regulator-vibrator";
		label = "vibrator";
		min-volt = <2300000>;
		max-volt = <3200000>;
		min-limit = <15>;
		max-limit = <15000>;
		vib-supply = <&mt_pmic_vibr_ldo_reg>;
	};

	apmixed: apmixed@1000c000 {
		compatible = "mediatek,mt6761-apmixedsys", "syscon";
		reg = <0 0x1000c000 0 0xe00>;
		#clock-cells = <1>;
	};

	fhctl: fhctl@1000ce00 {
			compatible = "mediatek,mt6761-fhctl";
			reg = <0 0x1000ce00 0 0x100>, //AP FHCTL base
				<0 0x1000c000 0 0xe00>; //APMIX base

			map0 {
				domain = "top";
				method = "fhctl-sspm";
				armpll {
					fh-id = <0>;
				};
				mainpll {
					fh-id = <1>;
				};
				msdcpll {
					fh-id = <2>;
				};
				mfgpll {
					fh-id = <3>;
				};
				mpll {
					fh-id = <5>;
				};
				mmpll {
					fh-id = <6>;
				};
			};
	};

	pwrap: pwrap@1000d000 {
		compatible = "mediatek,mt6761-pwrap", "syscon";
		reg = <0 0x1000d000 0 0x1000>;
		reg-names = "pwrap";
		interrupts = <GIC_SPI 123 IRQ_TYPE_LEVEL_HIGH 0>;
		clocks = <&clk26m>, <&infracfg_ao CLK_IFR_PMIC_AP>,
				<&topckgen CLK_TOP_PWRAP_ULPOSC_SEL>;
		clock-names = "spi", "wrap", "ulposc";

		main_pmic: main_pmic {
			compatible = "mediatek,mt6357";
			interrupt-controller;
			#interrupt-cells = <2>;
			interrupt-parent = <&pio>;
			interrupts = <144 IRQ_TYPE_LEVEL_HIGH 144 0>;

			mtk_battery_oc_throttling {
				compatible =
					"mediatek,mt6357-battery_oc_throttling";
				oc-thd-h = <4670>;
				oc-thd-l = <5500>;
			};
			mtk_gauge: mtk_gauge {
				compatible = "mediatek,mt6357-gauge";
				charger = <&mtk_charger_type>;
				bootmode = <&chosen>;

				io-channels = <&pmic_auxadc AUXADC_BAT_TEMP>,
						<&pmic_auxadc AUXADC_BATADC>,
						<&pmic_auxadc AUXADC_VBIF>,
						<&pmic_auxadc AUXADC_IMP>,
						<&pmic_auxadc AUXADC_IMIX_R>;
				io-channel-names = "pmic_battery_temp",
						"pmic_battery_voltage",
						"pmic_bif_voltage",
						"pmic_ptim_voltage",
						"pmic_ptim_r";
				nvmem-cells = <&fg_init>, <&fg_soc>;
				nvmem-cell-names = "initialization", "state-of-charge";
			};
		};
	};

	scp: scp@10500000 {
		compatible = "mediatek,scp";
		status = "okay";
		reg = <0 0x10500000 0 0x40000>,
		      <0 0x105c0000 0 0x3000>,
		      <0 0x105c4000 0 0x1000>,
		      <0 0x105d4000 0 0x6000>;
		interrupts = <GIC_SPI 136 IRQ_TYPE_LEVEL_HIGH 0>;
		core_1 = "enable";
		scp_sramSize = <0x00040000>;
		scp_mpuRegionId = <27>;
		scp_feature_tbl = <0 47>,   /* vow */
				  <1 356>,  /* dsp */
				  <2 62>,   /* sensor */
				  <3 47>,   /* mp3 */
				  <4 26>,   /* flp */
				  <5 0>,    /* rtos */
				  <6 200>,  /* speaker */
				  <7 0>,    /* vcore */
				  <8 100>,  /* barge in */
				  <9 10>;   /* vow dump */

		scp_mem_key = "mediatek,reserve-memory-scp_share";
		scp_mem_tbl = <1 0x100000>, /* sensor */
			      <4 0x200000>; /* logger */
	};

	scp_dvfs {
		compatible = "mediatek,scp_dvfs";
		clocks = <&topckgen CLK_TOP_SCP_SEL>,
			<&clk26m>,
			<&topckgen CLK_TOP_SYSPLL4_D2>,
			<&topckgen CLK_TOP_UNIVPLL2_D2>,
			<&topckgen CLK_TOP_SYSPLL1_D2>,
			<&topckgen CLK_TOP_UNIVPLL1_D2>,
			<&topckgen CLK_TOP_SYSPLL_D3>,
			<&topckgen CLK_TOP_UNIVPLL_D3>;

		clock-names = "clk_mux",
			"clk_pll_0",
			"clk_pll_1",
			"clk_pll_2",
			"clk_pll_3",
			"clk_pll_4",
			"clk_pll_5",
			"clk_pll_6";

		dvfsrc-opp-num = <3>;
		dvfs-opp =
		/*	vcore	vsram	uv	dvfsrc	spm	freq	mux */
		<	0xff	0xff	0xff	0x0	0x0	250	0>,
		<	0xff	0xff	0xff	0x0	0x0	273	3>,
		<	0xff	0xff	0xff	0x2	0x8	330	5>,
		<	0xff	0xff	0xff	0x3	0xC	416	6>;

		pmic = <&main_pmic>;
		pmic-feature = "pmic-vow-lp", "pmic-pmrc";
		/*
		 * feature on off setting.
		 * 1: turns on, 0: turns off.
		 */
		pmic-feature-cfg = <0 0>;

		gpio = <&gpio 1>;
		gpio-feature = "gpio-mode";
		gpio-feature-cfg = <0>;
	};

	sleep_reg_md@1000f000 {
		compatible = "mediatek,sleep_reg_md";
		reg = <0 0x1000f000 0 0x1000>;
	};

	keypad: kp@10010000 {
		compatible = "mediatek,kp";
		reg = <0 0x10010000 0 0x1000>;
		interrupts = <GIC_SPI 124 IRQ_TYPE_EDGE_RISING 0>;
		mediatek,key-debounce-ms = <1024>;
		mediatek,hw-map-num = <72>;
		mediatek,hw-init-map = <114 0 0 0 0 0 0 0 0 0 0 0 0
					0 0 0 0 0 0 0 0 0 0 0 0 0 0
					0 0 0 0 0 0 0 0 0 0 0 0 0 0
					0 0 0 0 0 0 0 0 0 0 0 0 0 0
					0 0 0 0 0 0 0 0 0 0 0 0 0 0
					0 0 0>;
		clocks = <&clk26m>;
		clock-names = "kpd";
	};

	mrdump_ext_rst: mrdump_ext_rst {
		compatible = "mediatek, mrdump_ext_rst-eint";
		mode = "IRQ";
		status = "okay";
	};

	touch: touch {
		compatible = "goodix,touch";
	};

	accdet: accdet {
		compatible = "mediatek,pmic-accdet";
	};

	goodix_fp: fingerprint {
		compatible = "mediatek,goodix-fp";
	};

	topmisc@10011000 {
		compatible = "mediatek,topmisc";
		reg = <0 0x10011000 0 0x1000>;
	};

	dvfsrc: dvfsrc@10012000 {
		compatible = "mediatek,mt6761-dvfsrc";
		reg = <0 0x10012000 0 0x1000>,
			<0 0x10006000 0 0x1000>;
		reg-names = "dvfsrc", "spm";
		#interconnect-cells = <1>;

		dvfsrc_freq_opp2: opp2 {
			opp-peak-KBps = <0 0 0 0 0>;
		};
		dvfsrc_freq_opp1: opp1 {
			opp-peak-KBps = <5100000 5100000 3800000 5100000 0>;
		};
		dvfsrc_freq_opp0: opp0 {
			opp-peak-KBps = <7600000 7600000 5100000 7600000 0 >;
		};

		dvfsrc_vcore: dvfsrc-vcore {
			regulator-name = "dvfsrc-vcore";
			regulator-min-microvolt = <650000>;
			regulator-max-microvolt = <800000>;
			regulator-always-on;
		};

		dvfsrc_vscp: dvfsrc-vscp {
			regulator-name = "dvfsrc-vscp";
			regulator-min-microvolt = <650000>;
			regulator-max-microvolt = <800000>;
			regulator-always-on;
		};

		dvfsrc-helper {
			compatible = "mediatek,dvfsrc-helper";
			rc-vcore-supply = <&dvfsrc_vcore>;
			rc-vscp-supply = <&dvfsrc_vscp>;
			interconnects = <&dvfsrc MT6873_MASTER_DBGIF &dvfsrc MT6873_SLAVE_DDR_EMI>,
					<&dvfsrc MT6873_MASTER_DBGIF &dvfsrc MT6873_SLAVE_DDR_EMI>;
			interconnect-names = "icc-bw", "icc-perf-bw";
			required-opps = <&dvfsrc_freq_opp0>,
					<&dvfsrc_freq_opp1>,
					<&dvfsrc_freq_opp2>;
		};

		dvfsrc-met {
			compatible = "mediatek,dvfsrc-met";
		};

	};

	qos {
		compatible = "mediatek,mt6761-qos";
		reg = <0 0x00110b80 0 0x80>;
	};

	mbist_ao@10013000 {
		compatible = "mediatek,mbist_ao";
		reg = <0 0x10013000 0 0x1000>;
	};

	apcldmain_ao@10014000 {
		compatible = "mediatek,apcldmain_ao";
		reg = <0 0x10014000 0 0x400>;
	};

	apcldmaout_ao@10014400 {
		compatible = "mediatek,apcldmaout_ao";
		reg = <0 0x10014400 0 0x400>;
	};

	apcldmamisc_ao@10014800 {
		compatible = "mediatek,apcldmamisc_ao";
		reg = <0 0x10014800 0 0x400>;
	};

	apcldmamisc_ao@10014c00 {
		compatible = "mediatek,apcldmamisc_ao";
		reg = <0 0x10014c00 0 0x400>;
	};

	aes_top0@10016000 {
		compatible = "mediatek,aes_top0";
		reg = <0 0x10016000 0 0x1000>;
	};

	timer: timer@10017000 {
		compatible = "mediatek,sys_timer",
			     "mediatek,mt6761-timer",
			     "mediatek,mt6765-timer";
		reg = <0 0x10017000 0 0x1000>;
		reg-names = "sys_timer_base";
		interrupts = <GIC_SPI 138 IRQ_TYPE_LEVEL_HIGH 0>;
		clocks = <&clk13m>;
	};

	modem_temp_share@10018000 {
		compatible = "mediatek,modem_temp_share";
		reg = <0 0x10018000 0 0x1000>;
	};

	security_ao@1001a000 {
		compatible = "mediatek,security_ao";
		reg = <0 0x1001a000 0 0x1000>;
	};

	topckgen_ao@1001b000 {
		compatible = "mediatek,topckgen_ao";
		reg = <0 0x1001b000 0 0x1000>;
	};

	iocfg_0@10002000 {
		compatible = "mediatek,iocfg_0";
		reg = <0 0x10002000 0 0x200>;
	};

	iocfg_1@10002200 {
		compatible = "mediatek,iocfg_1";
		reg = <0 0x10002200 0 0x200>;
	};

	iocfg_2@10002400 {
		compatible = "mediatek,iocfg_2";
		reg = <0 0x10002400 0 0x200>;
	};

	iocfg_3@10002600 {
		compatible = "mediatek,iocfg_3";
		reg = <0 0x10002600 0 0x200>;
	};

	iocfg_4@10002800 {
		compatible = "mediatek,iocfg_4";
		reg = <0 0x10002800 0 0x200>;
	};

	iocfg_5@10002a00 {
		compatible = "mediatek,iocfg_5";
		reg = <0 0x10002a00 0 0x200>;
	};

	mdcldmain_ao@10015000 {
		compatible = "mediatek,mdcldmain_ao";
		reg = <0 0x10015000 0 0x400>;
	};

	mdcldmaout_ao@10015400 {
		compatible = "mediatek,mdcldmaout_ao";
		reg = <0 0x10015400 0 0x400>;
	};

	mdcldmamisc_ao@10015800 {
		compatible = "mediatek,mdcldmamisc_ao";
		reg = <0 0x10015800 0 0x400>;
	};

	sys_cirq@10204000 {
		compatible = "mediatek,sys_cirq";
		reg = <0 0x10204000 0 0x1000>;
		mediatek,cirq_num = <209>;
		mediatek,spi_start_offset = <16>;
		interrupts = <GIC_SPI 224 IRQ_TYPE_LEVEL_HIGH 0>;
	};

	mcucfg@10200000 {
		compatible = "mediatek,mcucfg";
		reg = <0 0x10200000 0 0x200>;
		interrupts = <GIC_SPI 0 IRQ_TYPE_LEVEL_HIGH 0>;
	};

	mcucfg@10200200 {
		compatible = "mediatek,mcucfg";
		reg = <0 0x10200200 0 0x200>;
		interrupts = <GIC_SPI 1 IRQ_TYPE_LEVEL_HIGH 0>;
	};

	mcucfg@10200400 {
		compatible = "mediatek,mcucfg";
		reg = <0 0x10200400 0 0x200>;
		interrupts = <GIC_SPI 2 IRQ_TYPE_LEVEL_HIGH 0>;
	};

	mcucfg@10200600 {
		compatible = "mediatek,mcucfg";
		reg = <0 0x10200600 0 0x200>;
		interrupts = <GIC_SPI 3 IRQ_TYPE_LEVEL_HIGH 0>;
	};

	mcucfg@10200800 {
		compatible = "mediatek,mcucfg";
		reg = <0 0x10200800 0 0x200>;
		interrupts = <GIC_SPI 4 IRQ_TYPE_LEVEL_HIGH 0>;
	};

	mcucfg@10200a00 {
		compatible = "mediatek,mcucfg";
		reg = <0 0x10200a00 0 0x300>;
		interrupts = <GIC_SPI 5 IRQ_TYPE_LEVEL_HIGH 0>;
	};

	mcucfg@10200f00 {
		compatible = "mediatek,mcucfg";
		reg = <0 0x10200f00 0 0x100>;
		interrupts = <GIC_SPI 6 IRQ_TYPE_LEVEL_HIGH 0>;
	};

	mcucfg@10201000 {
		compatible = "mediatek,mcucfg";
		reg = <0 0x10201000 0 0x1000>;
		interrupts = <GIC_SPI 7 IRQ_TYPE_LEVEL_HIGH 0>;
	};

	mcucfg@10202000 {
		compatible = "mediatek,mcucfg";
		reg = <0 0x10202000 0 0x1000>;
		interrupts = <GIC_SPI 8 IRQ_TYPE_LEVEL_HIGH 0>;
	};

	mcucfg@10203000 {
		compatible = "mediatek,mcucfg";
		reg = <0 0x10203000 0 0x1000>;
		interrupts = <GIC_SPI 9 IRQ_TYPE_LEVEL_HIGH 0>;
	};

	mcucfg_mp0_counter@10200000 {
		compatible = "mediatek,mcucfg_mp0_counter";
		reg = <0 0x10200000 0 0x4000>;
	};

	iommu: m4u@10205000 {
		cell-index = <0>;
		compatible = "mediatek,mt6761-m4u";
		reg = <0 0x10205000 0 0x1000>;
		mediatek,larbs = <&smi_larb0 &smi_larb1 &smi_larb2>;
		interrupts = <GIC_SPI 102 IRQ_TYPE_LEVEL_HIGH 0>;
		#iommu-cells = <1>;
	};

	mtk_iommu_debug {
		compatible = "mediatek,mt6761-iommu-debug";
	};

	mtk_dmabufheap_debug0: dmaheap_test0{
			compatible = "mediatek, mtk_dmabufheap, iommu0";
			iommus = <&iommu M4U_PORT_DISP_WDMA0>;
	};

	mtk_dmabufheap_debug1: dmaheap_test1{
			compatible = "mediatek, mtk_dmabufheap, iommu1";
			iommus = <&iommu M4U_PORT_DISP_FAKE0>;
	};

	iommu_test {
		compatible = "mediatek,ktf-iommu-test";
		iommus = <&iommu M4U_PORT_DISP_RDMA0>;
		};

	devapc@10207000 {
		compatible = "mediatek,devapc";
		reg = <0 0x10207000 0 0x1000>;
		interrupts = <GIC_SPI 86 IRQ_TYPE_LEVEL_HIGH 0>;
		clocks = <&infracfg_ao CLK_IFR_DEVICE_APC>;
		clock-names = "devapc-infra-clock";
	};

	hwrng: hwrng {
		compatible = "mediatek,mt67xx-rng";
	};

	bus_dbg@10208000 {
		compatible = "mediatek,bus_dbg-v2";
		reg = <0 0x10208000 0 0x1000>,
			<0 0x10001000 0 0x1000>;
		mediatek,bus_dbg_con_offset = <0x2fc>;
		interrupts = <GIC_SPI 85 IRQ_TYPE_LEVEL_HIGH 0>;
	};

	ap_ccif0@10209000 {
		compatible = "mediatek,ap_ccif0";
		reg = <0 0x10209000 0 0x1000>;
		interrupts = <GIC_SPI 92 IRQ_TYPE_LEVEL_HIGH 0>;
	};

	md_ccif0@1020a000 {
		compatible = "mediatek,md_ccif0";
		reg = <0 0x1020a000 0 0x1000>;
	};

	ap_ccif1@1020b000 {
		compatible = "mediatek,ap_ccif1";
		reg = <0 0x1020b000 0 0x1000>;
		interrupts = <GIC_SPI 94 IRQ_TYPE_LEVEL_HIGH 0>;
	};

	md_ccif1@1020c000 {
		compatible = "mediatek,md_ccif1";
		reg = <0 0x1020c000 0 0x1000>;
	};

	infra_mbist@1020d000 {
		compatible = "mediatek,infra_mbist";
		reg = <0 0x1020d000 0 0x1000>;
	};

	infracfg@1020e000 {
		compatible = "mediatek,infracfg";
		reg = <0 0x1020e000 0 0x1000>;
	};

	trng@1020f000 {
		compatible = "mediatek,trng";
		reg = <0 0x1020f000 0 0x1000>;
		interrupts = <GIC_SPI 105 IRQ_TYPE_LEVEL_HIGH 0>;
	};

	dxcc_sec@10210000 {
		compatible = "mediatek,dxcc_sec";
		reg = <0 0x10210000 0 0x1000>;
		interrupts = <GIC_SPI 106 IRQ_TYPE_LEVEL_HIGH 0>;
	};

	mcupm_sram2@10211000 {
		compatible = "mediatek,mcupm_sram2";
		reg = <0 0x10211000 0 0x1000>;
	};

	cqdma-controller@10212000 {
		compatible = "mediatek,mt6765-cqdma";
		reg = <0 0x10212000 0 0x80>,
			<0 0x10212080 0 0x80>,
			<0 0x10212100 0 0x68>;
		interrupts = <GIC_SPI 57 IRQ_TYPE_LEVEL_HIGH 0>,
				<GIC_SPI 58 IRQ_TYPE_LEVEL_HIGH 0>,
				<GIC_SPI 59 IRQ_TYPE_LEVEL_HIGH 0>;
		/* clocks = <&infracfg_ao CLK_IFR_CQ_DMA>; */
		/* clock-names = "cqdma"; */
		dma-channel-mask = <63>;
		dma-channels = <3>;
		dma-requests = <10>;
		#dma-cells = <1>;
	};

	mcupm_sram3@10213000 {
		compatible = "mediatek,mcupm_sram3";
		reg = <0 0x10213000 0 0x1000>;
	};

	sramrom@10214000 {
		compatible = "mediatek,sramrom";
		reg = <0 0x10214000 0 0x1000>;
	};

	mcupm_reg@10216000 {
		compatible = "mediatek,mcupm_reg";
		reg = <0 0x10216000 0 0x1000>;
	};

	mcupm_sram0@10217000 {
		compatible = "mediatek,mcupm_sram0";
		reg = <0 0x10217000 0 0x1000>;
	};

	mcupm_sram1@10218000 {
		compatible = "mediatek,mcupm_sram1";
		reg = <0 0x10218000 0 0x1000>;
	};

	apcldmain@1021b000 {
		compatible = "mediatek,apcldmain";
		reg = <0 0x1021b000 0 0x100>;
	};

	apcldmaout@1021b400 {
		compatible = "mediatek,apcldmaout";
		reg = <0 0x1021b400 0 0x100>;
	};

	apcldmamisc@1021b800 {
		compatible = "mediatek,apcldmamisc";
		reg = <0 0x1021b800 0 0x100>;
		interrupts = <GIC_SPI 109 IRQ_TYPE_LEVEL_HIGH 0>;
	};

	mdcldmain@1021c000 {
		compatible = "mediatek,mdcldmain";
		reg = <0 0x1021c000 0 0x400>;
	};

	mdcldmaout@1021c400 {
		compatible = "mediatek,mdcldmaout";
		reg = <0 0x1021c400 0 0x400>;
	};

	mdcldmamisc@1021c800 {
		compatible = "mediatek,mdcldmamisc";
		reg = <0 0x1021c800 0 0x400>;
	};

	ccifdriver:ccifdriver@10209000 {
		compatible = "mediatek,ccci_ccif";
		reg = <0 0x10209000 0 0x1000>, /*AP_CCIF_BASE*/
			<0 0x1020a000 0 0x1000>; /*MD_CCIF_BASE*/
		mediatek,sram_size = <512>;
		/*CCIF0 174/206, CCIF0 175/207*/
		interrupts = <GIC_SPI 92 IRQ_TYPE_LEVEL_HIGH 0>,
					<GIC_SPI 93 IRQ_TYPE_LEVEL_HIGH 0>;
		clocks = <&infracfg_ao CLK_IFR_CCIF_AP>,
			<&infracfg_ao CLK_IFR_CCIF_MD>,
			<&infracfg_ao CLK_IFR_CCIF1_AP>,
			<&infracfg_ao CLK_IFR_CCIF1_MD>;
		clock-names = "infra-ccif-ap",
			"infra-ccif-md",
			"infra-ccif1-ap",
			"infra-ccif1-md";
	};

	cldmadriver:cldmadriver@10014000 {
		compatible = "mediatek,ccci_cldma";
		reg = <0 0x10014000 0 0x1000>, /*AP_CLDMA_AO "mediatek,apcldmain_ao*/
			  <0 0x1021b000 0 0x1000>; /*AP_CLDMA_PDN "mediatek,apcldmain*/
		/* IRQ_CLDMA "mediatek,apcldmamisc" */
		interrupts = <GIC_SPI 109 IRQ_TYPE_LEVEL_HIGH 0>;
		mediatek,cldma_capability = <6>;
		mediatek,md_generation = <6293>;
		mediatek,platform = <6761>;
		clocks = <&infracfg_ao CLK_IFR_CLDMA_BCLK>;
		clock-names = "infra-cldma-bclk";
		cldma-infracfg = <&infracfg_ao>;
	};

	mddriver:mddriver {
		compatible = "mediatek,mddriver";
		/* bit0~3: CLDMA|CCIF|DPMAIF */
		mediatek,mdhif_type = <3>; /* bit0 CLDMA|bit1 CCIF|bit2 DPMAIF */
		mediatek,md_id = <0>;
		mediatek,ap_plat_info = <6761>;
		mediatek,md_generation = <6293>;
		mediatek,offset_epon_md1 = <0x1c24>;
		mediatek,cldma_capability = <6>;
		/* bit0:srcclkena|bit1:srclken_o1_on|bit2:revert_sequencer */
		mediatek,power_flow_config = <0x1>;//bit0~4:10000
		/* srclken_o1 set value |= 1<<21 */
		mediatek,srclken_o1 = <0>;
		/* DTS/GIC_ID: MDWDT 205/107; CCIF0 92/128; CCIF0 93/129 */
		interrupts = <GIC_SPI 205 IRQ_TYPE_EDGE_RISING 0>,
				<GIC_SPI 92 IRQ_TYPE_LEVEL_HIGH 0>,
				<GIC_SPI 93 IRQ_TYPE_LEVEL_HIGH 0>;
		clocks = <&scpsys_clk SCP_SYS_MD1>;
		clock-names = "scp-sys-md1-main";
		ccci-infracfg = <&infracfg_ao>;
		ccci-topckgen = <&topckgen>;
		dvfsrc-vcore-supply = <&dvfsrc_vcore>;
	};

	md_auxadc:md_auxadc {
		compatible = "mediatek,md_auxadc";
		io-channels = <&auxadc 2>;
		io-channel-names = "md-channel",
			"md-battery";
	};

	ccci_scp:ccci_scp {
		compatible = "mediatek,ccci_md_scp";
		clocks = <&infracfg_ao CLK_IFR_CCIF2_AP>,
			<&infracfg_ao CLK_IFR_CCIF2_MD>;
		clock-names = "infra-ccif2-ap",
			"infra-ccif2-md";
	};

	md1_sim1_hot_plug_eint:MD1_SIM1_HOT_PLUG_EINT {
	};

	md1_sim2_hot_plug_eint:MD1_SIM2_HOT_PLUG_EINT {
	};

	bpi_bsi_slv0@1021e000 {
		compatible = "mediatek,bpi_bsi_slv0";
		reg = <0 0x1021e000 0 0x1000>;
	};

	bpi_bsi_slv1@1021f000 {
		compatible = "mediatek,bpi_bsi_slv1";
		reg = <0 0x1021f000 0 0x6000>;
	};

	bpi_bsi_slv2@10225000 {
		compatible = "mediatek,bpi_bsi_slv2";
		reg = <0 0x10225000 0 0x1000>;
	};

	dvfsp@10227000 {
		compatible = "mediatek,dvfsp";
		reg = <0 0x10227000 0 0x1000>;
	};

	dvfsp@00110c00 {
		compatible = "mediatek,mt6761-dvfsp";
		reg = <0 0x00110c00 0 0x1400>,
		      <0 0x00110c00 0 0x1400>;
		nvmem-cells = <&efuse_segment>;
		nvmem-cell-names = "efuse_segment_cell";
	};

	dramc@1022a000 {
		compatible = "mediatek,common-dramc";
		reg = <0 0x1022a000 0 0x2000>, /* DRAMC AO CHA */
			<0 0x10232000 0 0x2000>, /* DRAMC AO CHB */
			<0 0x1022c000 0 0x1000>, /* DRAMC NAO CHA */
			<0 0x10234000 0 0x1000>, /* DRAMC NAO CHB */
			<0 0x10228000 0 0x2000>, /* DDRPHY AO CHA */
			<0 0x10230000 0 0x2000>, /* DDRPHY AO CHB */
			<0 0x1022e000 0 0x1000>, /* DDRPHY NAO CHA */
			<0 0x10236000 0 0x1000>, /* DDRPHY NAO CHB */
			<0 0x10006000 0 0x1000>; /* SLEEP BASE */
		mr4_version = <1>;
		mr4_rg = <0x0090 0x0000ffff 0>;
		fmeter_version = <0>;
		crystal_freq = <52>;
		pll_id = <0x0510 0x80000000 31>;
		shu_lv = <0x00e4 0x00000006 1>;
		shu_of = <0x500>;
		sdmpcw = <0x0d9c 0xffff0000 16>,
			<0x0d94 0xffff0000 16>;
		prediv = <0x0da8 0x000c0000 18>,
			<0x0da0 0x000c0000 18>;
		posdiv = <0x0da8 0x00000007 0>,
			<0x0da0 0x00000007 0>;
		ckdiv4 = <0x0d18 0x08000000 27>,
			<0x0d18 0x08000000 27>;
	};

	emichn: emichn@1022d000 {
		compatible = "mediatek,mt6779-emichn",
			     "mediatek,common-emichn";
		reg = <0 0x1022d000 0 0x1000>,
		      <0 0x10235000 0 0x1000>;
	};

	emicen: emicen@10219000 {
		compatible = "mediatek,mt6779-emicen",
			     "mediatek,common-emicen";
		reg = <0 0x10219000 0 0x1000>;
		mediatek,emi-reg = <&emichn>;
	};

	emiisu {
		compatible = "mediatek,mt6779-emiisu",
			     "mediatek,common-emiisu";
		ctrl_intf = <1>;
	};

	emictrl {
		compatible = "mediatek,common-emictrl";
		mediatek,emi-reg = <&emicen>;
	};

	mdpsys_config: mdpsys_config@14000000 {
		compatible = "mediatek,mdpsys_config";
		clocks = <&mmsys_config CLK_MM_CAM_MDP>,
			<&mmsys_config CLK_MM_IMG_DL_RELAY>,
			<&mmsys_config CLK_MM_IMG_DL_ASYNC_TOP>;
		clock-names = "CAM_MDP", "IMG_DL_RELAY",
			"IMG_DL_ASYNC_TOP";
		iommus = <&iommu M4U_PORT_MDP_RDMA0>,
			<&iommu M4U_PORT_MDP_WDMA0>,
			<&iommu M4U_PORT_MDP_WROT0>;
		dma_mask_bit = <35>;
	};

	emimpu@10226000 {
		compatible = "mediatek,mt6761-emimpu",
				"mediatek,common-emimpu";
		reg = <0 0x10226000 0 0x1000>;
		mediatek,emi-reg = <&emicen>;
		interrupts = <GIC_SPI 88 IRQ_TYPE_LEVEL_HIGH 0>;
		region_cnt = <32>;
		domain_cnt = <16>;
		addr_align = <16>;
		ap_region = <31>;
		ap_apc = <0 5 5 5 0 5 6 5>,
			<0 0 5 5 5 5 5 5>;
		dump = <0x1f0 0x1f8 0x1fc>;
		clear = <0x160 0xffffffff 16>,
			<0x200 0x00000003 16>,
			<0x1f0 0x80000000 1>;
		clear_md = <0x1fc 0x80000000 1>;
		ctrl_intf = <1>;
		slverr = <0>;
		bypass = <1>;
	};

	gce: gce@10238000 {
		compatible = "mediatek,mdp", "syscon";
		reg = <0 0x10238000 0 0x4000>;
		interrupts = <GIC_SPI 98 IRQ_TYPE_LEVEL_HIGH 0>;
		mdpsys_config = <&mdpsys_config>;
		mmsys_config = <&mmsys_config>;
		mdp_rdma0 = <&mdp_rdma0>;
		mdp_rsz0 = <&mdp_rsz0>;
		mdp_rsz1 = <&mdp_rsz1>;
		mdp_wdma0 = <&mdp_wdma0>;
		mdp_wrot0 = <&mdp_wrot0>;
		mdp_tdshp0 = <&mdp_tdshp0>;
		mdp_color0 = <&disp_color0>;
		mdp_ccorr0 = <&mdp_ccorr>;
		mm_mutex = <&disp_mutex0>;
		mediatek,larb = <&smi_larb0>;
		g3d_config_base = <0x13000000 0 0xffff0000>;
		mmsys_config_base = <0x14000000 1 0xffff0000>;
		disp_dither_base = <0x14010000 2 0xffff0000>;
		mm_na_base = <0x14020000 3 0xffff0000>;
		imgsys_base = <0x15020000 4 0xffff0000>;
		vdec_gcon_base = <0x18800000 5 0xffff0000>;
		venc_gcon_base = <0x18810000 6 0xffff0000>;
		conn_peri_base = <0x18820000 7 0xffff0000>;
		topckgen_base = <0x18830000 8 0xffff0000>;
		kp_base = <0x18840000 9 0xffff0000>;
		scp_sram_base = <0x10000000 10 0xffff0000>;
		infra_na3_base = <0x10010000 11 0xffff0000>;
		infra_na4_base = <0x10020000 12 0xffff0000>;
		scp_base = <0x10030000 13 0xffff0000>;
		mcucfg_base = <0x10040000 14 0xffff0000>;
		gcpu_base = <0x10050000 15 0xffff0000>;
		usb0_base = <0x10200000 16 0xffff0000>;
		usb_sif_base = <0x10280000 17 0xffff0000>;
		audio_base = <0x17000000 18 0xffff0000>;
		vdec_base = <0x17010000 19 0xffff0000>;
		msdc2_base = <0x17020000 20 0xffff0000>;
		vdec1_base = <0x17030000 21 0xffff0000>;
		msdc3_base = <0x18000000 22 0xffff0000>;
		ap_dma_base = <0x18010000 23 0xffff0000>;
		gce_base = <0x18020000 24 0xffff0000>;
		vdec2_base = <0x18040000 25 0xffff0000>;
		vdec3_base = <0x18050000 26 0xffff0000>;
		camsys_base = <0x18080000 27 0xffff0000>;
		camsys1_base = <0x180a0000 28 0xffff0000>;
		camsys2_base = <0x180b0000 29 0xffff0000>;
		pwm_sw_base = <0x1100e000 99 0xffff0000>;
		mipitx0_base = <0x11c80000 99 0xffff0000>;
		mdp_rdma0_sof = <CMDQ_EVENT_MDP_RDMA0_SOF>;
		mdp_ccorr0_sof = <CMDQ_EVENT_MDP_CCORR0_SOF>;
		mdp_rsz0_sof = <CMDQ_EVENT_MDP_RSZ0_SOF>;
		mdp_rsz1_sof = <CMDQ_EVENT_MDP_RSZ1_SOF>;
		mdp_wdma_sof = <CMDQ_EVENT_MDP_WDMA_SOF>;
		mdp_wrot0_sof = <CMDQ_EVENT_MDP_WROT0_SOF>;
		mdp_tdshp0_sof = <CMDQ_EVENT_MDP_TDSHP0_SOF>;
		disp_ovl0_sof = <CMDQ_EVENT_DISP_OVL0_SOF>;
		disp_2l_ovl0_sof = <CMDQ_EVENT_DISP_2L_OVL0_SOF>;
		disp_rdma0_sof = <CMDQ_EVENT_DISP_RDMA0_SOF>;
		disp_wdma0_sof = <CMDQ_EVENT_DISP_WDMA0_SOF>;
		disp_color0_sof = <CMDQ_EVENT_DISP_COLOR0_SOF>;
		disp_ccorr0_sof = <CMDQ_EVENT_DISP_CCORR0_SOF>;
		disp_aal0_sof = <CMDQ_EVENT_DISP_AAL0_SOF>;
		disp_gamma0_sof = <CMDQ_EVENT_DISP_GAMMA0_SOF>;
		disp_dither0_sof = <CMDQ_EVENT_DISP_DITHER0_SOF>;
		disp_dsi0_sof = <CMDQ_EVENT_DISP_DSI0_SOF>;
		disp_rsz0_sof = <CMDQ_EVENT_DISP_RSZ0_SOF>;
		img_dl_relay_sof = <CMDQ_EVENT_IMG_DL_RELAY_SOF>;
		disp_pwm0_sof = <CMDQ_EVENT_DISP_PWM0_SOF>;
		mdp_rdma0_frame_done = <CMDQ_EVENT_MDP_RDMA0_EOF>;
		mdp_ccorr0_frame_done = <CMDQ_EVENT_MDP_CCORR0_FRAME_DONE>;
		mdp_rsz0_frame_done = <CMDQ_EVENT_MDP_RSZ0_EOF>;
		mdp_rsz1_frame_done = <CMDQ_EVENT_MDP_RSZ1_EOF>;
		mdp_wrot0_write_frame_done = <CMDQ_EVENT_MDP_WROT0_W_EOF>;
		mdp_wdma_frame_done = <CMDQ_EVENT_MDP_WDMA_EOF>;
		mdp_tdshp0_frame_done = <CMDQ_EVENT_MDP_TDSHP0_EOF>;
		disp_ovl0_frame_done = <CMDQ_EVENT_DISP_OVL0_EOF>;
		disp_2l_ovl0_frame_done = <CMDQ_EVENT_DISP_2L_OVL0_EOF>;
		disp_rsz0_frame_done = <CMDQ_EVENT_DISP_RSZ0_EOF>;
		disp_rdma0_frame_done = <CMDQ_EVENT_DISP_RDMA0_EOF>;
		disp_wdma0_frame_done = <CMDQ_EVENT_DISP_WDMA0_EOF>;
		disp_color0_frame_done = <CMDQ_EVENT_DISP_COLOR0_EOF>;
		disp_ccorr0_frame_done = <CMDQ_EVENT_DISP_CCORR0_EOF>;
		disp_aal0_frame_done = <CMDQ_EVENT_DISP_AAL0_EOF>;
		disp_gamma0_frame_done = <CMDQ_EVENT_DISP_GAMMA0_EOF>;
		disp_dither0_frame_done = <CMDQ_EVENT_DISP_DITHER0_EOF>;
		disp_dsi0_frame_done = <CMDQ_EVENT_DISP_DSI0_EOF>;
		stream_done_0 = <CMDQ_EVENT_MUTEX0_STREAM_EOF>;
		stream_done_1 = <CMDQ_EVENT_MUTEX1_STREAM_EOF>;
		stream_done_2 = <CMDQ_EVENT_MUTEX2_STREAM_EOF>;
		stream_done_3 = <CMDQ_EVENT_MUTEX3_STREAM_EOF>;
		stream_done_4 = <CMDQ_EVENT_MUTEX4_STREAM_EOF>;
		stream_done_5 = <CMDQ_EVENT_MUTEX5_STREAM_EOF>;
		stream_done_6 = <CMDQ_EVENT_MUTEX6_STREAM_EOF>;
		stream_done_7 = <CMDQ_EVENT_MUTEX7_STREAM_EOF>;
		stream_done_8 = <CMDQ_EVENT_MUTEX8_STREAM_EOF>;
		stream_done_9 = <CMDQ_EVENT_MUTEX9_STREAM_EOF>;
		buf_underrun_event_0 = <CMDQ_EVENT_DISP_RDMA0_UNDERRUN>;
		dsi0_te_event = <CMDQ_EVENT_DSI0_TE>;
		dsi0_irq_event = <CMDQ_EVENT_DSI0_IRQ_EVENT>;
		dsi0_done_event = <CMDQ_EVENT_DSI0_DONE_EVENT>;
		disp_wdma0_rst_done = <CMDQ_EVENT_DISP_WDMA0_RST_DONE>;
		mdp_wdma_rst_done = <CMDQ_EVENT_MDP_WDMA_RST_DONE>;
		mdp_wrot0_rst_done = <CMDQ_EVENT_MDP_WROT0_RST_DONE>;
		mdp_rdma0_rst_done = <CMDQ_EVENT_MDP_RDMA0_RST_DONE>;
		disp_ovl0_frame_rst_done_pusle = <CMDQ_EVENT_DISP_OVL0_RST_DONE>;
		dip_cq_thread2_frame_done = <257>;
		dip_cq_thread1_frame_done = <258>;
		dip_cq_thread0_frame_done = <259>;
		isp_frame_done_p1_1 = <260>;
		isp_frame_done_p1_0 = <261>;
		camsv_0_pass1_done = <262>;
		camsv_1_pass1_done = <263>;
		seninf_0_fifo_full = <264>;
		seninf_1_fifo_full = <265>;
		seninf_2_fifo_full = <266>;
		seninf_3_fifo_full = <267>;
		seninf_4_fifo_full = <268>;
		seninf_5_fifo_full = <269>;
		seninf_6_fifo_full = <270>;
		seninf_7_fifo_full = <271>;
		venc_done = <CMDQ_EVENT_VENC_EOF>;
		jpgenc_done = <CMDQ_EVENT_JPEG_ENC_EOF>;
		jpgdec_done = <CMDQ_EVENT_JPEG_DEC_EOF>;
		venc_mb_done = <CMDQ_EVENT_VENC_MB_DONE>;
		venc_128byte_cnt_done = <CMDQ_EVENT_VENC_128BYTE_CNT_DONE>;
		max_prefetch_cnt = <1>;
		prefetch_size = <96>;
		sram_size_cpr_64 = <64>;
		sram_share_cnt = <1>;
		sram_share_engine = <10>;
		sram_share_event = <710>;
		thread_count = <16>;
		mediatek,mailbox-gce = <&gce_mbox>;
		secure_thread = <8 10>;
		mboxes = <&gce_mbox 11 0 CMDQ_THR_PRIO_1>,
				<&gce_mbox 12 0 CMDQ_THR_PRIO_1>;
		clocks = <&infracfg_ao CLK_IFR_GCE>,
				<&infracfg_ao CLK_IFR_GCE_26M>;
		clock-names = "GCE", "GCE_TIMER";
		interconnects =
			<&mmqos MASTER_LARB_PORT(M4U_PORT_MDP_RDMA0)
				&mmqos SLAVE_COMMON(0)>,
			<&mmqos MASTER_LARB_PORT(M4U_PORT_MDP_WROT0)
				&mmqos SLAVE_COMMON(0)>,
			<&mmqos MASTER_LARB_PORT(M4U_PORT_MDP_WDMA0)
				&mmqos SLAVE_COMMON(0)>;
		interconnect-names =
			"mdp_rdma0",
			"mdp_wrot0",
			"mdp_wdma";
		operating-points-v2 = <&opp_table_mm>;
		mdp-opp = <&opp_table_mm>;
		isp-opp = <&opp_table_mm>;
		mdp-dvfsrc-vcore-supply = <&dvfsrc_vcore>;
		isp-dvfsrc-vcore-supply = <&dvfsrc_vcore>;
	};

	gce_mbox: gce_mbox@10238000 {
		compatible = "mediatek,mt6761-gce";
		reg = <0 0x10238000 0 0x4000>;
		interrupts = <GIC_SPI 98 IRQ_TYPE_LEVEL_HIGH 0>;
		#mbox-cells = <3>;
		#gce-event-cells = <1>;
		#gce-subsys-cells = <2>;
		default_tokens = /bits/ 16 <CMDQ_SYNC_TOKEN_GPR_SET_0>,
			/bits/ 16 <CMDQ_SYNC_TOKEN_GPR_SET_1>,
			/bits/ 16 <CMDQ_SYNC_TOKEN_GPR_SET_2>,
			/bits/ 16 <CMDQ_SYNC_TOKEN_GPR_SET_3>,
			/bits/ 16 <CMDQ_SYNC_TOKEN_GPR_SET_4>,
			/bits/ 16 <CMDQ_SYNC_RESOURCE_WROT0>,
			/bits/ 16 <CMDQ_SYNC_RESOURCE_WROT1>;
		clocks = <&infracfg_ao CLK_IFR_GCE>,
			<&infracfg_ao CLK_IFR_GCE_26M>;
		clock-names = "gce", "gce-timer";
		power-domains = <&scpsys MT6761_POWER_DOMAIN_DIS>;
		skip-poll-sleep;
		cpr-not-support-cookie;
	};

	cmdq-test {
		compatible = "mediatek,cmdq-test";
		mediatek,gce = <&gce_mbox>;
		mmsys_config = <&mmsys_config>;
		devlink-supply = <&gce_mbox>;
		mediatek,gce-subsys = <99>, <SUBSYS_1400XXXX>;
/*
		mboxes = <&gce_mbox 11 0 CMDQ_THR_PRIO_1>,
			<&gce_mbox 12 CMDQ_NO_TIMEOUT CMDQ_THR_PRIO_1>,
			<&gce_mbox_sec 10 0 CMDQ_THR_PRIO_1>;
*/
		token_user0 = /bits/ 16 <CMDQ_SYNC_TOKEN_USER_0>;
		token_gpr_set4 = /bits/ 16 <CMDQ_SYNC_TOKEN_GPR_SET_4>;
	};

	gce_mbox_svp: gce_mbox_svp@10238000 {
		compatible = "mediatek,mailbox-gce-sec";
		reg = <0 0x10238000 0 0x4000>;
		interrupts = <GIC_SPI 98 IRQ_TYPE_LEVEL_HIGH 0>;
		#mbox-cells = <3>;
		clocks = <&infracfg_ao CLK_IFR_GCE>,
			<&infracfg_ao CLK_IFR_GCE_26M>;
		clock-names = "gce", "gce-timer";
	};

	ap_ccif2@1023c000 {
		compatible = "mediatek,ap_ccif2";
		reg = <0 0x1023c000 0 0x1000>;
		interrupts = <GIC_SPI 87 IRQ_TYPE_LEVEL_HIGH 0>;
	};

	md_ccif2@1023d000 {
		compatible = "mediatek,md_ccif2";
		reg = <0 0x1023d000 0 0x1000>;
	};

	ap_ccif3@1023e000 {
		compatible = "mediatek,ap_ccif3";
		reg = <0 0x1023e000 0 0x1000>;
		interrupts = <GIC_SPI 90 IRQ_TYPE_LEVEL_HIGH 0>;
	};

	md_ccif3@1023f000 {
		compatible = "mediatek,md_ccif3";
		reg = <0 0x1023f000 0 0x1000>;
	};

	sspm@10440000 {
		compatible = "mediatek,sspm";
		reg = <0 0x10440000 0 0x10000>,
			<0 0x10450000 0 0x100>,
			<0 0x10451000 0 0x8>,
			<0 0x10460000 0 0x100>,
			<0 0x10461000 0 0x8>,
			<0 0x10470000 0 0x100>,
			<0 0x10471000 0 0x8>,
			<0 0x10480000 0 0x100>,
			<0 0x10481000 0 0x8>,
			<0 0x10490000 0 0x100>,
			<0 0x10491000 0 0x8>;

		reg-names = "cfgreg",
			"mbox0_base",
			"mbox0_ctrl",
			"mbox1_base",
			"mbox1_ctrl",
			"mbox2_base",
			"mbox2_ctrl",
			"mbox3_base",
			"mbox3_ctrl",
			"mbox4_base",
			"mbox4_ctrl";

		interrupts = <GIC_SPI 146 IRQ_TYPE_LEVEL_HIGH 0>,
			<GIC_SPI 149 IRQ_TYPE_LEVEL_HIGH 0>,
			<GIC_SPI 150 IRQ_TYPE_LEVEL_HIGH 0>,
			<GIC_SPI 151 IRQ_TYPE_LEVEL_HIGH 0>,
			<GIC_SPI 152 IRQ_TYPE_LEVEL_HIGH 0>,
			<GIC_SPI 153 IRQ_TYPE_LEVEL_HIGH 0>;

		interrupt-names = "ipc",
			"mbox0",
			"mbox1",
			"mbox2",
			"mbox3",
			"mbox4";
		sspm_mem_key = "mediatek,reserve-memory-sspm_share";
		sspm_mem_tbl = <0 0x100400>, /* logger header + 1M log buffer */
			<1 0x300>,	/* PWRAP 768bytes*/
			<2 0xc00>,	/* PMIC 3K */
			<3 0x1800>,	/* UPD 6K */
			<4 0x1000>,	/* QOS 4K*/
			<5 0xc00>,	/* SWPM 6K*/
			<6 0x400000>,	/* MET 4M */
			<7 0x0>;	/* SMI 36K */

		sspm_ipi_send_pin_tbl = < 3 0 1 0 0 >,
					/* PINS_SIZE_PLATFORM, mbox, retdata, lock, polling */
			< 4 0 1 1 1 >,	/* PINS_SIZE_CPU_DVFS, mbox, retdata, lock, polling */
			< 4 0 1 1 1 >,	/* PINS_SIZE_QOS, mbox, retdata, lock, polling */
			< 4 0 1 0 0 >,	/* PINS_SIZE_TST1, mbox, retdata, lock, polling */
			< 9 0 1 1 1 >,	/* PINS_SIZE_FHCTL, mbox, retdata, lock, polling */
			< 2 1 1 1 1 >,	/* PINS_SIZE_MCDI, mbox, retdata, lock, polling */
			< 8 1 1 1 1 >,	/* PINS_SIZE_SPM_SUSPEND, mbox, retdata, lock, polling */
			< 5 1 1 1 1 >,	/* PINS_SIZE_PMIC, mbox, retdata, lock, polling */
			< 7 1 1 1 1 >,	/* PINS_SIZE_PPM, mbox, retdata, lock, polling */
			< 4 1 1 0 0 >,	/* PINS_SIZE_THERMAL, mbox, retdata, lock, polling */
			< 4 1 1 1 1 >,	/* PINS_SIZE_UPOWER, mbox, retdata, lock, polling */
			< 2 1 1 0 0 >;
			/* PINS_SIZE_UNUSED/PINS_SIZE_CM, mbox, retdata, lock, polling */

		mbox_tbl = < 4 >, /* end index of pin table: mbox 0 */
			< 11 >,  /* end index of pin table: mbox 1 */
			< 3 >,  /* end index of pin table: mbox 2 */
			< 0 >; /* end index of pin table: mbox 3 */

		pin_name_tbl = "PLATFORM",
			"CPU_DVFS",
			"QOS",
			"TST1",
			"FHCTL",
			"MCDI",
			"SPM_SUSPEND",
			"PMIC",
			"PPM",
			"Thermal",
			"UPower",
			"CM_MGR";
	};

	gic500@0c000000 {
		compatible = "mediatek,gic500";
		reg = <0 0x0c000000 0 0x400000>;
	};

	gic_cpu@0c400000 {
		compatible = "mediatek,gic_cpu";
		reg = <0 0x0c400000 0 0x40000>;
	};

	dfd@10200b00 {
		compatible = "mediatek,dfd";
		reg = <0 0x10200b00 0 0x10000>;

		mediatek,enabled = <1>;
		mediatek,chain_length = <0x61a8>;
		mediatek,rg_dfd_timeout = <0xa0>;
		mediatek,check_dfd_support = <1>;
		mediatek,dfd_infra_base = <0x390>;
		mediatek,dfd_ap_addr_offset = <24>;
		mediatek,dfd_latch_offset = <0x48>;
	};

	dfd_cache: dfd_cache {
		compatible = "mediatek,dfd_cache";
		mediatek,enabled = <0>; /*don't support cache*/
	};

	dbg_cti@0d020000 {
		compatible = "mediatek,dbg_cti";
		reg = <0 0x0d020000 0 0x10000>;
	};

	dbg_etr@0d030000 {
		compatible = "mediatek,dbg_etr";
		reg = <0 0x0d030000 0 0x10000>;
	};

	dbg_funnel@0d040000 {
		compatible = "mediatek,dbg_funnel";
		reg = <0 0x0d040000 0 0x10000>;
	};

	dbg_dem@0d0a0000 {
		compatible = "mediatek,dbg_dem";
		reg = <0 0x0d0a0000 0 0x10000>;
		interrupts = <GIC_SPI 84 IRQ_TYPE_LEVEL_HIGH 0>;
	};

	dbg_mdsys1@0d0c0000 {
		compatible = "mediatek,dbg_mdsys1";
		reg = <0 0x0d0c0000 0 0x40000>;
	};

	dbg_apmcu_mp0@0d400000 {
		compatible = "mediatek,dbg_apmcu_mp0";
		reg = <0 0x0d400000 0 0x1000>;
	};

	dbg_apmcu_mp0@0d410000 {
		compatible = "mediatek,dbg_apmcu_mp0";
		reg = <0 0x0d410000 0 0x1000>;
	};

	dbg_apmcu_mp0@0d420000 {
		compatible = "mediatek,dbg_apmcu_mp0";
		reg = <0 0x0d420000 0 0x1000>;
	};

	dbg_apmcu_mp0@0d430000 {
		compatible = "mediatek,dbg_apmcu_mp0";
		reg = <0 0x0d430000 0 0x1000>;
	};

	dbg_apmcu_mp0@0d440000 {
		compatible = "mediatek,dbg_apmcu_mp0";
		reg = <0 0x0d440000 0 0x1000>;
	};

	dbg_apmcu_mp0@0d510000 {
		compatible = "mediatek,dbg_apmcu_mp0";
		reg = <0 0x0d510000 0 0x1000>;
	};

	dbg_apmcu_mp0@0d520000 {
		compatible = "mediatek,dbg_apmcu_mp0";
		reg = <0 0x0d520000 0 0x1000>;
	};

	dbg_apmcu_mp0@0d530000 {
		compatible = "mediatek,dbg_apmcu_mp0";
		reg = <0 0x0d530000 0 0x1000>;
	};

	dbg_apmcu_mp0@0d540000 {
		compatible = "mediatek,dbg_apmcu_mp0";
		reg = <0 0x0d540000 0 0x1000>;
	};

	dbg_apmcu_mp0@0d610000 {
		compatible = "mediatek,dbg_apmcu_mp0";
		reg = <0 0x0d610000 0 0x1000>;
	};

	dbg_apmcu_mp0@0d620000 {
		compatible = "mediatek,dbg_apmcu_mp0";
		reg = <0 0x0d620000 0 0x1000>;
	};

	dbg_apmcu_mp0@0d630000 {
		compatible = "mediatek,dbg_apmcu_mp0";
		reg = <0 0x0d630000 0 0x1000>;
	};

	dbg_apmcu_mp0@0d640000 {
		compatible = "mediatek,dbg_apmcu_mp0";
		reg = <0 0x0d640000 0 0x1000>;
	};

	dbg_apmcu_mp0@0d710000 {
		compatible = "mediatek,dbg_apmcu_mp0";
		reg = <0 0x0d710000 0 0x1000>;
	};

	dbg_apmcu_mp0@0d720000 {
		compatible = "mediatek,dbg_apmcu_mp0";
		reg = <0 0x0d720000 0 0x1000>;
	};

	dbg_apmcu_mp0@0d730000 {
		compatible = "mediatek,dbg_apmcu_mp0";
		reg = <0 0x0d730000 0 0x1000>;
	};

	dbg_apmcu_mp0@0d740000 {
		compatible = "mediatek,dbg_apmcu_mp0";
		reg = <0 0x0d740000 0 0x1000>;
	};

	dbg_apmcu_mp1@0d800000 {
		compatible = "mediatek,dbg_apmcu_mp1";
		reg = <0 0x0d800000 0 0x1000>;
	};

	dbg_apmcu_mp1@0d810000 {
		compatible = "mediatek,dbg_apmcu_mp1";
		reg = <0 0x0d810000 0 0x1000>;
	};

	dbg_apmcu_mp1@0d820000 {
		compatible = "mediatek,dbg_apmcu_mp1";
		reg = <0 0x0d820000 0 0x1000>;
	};

	dbg_apmcu_mp1@0d830000 {
		compatible = "mediatek,dbg_apmcu_mp1";
		reg = <0 0x0d830000 0 0x1000>;
	};

	dbg_apmcu_mp1@0d840000 {
		compatible = "mediatek,dbg_apmcu_mp1";
		reg = <0 0x0d840000 0 0x1000>;
	};

	dbg_apmcu_mp1@0d910000 {
		compatible = "mediatek,dbg_apmcu_mp1";
		reg = <0 0x0d910000 0 0x1000>;
	};

	dbg_apmcu_mp1@0d920000 {
		compatible = "mediatek,dbg_apmcu_mp1";
		reg = <0 0x0d920000 0 0x1000>;
	};

	dbg_apmcu_mp1@0d930000 {
		compatible = "mediatek,dbg_apmcu_mp1";
		reg = <0 0x0d930000 0 0x1000>;
	};

	dbg_apmcu_mp1@0d940000 {
		compatible = "mediatek,dbg_apmcu_mp1";
		reg = <0 0x0d940000 0 0x1000>;
	};

	dbg_apmcu_mp1@0da10000 {
		compatible = "mediatek,dbg_apmcu_mp1";
		reg = <0 0x0da10000 0 0x1000>;
	};

	dbg_apmcu_mp1@0da20000 {
		compatible = "mediatek,dbg_apmcu_mp1";
		reg = <0 0x0da20000 0 0x1000>;
	};

	dbg_apmcu_mp1@0da30000 {
		compatible = "mediatek,dbg_apmcu_mp1";
		reg = <0 0x0da30000 0 0x1000>;
	};

	dbg_apmcu_mp1@0da40000 {
		compatible = "mediatek,dbg_apmcu_mp1";
		reg = <0 0x0da40000 0 0x1000>;
	};

	dbg_apmcu_mp1@0db10000 {
		compatible = "mediatek,dbg_apmcu_mp1";
		reg = <0 0x0db10000 0 0x1000>;
	};

	dbg_apmcu_mp1@0db20000 {
		compatible = "mediatek,dbg_apmcu_mp1";
		reg = <0 0x0db20000 0 0x1000>;
	};

	dbg_apmcu_mp1@0db30000 {
		compatible = "mediatek,dbg_apmcu_mp1";
		reg = <0 0x0db30000 0 0x1000>;
	};

	dbg_apmcu_mp1@0db40000 {
		compatible = "mediatek,dbg_apmcu_mp1";
		reg = <0 0x0db40000 0 0x1000>;
	};

	ap_dma@11000000 {
		compatible = "mediatek,ap_dma";
		reg = <0 0x11000000 0 0x1000>;
		interrupts = <GIC_SPI 41 IRQ_TYPE_LEVEL_HIGH 0>;
	};

	auxadc: auxadc@11001000 {
		compatible = "mediatek,mt6765-auxadc";
		reg = <0 0x11001000 0 0x1000>;
		interrupts = <GIC_SPI 20 IRQ_TYPE_EDGE_RISING 0>;
		clocks = <&infracfg_ao CLK_IFR_AUXADC>;
		clock-names = "main";
		#io-channel-cells = <1>;
		/* Auxadc efuse calibration */
		/* 1. Auxadc cali on/off bit shift */
		mediatek,cali-en-bit = <20>;
		/* 2. Auxadc cali ge bits shift */
		mediatek,cali-ge-bit = <10>;
		/* 3. Auxadc cali oe bits shift */
		mediatek,cali-oe-bit = <0>;
		/* 4. Auxadc cali efuse reg offset */
		mediatek,cali-efuse-reg-offset = <0x1A8>;
		nvmem = <&efuse>;
		nvmem-names = "mtk_efuse";
		#interconnect-cells = <1>;
	};

	apdma: dma-controller@11000580 {
		compatible = "mediatek,mt6779-uart-dma";
		reg = <0 0x11000680 0 0x80>,
		      <0 0x11000700 0 0x80>,
		      <0 0x11000780 0 0x80>,
		      <0 0x11000800 0 0x80>;
		interrupts = <GIC_SPI 53 IRQ_TYPE_LEVEL_HIGH 0>,
			     <GIC_SPI 54 IRQ_TYPE_LEVEL_HIGH 0>,
			     <GIC_SPI 55 IRQ_TYPE_LEVEL_HIGH 0>,
			     <GIC_SPI 60 IRQ_TYPE_LEVEL_HIGH 0>;
		clocks = <&infracfg_ao CLK_IFR_AP_DMA>;
		clock-names = "apdma";
		dma-requests = <4>;
		#dma-cells = <1>;
	};

	uart0: serial@11020000 {
		compatible = "mediatek,mt6761-uart",
			     "mediatek,mt6577-uart";
		reg = <0 0x11002000 0 0x1000>;
		interrupts = <GIC_SPI 35 IRQ_TYPE_LEVEL_HIGH 0>;
		clocks = <&clk26m>, <&infracfg_ao CLK_IFR_UART0>;
		clock-names = "baud", "bus";
		dmas = <&apdma 0 &apdma 1>;
		dma-names = "tx", "rx";
	};

	uart1: serial@11030000 {
		compatible = "mediatek,mt6761-uart",
			     "mediatek,mt6577-uart";
		reg = <0 0x11003000 0 0x1000>;
		interrupts = <GIC_SPI 36 IRQ_TYPE_LEVEL_HIGH 0>;
		clocks = <&clk26m>, <&infracfg_ao CLK_IFR_UART1>;
		clock-names = "baud", "bus";
		dmas = <&apdma 2 &apdma 3>;
		dma-names = "tx", "rx";
	};

	pwm: pwm@11006000 {
		compatible = "mediatek,pwm";
		reg = <0 0x11006000 0 0x1000>;
		interrupts = <GIC_SPI 21 IRQ_TYPE_LEVEL_HIGH 0>;
		clocks = <&infracfg_ao CLK_IFR_PWM1>,
				<&infracfg_ao CLK_IFR_PWM2>,
				<&infracfg_ao CLK_IFR_PWM3>,
				<&infracfg_ao CLK_IFR_PWM4>,
				<&infracfg_ao CLK_IFR_PWM5>,
				<&infracfg_ao CLK_IFR_RG_PWM_FBCLK6>,
				<&infracfg_ao CLK_IFR_PWM_HCLK>,
				<&infracfg_ao CLK_IFR_PWM>;
		clock-names = "PWM1-main", "PWM2-main",
				"PWM3-main", "PWM4-main",
				"PWM5-main", "PWM6-main",
				"PWM-HCLK-main", "PWM-main";

		/* 1. pwm infraclk control reg offset */
		mediatek,pwm-topclk-ctl-reg = <0x410>;
		/* 2. pwm bclk sw ctrl offset */
		mediatek,pwm-bclk-sw-ctrl-offset = <12>;
		/* 3. pwm_x bclk sw ctrl offset */
		mediatek,pwm1-bclk-sw-ctrl-offset = <0>;
		mediatek,pwm2-bclk-sw-ctrl-offset = <2>;
		mediatek,pwm3-bclk-sw-ctrl-offset = <4>;
		mediatek,pwm4-bclk-sw-ctrl-offset = <6>;
		mediatek,pwm5-bclk-sw-ctrl-offset = <8>;
		mediatek,pwm6-bclk-sw-ctrl-offset = <10>;
		/* 4. pwm version */
		mediatek,pwm-version = <0x1>;

		pwmsrcclk = <&infracfg_ao>;
	};

	i2c0: i2c0@11007000 {
		compatible = "mediatek,mt6761-i2c";
		reg = <0 0x11007000 0 0x1000>,
			<0 0x11000080 0 0x80>;
		interrupts = <GIC_SPI 28 IRQ_TYPE_LEVEL_HIGH 0>;
		clocks = <&infracfg_ao CLK_IFR_I2C_AP>,
			<&infracfg_ao CLK_IFR_AP_DMA>;
		clock-names = "main", "dma";
		clock-div = <1>;
	};

	i2c1: i2c1@11008000 {
		compatible = "mediatek,mt6761-i2c";
		reg = <0 0x11008000 0 0x1000>,
			<0 0x11000100 0 0x80>;
		interrupts = <GIC_SPI 29 IRQ_TYPE_LEVEL_HIGH 0>;
		clocks = <&infracfg_ao CLK_IFR_I2C_AP>,
			<&infracfg_ao CLK_IFR_AP_DMA>;
		clock-names = "main", "dma";
		clock-div = <1>;
	};

	i2c2: i2c2@11009000 {
		compatible = "mediatek,mt6761-i2c";
		reg = <0 0x11009000 0 0x1000>,
			<0 0x11000180 0 0x180>;
		interrupts = <GIC_SPI 30 IRQ_TYPE_LEVEL_HIGH 0>;
		clocks = <&infracfg_ao CLK_IFR_I2C_AP>,
			<&infracfg_ao CLK_IFR_AP_DMA>;
		clock-names = "main", "dma";
		clock-div = <1>;
	};

	i2c3: i2c3@1100f000 {
		compatible = "mediatek,mt6761-i2c";
		reg = <0 0x1100f000 0 0x1000>,
			<0 0x11000300 0 0x100>;
		interrupts = <GIC_SPI 31 IRQ_TYPE_LEVEL_HIGH 0>;
		clocks = <&infracfg_ao CLK_IFR_I2C_AP>,
			<&infracfg_ao CLK_IFR_AP_DMA>;
		clock-names = "main", "dma";
		clock-div = <1>;
	};

	i2c4: i2c4@11011000 {
		compatible = "mediatek,mt6761-i2c";
		reg = <0 0x11011000 0 0x1000>,
			<0 0x11000400 0 0x180>;
		interrupts = <GIC_SPI 32 IRQ_TYPE_LEVEL_HIGH 0>;
		clocks = <&infracfg_ao CLK_IFR_I2C_AP>,
			<&infracfg_ao CLK_IFR_AP_DMA>;
		clock-names = "main", "dma";
		clock-div = <1>;
	};

	i2c5: i2c5@11016000 {
		compatible = "mediatek,mt6761-i2c";
		reg = <0 0x11016000 0 0x1000>,
			<0 0x11000580 0 0x80>;
		interrupts = <GIC_SPI 74 IRQ_TYPE_LEVEL_HIGH 0>;
		clocks = <&infracfg_ao CLK_IFR_I2C_AP>,
			<&infracfg_ao CLK_IFR_AP_DMA>;
		clock-names = "main", "dma";
		clock-div = <1>;
	};

	i2c6: i2c6@1100d000 {
		compatible = "mediatek,mt6761-i2c";
		reg = <0 0x1100d000 0 0x1000>,
			<0 0x11000600 0 0x80>;
		interrupts = <GIC_SPI 75 IRQ_TYPE_LEVEL_HIGH 0>;
		clocks = <&infracfg_ao CLK_IFR_I2C_AP>,
			<&infracfg_ao CLK_IFR_AP_DMA>;
		clock-names = "main", "dma";
		clock-div = <1>;
	};
	i2c7: i2c7 {};
	i2c8: i2c8 {};
	i2c9: i2c9 {};

	spi0: spi0@1100a000 {
		compatible = "mediatek,mt6765-spi";
		mediatek,pad-select = <0>;
		reg = <0 0x1100a000 0 0x1000>;
		interrupts = <GIC_SPI 62 IRQ_TYPE_LEVEL_HIGH 0>;
		clocks = <&topckgen CLK_TOP_SYSPLL3_D2>,
				<&topckgen CLK_TOP_SPI_SEL>,
				<&infracfg_ao CLK_IFR_SPI0>;
		clock-names = "parent-clk", "sel-clk", "spi-clk";
	};

	therm_ctrl@1100b000 {
		compatible = "mediatek,therm_ctrl";
		reg = <0 0x1100b000 0 0x1000>;
		interrupts = <GIC_SPI 22 IRQ_TYPE_LEVEL_HIGH 0>;
		clocks = <&infracfg_ao CLK_IFR_THERM>, <&infracfg_ao CLK_IFR_AUXADC>;
		clock-names = "therm-main", "auxadc-main";
		nvmem = <&efuse>;
		nvmem-names = "mtk_efuse";
		nvmem-cells = <&cpu_freq_segment>,
					<&thermal_efuse>;
		nvmem-cell-names = "cpu_freq_segment_cell",
						"thermal_efuse_cell";
	};
	tboard_thermistor1: thermal-sensor1 {
		compatible = "mediatek,mtboard-thermistor1";
		io-channels = <&auxadc 0>;
		io-channel-names = "thermistor-ch0";
		interconnects = <&auxadc 0>;
	};

	tboard_thermistor2: thermal-sensor2 {
		compatible = "mediatek,mtboard-thermistor2";
		io-channels = <&auxadc 1>;
		io-channel-names = "thermistor-ch1";
		interconnects = <&auxadc 1>;
	};
	tboard_thermistor3: thermal-sensor3 {
		compatible = "mediatek,mtboard-thermistor3";
		io-channels = <&auxadc 2>;
		io-channel-names = "thermistor-ch2";
		interconnects = <&auxadc 2>;
	};
	eem_fsm@1100b000 {
		compatible = "mediatek,eem_fsm";
		reg = <0 0x1100b000 0 0x1000>;
		interrupts = <GIC_SPI 69 IRQ_TYPE_LEVEL_HIGH 0>;
		nvmem = <&efuse>;
		nvmem-names = "mtk_efuse";
		nvmem-cells = <&efuse_segment>;
		nvmem-cell-names = "efuse_segment_cell";
	};

	btif@1100c000 {
		compatible = "mediatek,btif";
			/*btif base*/
		reg = <0 0x1100c000 0 0x1000>,
			/*btif tx dma base*/
		    <0 0x11000880 0 0x80>,
			/*btif rx dma base*/
		    <0 0x11000900 0 0x80>;
			/*btif irq, IRQS_Sync ID, btif_irq_b*/
		interrupts = <GIC_SPI 56 IRQ_TYPE_LEVEL_HIGH 0>,
			/*btif tx dma irq*/
			   <GIC_SPI 76 IRQ_TYPE_LEVEL_HIGH 0>,
			/*btif rx dma irq*/
			   <GIC_SPI 77 IRQ_TYPE_LEVEL_HIGH 0>;
		clocks = <&infracfg_ao CLK_IFR_BTIF>,
			/*btif clock*/
		       <&infracfg_ao CLK_IFR_AP_DMA>;
			/*ap dma clock*/
		clock-names = "btifc","apdmac";
	};

	consys: consys@18002000 {
		compatible = "mediatek,mt6761-consys";
		#address-cells = <2>;
		#size-cells = <2>;
			/*CONN_MCU_CONFIG_BASE */
		reg = <0 0x18002000 0 0x1000>,
			/*TOP_RGU_BASE */
		    <0 0x10007000 0 0x0100>,
			/*INFRACFG_AO_BASE */
		    <0 0x10001000 0 0x1000>,
			/*SPM_BASE */
		    <0 0x10006000 0 0x1000>,
			/*CONN_HIF_ON_BASE */
		    <0 0x18007000 0 0x1000>,
			/*CONN_TOP_MISC_OFF_BASE */
		    <0 0x180b1000 0 0x1000>,
			/*CONN_MCU_CFG_ON_BASE */
		    <0 0x180a3000 0 0x1000>,
			/*CONN_MCU_CIRQ_BASE */
		    <0 0x180a5000 0 0x800>,
			/*CONN_TOP_MISC_ON_BASE */
		    <0 0x180c1000 0 0x1000>,
			/*CONN_HIF_PDMA_BASE */
		    <0 0x18004000 0 0x1000>;
			/*BGF_EINT conn2ap_btif_wakeup_out_b*/
		interrupts = <GIC_SPI 211 IRQ_TYPE_LEVEL_HIGH 0>,
			/*WDT_EINT conn_wdt_irq_b*/
			   <GIC_SPI 213 IRQ_TYPE_LEVEL_HIGH 0>,
			/*conn2ap_sw_irq*/
			   <GIC_SPI 214 IRQ_TYPE_EDGE_RISING>;
		power-domains = <&scpsys MT6761_POWER_DOMAIN_CONN>;
		pmic = <&main_pmic>;
		memory-region = <&consys_mem>;
	};

	wifi: wifi@18000000 {
		compatible = "mediatek,wifi";
		reg = <0 0x18000000 0 0x100000>;
		interrupts = <GIC_SPI 212 IRQ_TYPE_LEVEL_HIGH 0>;
		memory-region = <&wifi_mem>;
	};

	disp_pwm@1100e000 {
		compatible = "mediatek,disp_pwm";
		reg = <0 0x1100e000 0 0x1000>;
	};

	spi1: spi1@11010000 {
		compatible = "mediatek,mt6765-spi";
		mediatek,pad-select = <0>;
		reg = <0 0x11010000 0 0x1000>;
		interrupts = <GIC_SPI 66 IRQ_TYPE_LEVEL_HIGH 0>;
		clocks = <&topckgen CLK_TOP_SYSPLL3_D2>,
				<&topckgen CLK_TOP_SPI_SEL>,
				<&infracfg_ao CLK_IFR_SPI1>;
		clock-names = "parent-clk", "sel-clk", "spi-clk";
	};

	spi2: spi2@11012000 {
		compatible = "mediatek,mt6765-spi";
		mediatek,pad-select = <0>;
		reg = <0 0x11012000 0 0x1000>;
		interrupts = <GIC_SPI 72 IRQ_TYPE_LEVEL_HIGH 0>;
		clocks = <&topckgen CLK_TOP_SYSPLL3_D2>,
				<&topckgen CLK_TOP_SPI_SEL>,
				<&infracfg_ao CLK_IFR_SPI2>;
		clock-names = "parent-clk", "sel-clk", "spi-clk";
	};

	spi3: spi3@11013000 {
		compatible = "mediatek,mt6765-spi";
		mediatek,pad-select = <0>;
		reg = <0 0x11013000 0 0x1000>;
		interrupts = <GIC_SPI 73 IRQ_TYPE_LEVEL_HIGH 0>;
		clocks = <&topckgen CLK_TOP_SYSPLL3_D2>,
				<&topckgen CLK_TOP_SPI_SEL>,
				<&infracfg_ao CLK_IFR_SPI3>;
		clock-names = "parent-clk", "sel-clk", "spi-clk";
	};

	spi4: spi4@11014000 {
		compatible = "mediatek,mt6765-spi";
		mediatek,pad-select = <0>;
		reg = <0 0x11014000 0 0x1000>;
		interrupts = <GIC_SPI 39 IRQ_TYPE_LEVEL_HIGH 0>;
		clocks = <&topckgen CLK_TOP_SYSPLL3_D2>,
				<&topckgen CLK_TOP_SPI_SEL>,
				<&infracfg_ao CLK_IFR_SPI4>;
		clock-names = "parent-clk", "sel-clk", "spi-clk";
	};

	spi5: spi5@11015000 {
		compatible = "mediatek,mt6765-spi";
		mediatek,pad-select = <0>;
		reg = <0 0x11015000 0 0x1000>;
		interrupts = <GIC_SPI 40 IRQ_TYPE_LEVEL_HIGH 0>;
		clocks = <&topckgen CLK_TOP_SYSPLL3_D2>,
				<&topckgen CLK_TOP_SPI_SEL>,
				<&infracfg_ao CLK_IFR_SPI5>;
		clock-names = "parent-clk", "sel-clk", "spi-clk";
	};

	imp_iic@11017000 {
		compatible = "mediatek,imp_iic";
		reg = <0 0x11017000 0 0x1000>;
	};

	nfi@11018000 {
		compatible = "mediatek,nfi";
		reg = <0 0x11018000 0 0x1000>;
	};

	nfiecc@11019000 {
		compatible = "mediatek,nfiecc";
		reg = <0 0x11019000 0 0x1000>;
	};

	usb: usb0@11200000 {
		compatible = "mediatek,mt6761-usb20";
		reg = <0 0x11200000 0 0x10000>,
		      <0 0x11cc0000 0 0x10000>;
		interrupts = <GIC_SPI 17 IRQ_TYPE_LEVEL_HIGH 0>;
		mode = <2>;
		multipoint = <1>;
		num_eps = <16>;
		clocks =  <&infracfg_ao CLK_IFR_ICUSB>,
			<&topckgen CLK_TOP_USB_TOP_SEL>,
			<&topckgen CLK_TOP_UNIVPLL3_D4>;
		clock-names = "sys_clk",
			"ref_clk",
			"src_clk";
		pericfg= <&pericfg>;
		interrupt-names = "mc";
		phys = <&u2port0 PHY_TYPE_USB2>;
		dr_mode = "otg";
		usb-role-switch;
		usb_phy_offset = <0x800>;
		cdp-block;
		wakeup-source;
		infracg = <&infracfg_ao>;
		port {
			musb_drd_switch: endpoint@0 {
				remote-endpoint = <&usb_role>;
			};
		};
	};

	u2phy0: usb-phy@11cc0000 {
		compatible = "mediatek,generic-tphy-v1";
		reg = <0 0x11cc0000 0 0x0800>;
		#address-cells = <2>;
		#size-cells = <2>;
		ranges;
		status = "okay";
		u2port0: usb-phy@11cc0800 {
			reg = <0 0x11cc0800 0 0x100>;
			clocks = <&clk26m>;
			clock-names = "ref";
			mediatek,usb-special-phy-settings;
			#phy-cells = <1>;
			nvmem-cells = <&u2_phy_data>;
			nvmem-cell-names = "intr_cal";
			nvmem-cell-masks = <0x1f>;
			status = "okay";
		};
	};

	usb_meta: usb_meta {
		compatible = "mediatek,usb_meta";
		udc = <&usb>;
	};

	usb_boost: usb_boost_manager {
		compatible = "mediatek,usb_boost", "mediatek,mt6761-usb_boost";
		interconnects = <&dvfsrc MT6873_MASTER_USB &dvfsrc MT6873_SLAVE_DDR_EMI>;
		interconnect-names = "icc-bw";
		required-opps = <&dvfsrc_freq_opp0>;
		usb-audio;
		small-core = <1250000>;
	};

	mmc0: mmc@11230000 {
		compatible = "mediatek,mt6765-mmc";
		reg = <0 0x11230000 0 0x10000>,
		<0 0x11cd0000 0 0x1000>;
		interrupts = <GIC_SPI 23 IRQ_TYPE_LEVEL_HIGH 0>;
		clocks = <&infracfg_ao CLK_IFR_MSDC0_SRC>,
			<&infracfg_ao CLK_IFR_MSDC0>,
			<&infracfg_ao CLK_IFR_FAES_FDE>;
		clock-names = "source", "hclk", "crypto_clk";
		/*
		 * trust frameware version
		 * atf: atf v1.3, atf v1.4, atf v1.6
		 * tf-a: tf-a
		 */
		tf-ver = "atf";
		status = "disabled";
	};

	mmc1: mmc@11240000 {
		compatible = "mediatek,mt6765-mmc";
		reg = <0 0x11240000 0 0x10000>,
			<0 0x11c90000 0 0x1000>;
		interrupts = <GIC_SPI 24 IRQ_TYPE_LEVEL_HIGH 0>;
		clocks = <&infracfg_ao CLK_IFR_MSDC1_SRC>,
			<&infracfg_ao CLK_IFR_MSDC1>;
		clock-names = "source", "hclk";
		status = "disabled";
	};

	msdc1_ins:msdc1_ins@0 {
		compatible = "mediatek,mt6761-sdcard-ins";
	};

	msdc0_top@11cd0000 {
		compatible = "mediatek,msdc0_top";
		reg = <0 0x11cd0000 0 0x1000>;
	};

	msdc1_top@11c90000 {
		compatible = "mediatek,msdc1_top";
		reg = <0 0x11c90000 0 0x1000>;
	};

	usb1p_sif@11210000 {
		compatible = "mediatek,usb1p_sif";
		reg = <0 0x11210000 0 0x10000>;
	};

	audclk: audclk@11220000 {
		compatible = "mediatek,mt6761-audsys", "syscon";
		reg = <0 0x11220000 0 0x1000>;
		#clock-cells = <1>;
	};

	audio: audio@11220000 {
		compatible = "mediatek,audio", "syscon";
		reg = <0 0x11220000 0 0x1000>;
		/* interrupts = <GIC_SPI 97 IRQ_TYPE_LEVEL_HIGH 0>; */
		mediatek,btcvsd_snd = <&btcvsd_snd>;
		devlink-supply = <&pmic_accdet>;
	};

	audgpio: mt_soc_dl1_pcm@11220000 {
		compatible = "mediatek,mt_soc_pcm_dl1";
		reg = <0 0x11220000 0 0x1000>;
		interrupts = <GIC_SPI 97 IRQ_TYPE_LEVEL_HIGH 0>;
		clocks = <&audclk CLK_AUDIO_AFE>,
			<&audclk CLK_AUDIO_DAC>,
			<&audclk CLK_AUDIO_DAC_PREDIS>,
			<&audclk CLK_AUDIO_ADC>,
			<&audclk CLK_AUDIO_22M>,
			<&audclk CLK_AUDIO_APLL_TUNER>,
			<&audclk CLK_AUDIO_TML>,
			<&infracfg_ao CLK_IFR_AUDIO>,
			<&infracfg_ao CLK_IFR_AUDIO_26M_BCLK>,
			<&topckgen CLK_TOP_AUDIO_SEL>,
			<&topckgen CLK_TOP_AUD_INTBUS_SEL>,
			<&topckgen CLK_TOP_SYSPLL1_D4>,
			<&topckgen CLK_TOP_AUD_1_SEL>,
			<&topckgen CLK_TOP_APLL1>,
			<&topckgen CLK_TOP_AUD_ENGEN1_SEL>,
			<&topckgen CLK_TOP_APLL1_D8>,
			<&apmixed CLK_APMIXED_APLL1>,
			<&clk26m>;
		clock-names = "aud_afe_clk",
			"aud_dac_clk",
			"aud_dac_predis_clk",
			"aud_adc_clk",
			"aud_apll22m_clk",
			"aud_apll1_tuner_clk",
			"aud_tml_clk",
			"aud_infra_clk",
			"mtkaif_26m_clk",
			"top_mux_audio",
			"top_mux_audio_int",
			"top_sys_pll1_d4",
			"top_mux_aud_1",
			"top_apll1_ck",
			"top_mux_aud_eng1",
			"top_apll1_d8",
			"apmixed_apll1",
			"top_clk26m_clk";
	};
	audio_sram@11221000 {
		compatible = "mediatek,audio_sram";
		reg = <0 0x11221000 0 0x9000>;
	};

	btcvsd_snd: mtk-btcvsd-snd@18050000 {
		compatible = "mediatek,mtk-btcvsd-snd";
		reg=<0 0x18050000 0 0x1000>, /*PKV_PHYSICAL_BASE*/
		    <0 0x18080000 0 0x10000>; /*SRAM_BANK2*/
		interrupts = <GIC_SPI 210 IRQ_TYPE_LEVEL_HIGH 0>;
		mediatek,infracfg = <&infracfg_ao>;
		/*INFRA MISC, conn_bt_cvsd_mask*/
		/*cvsd_mcu_read, write, packet_indicator*/
		mediatek,offset =<0xf00 0x800 0x140 0x144 0x148>;
		disable_write_silence = <0>;
	};

	mipi_rx_ana_csi0a: mipi_rx_ana_csi0a@11c10000 {
		compatible = "mediatek,mt6761-mipi0a", "syscon";
		reg = <0 0x11c10000 0 0x1000>;
		#clock-cells = <1>;
	};

	mipi_rx_ana_csi1@11c20000 {
		compatible = "mediatek,mipi_rx_ana_csi1";
		reg = <0 0x11c20000 0 0x10000>;
	};

	mipi_rx_ana_csi0b: mipi_rx_ana_csi0b@11c11000 {
		compatible = "mediatek,mt6761-mipi0b", "syscon";
		reg = <0 0x11c11000 0 0x1000>;
		#clock-cells = <1>;
	};

	mipi_rx_ana_csi1a: mipi_rx_ana_csi1a@11c12000 {
		compatible = "mediatek,mt6761-mipi1a", "syscon";
		reg = <0 0x11c12000 0 0x1000>;
		#clock-cells = <1>;
	};

	mipi_rx_ana_csi1b: mipi_rx_ana_csi1b@11c13000 {
		compatible = "mediatek,mt6761-mipi1b", "syscon";
		reg = <0 0x11c13000 0 0x1000>;
		#clock-cells = <1>;
	};

	mipi_rx_ana_csi2a: mipi_rx_ana_csi2a@11c14000 {
		compatible = "mediatek,mt6761-mipi2a", "syscon";
		reg = <0 0x11c14000 0 0x1000>;
		#clock-cells = <1>;
	};

	mipi_rx_ana_csi2b: mipi_rx_ana_csi2b@11c15000 {
		compatible = "mediatek,mt6761-mipi2b", "syscon";
		reg = <0 0x11c15000 0 0x1000>;
		#clock-cells = <1>;
	};

	mipi_rx_ana_csi2@11c30000 {
		compatible = "mediatek,mipi_rx_ana_csi2";
		reg = <0 0x11c30000 0 0x10000>;
	};

	efuse: efuse@11c50000 {
		compatible = "mediatek,devinfo";
		reg = <0 0x11c50000 0 0x10000>;

		#address-cells = <1>;
		#size-cells = <1>;

		efuse_segment: segment@78 {
			reg = <0x78 0x4>;
		};
		cpu_freq_segment: segment@1c {
			reg = <0x1c 0x4>;
		};
		thermal_efuse: segment@190 {
			reg = <0x190 0xc>;
		};
		efuse_analog7: efuse_analog7@1ac {
			reg = <0x1ac 0x4>;
		};
		u2_phy_data: u2_phy_data@1ac {
			reg = <0x1ac 0x4>;
		};
	};

	msdc1_pad_macro@11c90000 {
		compatible = "mediatek,msdc1_pad_macro";
		reg = <0 0x11c90000 0 0x10000>;
	};

	msdc0_pad_macro@11cd0000 {
		compatible = "mediatek,msdc0_pad_macro";
		reg = <0 0x11cd0000 0 0x10000>;
	};

	mfg_clark: mfg_clark@13000000 {
		compatible = "mediatek,clark";
		reg = <0 0x13000000 0 0x80000>;
		interrupts = <GIC_SPI 203 IRQ_TYPE_LEVEL_HIGH 0>;
		interrupt-names = "RGX";
		clock-frequency = <570000000>;
		ged-supply = <&ged>;
	};

	mfg_cfg: mfg_cfg@13ffe000 {
		compatible = "mediatek,mfgcfg", "syscon";
		reg = <0 0x13ffe000 0 0x1000>;
		#clock-cells = <1>;
	};

	gpufreq: gpufreq {
		compatible = "mediatek,gpufreq";
		clocks =
			<&topckgen CLK_TOP_MFG_SEL>,
			<&topckgen CLK_TOP_MFGPLL>,
			<&clk26m>,
			<&scpsys_clk SCP_SYS_MFG_ASYNC>,
			<&scpsys_clk SCP_SYS_MFG>,
			<&scpsys_clk SCP_SYS_MFG_CORE0>;
		clock-names =
			"clk_mux",
			"clk_main_parent",
			"clk_sub_parent",
			"mtcmos_mfg_async",
			"mtcmos_mfg",
			"mtcmos_mfg_core0";
		nvmem-cells = <&efuse_segment>;
		nvmem-cell-names = "efuse_segment_cell";
		dvfsrc-vcore-supply = <&dvfsrc_vcore>;
		vcore-supply = <&mt_pmic_vcore_buck_reg>;
	};

	gpufreq_wrapper: gpufreq_wrapper {
		compatible = "mediatek,gpufreq_wrapper";
		gpufreq-version = <2>;
		dual-buck = <0>;
		gpueb-support = <0>;
	};

	ged: ged {
		compatible = "mediatek,ged";
		gpufreq-supply = <&gpufreq>;
	};

	mmsys_config: mmsys_config@14000000 {
		compatible = "mediatek,mt6761-mmsys_config", "syscon";
		reg = <0 0x14000000 0 0x1000>;
		interrupts = <GIC_SPI 171 IRQ_TYPE_LEVEL_HIGH 0>;
		#clock-cells = <1>;
	};

	nfc:nfc {
		compatible = "mediatek,nfc-gpio-v2";
		gpio-rst = <172>;
		gpio-rst-std = <&pio 172 0x0>;
		gpio-irq = <10>;
		gpio-irq-std = <&pio 10 0x0>;
	};

	irq_nfc: irq_nfc {
		compatible = "mediatek,irq_nfc-eint";
	};

	smi_bwc {
		compatible = "mediatek,smi-legacy-bwc",
					"mediatek,mt6761-smi-bwc";
	};

	smi_common: smi_common@14002000 {
		compatible = "mediatek,smi-common",
			     "mediatek,mt6761-smi-common", "syscon";
		reg = <0 0x14002000 0 0x1000>;
		mediatek,common-id = <0>;
		smi-common;
		operating-points-v2 = <&opp_table_mm>;
		power-domains = <&scpsys MT6761_POWER_DOMAIN_DIS>;
		clocks = <&mmsys_config CLK_MM_SMI_COMM0>,
			<&mmsys_config CLK_MM_SMI_COMM1>,
			<&mmsys_config CLK_MM_SMI_COMMON>,
			<&mmsys_config CLK_MM_SMI_COMMON>;
		clock-names = "apb", "smi", "gals0", "gals1";
	};

	opp_table_mm: opp-table-mm {
		compatible = "operating-points-v2";
		opp-0 {
			opp-hz = /bits/ 64 <227000000>;
			opp-microvolt = <650000>;
		};
		opp-1 {
			opp-hz = /bits/ 64 <312000000>;
			opp-microvolt = <700000>;
		};
		opp-2 {
			opp-hz = /bits/ 64 <436000000>;
			opp-microvolt = <800000>;
		};
	};

	mmdvfs-debug {
		compatible = "mediatek,mmdvfs-debug";
		dvfsrc-vcore-supply = <&dvfsrc_vcore>;
		force-step0 = <0>;
		release-step0 = <0>;
	};

	mmdvfs {
		compatible = "mediatek,mmdvfs";
		operating-points-v2 = <&opp_table_mm>;
		mediatek,support_mux = "mm";
		mediatek,mux_mm = "TOP_MMPLL_D2",
			"TOP_UNIVPLL1_D2", "TOP_MMPLL";

		dvfsrc-vcore-supply = <&dvfsrc_vcore>;
		_vcore-supply = <&mt_pmic_vcore_buck_reg>;

		mediatek,support_hopping = "clk_mmpll_ck";
		mediatek,hopping_clk_mmpll_ck = <454000000 436000000
			436000000>;
		mediatek,action = <1>;

		clocks = <&topckgen CLK_TOP_MM_SEL>,	/* 0 */
			<&topckgen CLK_TOP_MMPLL>,			/* 1 */
			<&topckgen CLK_TOP_UNIVPLL1_D2>,	/* 2 */
			<&topckgen CLK_TOP_MMPLL_D2>,		/* 3 */
			<&apmixed CLK_APMIXED_MMPLL>;

		clock-names = "mm",	/* 0 */
			"TOP_MMPLL",			/* 1 */
			"TOP_UNIVPLL1_D2",		/* 2 */
			"TOP_MMPLL_D2",			/* 3 */
			"clk_mmpll_ck";
	};

	mmqos_wrapper {
		compatible = "mediatek,mt6761-mmqos-wrapper";
	};

	mmqos: interconnect {
		compatible = "mediatek,mt6761-mmqos";
		#mtk-interconnect-cells = <1>;
		mediatek,larbs = <&smi_larb0 &smi_larb1 &smi_larb2>;
		mediatek,commons = <&smi_common>;
		disable-ostd;
		disable-bwl;
		clocks = <&topckgen CLK_TOP_MM_SEL>;
		clock-names = "mm";
		interconnects = <&dvfsrc MT6873_MASTER_MMSYS &dvfsrc MT6873_SLAVE_DDR_EMI>,
				<&dvfsrc MT6873_MASTER_HRT_MMSYS
				 &dvfsrc MT6873_SLAVE_HRT_DDR_EMI>;
		interconnect-names = "icc-bw", "icc-hrt-bw";
	};

	smi_larb0: smi_larb0@14003000 {
		compatible = "mediatek,smi_larb0", "mediatek,smi-larb",
			     "mediatek,mt6761-smi-larb";
		reg = <0 0x14003000 0 0x1000>;
		mediatek,smi = <&smi_common>;
		mediatek,larb-id = <0>;
		init-power-on;
		power-domains = <&scpsys MT6761_POWER_DOMAIN_DIS>;
		clocks = <&mmsys_config CLK_MM_SMI_LARB0>,
				<&mmsys_config CLK_MM_SMI_LARB0>;
		clock-names = "apb", "smi";
	};

	mdp_rdma0: mdp_rdma0@14004000 {
		compatible = "mediatek,mdp_rdma0";
		reg = <0 0x14004000 0 0x1000>;
		interrupts = <GIC_SPI 155 IRQ_TYPE_LEVEL_HIGH 0>;
		clocks = <&mmsys_config CLK_MM_MDP_RDMA0>;
		clock-names = "MDP_RDMA0";
	};

	mdp_ccorr: mdp_ccorr0@14005000 {
		compatible = "mediatek,mdp_ccorr0";
		reg = <0 0x14005000 0 0x1000>;
		interrupts = <GIC_SPI 170 IRQ_TYPE_LEVEL_HIGH 0>;
		clocks = <&mmsys_config CLK_MM_MDP_CCORR0>;
		clock-names = "MDP_CCORR";
	};

	mdp_rsz0: mdp_rsz0@14006000 {
		compatible = "mediatek,mdp_rsz0";
		reg = <0 0x14006000 0 0x1000>;
		interrupts = <GIC_SPI 156 IRQ_TYPE_LEVEL_HIGH 0>;
		clocks = <&mmsys_config CLK_MM_MDP_RSZ0>;
		clock-names = "MDP_RSZ0";
	};

	mdp_rsz1: mdp_rsz1@14007000 {
		compatible = "mediatek,mdp_rsz1";
		reg = <0 0x14007000 0 0x1000>;
		interrupts = <GIC_SPI 157 IRQ_TYPE_LEVEL_HIGH 0>;
		clocks = <&mmsys_config CLK_MM_MDP_RSZ1>;
		clock-names = "MDP_RSZ1";
	};

	mdp_wdma0: mdp_wdma0@14008000 {
		compatible = "mediatek,mdp_wdma0";
		reg = <0 0x14008000 0 0x1000>;
		interrupts = <GIC_SPI 160 IRQ_TYPE_LEVEL_HIGH 0>;
		clocks = <&mmsys_config CLK_MM_MDP_WDMA0>;
		clock-names = "MDP_WDMA";
	};

	mdp_wrot0: mdp_wrot0@14009000 {
		compatible = "mediatek,mdp_wrot0";
		reg = <0 0x14009000 0 0x1000>;
		interrupts = <GIC_SPI 159 IRQ_TYPE_LEVEL_HIGH 0>;
		clocks = <&mmsys_config CLK_MM_MDP_WROT0>;
		clock-names = "MDP_WROT0";
	};

	mdp_tdshp0: mdp_tdshp0@1400a000 {
		compatible = "mediatek,mdp_tdshp0";
		reg = <0 0x1400a000 0 0x1000>;
		clocks = <&mmsys_config CLK_MM_MDP_TDSHP0>;
		clock-names = "MDP_TDSHP";
	};

	mtkfb: mtkfb@0 {
		compatible = "mediatek,mtkfb";
	};

	dispsys {
		compatible = "mediatek,dispsys";
		mediatek,larb = <&smi_larb0>;
		power-domains = <&scpsys MT6761_POWER_DOMAIN_DIS>;
		clocks = <&mmsys_config CLK_MM_SMI_COMMON>,
			<&mmsys_config CLK_MM_SMI_LARB0>,
			<&mmsys_config CLK_MM_SMI_COMM0>,
			<&mmsys_config CLK_MM_SMI_COMM1>,
			<&mmsys_config CLK_MM_DISP_OVL0>,
			<&mmsys_config CLK_MM_DISP_OVL0_2L>,
			<&mmsys_config CLK_MM_DISP_RDMA0>,
			<&mmsys_config CLK_MM_DISP_WDMA0>,
			<&mmsys_config CLK_MM_DISP_COLOR0>,
			<&mmsys_config CLK_MM_DISP_CCORR0>,
			<&mmsys_config CLK_MM_DISP_AAL0>,
			<&mmsys_config CLK_MM_DISP_GAMMA0>,
			<&mmsys_config CLK_MM_DISP_DITHER0>,
			<&mmsys_config CLK_MM_DSI0>,
			<&mmsys_config CLK_MM_DIG_DSI>,
			<&mmsys_config CLK_MM_F26M_HRTWT>,
			<&mmsys_config CLK_MM_DISP_RSZ0>,
			<&apmixed CLK_APMIXED_MIPID0_26M>,
			<&topckgen CLK_TOP_DISP_PWM_SEL>,
			<&infracfg_ao CLK_IFR_DISP_PWM>,
			<&clk26m>,
			<&topckgen CLK_TOP_UNIVPLL2_D4>,
			<&topckgen CLK_TOP_ULPOSC1_D2>,
			<&topckgen CLK_TOP_ULPOSC1_D8>;

		clock-names = "MMSYS_SMI_COMMON",
			"MMSYS_SMI_LARB0",
			"MMSYS_GALS_COMM0",
			"MMSYS_GALS_COMM1",
			"MMSYS_DISP_OVL0",
			"MMSYS_DISP_OVL0_2L",
			"MMSYS_DISP_RDMA0",
			"MMSYS_DISP_WDMA0",
			"MMSYS_DISP_COLOR0",
			"MMSYS_DISP_CCORR0",
			"MMSYS_DISP_AAL0",
			"MMSYS_DISP_GAMMA0",
			"MMSYS_DISP_DITHER0",
			"MMSYS_DSI0_MM_CK",
			"MMSYS_DSI0_IF_CK",
			"MMSYS_26M",
			"MMSYS_DISP_RSZ0",
			"APMIXED_MIPI_26M",
			"TOP_MUX_DISP_PWM",
			"DISP_PWM",
			"TOP_26M",
			"TOP_UNIVPLL2_D4",
			"TOP_ULPOSC1_D2",
			"TOP_ULPOSC1_D8";
	};

	mm_mutex: mm_mutex@14016000 {
		compatible = "mediatek,mm_mutex";
		reg = <0 0x14016000 0 0x1000>;
	};

	camsys: camsys@15000000  {
		compatible = "mediatek,mt6761-camsys", "syscon";
		reg = <0 0x15000000  0 0x1000>;
		#clock-cells = <1>;
	};

	cam_mem {
		compatible = "mediatek,cam_mem";
		mediatek,platform = "mt6761";
		dma-ranges = <0x0 0x0 0x0 0x0 0x0 0x80000000>;

		iommus = /* LARB2 */
			<&iommu M4U_PORT_CAM_IMGO>,
			<&iommu M4U_PORT_CAM_RRZO>,
			<&iommu M4U_PORT_CAM_AAO>,
			<&iommu M4U_PORT_CAM_LCSO>,
			<&iommu M4U_PORT_CAM_ESFKO>,
			<&iommu M4U_PORT_CAM_IMGO_S>,
			<&iommu M4U_PORT_CAM_LSCI>,
			<&iommu M4U_PORT_CAM_LSCI_D>,
			<&iommu M4U_PORT_CAM_AFO>,
			<&iommu M4U_PORT_CAM_AFO_D>,
			<&iommu M4U_PORT_CAM_BPCI>,
			<&iommu M4U_PORT_CAM_BPCI_D>,
			<&iommu M4U_PORT_CAM_UFDI>,
			<&iommu M4U_PORT_CAM_IMGI>,
			<&iommu M4U_PORT_CAM_IMG2O>,
			<&iommu M4U_PORT_CAM_IMG3O>,
			<&iommu M4U_PORT_CAM_VIPI>,
			<&iommu M4U_PORT_CAM_VIP2I>,
			<&iommu M4U_PORT_CAM_VIP3I>,
			<&iommu M4U_PORT_CAM_FD_RP>,
			<&iommu M4U_PORT_CAM_FD_WR>,
			<&iommu M4U_PORT_CAM_FD_RB>,
			<&iommu M4U_PORT_CAM_ICEI>;
	};

	cam_qos_legacy {
		/* non-v4l2 legacy camera */
		compatible = "mediatek,cam_qos_legacy";
		operating-points-v2 = <&opp_table_mm>;
		dvfsrc-vcore-supply = <&dvfsrc_vcore>;
		mediatek,platform = "mt6761";

		l2_cam_imgo = <M4U_PORT_CAM_IMGO>;
		l2_cam_rrzo = <M4U_PORT_CAM_RRZO>;
		l2_cam_aao = <M4U_PORT_CAM_AAO>;
		l2_cam_lcso = <M4U_PORT_CAM_LCSO>;
		l2_cam_esfko = <M4U_PORT_CAM_ESFKO>;
		l2_cam_imgo_s = <M4U_PORT_CAM_IMGO_S>;
		l2_cam_imgo_s2 = <M4U_PORT_CAM_IMGO_S2>;
		l2_cam_lsci = <M4U_PORT_CAM_LSCI>;
		l2_cam_lsci_d = <M4U_PORT_CAM_LSCI_D>;
		l2_cam_afo = <M4U_PORT_CAM_AFO>;
		l2_cam_afo_d = <M4U_PORT_CAM_AFO_D>;
		l2_cam_bpci = <M4U_PORT_CAM_BPCI>;
		l2_cam_bpci_d = <M4U_PORT_CAM_BPCI_D>;
		l2_cam_ufdi = <M4U_PORT_CAM_UFDI>;
		l2_cam_imgi = <M4U_PORT_CAM_IMGI>;
		l2_cam_img2o = <M4U_PORT_CAM_IMG2O>;
		l2_cam_img3o = <M4U_PORT_CAM_IMG3O>;
		l2_cam_vipi = <M4U_PORT_CAM_VIPI>;
		l2_cam_vip2i = <M4U_PORT_CAM_VIP2I>;
		l2_cam_vip3i = <M4U_PORT_CAM_VIP3I>;
		l2_cam_icei = <M4U_PORT_CAM_ICEI>;
	};

	ispsys: ispsys@15000000 {
		compatible = "mediatek,mt6761-ispsys";
		reg = <0x0 0x15004000 0x0 0x9000
			0x0 0x1500d000 0x0 0x1000
			0x0 0x15000000 0x0 0x52000
			0x0 0x15040000 0x0 0x8000
			0x0 0x10215000 0x0 0x3000
			0x0 0x10211000 0x0 0x1000>;
		mediatek,larb = <&smi_larb2>;

		power-domains =
			<&scpsys MT6761_POWER_DOMAIN_DIS>,
			<&scpsys MT6761_POWER_DOMAIN_CAM>;

		interrupts = <GIC_SPI 179 IRQ_TYPE_LEVEL_HIGH 0>, /* CAM0 */
		<GIC_SPI 180 IRQ_TYPE_LEVEL_HIGH 0>, /* CAM1 */
		<GIC_SPI 181 IRQ_TYPE_LEVEL_HIGH 0>, /* CAM2 */
		<GIC_SPI 184 IRQ_TYPE_LEVEL_HIGH 0>, /* CAMSV1 */
		<GIC_SPI 185 IRQ_TYPE_LEVEL_HIGH 0>, /* CAMSV1 */
		<GIC_SPI 186 IRQ_TYPE_LEVEL_HIGH 0>, /* CAMSV0 */
		<GIC_SPI 187 IRQ_TYPE_LEVEL_HIGH 0>; /* CAMSV0 */
		clocks = <&camsys CLK_CAM_LARB2>,
				<&camsys CLK_CAM>,
				<&camsys CLK_CAMTG>,
				<&camsys CLK_CAM_SENINF>,
				<&camsys CLK_CAMSV0>,
				<&camsys CLK_CAMSV1>,
				<&mmsys_config CLK_MM_SMI_COMM0>,
				<&mmsys_config CLK_MM_SMI_COMM1>,
				<&mmsys_config CLK_MM_SMI_COMMON>;


		clock-names = "CG_CAM_LARB2",
				"CG_CAM",
				"CG_CAMTG",
				"CG_CAM_SENINF",
				"CG_CAMSV0",
				"CG_CAMSV1",
				"CG_MM_SMI_COMM0",
				"CG_MM_SMI_COMM1",
				"CG_MM_SMI_COMMON";
	};

	smi_larb2: smi_larb2@15001000 {
		compatible = "mediatek,smi_larb2", "mediatek,smi-larb",
			     "mediatek,mt6761-smi-larb";
		reg = <0 0x15001000 0 0x1000>;
		mediatek,smi = <&smi_common>;
		mediatek,larb-id = <2>;
		power-domains = <&scpsys MT6761_POWER_DOMAIN_CAM>;
		clocks = <&mmsys_config CLK_MM_SMI_IMG>,
				<&camsys CLK_CAM_LARB2>;
		clock-names = "apb", "smi";
	};

	cam@15004000 {
		compatible = "mediatek,cam";
		reg = <0 0x15004000 0 0x1000>;
	};

	cam_lut@15005000 {
		compatible = "mediatek,cam_lut";
		reg = <0 0x15005000 0 0x1000>;
	};

	camd@15006000 {
		compatible = "mediatek,camd";
		reg = <0 0x15006000 0 0x1000>;
	};

	cam_dma@15007000 {
		compatible = "mediatek,cam_dma";
		reg = <0 0x15007000 0 0x1000>;
	};

	fdvt@1500b000 {
		compatible = "mediatek,fdvt";
		reg = <0 0x1500b000 0 0x1000>;
		dma-ranges = <0x0 0x0 0x0 0x0 0x4 0x0>;
		interrupts = <GIC_SPI 182 IRQ_TYPE_LEVEL_HIGH 0>;
		power-domains = <&scpsys MT6761_POWER_DOMAIN_DIS>,
			<&scpsys MT6761_POWER_DOMAIN_CAM>;
		clocks = <&camsys CLK_CAM_FDVT>;
		clock-names = "FD_CLK_CAM_FDVT";
		iommus = <&iommu M4U_PORT_CAM_FD_RP>,
			 <&iommu M4U_PORT_CAM_FD_WR>,
			 <&iommu M4U_PORT_CAM_FD_RB>;
		mediatek,larb = <&smi_larb2>;
	};

	cam_inner@1500d000 {
		compatible = "mediatek,cam_inner";
		reg = <0 0x1500d000 0 0x1000>;
	};

	camd_inner@1500e000 {
		compatible = "mediatek,camd_inner";
		reg = <0 0x1500e000 0 0x1000>;
	};

	cam_inner_dma@1500f000 {
		compatible = "mediatek,cam_inner_dma";
		reg = <0 0x1500f000 0 0x1000>;
	};


	camsv0@15050000 {
		compatible = "mediatek,camsv0";
		reg = <0 0x15050000 0 0x1000>;
	};

	camsv1@15051000 {
		compatible = "mediatek,camsv1";
		reg = <0 0x15051000 0 0x1000>;
	};


	kd_camera_hw1: kd_camera_hw1@15040000 {
		compatible = "mediatek,camera_hw";
		reg = <0 0x15040000 0 0x1000>;
		/* SENINF_ADDR */
		/* Camera Common Clock Framework (CCF) */
		power-domains = <&scpsys MT6761_POWER_DOMAIN_CAM>;
		clocks = <&topckgen CLK_TOP_CAMTG_SEL>,
		<&topckgen CLK_TOP_CAMTG1_SEL>,
		<&topckgen CLK_TOP_CAMTG2_SEL>,
		<&topckgen CLK_TOP_CAMTG3_SEL>,
		<&topckgen CLK_TOP_USB20_192M_D32>,
		<&topckgen CLK_TOP_USB20_192M_D16>,
		<&topckgen CLK_TOP_UNIVPLL2_D32>,
		<&topckgen CLK_TOP_USB20_192M_D4>,
		<&topckgen CLK_TOP_UNIVPLL2_D8>,
		<&topckgen CLK_TOP_USB20_192M_D8>,
		<&clk26m>,
		<&camsys CLK_CAM_SENINF>,
		<&apmixed CLK_APMIXED_MIPIC0_26M>,
		<&apmixed CLK_APMIXED_MIPIC1_26M>,
		<&mipi_rx_ana_csi0a CLK_MIPI0A_CSR_CSI_EN_0A>,
		<&topckgen CLK_TOP_CAMTM_SEL>,
		<&topckgen CLK_TOP_UNIVPLL2_D2>;


		clock-names = "CLK_TOP_CAMTG_SEL",
			"CLK_TOP_CAMTG1_SEL",
			"CLK_TOP_CAMTG2_SEL",
			"CLK_TOP_CAMTG3_SEL",
			"CLK_MCLK_6M",
			"CLK_MCLK_12M",
			"CLK_MCLK_13M",
			"CLK_MCLK_48M",
			"CLK_MCLK_52M",
			"CLK_MCLK_24M",
			"CLK_MCLK_26M",
			"CLK_CAM_SENINF_CG",
			"CLK_MIPI_C0_26M_CG",
			"CLK_MIPI_C1_26M_CG",
			"CLK_MIPI_ANA_0A_CG",
			"CLK_TOP_CAMTM_SEL_CG",
			"CLK_TOP_CAMTM_208_CG";
		operating-points-v2 = <&opp_table_mm>;
		dvfsrc-vcore-supply = <&dvfsrc_vcore>;
	};

	camera_af_hw_node: camera_af_hw_node {
		compatible = "mediatek,camera_af_lens";
		camaf_m1_pmic-supply = <&mt_pmic_vldo28_ldo_reg>;
	};

	mtk_composite_v4l2_1: mtk_composite_v4l2_1 {
		compatible = "mediatek,mtk_composite_v4l2_1";
	};

	flashlight_core: flashlight_core {
		compatible = "mediatek,flashlight_core";
	};

	flashlights_mt6370: flashlights_mt6370 {
		compatible = "mediatek,flashlights_mt6370";
		decouple = <0>;
		channel@1 {
			type = <0>;
			ct = <0>;
			part = <0>;
		};
		channel@2 {
			type = <0>;
			ct = <1>;
			part = <0>;
		};
	};

	vcodecsys: vcodecsys@17000000 {
		compatible =  "mediatek,mt6761-vcodecsys", "syscon";
		reg = <0 0x17000000 0 0x10000>;
		#clock-cells = <1>;
	};

	venc_gcon: venc_gcon@17000000 {
		compatible = "mediatek,venc_gcon", "syscon";
		mediatek,platform = "platform:mt6761";
		reg = <0 0x17000000 0 0x10000>;
		power-domains = <&scpsys MT6761_POWER_DOMAIN_DIS>,
			<&scpsys MT6761_POWER_DOMAIN_VCODEC>;
		power-domain-names = "pd_disp",
			"pd_vcodec";
		clocks =
			<&vcodecsys CLK_VENC_SET3_VDEC>,
			<&vcodecsys CLK_VENC_SET1_VENC>;
		clock-names =
			"MT_CG_VDEC",
			"MT_CG_VENC";
		mediatek,larbs = <&smi_larb1>;
		iommus = <&iommu M4U_PORT_VENC_RCPU>,
			<&iommu M4U_PORT_VENC_REC>,
			<&iommu M4U_PORT_VENC_BSDMA>,
			<&iommu M4U_PORT_VENC_SV_COMV>,
			<&iommu M4U_PORT_VENC_RD_COMV>,
			<&iommu M4U_PORT_JPGENC_RDMA>,
			<&iommu M4U_PORT_JPGENC_BSDMA>,
			<&iommu M4U_PORT_VENC_CUR_CHROMA>,
			<&iommu M4U_PORT_VENC_REF_LUMA>,
			<&iommu M4U_PORT_VENC_REF_CHROMA>;
		operating-points-v2 = <&opp_table_mm>;
		_vcore-supply = <&mt_pmic_vcore_buck_reg>;
		interconnects = <&mmqos SLAVE_LARB(1) &mmqos SLAVE_COMMON(0)>;
		interconnect-names = "path_larb1";
		interconnect-num = <1>;
	};

	smi_larb1: smi_larb1@17010000 {
		compatible = "mediatek,smi_larb1", "mediatek,smi-larb",
			     "mediatek,mt6761-smi-larb";
		reg = <0 0x17010000 0 0x1000>;
		mediatek,smi = <&smi_common>;
		mediatek,larb-id = <1>;
		power-domains = <&scpsys MT6761_POWER_DOMAIN_VCODEC>;
		clocks = <&vcodecsys CLK_VENC_SET1_VENC>,
				<&vcodecsys CLK_VENC_SET1_VENC>;
		clock-names = "apb", "smi";
	};

	venc@17020000 {
		compatible = "mediatek,venc";
		mediatek,platform = "platform:mt6761";
		reg = <0 0x17020000 0 0x10000>;
		interrupts = <GIC_SPI 174 IRQ_TYPE_LEVEL_HIGH 0>;
	};

	venc_jpg@17030000 {
		compatible = "mediatek,mtk-jpgenc-32bit";
		reg = <0 0x17030000 0 0x10000>;
		interrupts = <GIC_SPI 176 IRQ_TYPE_LEVEL_HIGH 0>;
		clocks =
			<&vcodecsys CLK_VENC_SET2_JPGENC>;
		clock-names = "jpgenc";
		mediatek,larb = <&smi_larb1>;
		dma-ranges = <0x0 0x0 0x0 0x0 0x4 0x0>;
		iommus = <&iommu M4U_PORT_JPGENC_BSDMA>;
		operating-points-v2 = <&opp_table_mm>;
		dvfsrc-vcore-supply = <&dvfsrc_vcore>;
		interconnects = <&mmqos MASTER_LARB_PORT(M4U_PORT_JPGENC_BSDMA)
					&mmqos SLAVE_COMMON(0)>;
		interconnect-names = "path_jpegenc_bsdma";
		interconnect-num = <1>;
		cshot-spec = <26>;
	};

	vdec@17040000 {
		compatible = "mediatek,vdec";
		mediatek,platform = "platform:mt6761";
		reg = <0 0x17040000 0 0x10000>;
		interrupts = <GIC_SPI 177 IRQ_TYPE_LEVEL_HIGH 0>;
	};

	mbist@17050000 {
		compatible = "mediatek,mbist";
		reg = <0 0x17050000 0 0x10000>;
	};

	otg_iddig: otg_iddig{
		compatible = "mediatek,usb_iddig_bi_eint";
	};

	odm: odm{
		compatible = "simple-bus";
		/* reserved for overlay by odm */
	};

	audio_snd_card {
		compatible = "mediatek,audio_snd_card";
	};

	mt_soc_deep_buffer_dl_pcm {
		compatible = "mediatek,mt_soc_pcm_deep_buffer_dl";
	};

	mt_soc_ul1_pcm {
		compatible = "mediatek,mt_soc_pcm_capture";
	};

	mt_soc_voice_md1 {
		compatible = "mediatek,mt_soc_pcm_voice_md1";
	};

	mt_soc_uldlloopback_pcm {
		compatible = "mediatek,mt_soc_pcm_uldlloopback";
	};

	mt_soc_i2s0_pcm {
		compatible = "mediatek,mt_soc_pcm_dl1_i2s0";
	};

	mt_soc_mrgrx_pcm {
		compatible = "mediatek,mt_soc_pcm_mrgrx";
	};

	mt_soc_mrgrx_awb_pcm {
		compatible = "mediatek,mt_soc_pcm_mrgrx_awb";
	};

	mt_soc_fm_i2s_pcm {
		compatible = "mediatek,mt_soc_pcm_fm_i2s";
	};

	mt_soc_fm_i2s_awb_pcm {
		compatible = "mediatek,mt_soc_pcm_fm_i2s_awb";
	};

	mt_soc_i2s0dl1_pcm {
		compatible = "mediatek,mt_soc_pcm_dl1_i2s0dl1";
	};

	mt_soc_dl1_awb_pcm {
		compatible = "mediatek,mt_soc_pcm_dl1_awb";
	};

	mt_soc_voice_md1_bt {
		compatible = "mediatek,mt_soc_pcm_voice_md1_bt";
	};

	mt_soc_voip_bt_out {
		compatible = "mediatek,mt_soc_pcm_dl1_bt";
	};

	mt_soc_voip_bt_in {
		compatible = "mediatek,mt_soc_pcm_bt_dai";
	};

	mt_soc_tdmrx_pcm {
		compatible = "mediatek,mt_soc_tdm_capture";
	};

	mt_soc_fm_mrgtx_pcm {
		compatible = "mediatek,mt_soc_pcm_fmtx";
	};

	mt_soc_ul2_pcm {
		compatible = "mediatek,mt_soc_pcm_capture2";
	};

	mt_soc_i2s0_awb_pcm {
		compatible = "mediatek,mt_soc_pcm_i2s0_awb";
	};

	mt_soc_voice_md2 {
		compatible = "mediatek,mt_soc_pcm_voice_md2";
	};

	mt_soc_pcm_dl1_scp_spk {
		compatible = "mediatek,mt_soc_pcm_dl1_scp_spk";
	};
	mt_soc_pcm_voice_scp {
		compatible = "mediatek,mt_soc_pcm_voice_scp";
	};

	mt_soc_routing_pcm {
		compatible = "mediatek,mt_soc_pcm_routing";
		/*i2s1clk-gpio = <7 6>;*/
		/*i2s1dat-gpio = <5 6>;*/
		/*i2s1mclk-gpio = <9 6>;*/
		/*i2s1ws-gpio = <6 6>;*/
	};

	mt_soc_voice_md2_bt {
		compatible = "mediatek,mt_soc_pcm_voice_md2_bt";
	};

	mt_soc_hp_impedance_pcm {
		compatible = "mediatek,mt_soc_pcm_hp_impedance";
	};

	mt_soc_dummy_pcm {
		compatible = "mediatek,mt_soc_pcm_dummy";
	};

	mt_soc_codec_dummy_name {
		compatible = "mediatek,mt_soc_codec_dummy";
	};

	mt_soc_routing_dai_name {
		compatible = "mediatek,mt_soc_dai_routing";
	};

	mt_soc_dai_name {
		compatible = "mediatek,mt_soc_dai_stub";
	};

	mt_soc_dl2_pcm {
		compatible = "mediatek,mt_soc_pcm_dl2";
	};

	mt_soc_anc_pcm {
		compatible = "mediatek,mt_soc_pcm_anc";
	};

	mt_soc_pcm_voice_ultra {
		compatible = "mediatek,mt_soc_pcm_voice_ultra";
	};

	mt_soc_pcm_voice_usb {
		compatible = "mediatek,mt_soc_pcm_voice_usb";
	};

	mt_soc_pcm_voice_usb_echoref {
		compatible = "mediatek,mt_soc_pcm_voice_usb_echoref";
	};

	lk_charger: lk_charger {
		compatible = "mediatek,lk_charger";
		enable_anime;
		enable_pe_plus;
		enable_pd20_reset;
		power_path_support;
		max_charger_voltage = <6500000>;
		fast_charge_voltage = <3000000>;

		/* charging current */
		usb_charger_current = <500000>;
		ac_charger_current = <2050000>;
		ac_charger_input_current = <3200000>;
		non_std_ac_charger_current = <500000>;
		charging_host_charger_current = <1500000>;
		ta_ac_charger_current = <3000000>;
		pd_charger_current = <500000>;

		/* battery temperature protection */
		temp_t4_threshold = <50>;
		temp_t3_threshold = <45>;
		temp_t1_threshold = <0>;
	};

	pe: pe {
		compatible = "mediatek,charger,pe";
		gauge = <&mtk_gauge>;

		ta_12v_support;
		ta_9v_support;

		pe_ichg_level_threshold = <1000000>; /* uA */
		ta_start_battery_soc = <0>;
		ta_stop_battery_soc = <85>;
		min_charger_voltage = <4600000>;

		ta_ac_12v_input_current = <3200000>;
		ta_ac_9v_input_current = <3200000>;
		ta_ac_7v_input_current = <3200000>;
		pe_charger_current = <3000000>;
	};

	pe2: pe2 {
		compatible = "mediatek,charger,pe2";
		gauge = <&mtk_gauge>;

		/* PE 2.0 */
		pe20_ichg_level_threshold = <1000000>; /* uA */
		ta_start_battery_soc = <0>;
		ta_stop_battery_soc = <85>;
		min_charger_voltage = <4600000>;

		/* cable measurement impedance */
		cable_imp_threshold = <699>;
		vbat_cable_imp_threshold = <3900000>; /* uV */

		/* single charger */
		sc_input_current = <3200000>;
		sc_charger_current = <3000000>;

		/* dual charger in series */
		dcs_input_current = <3200000>;
		dcs_chg1_charger_current = <1500000>;
		dcs_chg2_charger_current = <1500000>;

		dual_polling_ieoc = <450000>;
		slave_mivr_diff = <100000>;
	};

	pdc: pdc {
		compatible = "mediatek,charger,pd";
		gauge = <&mtk_gauge>;

		min_charger_voltage = <4600000>;
		pd_vbus_low_bound = <5000000>;
		pd_vbus_upper_bound = <5000000>;
		vsys_watt = <5000000>;
		ibus_err = <14>;

		pd_stop_battery_soc = <80>;

		/* single charger */
		sc_input_current = <3200000>;
		sc_charger_current = <3000000>;

		/* dual charger in series */
		dcs_input_current = <3200000>;
		dcs_chg1_charger_current = <1500000>;
		dcs_chg2_charger_current = <1500000>;

		/* dual charger */
		dual_polling_ieoc = <450000>;
		slave_mivr_diff = <100000>;
	};

	pe4: pe4 {
		compatible = "mediatek,charger,pe4";
		gauge = <&mtk_gauge>;

		min_charger_voltage = <4600000>;
		pe40_stop_battery_soc = <80>;

		high_temp_to_leave_pe40 = <46>;
		high_temp_to_enter_pe40 = <39>;
		low_temp_to_leave_pe40 = <10>;
		low_temp_to_enter_pe40 = <16>;
		ibus_err = <14>;

		/* PE 4.0 cable impedance (mohm) */
		pe40_r_cable_1a_lower = <500>;
		pe40_r_cable_2a_lower = <351>;
		pe40_r_cable_3a_lower = <240>;

		/* single charger */
		sc_input_current = <3200000>;
		sc_charger_current = <3000000>;

		/* dual charger in series*/
		dcs_input_current = <3200000>;
		dcs_chg1_charger_current = <1500000>;
		dcs_chg2_charger_current = <1500000>;

		dual_polling_ieoc = <450000>;
		slave_mivr_diff = <100000>;
	};

	charger: charger {
		compatible = "mediatek,charger";
		gauge = <&mtk_gauge>;
		charger = <&mtk_charger_type>;
		bootmode = <&chosen>;
		pmic = <&main_pmic>;

		algorithm_name = "Basic";
		charger_configuration= <0>;

		/* common */
		battery_cv = <4350000>;
		max_charger_voltage = <6500000>;
		min_charger_voltage = <4600000>;

		/* sw jeita */
		/* enable_sw_jeita; */
		jeita_temp_above_t4_cv = <4240000>;
		jeita_temp_t3_to_t4_cv = <4240000>;
		jeita_temp_t2_to_t3_cv = <4340000>;
		jeita_temp_t1_to_t2_cv = <4240000>;
		jeita_temp_t0_to_t1_cv = <4040000>;
		jeita_temp_below_t0_cv = <4040000>;
		temp_t4_thres = <50>;
		temp_t4_thres_minus_x_degree = <47>;
		temp_t3_thres = <45>;
		temp_t3_thres_minus_x_degree = <39>;
		temp_t2_thres = <10>;
		temp_t2_thres_plus_x_degree = <16>;
		temp_t1_thres = <0>;
		temp_t1_thres_plus_x_degree = <6>;
		temp_t0_thres = <0>;
		temp_t0_thres_plus_x_degree = <0>;
		temp_neg_10_thres = <0>;

		/* battery temperature protection */
		enable_min_charge_temp;
		min_charge_temp = <0>;
		min_charge_temp_plus_x_degree = <6>;
		max_charge_temp = <50>;
		max_charge_temp_minus_x_degree = <47>;

		/* charging current */
		usb_charger_current = <500000>;
		ac_charger_current = <2050000>;
		ac_charger_input_current = <3200000>;
		charging_host_charger_current = <1500000>;

		/* dynamic mivr */
		enable_dynamic_mivr;
		min_charger_voltage_1 = <4400000>;
		min_charger_voltage_2 = <4200000>;
		max_dmivr_charger_current = <1800000>;

		/* fast charging algo support indicator */
		enable_fast_charging_indicator;
	};
	mtk_ctd: mtk_ctd {
		compatible = "mediatek,mtk_ctd";
		bc12 = <&mtk_charger_type>;
		bc12_sel = <1>;
	};

	pd_adapter: pd_adapter {
		compatible = "mediatek,pd_adapter";
		adapter_name = "pd_adapter";
	};

	extcon_usb: extcon_usb {
		compatible = "mediatek,extcon-usb";
		charger = <&mtk_charger_type>;
		vbus-supply = <&otg_vbus>;
		vbus-voltage = <5000000>;
		vbus-current = <1800000>;
		tcpc = "type_c_port0";
		mediatek,bypss-typec-sink = <1>;
		mediatek,u2;
		port {
			usb_role: endpoint@0 {
				remote-endpoint = <&musb_drd_switch>;
			};
		};
	};

	rt9465_slave_chr: rt9465_slave_chr {
		compatible = "richtek,rt9465";
		status = "disabled";
	};

	rt-pd-manager {
		compatible = "mediatek,rt-pd-manager";
	};

	subpmic_pmu_eint: mt6370_pmu_eint {
	};

	pmic_clock_buffer_ctrl: pmic_clock_buffer_ctrl {
		compatible = "mediatek,clock_buffer_ctrl";
		mediatek,xo-buf-hwbblpm-mask = <1 0 0 0 0 0 0>;
		mediatek,xo-buf-hwbblpm-bypass = <0 0 0 0 0 0 0>;
		pmif = <&pwrap 0>;
		mediatek,enable;
	};

	low_battery_throttling {
		compatible = "mediatek,low_battery_throttling";
		hv_thd_volt = <3400>;
		lv1_thd_volt = <3250>;
		lv2_thd_volt = <3100>;
	};

	cpu_power_throttling: cpu_power_throttling {
		compatible = "mediatek,cpu-power-throttling";
		lbat_cpu_limit = <900000 900000 1300000>;
		oc_cpu_limit = <900000 900000 1300000>;
	};


	md_power_throttling: md_power_throttling {
		compatible = "mediatek,md-power-throttling";
		lbat_md_reduce_tx = <6>;
		oc_md_reduce_tx = <6>;
	};

	bp_thl: bp_thl {
		compatible = "mediatek,mtk-bp-thl";
		soc_limit = <15>;
		soc_limit_ext = <20>;
		soc_limit_ext_release = <25>;
	};

	pbm: pbm {
		compatible = "mediatek,pbm";
	};

	bat_gm30: battery {
		compatible = "mediatek,bat_gm30";
	};

	pseudo_m4u {
		compatible = "mediatek,mt-pseudo_m4u";
		iommus = <&iommu M4U_PORT_DISP_RDMA0>;
	};

	pseudo_m4u-larb0 {
		compatible = "mediatek,mt-pseudo_m4u-port";
		mediatek,larbid = <0>;
		iommus = <&iommu M4U_PORT_DISP_OVL0>,
			 <&iommu M4U_PORT_DISP_2L_OVL0_LARB0>,
			 <&iommu M4U_PORT_DISP_RDMA0>,
			 <&iommu M4U_PORT_DISP_WDMA0>,
			 <&iommu M4U_PORT_MDP_RDMA0>,
			 <&iommu M4U_PORT_MDP_WDMA0>,
			 <&iommu M4U_PORT_MDP_WROT0>,
			 <&iommu M4U_PORT_DISP_FAKE0>;
	};

	pseudo_m4u-larb1 {
		compatible = "mediatek,mt-pseudo_m4u-port";
		mediatek,larbid = <1>;
		iommus = <&iommu M4U_PORT_VENC_RCPU>,
			 <&iommu M4U_PORT_VENC_REC>;
	};

	pseudo_m4u-larb2 {
		compatible = "mediatek,mt-pseudo_m4u-port";
		mediatek,larbid = <2>;
		iommus = <&iommu M4U_PORT_CAM_IMGO>,
			 <&iommu M4U_PORT_CAM_RRZO>;
	};

	radio_md_cfg: radio_md_cfg {
		compatible = "mediatek,radio_md_cfg";
	};

	dynamic_options: dynamic_options {
		compatible = "mediatek,dynamic_options";
	};

	cm_mgr: cm_mgr@10200000 {
		compatible = "mediatek,mt6761-cm_mgr";
		reg = <0 0x10200000 0 0x4000>;
		reg-names = "cm_mgr_base";
		interconnects =
			<&dvfsrc MT6873_MASTER_MCU_0 &dvfsrc MT6873_SLAVE_DDR_EMI>;
		interconnect-names = "cm-perf-bw";
		required-opps = <&dvfsrc_freq_opp0>,
				<&dvfsrc_freq_opp1>,
				<&dvfsrc_freq_opp2>;
		cm_mgr,cp_down = <100 100>;
		cm_mgr,cp_up = <100 100>;
		cm_mgr,dt_down = <0 3>;
		cm_mgr,dt_up = <0 3>;
		cm_mgr,vp_down = <100 100>;
		cm_mgr,vp_up = <100 100>;

		/* use_bcpu_weight = "enable"; */
		/* cpu_power_bcpu_weight_max = <100>; */
		/* cpu_power_bcpu_weight_min = <100>; */

		use_cpu_to_dram_map = "enable";
		cm_mgr_cpu_opp_to_dram = <0 0 0 0 1 1 1 1
					1 2 2 2 2 2 2 2>;

		/* use_cpu_to_dram_map_new = "enable"; */
		dvfs = <&dvfsrc>;
	};

	fpsgo: fpsgo {
		compatible = "mediatek,fpsgo";
		interconnects = <&dvfsrc MT6873_MASTER_MCU_1 &dvfsrc MT6873_SLAVE_DDR_EMI>;
		interconnect-names = "fpsgo-perf-bw";
		required-opps = <&dvfsrc_freq_opp0>;

		adj_count = <30>;
		gcc_enable = <0>;
		fbt_cpu_mask = <15 15 15 15>;
		sbe_resceue_enable = <1>;
	};

	dram_ctrl {
		compatible = "mediatek,dram-qosctrl";
		required-opps = <&dvfsrc_freq_opp0>,
				<&dvfsrc_freq_opp1>;
	};

	disable_unused: disable_unused {
		compatible = "simple-bus";
	};

	met {
		met_emi: met-emi {
			compatible = "mediatek,met_emi";
			emi_num = <1>;
			dram_num = <1>;
			dramc_ver = <2>;
			seda_ver = <300>;
			/*0: dram ebg, 1:emi_freq, 2: DRAMC_DCM_CTRL 3:chn_emi_low_effi */
			met_emi_support_list = <0x4>;
			cen_emi_reg_base = <0x10219000>;
			cen_emi_reg_size = <0x1000>;
			chn_emi_reg_base = <0x1022d000 0x10235000>;
			chn_emi_reg_size = <0xa90>;
			dramc_nao_reg_base = <0x1022c000 0x10234000>;
			dramc_nao_reg_size = <0x76c>;
			dramc_ao_reg_base = <0x1022a000 0x10232000>;
			dramc_ao_reg_size = <0x2000>;
			ddrphy_ao_reg_base = <0x10228000 0x10230000>;
			ddrphy_ao_reg_size = <0x1650>;
			ddrphy_ao_misc_cg_ctrl0 = <0x284>;
			ddrphy_ao_misc_cg_ctrl2 = <0x28c>;
			dram_freq_default = <6400>;
			ddr_ratio_default = <8>;
			dram_type_default = <8>;
		};
		met_res_ram {
			compatible = "mediatek,met_res_ram";
			met_res_ram_sspm {
				size = <0x400000>; /* 4M: only reserve on userdebug/eng load */
				start = <0x0>; /* start addr of reserved ram*/
			};
		};
		sspm_rts_header:sspm-rts-header {
			node_0 = "SSPM_PTPOD",
				"_id,voltage";

			node_1 = "SSPM_MET_UNIT_TEST",
				"test";
		};
	};

};

#include "cust_mt6761_msdc.dtsi"
#include "mt6357.dtsi"
#include "bat_setting/mt6761_battery_prop.dtsi"
#include "mt6370.dtsi"
#include "mt6761-disable-unused.dtsi"
//#include "mt6370_pd.dtsi"

&mddriver {
	/* for md pmic voltage setting*/
	md_vmodem-supply = <&mt_pmic_vmodem_buck_reg>;
	md_vmodem = <800000 800000>;
};

&mt6370_chg {
	charger = <&mtk_charger_type>; /*mt6370 get online status*/
};

&mtk_charger_type {
	charger = <&mt6370_chg>; /*mt6357 get charger status*/
};

&mt6370 {
	interrupts = <11 IRQ_TYPE_LEVEL_LOW 11 0>; /*mt6370-irq gpio is gpio 11 for mt6761*/
};
