/* Copyright (c) 2013, The Linux Foundation. All rights reserved.
 *
 * This program is free software; you can redistribute it and/or modify
 * it under the terms of the GNU General Public License version 2 and
 * only version 2 as published by the Free Software Foundation.
 *
 * This program is distributed in the hope that it will be useful,
 * but WITHOUT ANY WARRANTY; without even the implied warranty of
 * MERCHANTABILITY or FITNESS FOR A PARTICULAR PURPOSE.  See the
 * GNU General Public License for more details.
 */

/dts-v1/;

#include "apq8084.dtsi"
#include "apq8084-cdp.dtsi"

/ {
	model = "Qualcomm APQ 8084, SMB349 CDP";
	compatible = "qcom,apq8084-cdp", "qcom,apq8084", "qcom,cdp";
	qcom,board-id = <1 0>,
			<1 1>,
			<21 0>,
			<21 1>;
};

&i2c_0 {
	smb349_otg_vreg: smb349-charger@1b {
		compatible = "qcom,smb349-charger";
		reg = <0x1b>;
		interrupt-parent = <&spmi_bus>;
		interrupts = <0x00 0xcd 0x0>; /* PMA8084 GPIO 14 */
		qcom,charging-disabled;
		regulator-name = "smb349_otg_vreg";
	};
};

&usb3 {
	vbus_dwc3-supply = <&smb349_otg_vreg>;
};
