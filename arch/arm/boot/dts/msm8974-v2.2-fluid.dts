/* Copyright (c) 2013, The Linux Foundation. All rights reserved.
 *
 * This program is free software; you can redistribute it and/or modify
 * it under the terms of the GNU General Public License version 2 and
 * only version 2 as published by the Free Software Foundation.
 *
 * This program is distributed in the hope that it will be useful,
 * but WITHOUT ANY WARRANTY; without even the implied warranty of
 * MERCHANTABILITY or FITNESS FOR A PARTICULAR PURPOSE.  See the
 * GNU General Public License for more details.
 */

/dts-v1/;

#include "msm8974-v2.2.dtsi"
#include "msm8974-fluid.dtsi"

/ {
	model = "Qualcomm MSM 8974v2.2 FLUID";
	compatible = "qcom,msm8974-fluid", "qcom,msm8974", "qcom,fluid";
	qcom,msm-id = <126 3 0x20002>,
		      <185 3 0x20002>,
		      <186 3 0x20002>;
};
