/* Copyright (c) 2013, The Linux Foundation. All rights reserved.
 * Copyright (C) 2015 XiaoMi, Inc.
 *
 * This program is free software; you can redistribute it and/or modify
 * it under the terms of the GNU General Public License version 2 and
 * only version 2 as published by the Free Software Foundation.
 *
 * This program is distributed in the hope that it will be useful,
 * but WITHOUT ANY WARRANTY; without even the implied warranty of
 * MERCHANTABILITY or FITNESS FOR A PARTICULAR PURPOSE.  See the
 * GNU General Public License for more details.
 */

qcom,BM31-LG-3020mAh-data {
	qcom,fcc-mah = <3020>;
	qcom,default-rbatt-mohm = <138>;
	qcom,rbatt-capacitive-mohm = <0>;
	qcom,flat-ocv-threshold-uv = <3800000>;
	qcom,max-voltage-uv = <4350000>;
	qcom,v-cutoff-uv = <3400000>;
	qcom,chg-term-ua = <200000>;
	qcom,batt-id-kohm = <50>;
	xiaomi,batt-version = <4>;

	qcom,rbatt-sf-lut {
		qcom,lut-col-legend = <(-20) (-10) 0 5 10 15 20 25 30 40 60>;
		qcom,lut-row-legend = <100 95 90 85 80>,
				<75 70 65 60 55>,
				<50 45 40 35 30>,
				<25 20 16 13 11>,
				<10 9 8 7 6>,
				<5 4 3 2 1>;
		qcom,lut-data = <1207 725 299 212 159 130 113 100 92 83 75>,
			<1207 725 299 212 159 130 113 100 92 83 75>,
			<1107 675 304 216 164 133 115 103 95 85 76>,
			<1073 641 306 222 168 138 119 107 98 88 78>,
			<1064 657 323 226 174 142 123 111 101 90 80>,
			<1009 619 330 242 188 151 130 115 106 93 81>,
			<1009 609 317 241 192 157 135 120 109 97 84>,
			<1000 604 316 243 199 166 143 128 114 100 87>,
			<1015 596 303 228 186 161 147 135 123 108 91>,
			<1053 603 294 214 167 139 121 109 101 89 79>,
			<1107 631 294 212 164 134 116 104 95 85 77>,
			<1172 674 309 214 165 136 117 106 98 87 79>,
			<1238 727 336 226 170 138 121 109 99 91 82>,
			<1304 787 377 249 181 143 124 112 103 94 86>,
			<1373 849 436 281 200 154 130 116 104 91 78>,
			<1454 907 503 328 226 168 137 118 104 89 77>,
			<1550 976 571 371 248 180 143 121 107 90 78>,
			<1658 1048 627 410 265 188 145 122 107 90 77>,
			<1756 1132 678 454 290 201 151 125 109 91 78>,
			<1824 1196 720 491 316 217 159 130 114 94 80>,
			<1837 1223 737 508 331 227 166 136 117 97 81>,
			<1888 1238 739 513 338 233 171 140 120 99 82>,
			<2105 1281 769 535 353 246 178 143 123 100 83>,
			<2379 1343 804 564 372 261 187 149 127 103 84>,
			<2736 1408 846 594 393 274 196 154 130 103 86>,
			<3196 1496 886 626 414 286 201 155 128 102 87>,
			<3831 1667 932 665 441 300 207 159 131 104 86>,
			<4765 1965 994 718 478 326 225 171 139 110 91>,
			<6200 2498 1077 788 533 364 254 191 155 119 96>,
			<8943 3632 1374 938 630 438 307 228 178 135 109>;
	};

	qcom,fcc-temp-lut {
		qcom,lut-col-legend = <(-20) (-10) 0 5 10 15 20 25 30 40 60>;
		qcom,lut-data = <3058 3046 3046 3046 3044 3044 3042 3040 3039 3034 3019>;
	};

	qcom,pc-temp-ocv-lut {
		qcom,lut-col-legend = <(-20) (-10) 0 5 10 15 20 25 30 40 60>;
		qcom,lut-row-legend = <100 95 90 85 80>,
				<75 70 65 60 55>,
				<50 45 40 35 30>,
				<25 20 16 13 11>,
				<10 9 8 7 6>,
				<5 4 3 2 1 0>;
		qcom,lut-data = <4317 4316 4315 4314 4313 4312 4311 4310 4308 4305 4298>,
			<4227 4242 4256 4259 4262 4263 4264 4263 4262 4261 4256>,
			<4156 4174 4192 4198 4202 4204 4206 4206 4206 4204 4200>,
			<4101 4109 4135 4142 4146 4149 4150 4150 4150 4150 4146>,
			<4044 4066 4083 4090 4094 4096 4098 4098 4098 4098 4094>,
			<3962 4000 4030 4039 4044 4048 4049 4050 4050 4048 4045>,
			<3913 3949 3979 3990 3996 4000 4002 4002 4003 4004 4000>,
			<3866 3902 3934 3948 3956 3960 3962 3963 3964 3963 3960>,
			<3837 3858 3887 3898 3906 3914 3920 3923 3924 3926 3922>,
			<3819 3827 3847 3856 3862 3866 3868 3870 3870 3872 3870>,
			<3804 3810 3817 3824 3830 3834 3836 3836 3838 3838 3838>,
			<3789 3798 3798 3802 3806 3810 3812 3813 3814 3814 3814>,
			<3771 3784 3786 3787 3789 3791 3793 3794 3794 3796 3794>,
			<3752 3770 3776 3778 3778 3778 3778 3779 3779 3780 3778>,
			<3732 3753 3764 3768 3768 3768 3769 3768 3767 3764 3754>,
			<3711 3732 3746 3752 3756 3758 3756 3754 3752 3746 3732>,
			<3687 3709 3721 3726 3731 3732 3733 3732 3728 3723 3708>,
			<3664 3688 3696 3698 3700 3701 3700 3699 3696 3691 3679>,
			<3643 3670 3679 3681 3682 3682 3682 3680 3678 3674 3662>,
			<3626 3658 3668 3672 3672 3674 3674 3674 3673 3668 3658>,
			<3617 3653 3664 3667 3669 3671 3672 3672 3670 3666 3656>,
			<3608 3646 3658 3662 3666 3668 3670 3670 3668 3664 3654>,
			<3596 3638 3652 3658 3661 3664 3666 3666 3665 3662 3650>,
			<3580 3628 3644 3648 3654 3657 3659 3660 3659 3655 3642>,
			<3561 3613 3629 3633 3638 3644 3645 3644 3645 3638 3620>,
			<3535 3588 3604 3606 3612 3615 3616 3614 3613 3605 3584>,
			<3499 3550 3564 3565 3570 3570 3569 3565 3564 3556 3536>,
			<3450 3494 3508 3508 3510 3509 3506 3502 3502 3494 3474>,
			<3377 3414 3426 3428 3428 3426 3422 3420 3418 3411 3390>,
			<3264 3290 3303 3304 3302 3300 3295 3292 3294 3284 3261>,
			<3000 3000 3000 3000 3000 3000 3000 3000 3000 3000 3000>;
	};
};
