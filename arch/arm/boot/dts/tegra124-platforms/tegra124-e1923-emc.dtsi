/ {
memory-controller@7001b000 {
		compatible = "nvidia,tegra12-emc";
		reg = <0x7001b000 0x800>;
		#address-cells = <1>;
		#size-cells = <0>;
		emc-table@102000 {
			compatible = "nvidia,tegra12-emc-table";
			nvidia,revision = <0x18>;
			nvidia,dvfs-version = "01_102000_01_V5.0.12_V0.9";
			clock-frequency = <102000>;
			nvidia,emc-min-mv = <800>;
			nvidia,gk20a-min-mv = <800>;
			nvidia,source = "pllp_out0";
			nvidia,src-sel-reg = <0x40000006>;
			nvidia,burst-regs-num = <164>;
			nvidia,burst-up-down-regs-num = <31>;
			nvidia,emc-registers = <
				0x00000006
				0x00000015
				0x00000000
				0x00000004
				0x00000002
				0x00000006
				0x00000008
				0x00000003
				0x0000000a
				0x00000002
				0x00000002
				0x00000001
				0x00000002
				0x00000000
				0x00000003
				0x00000003
				0x00000006
				0x00000002
				0x00000000
				0x00000005
				0x00000005
				0x00010000
				0x00000003
				0x00000000
				0x00000000
				0x00000000
				0x00000000
				0x00000004
				0x0000000c
				0x0000000d
				0x0000000f
				0x00000182
				0x00000000
				0x00000060
				0x00000002
				0x00000002
				0x00000002
				0x00000000
				0x00000001
				0x0000000c
				0x00000017
				0x00000017
				0x00000003
				0x00000003
				0x00000003
				0x00000006
				0x00000004
				0x00000003
				0x00000003
				0x000002ae
				0x00000000
				0x00000000
				0x00000000
				0x1363a296
				0x005800a0
				0x00008000
				0x00048000
				0x00048000
				0x00048000
				0x00048000
				0x00048000
				0x00048000
				0x00048000
				0x00048000
				0x00048000
				0x00048000
				0x00048000
				0x00048000
				0x00048000
				0x00048000
				0x00048000
				0x00048000
				0x00000000
				0x00000000
				0x00000000
				0x00000000
				0x00000000
				0x00000000
				0x00000000
				0x00000000
				0x000fc000
				0x000fc000
				0x00000000
				0x000fc000
				0x000fc000
				0x00000000
				0x00000000
				0x00000000
				0x00000000
				0x00000000
				0x00000000
				0x00000000
				0x00000000
				0x00000000
				0x00000000
				0x00000000
				0x00000000
				0x00000000
				0x00000000
				0x00000000
				0x00000000
				0x00000000
				0x00000000
				0x00000000
				0x00000000
				0x00000000
				0x00000000
				0x00000000
				0x00000000
				0x00000000
				0x000fc000
				0x000fc000
				0x000fc000
				0x000fc000
				0x0000fc00
				0x0000fc00
				0x0000fc00
				0x0000fc00
				0x00000200
				0x00000000
				0x00100100
				0x0130b018
				0x00000000
				0x00000000
				0x77ffc000
				0x00000303
				0x81f1f008
				0x07070000
				0x0000003f
				0x015ddddd
				0x51451400
				0x00514514
				0x00514514
				0x51451400
				0x0000003f
				0x00000000
				0x00000000
				0x00064000
				0x00000025
				0x00660011
				0x00660011
				0x00000000
				0x00000003
				0x0000f3f3
				0x8000040b
				0x0000000a
				0x08000001
				0x80000026
				0x00000001
				0x00000001
				0x00000003
				0x00000001
				0x00000003
				0x00000001
				0x00000002
				0x00000007
				0x00000002
				0x00000001
				0x00000004
				0x00000005
				0x05040102
				0x00090403
				0x73430504
				0x001f0000
			>;
			nvidia,emc-burst-up-down-regs = <
			0x00000001
			0x00000031
			0x00ff00da
			0x00ff00da
			0x00ff0075
			0x00ff00ff
			0x00ff009d
			0x00ff00ff
			0x00ff009d
			0x009b0049
			0x00ff0080
			0x00ff0004
			0x00ff0004
			0x000800ad
			0x000000ff
			0x00ff0004
			0x00ff00c6
			0x00ff006d
			0x00ff0024
			0x00ff00d6
			0x000000ff
			0x0000009f
			0x00ff00ff
			0x0000009f
			0x00ff00ff
			0x00ff00ff
			0x009f00a0
			0x00ff00ff
			0x00ff00ff
			0x00ff00ff
			0x00ff00da
			>;
			nvidia,emc-zcal-cnt-long = <0x00000015>;
			nvidia,emc-acal-interval = <0x001fffff>;
			nvidia,emc-ctt-term_ctrl = <0x00000802>;
			nvidia,emc-cfg = <0xf3200000>;
			nvidia,emc-cfg-2 = <0x000008c7>;
			nvidia,emc-sel-dpd-ctrl = <0x0004013c>;
			nvidia,emc-cfg-dig-dll = <0x00580068>;
			nvidia,emc-bgbias-ctl0 = <0x00000008>;
			nvidia,emc-auto-cal-config2 = <0x00000000>;
			nvidia,emc-auto-cal-config3 = <0x00000000>;
			nvidia,emc-auto-cal-config = <0xa1430000>;
			nvidia,emc-mode-0 = <0x00000000>;
			nvidia,emc-mode-1 = <0x00010083>;
			nvidia,emc-mode-2 = <0x00020004>;
			nvidia,emc-mode-4 = <0x800b0000>;
		};
		emc-table@924000 {
			compatible = "nvidia,tegra12-emc-table";
			nvidia,revision = <0x18>;
			nvidia,dvfs-version = "01_924000_01_V5.0.12_V0.9";
			clock-frequency = <924000>;
			nvidia,emc-min-mv = <1010>;
			nvidia,gk20a-min-mv = <1100>;
			nvidia,source = "pllm_ud";
			nvidia,src-sel-reg = <0x80000000>;
			nvidia,burst-regs-num = <164>;
			nvidia,burst-up-down-regs-num = <31>;
			nvidia,emc-registers = <
				0x00000037
				0x000000c2
				0x00000000
				0x00000026
				0x00000010
				0x0000000f
				0x00000010
				0x00000006
				0x00000017
				0x00000010
				0x00000010
				0x00000009
				0x00000005
				0x00000000
				0x00000007
				0x00000007
				0x00000010
				0x00000005
				0x00000000
				0x00000005
				0x00000012
				0x000d0000
				0x00000007
				0x00000000
				0x00000000
				0x00000000
				0x00000000
				0x00000004
				0x00000019
				0x00000020
				0x00000022
				0x00000dd4
				0x00000000
				0x00000375
				0x00000006
				0x00000006
				0x00000010
				0x00000000
				0x00000001
				0x0000001b
				0x000000cc
				0x000000cc
				0x00000007
				0x0000000e
				0x00000007
				0x0000002d
				0x00000014
				0x00000003
				0x00000003
				0x00001842
				0x00000000
				0x00000000
				0x00000000
				0x1363a896
				0xe00400b9
				0x00008000
				0x00000004
				0x00000004
				0x00000004
				0x00000004
				0x00000004
				0x00000004
				0x00000004
				0x00000004
				0x00000004
				0x00000004
				0x00000004
				0x00000004
				0x00000004
				0x00000004
				0x00000004
				0x00000004
				0x00000000
				0x00000000
				0x00000000
				0x00000000
				0x00000000
				0x00000000
				0x00000000
				0x00000000
				0x0000400d
				0x0000400d
				0x00000000
				0x00000011
				0x00000011
				0x00000000
				0x00000000
				0x00000000
				0x00000000
				0x00000000
				0x00000000
				0x00000000
				0x00000000
				0x00000000
				0x00000008
				0x00000008
				0x00000008
				0x00000007
				0x00000007
				0x00000007
				0x00000008
				0x00000006
				0x00000008
				0x00000008
				0x00000008
				0x00000007
				0x00000007
				0x00000007
				0x00000008
				0x00000006
				0x00000009
				0x00000009
				0x00000009
				0x00000009
				0x0000000a
				0x00000009
				0x0000000a
				0x00000009
				0x00000220
				0x00000000
				0x00100100
				0x0120103d
				0x00000000
				0x00000000
				0x77ffc004
				0x00000303
				0x81f1f008
				0x07070000
				0x00000000
				0x015ddddd
				0x5d75d720
				0x00514514
				0x00514514
				0x5d75d700
				0x0000003f
				0x00000000
				0x00000000
				0x00064000
				0x0000014d
				0x039c0019
				0x039c0019
				0x00000000
				0x00000007
				0x00004080
				0x80001c77
				0x00000017
				0x0e00000d
				0x80000040
				0x00000007
				0x00000008
				0x0000001b
				0x00000012
				0x00000017
				0x00000004
				0x00000004
				0x0000000e
				0x00000004
				0x00000001
				0x00000009
				0x00000009
				0x09090104
				0x001e141b
				0x72ae2a1c
				0x001f0000
			>;
			nvidia,emc-burst-up-down-regs = <
			0x00000017
			0x000001bb
			0x006e0038
			0x006e0038
			0x006e003c
			0x006e0090
			0x006e0041
			0x006e0090
			0x006e0041
			0x00270049
			0x006e0080
			0x006e0004
			0x006e0004
			0x00080016
			0x0000006e
			0x006e0004
			0x006e0019
			0x006e0018
			0x006e0024
			0x006e001b
			0x0000006e
			0x00000036
			0x006e006e
			0x00000036
			0x006e006e
			0x00d400ff
			0x00510029
			0x006e006e
			0x006e006e
			0x006e0065
			0x006e001c
			>;
			nvidia,emc-zcal-cnt-long = <0x00000058>;
			nvidia,emc-acal-interval = <0x001fffff>;
			nvidia,emc-ctt-term_ctrl = <0x00000802>;
			nvidia,emc-cfg = <0xf3300000>;
			nvidia,emc-cfg-2 = <0x0000089f>;
			nvidia,emc-sel-dpd-ctrl = <0x0004001c>;
			nvidia,emc-cfg-dig-dll = <0xe0040069>;
			nvidia,emc-bgbias-ctl0 = <0x00000000>;
			nvidia,emc-auto-cal-config2 = <0x00000000>;
			nvidia,emc-auto-cal-config3 = <0x00000000>;
			nvidia,emc-auto-cal-config = <0xa1430000>;
			nvidia,emc-mode-0 = <0x00000000>;
			nvidia,emc-mode-1 = <0x00010083>;
			nvidia,emc-mode-2 = <0x0002001c>;
			nvidia,emc-mode-4 = <0x800b0000>;
		};
	};
};
