#include <dt-bindings/gpio/tegra-gpio.h>

/ {
	gpio: gpio@6000d000 {
		gpio-init-names = "default";
		gpio-init-0 = <&gpio_default>;

		gpio_default: default {
			gpio-input = <TEGRA_GPIO(A, 2)
					TEGRA_GPIO(A, 3)
					TEGRA_GPIO(G, 2)
					TEGRA_GPIO(G, 3)
					TEGRA_GPIO(I, 5)
					TEGRA_GPIO(I, 6)
					TEGRA_GPIO(I, 7)
					TEGRA_GPIO(J, 0)
					TEGRA_GPIO(K, 2)
					TEGRA_GPIO(Q, 0)
					TEGRA_GPIO(Q, 5)
					TEGRA_GPIO(Q, 6)
					TEGRA_GPIO(Q, 7)
					TEGRA_GPIO(R, 7)
					TEGRA_GPIO(S, 0)
					TEGRA_GPIO(S, 5)
					TEGRA_GPIO(U, 5)
					TEGRA_GPIO(U, 6)
					TEGRA_GPIO(W, 2)
					TEGRA_GPIO(W, 3)
					TEGRA_GPIO(X, 3)>;
			gpio-output-low = <TEGRA_GPIO(A, 4)
					TEGRA_GPIO(A, 5)
					TEGRA_GPIO(G, 6)
					TEGRA_GPIO(G, 7)
					TEGRA_GPIO(H, 5)
					TEGRA_GPIO(I, 0)
					TEGRA_GPIO(K, 1)
					TEGRA_GPIO(K, 4)
					TEGRA_GPIO(Q, 4)
					TEGRA_GPIO(R, 0)
					TEGRA_GPIO(R, 1)
					TEGRA_GPIO(R, 3)
					TEGRA_GPIO(R, 5)
					TEGRA_GPIO(S, 6)
					TEGRA_GPIO(X, 1)
					TEGRA_GPIO(X, 7)
					TEGRA_GPIO(BB, 3)
					TEGRA_GPIO(BB, 6)
					TEGRA_GPIO(BB, 7)
					TEGRA_GPIO(CC, 1)
					TEGRA_GPIO(CC, 5)
					TEGRA_GPIO(EE, 1)>;
			gpio-output-high = <TEGRA_GPIO(H, 3)
					TEGRA_GPIO(I, 4)
					TEGRA_GPIO(R, 2)
					TEGRA_GPIO(S, 2)
					TEGRA_GPIO(W, 5)
					TEGRA_GPIO(X, 5)
					TEGRA_GPIO(BB, 4)
					TEGRA_GPIO(BB, 5)>;
		};
	};
};
