#include <dt-bindings/gpio/tegra-gpio.h>

/ {
	gpio: gpio@6000d000 {
		gpio-init-names = "default";
		gpio-init-0 = <&gpio_default>;

		gpio_default: default {
			gpio-input = <  TEGRA_GPIO(C, 7)
					TEGRA_GPIO(G, 2)
					TEGRA_GPIO(G, 3)
					TEGRA_GPIO(H, 4)
					TEGRA_GPIO(H, 6)
					TEGRA_GPIO(I, 5)
					TEGRA_GPIO(I, 6)
					TEGRA_GPIO(J, 0)
					TEGRA_GPIO(J, 2)
					TEGRA_GPIO(FF, 2)
					TEGRA_GPIO(K, 2)
					TEGRA_GPIO(K, 3)
					TEGRA_GPIO(N, 7)
					TEGRA_GPIO(O, 0)
					TEGRA_GPIO(O, 1)
					TEGRA_GPIO(O, 2)
					TEGRA_GPIO(O, 3)
					TEGRA_GPIO(O, 5)
					TEGRA_GPIO(O, 7)
					TEGRA_GPIO(Q, 0)
					TEGRA_GPIO(Q, 1)
					TEGRA_GPIO(Q, 2)
					TEGRA_GPIO(Q, 5)
					TEGRA_GPIO(Q, 6)
					TEGRA_GPIO(Q, 7)
					TEGRA_GPIO(R, 4)
					TEGRA_GPIO(R, 7)
					TEGRA_GPIO(S, 0)
					TEGRA_GPIO(S, 5)
					TEGRA_GPIO(U, 1)
					TEGRA_GPIO(U, 2)
					TEGRA_GPIO(U, 5)
					TEGRA_GPIO(U, 6)
					TEGRA_GPIO(V, 0)
					TEGRA_GPIO(V, 1)
					TEGRA_GPIO(W, 2)
					TEGRA_GPIO(W, 3)
					TEGRA_GPIO(X, 3)
					TEGRA_GPIO(X, 5)
					TEGRA_GPIO(X, 6)
					TEGRA_GPIO(CC, 1)
					TEGRA_GPIO(CC, 2)>;
			gpio-output-low = <TEGRA_GPIO(G, 0)
					TEGRA_GPIO(P, 0)
					TEGRA_GPIO(P, 1)
					TEGRA_GPIO(P, 2)
					TEGRA_GPIO(BB, 4)
					TEGRA_GPIO(G, 1)
					TEGRA_GPIO(H, 3)
					TEGRA_GPIO(H, 5)
					TEGRA_GPIO(I, 0)
					TEGRA_GPIO(I, 2)
					TEGRA_GPIO(I, 4)
					TEGRA_GPIO(K, 1)
					TEGRA_GPIO(K, 5)
					TEGRA_GPIO(K, 6)
					TEGRA_GPIO(O, 6)
					TEGRA_GPIO(R, 0)
					TEGRA_GPIO(R, 1)
					TEGRA_GPIO(R, 2)
					TEGRA_GPIO(R, 5)
					TEGRA_GPIO(S, 3)
					TEGRA_GPIO(S, 4)
					TEGRA_GPIO(S, 6)
					TEGRA_GPIO(U, 0)
					TEGRA_GPIO(U, 3)
					TEGRA_GPIO(U, 4)
					TEGRA_GPIO(X, 1)
					TEGRA_GPIO(X, 4)
					TEGRA_GPIO(X, 7)
					TEGRA_GPIO(T, 0)
					TEGRA_GPIO(T, 1)
					TEGRA_GPIO(BB, 3)
					TEGRA_GPIO(BB, 5)
					TEGRA_GPIO(BB, 6)
					TEGRA_GPIO(BB, 7)
					TEGRA_GPIO(CC, 5)
					TEGRA_GPIO(DD, 6)
					TEGRA_GPIO(FF, 1)
					TEGRA_GPIO(H, 2)
					TEGRA_GPIO(EE, 1)>;
			gpio-output-high = <TEGRA_GPIO(K, 4)>;
		};
	};
};
