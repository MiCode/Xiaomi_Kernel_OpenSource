/* Copyright (C) 2014 XiaoMi, Inc.
 *
 * This program is free software; you can redistribute it and/or modify
 * it under the terms of the GNU General Public License version 2 and
 * only version 2 as published by the Free Software Foundation.
 *
 * This program is distributed in the hope that it will be useful,
 * but WITHOUT ANY WARRANTY; without even the implied warranty of
 * MERCHANTABILITY or FITNESS FOR A PARTICULAR PURPOSE.  See the
 * GNU General Public License for more details.
 */

/*---------------------------------------------------------------------------
 * This file is autogenerated file using gcdb parser. Please do not edit it.
 * Update input XML file to add a new entry or update variable in this file
 * VERSION = "1.0"
 *---------------------------------------------------------------------------*/
&mdss_mdp {
	dsi_sharp_720_vid: qcom,mdss_dsi_sharp_720p_video {
		qcom,mdss-dsi-panel-name = "sharp 720p video mode dsi panel";
		qcom,mdss-dsi-panel-controller = <&mdss_dsi0>;
		qcom,mdss-dsi-panel-type = "dsi_video_mode";
		qcom,mdss-dsi-panel-destination = "display_1";
		qcom,mdss-dsi-panel-framerate = <60>;
		qcom,mdss-dsi-virtual-channel-id = <0>;
		qcom,mdss-dsi-stream = <0>;
		qcom,mdss-dsi-panel-width = <720>;
		qcom,mdss-dsi-panel-height = <1280>;
		qcom,mdss-dsi-h-front-porch = <140>;
		qcom,mdss-dsi-h-back-porch = <20>;
		qcom,mdss-dsi-h-pulse-width = <10>;
		qcom,mdss-dsi-h-sync-skew = <0>;
		qcom,mdss-dsi-v-back-porch = <12>;
		qcom,mdss-dsi-v-front-porch = <12>;
		qcom,mdss-dsi-v-pulse-width = <1>;
		qcom,mdss-dsi-h-left-border = <0>;
		qcom,mdss-dsi-h-right-border = <0>;
		qcom,mdss-dsi-v-top-border = <0>;
		qcom,mdss-dsi-v-bottom-border = <0>;
		qcom,mdss-dsi-bpp = <24>;
		qcom,mdss-dsi-color-order = <0>;
		qcom,mdss-dsi-underflow-color = <0xff>;
		qcom,mdss-dsi-border-color = <0>;
		qcom,mdss-dsi-on-command = [
				23 01 00 00 00 00 02 b0 00
				29 01 00 00 00 00 06 b3 1c 00 00 00 00
				23 01 00 00 00 00 02 d6 01
				29 01 00 00 10 00 19 CE 7D 40 48 56 67 78 88 98 A7 B5 C3 D1 DE E9 F2 FA FF 01 5F 04 04 00 00 00
				23 01 00 00 00 00 02 b0 03
				15 01 00 00 10 00 02 51 fe
				15 01 00 00 10 00 02 53 2C
				15 01 00 00 10 00 02 55 01
				05 01 00 00 14 00 02 29 00
				05 01 00 00 78 00 02 11 00];

		qcom,mdss-dsi-off-command = [05 01 00 00 14 00 02 28 00
				05 01 00 00 64 00 02 10 00
				23 01 00 00 00 00 02 b0 00
				23 01 00 00 00 00 02 b0 01];
		qcom,mdss-dsi-on-command-state = "dsi_lp_mode";
		qcom,mdss-dsi-off-command-state = "dsi_hs_mode";
		qcom,mdss-dsi-h-sync-pulse = <1>;
		qcom,mdss-dsi-traffic-mode = <2>;
		qcom,mdss-dsi-lane-map = <0>;
		qcom,mdss-dsi-bllp-eof-power-mode;
		qcom,mdss-dsi-bllp-power-mode;
		qcom,mdss-dsi-lane-0-state;
		qcom,mdss-dsi-lane-1-state;
		qcom,mdss-dsi-lane-2-state;
		qcom,mdss-dsi-force-clk-lane-hs;
		qcom,mdss-dsi-lp11-init;
		qcom,mdss-dsi-panel-timings = [C0 90 24 00 9B 98 27 92 28 03 04 00];
		qcom,mdss-dsi-t-clk-post = <0x19>;
		qcom,mdss-dsi-t-clk-pre = <0x30>;
		qcom,mdss-dsi-bl-min-level = <1>;
		qcom,mdss-dsi-bl-max-level = <4095>;
		qcom,mdss-dsi-dma-trigger = <4>;
		qcom,mdss-dsi-mdp-trigger = <0>;
		qcom,mdss-dsi-bl-pmic-control-type = "bl_ctrl_wled";
		qcom,mdss-dsi-reset-sequence = <1 20>, <0 10>, <1 20>;
		qcom,mdss-pan-physical-width-dimension = <58>;
		qcom,mdss-pan-physical-height-dimension = <103>;
		qcom,dispparam-enabled;
		qcom,mdss-dsi-dispparam-ceon-command = [
				23 01 00 00 00 00 02 b0 00
				29 01 00 00 00 00 06 b3 1c 00 00 00 00
				29 01 00 00 00 00 21 CA 01 80 82 98 B0 9C 90 90 14 30 00 80 0A 42 44 80 69 DA 08 08 08 06 08 04 00 00 10 10 3F 3F 3F 3F
				23 01 00 00 00 00 02 d6 01
				23 01 00 00 00 00 02 b0 03
				];
		qcom,mdss-dsi-dispparam-ceon-command-state = "dsi_hs_mode";
		qcom,mdss-dsi-dispparam-ceoff-command = [
				23 01 00 00 00 00 02 b0 00
				29 01 00 00 00 00 06 b3 1c 00 00 00 00
				29 01 00 00 00 00 21 CA 00 80 80 80 80 80 80 80 08 20 80 80 0A 4A 37 A0 55 F8 0C 0C 20 10 3F 3F 00 00 10 10 3F 3F 3F 3F
				23 01 00 00 00 00 02 d6 01
				23 01 00 00 00 00 02 b0 03
				];
		qcom,mdss-dsi-dispparam-ceoff-command-state = "dsi_hs_mode";

		qcom,mdss-dsi-dispparam-warm-command = [
                                29 01 00 00 00 00 02 b0 00
                                29 01 00 00 00 00 27 C7 12 21 2C 3B 47 50 66 75 82 8C 3D 48 54 66 70 7B 89 98 A6 00 19 24 33 3F 48 60 71 80 8C 3F 4C 5A 6E 78 85 93 A2 AF
                                29 01 00 00 00 00 27 c8 33 36 3E 48 51 59 6D 7B 86 92 42 4C 58 69 73 7E 8C 93 98 1F 2C 34 3E 49 51 67 79 86 92 44 4E 5E 6F 79 84 90 97 98
                                29 01 00 00 00 00 27 c9 4E 4F 53 5A 60 66 75 81 8B 95 45 4F 5B 6C 75 80 8D 93 98 3E 47 4B 52 5A 60 71 7F 8B 95 47 51 5F 72 7B 86 91 97 98
                                29 01 00 00 00 00 02 d6 01
                                29 01 00 00 00 00 02 b0 03
                                ];
		qcom,mdss-dsi-dispparam-warm-command-state = "dsi_hs_mode";
		qcom,mdss-dsi-dispparam-default-command = [
                                29 01 00 00 00 00 02 b0 00
                                29 01 00 00 00 00 27 c7 12 21 2C 3B 47 50 66 75 82 8C 3D 48 54 66 70 7B 89 98 A6 00 19 24 33 3F 48 60 71 80 8C 3F 4C 5A 6E 78 85 93 A2 AF
                                29 01 00 00 00 00 27 c8 12 21 2C 3B 47 50 66 75 82 8C 3D 48 54 66 70 7B 89 98 A6 00 19 24 33 3F 48 60 71 80 8C 3F 4C 5A 6E 78 85 93 A2 AF
                                29 01 00 00 00 00 27 c9 12 21 2C 3B 47 50 66 75 82 8C 3D 48 54 66 70 7B 89 98 A6 00 19 24 33 3F 48 60 71 80 8C 3F 4C 5A 6E 78 85 93 A2 AF
                                29 01 00 00 00 00 02 d6 01
                                29 01 00 00 00 00 02 b0 03
                                ];
		qcom,mdss-dsi-dispparam-default-command-state = "dsi_hs_mode";
		qcom,mdss-dsi-dispparam-cold-command = [
                                29 01 00 00 00 00 02 b0 00
                                29 01 00 00 00 00 27 c7 39 3A 41 4A 53 5A 6C 7A 86 91 42 4C 58 69 71 7F 8D 94 98 27 34 3B 44 4D 56 6A 7A 86 91 44 50 5C 6F 79 85 91 96 98
                                29 01 00 00 00 00 27 c8 2F 32 3A 45 4E 57 6B 79 85 91 41 4B 58 68 73 7E 8D 94 98 1B 2A 32 3D 48 51 67 77 85 91 43 4D 5C 6E 79 84 91 96 98
                                29 01 00 00 00 00 27 c9 12 1E 2C 3B 46 51 67 77 83 8F 40 4B 57 68 72 7D 8C 94 98 00 1A 26 33 40 4B 63 75 83 8F 42 4D 5B 6E 78 83 90 96 98
                                29 01 00 00 00 00 02 d6 01
                                29 01 00 00 00 00 02 b0 03
                                ];
		qcom,mdss-dsi-dispparam-cold-command-state = "dsi_hs_mode";

		qcom,mdss-dsi-dispparam-cabcon-command_GUI = [
				15 01 00 00 10 00 02 55 01
				];
		qcom,mdss-dsi-dispparam-cabcon-command_STILL = [
				15 01 00 00 10 00 02 55 02
				];
		qcom,mdss-dsi-dispparam-cabcon-command_MOVIE = [
				15 01 00 00 10 00 02 55 03
				];
		qcom,mdss-dsi-dispparam-cabcon-command-state = "dsi_hs_mode";
		qcom,mdss-dsi-dispparam-cabcoff-command = [
				39 01 00 00 10 00 02 55 00
				];
		qcom,mdss-dsi-dispparam-cabcoff-command-state = "dsi_hs_mode";
	};
};
