/dts-v1/;

#include "tegra124-tn8.dtsi"
#include "tegra124-platforms/tegra124-tn8-emc-p1761-1470-a00.dtsi"
#include "tegra124-platforms/tegra124-tn8-pmic-e1936-1000-a00.dtsi"
#include "tegra124-platforms/tegra124-tn8-fixed-e1936-1000-a00.dtsi"
#include "tegra124-platforms/tegra124-tn8-sensor-p1761-1470-a00.dtsi"
#include "tegra124-platforms/tegra124-tn8-pinmux-p1761-1470-a00.dtsi"
#include "tegra124-platforms/tegra124-tn8-gpio-p1761-1470-a00.dtsi"
#include "tegra124-platforms/tegra124-tn8-keys-e1780-1100-a02.dtsi"

/ {
	model = "NVIDIA Tegra124 TN8 FFD";
	compatible = "nvidia,tn8", "nvidia,tegra124";
	nvidia,dtsfilename = __FILE__;
	nvidia,boardids = "1761:1470:0";
	#address-cells = <1>;
	#size-cells = <1>;

	chosen {
		bootargs = "tegraid=40.0.0.00.00 vmalloc=256M video=tegrafb console=ttyS0,115200n8 earlyprintk";
		linux,initrd-start = <0x85000000>;
		linux,initrd-end = <0x851bc400>;
	};

};

