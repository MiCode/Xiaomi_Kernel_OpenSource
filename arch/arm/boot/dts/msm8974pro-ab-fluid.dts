/* Copyright (c) 2013, The Linux Foundation. All rights reserved.
 *
 * This program is free software; you can redistribute it and/or modify
 * it under the terms of the GNU General Public License version 2 and
 * only version 2 as published by the Free Software Foundation.
 *
 * This program is distributed in the hope that it will be useful,
 * but WITHOUT ANY WARRANTY; without even the implied warranty of
 * MERCHANTABILITY or FITNESS FOR A PARTICULAR PURPOSE.  See the
 * GNU General Public License for more details.
 */

/dts-v1/;

/include/ "msm8974pro-ab.dtsi"
/include/ "msm8974-fluid.dtsi"

/ {
	model = "Qualcomm MSM 8974Pro FLUID";
	compatible = "qcom,msm8974-fluid", "qcom,msm8974", "qcom,fluid";
	qcom,msm-id = <209 3 0x10000>,
		      <211 3 0x10000>,
		      <212 3 0x10000>,
		      <214 3 0x10000>,
		      <215 3 0x10000>,
		      <217 3 0x10000>,
		      <218 3 0x10000>;
};
