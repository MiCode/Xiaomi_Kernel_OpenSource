/* Copyright (c) 2013, The Linux Foundation. All rights reserved.
 *
 * This program is free software; you can redistribute it and/or modify
 * it under the terms of the GNU General Public License version 2 and
 * only version 2 as published by the Free Software Foundation.
 *
 * This program is distributed in the hope that it will be useful,
 * but WITHOUT ANY WARRANTY; without even the implied warranty of
 * MERCHANTABILITY or FITNESS FOR A PARTICULAR PURPOSE.  See the
 * GNU General Public License for more details.
 */

qcom,qrd-4v35-2500mAh-data {
	qcom,fcc-mah = <2500>;
	qcom,default-rbatt-mohm = <198>;
	qcom,rbatt-capacitive-mohm = <0>;
	qcom,flat-ocv-threshold-uv = <3800000>;
	qcom,max-voltage-uv = <4350000>;
	qcom,v-cutoff-uv = <3400000>;
	qcom,chg-term-ua = <100000>;
	qcom,batt-id-kohm = <470>;

	qcom,rbatt-sf-lut {
		qcom,lut-col-legend = <(-20) 0 25 40 60>;
		qcom,lut-row-legend = <100 95 90 85 80>,
				<75 70 65 60 55>,
				<50 45 40 35 30>,
				<25 20 15 10 9>,
				<8 7 6 5 4>,
				<3 2 1 0>;
		qcom,lut-data = <1809 428 100 64 57>,
				<1805 428 100 64 57>,
				<1674 443 103 65 57>,
				<1611 447 108 66 58>,
				<1407 474 113 69 59>,
				<1379 462 122 74 61>,
				<1335 381 124 74 63>,
				<1346 388 135 79 66>,
				<1410 382 123 82 68>,
				<1479 372 101 68 60>,
				<1542 363 100 66 59>,
				<1605 368 101 66 60>,
				<1665 406 102 68 61>,
				<1722 460 103 70 61>,
				<1779 525 103 68 61>,
				<1840 593 104 66 59>,
				<1914 669 104 65 58>,
				<2016 779 104 65 59>,
				<1955 827 107 67 60>,
				<2006 855 112 69 61>,
				<2057 882 116 71 63>,
				<2103 925 123 72 66>,
				<2162 955 128 73 62>,
				<2218 991 123 69 61>,
				<2286 1035 122 69 62>,
				<2382 1083 130 72 65>,
				<2780 1158 153 83 81>,
				<5073 1464 724 393 147>,
				<46882 49515 42109 55595 11697>;
	};

	qcom,fcc-temp-lut {
		qcom,lut-col-legend = <(-20) 0 25 40 60>;
		qcom,lut-data = <2578 2580 2590 2584 2573>;
	};

	qcom,pc-temp-ocv-lut {
		qcom,lut-col-legend = <(-20) 0 25 40 60>;
		qcom,lut-row-legend = <100 95 90 85 80>,
				<75 70 65 60 55>,
				<50 45 40 35 30>,
				<25 20 15 10 9>,
				<8 7 6 5 4>,
				<3 2 1 0>;
		qcom,lut-data = <4326 4323 4321 4319 4311>,
				<4192 4235 4253 4254 4249>,
				<4110 4175 4198 4199 4194>,
				<4058 4121 4146 4146 4141>,
				<3952 4076 4096 4096 4091>,
				<3906 4017 4052 4048 4043>,
				<3859 3942 3990 3997 3999>,
				<3828 3905 3954 3962 3959>,
				<3813 3869 3911 3918 3916>,
				<3799 3836 3866 3870 3868>,
				<3786 3808 3837 3840 3840>,
				<3772 3788 3815 3818 3817>,
				<3758 3777 3796 3799 3798>,
				<3743 3765 3780 3783 3781>,
				<3726 3751 3767 3767 3761>,
				<3707 3733 3753 3749 3736>,
				<3684 3713 3731 3727 3713>,
				<3654 3697 3699 3697 3685>,
				<3616 3678 3683 3680 3669>,
				<3605 3673 3682 3679 3667>,
				<3594 3667 3680 3678 3666>,
				<3578 3660 3676 3675 3662>,
				<3561 3647 3666 3667 3647>,
				<3541 3628 3637 3640 3610>,
				<3514 3598 3586 3590 3556>,
				<3478 3550 3515 3523 3485>,
				<3425 3476 3414 3429 3387>,
				<3330 3350 3272 3276 3222>,
				<3000 3000 3000 3000 3000>;
	};
};
