/*
 * Copyright (c) 2012, The Linux Foundation. All rights reserved.
 *
 * This program is free software; you can redistribute it and/or modify
 * it under the terms of the GNU General Public License version 2 and
 * only version 2 as published by the Free Software Foundation.
 *
 * This program is distributed in the hope that it will be useful,
 * but WITHOUT ANY WARRANTY; without even the implied warranty of
 * MERCHANTABILITY or FITNESS FOR A PARTICULAR PURPOSE.  See the
 * GNU General Public License for more details.
 */

&cci {

	qcom,camera@6e {
		compatible = "qcom,s5k3l1yx";
		reg = <0x6e 0x0>;
		qcom,csi-if = <1>;
		qcom,csid-core = <0>;
		qcom,flash-src-index = <&led_flash0>;
		qcom,mount-angle = <90>;
		qcom,sensor-name = "s5k3l1yx";
		cam_vdig-supply = <&pm8941_l3>;
		cam_vana-supply = <&pm8941_l17>;
		cam_vio-supply = <&pm8941_lvs3>;
		cam_vaf-supply = <&pm8941_l23>;
		qcom,cam-vreg-name = "cam_vdig", "cam_vana", "cam_vio",
				     "cam_vaf";
		qcom,cam-vreg-type = <0 0 1 0>;
		qcom,cam-vreg-min-voltage = <1225000 2850000 0 3000000>;
		qcom,cam-vreg-max-voltage = <1225000 2850000 0 3000000>;
		qcom,cam-vreg-op-mode = <105000 80000 0 100000>;
		qcom,gpio-no-mux = <0>;
		gpios = <&msmgpio 15 0>,
			<&msmgpio 19 0>,
			<&msmgpio 20 0>,
			<&msmgpio 90 0>;
		qcom,gpio-common-tbl-num = <0 1 2>;
		qcom,gpio-common-tbl-flags = <1 1 1>;
		qcom,gpio-common-tbl-label = "CAMIF_MCLK",
					     "CAMIF_I2C_DATA",
					     "CAMIF_I2C_CLK";
		qcom,gpio-req-tbl-num = <3>;
		qcom,gpio-req-tbl-flags = <0>;
		qcom,gpio-req-tbl-label = "CAM_RESET1";
		qcom,gpio-set-tbl-num = <3 3>;
		qcom,gpio-set-tbl-flags = <0 2>;
		qcom,gpio-set-tbl-delay = <1000 30000>;
		qcom,csi-lane-assign = <0x4320>;
		qcom,csi-lane-mask = <0x1F>;
		qcom,csi-phy-sel = <0>;
		qcom,camera-type = <0>;
		qcom,sensor-type = <0>;
		status = "ok";
	};

	qcom,camera@6c {
		compatible = "qcom,ov2720";
		reg = <0x6c 0x0>;
		qcom,csi-if = <1>;
		qcom,csid-core = <0>;
		qcom,mount-angle = <180>;
		qcom,sensor-name = "ov2720";
		cam_vdig-supply = <&pm8941_l3>;
		cam_vana-supply = <&pm8941_l17>;
		cam_vio-supply = <&pm8941_lvs3>;
		qcom,cam-vreg-name = "cam_vdig", "cam_vana", "cam_vio";
		qcom,cam-vreg-type = <0 0 1>;
		qcom,cam-vreg-min-voltage = <1225000 2850000 0>;
		qcom,cam-vreg-max-voltage = <1225000 2850000 0>;
		qcom,cam-vreg-op-mode = <105000 80000 0>;
		qcom,gpio-no-mux = <0>;
		gpios = <&msmgpio 17 0>,
			<&msmgpio 19 0>,
			<&msmgpio 20 0>,
			<&msmgpio 18 0>;
		qcom,gpio-common-tbl-num = <0 1 2>;
		qcom,gpio-common-tbl-flags = <1 1 1>;
		qcom,gpio-common-tbl-label = "CAMIF_MCLK",
					     "CAMIF_I2C_DATA",
					     "CAMIF_I2C_CLK";
		qcom,gpio-req-tbl-num = <3>;
		qcom,gpio-req-tbl-flags = <0>;
		qcom,gpio-req-tbl-label = "CAM_RESET1";
		qcom,gpio-set-tbl-num = <3 3>;
		qcom,gpio-set-tbl-flags = <0 2>;
		qcom,gpio-set-tbl-delay = <1000 4000>;
		qcom,csi-lane-assign = <0x4320>;
		qcom,csi-lane-mask = <0x7>;
		qcom,csi-phy-sel = <2>;
		qcom,camera-type = <1>;
		qcom,sensor-type = <0>;
		status = "ok";
	};
};
