/* Copyright (c) 2012-2013, The Linux Foundation. All rights reserved.
 *
 * This program is free software; you can redistribute it and/or modify
 * it under the terms of the GNU General Public License version 2 and
 * only version 2 as published by the Free Software Foundation.
 *
 * This program is distributed in the hope that it will be useful,
 * but WITHOUT ANY WARRANTY; without even the implied warranty of
 * MERCHANTABILITY or FITNESS FOR A PARTICULAR PURPOSE.  See the
 * GNU General Public License for more details.
 */

/dts-v1/;

/include/ "msm9625-v1.dtsi"
/include/ "msm9625-cdp.dtsi"

/ {
	model = "Qualcomm MSM 9625V1 CDP";
	compatible = "qcom,msm9625-cdp", "qcom,msm9625", "qcom,cdp";
	qcom,msm-id = <134 1 0>, <152 1 0>, <149 1 0>, <150 1 0>,
		      <151 1 0>, <148 1 0>, <173 1 0>, <174 1 0>,
		      <175 1 0>;
};
