/* Copyright (c) 2013, The Linux Foundation. All rights reserved.
 * Copyright (C) 2015 XiaoMi, Inc.
 *
 * This program is free software; you can redistribute it and/or modify
 * it under the terms of the GNU General Public License version 2 and
 * only version 2 as published by the Free Software Foundation.
 *
 * This program is distributed in the hope that it will be useful,
 * but WITHOUT ANY WARRANTY; without even the implied warranty of
 * MERCHANTABILITY or FITNESS FOR A PARTICULAR PURPOSE.  See the
 * GNU General Public License for more details.
 */

qcom,h2a-4v35-SAMSUNG {
	qcom,fcc-mah = <2050>;
	qcom,default-rbatt-mohm = <181>;
	qcom,rbatt-capacitive-mohm = <0>;
	qcom,flat-ocv-threshold-uv = <3800000>;
	qcom,max-voltage-uv = <4350000>;
	qcom,v-cutoff-uv = <3400000>;
	qcom,chg-term-ua = <100000>;
	qcom,batt-id-kohm = <17>;

	qcom,rbatt-sf-lut {
		qcom,lut-col-legend = <(-20) (-10) 0 5 10 15 20 25 30 40 60>;
		qcom,lut-row-legend = <100 95 90 85 80>,
				<75 70 65 60 55>,
				<50 45 40 35 30>,
				<25 20 16 13 11>,
				<10 9 8 7 6>,
				<5 4 3 2 1>;
		qcom,lut-data = <967 366 198 156 132 117 106 100 95 86 76>,
				<966 366 198 156 132 117 106 100 95 86 76>,
				<919 370 207 164 137 120 108 102 96 88 77>,
				<860 362 215 171 143 124 112 104 98 90 78>,
				<866 348 220 179 149 130 117 108 102 92 79>,
				<791 372 225 190 160 139 123 114 106 95 81>,
				<753 325 196 179 159 141 126 116 108 96 83>,
				<760 325 188 162 155 145 134 124 116 102 86>,
				<756 334 191 156 137 127 121 118 113 103 88>,
				<757 334 187 151 129 116 107 101 97 90 78>,
				<778 335 188 151 129 116 106 100 96 89 78>,
				<822 335 190 154 131 117 107 102 97 91 80>,
				<877 337 193 156 134 120 111 104 100 93 83>,
				<934 348 196 159 137 123 114 107 103 96 85>,
				<994 366 203 164 139 125 117 109 103 93 82>,
				<1059 398 211 170 145 127 116 107 101 91 80>,
				<1125 446 212 170 144 125 112 104 98 90 79>,
				<1170 496 209 162 135 119 108 101 96 88 77>,
				<1153 517 212 158 130 114 104 98 93 86 77>,
				<1065 481 209 156 129 114 104 99 95 88 79>,
				<1098 493 215 159 131 116 106 101 97 90 80>,
				<1129 509 222 165 135 119 110 103 98 92 82>,
				<1211 528 232 171 139 123 113 107 101 93 85>,
				<1302 547 241 179 146 128 117 109 104 97 89>,
				<1413 566 252 187 151 133 120 113 107 100 86>,
				<1533 585 256 190 153 131 118 108 102 93 81>,
				<1670 609 253 180 143 122 111 104 98 91 81>,
				<1901 642 260 184 146 125 113 107 101 95 85>,
				<2234 698 286 200 156 134 120 113 107 100 90>,
				<4035 1010 436 381 392 390 409 503 699 530 119>;
	};

	qcom,fcc-temp-lut {
		qcom,lut-col-legend = <(-20) (-10) 0 5 10 15 20 25 30 40 60>;
		qcom,lut-data = <2097 2098 2097 2097 2096 2096 2095 2095 2094 2093 2086>;
	};

	qcom,pc-temp-ocv-lut {
		qcom,lut-col-legend = <(-20) (-10) 0 5 10 15 20 25 30 40 60>;
		qcom,lut-row-legend = <100 95 90 85 80>,
				<75 70 65 60 55>,
				<50 45 40 35 30>,
				<25 20 16 13 11>,
				<10 9 8 7 6>,
				<5 4 3 2 1>,
				<0>;
		qcom,lut-data = 								<4328 4329 4328 4328 4327 4327 4326 4325 4324 4320 4314>,
				<4232 4254 4260 4261 4262 4263 4262 4262 4262 4260 4255>,
				<4163 4196 4206 4207 4208 4208 4208 4208 4207 4205 4201>,
				<4093 4139 4155 4156 4157 4156 4156 4155 4155 4153 4149>,
				<4060 4081 4105 4107 4107 4107 4106 4105 4104 4102 4098>,
				<3980 4039 4061 4067 4067 4066 4065 4063 4060 4055 4050>,
				<3917 3954 3971 3987 3994 3997 4000 4001 4002 4005 4006>,
				<3886 3914 3925 3934 3949 3956 3961 3965 3967 3968 3966>,
				<3851 3888 3899 3902 3907 3911 3916 3920 3922 3923 3921>,
				<3817 3859 3868 3869 3870 3871 3872 3873 3873 3874 3873>,
				<3793 3831 3840 3842 3843 3843 3844 3844 3844 3845 3844>,
				<3779 3807 3817 3819 3820 3821 3821 3821 3821 3822 3821>,
				<3767 3785 3798 3800 3802 3802 3803 3803 3803 3803 3802>,
				<3755 3769 3782 3785 3786 3787 3788 3787 3787 3786 3784>,
				<3744 3753 3771 3774 3774 3775 3775 3774 3773 3769 3763>,
				<3733 3738 3758 3762 3764 3763 3762 3760 3757 3751 3738>,
				<3720 3726 3737 3741 3744 3743 3741 3739 3735 3728 3714>,
				<3707 3717 3715 3716 3716 3715 3713 3710 3707 3701 3686>,
				<3693 3711 3704 3702 3699 3697 3694 3692 3689 3683 3671>,
				<3682 3704 3700 3698 3696 3694 3692 3689 3687 3681 3669>,
				<3675 3700 3698 3696 3695 3693 3691 3689 3686 3681 3668>,
				<3666 3695 3696 3695 3693 3692 3690 3688 3685 3680 3667>,
				<3657 3690 3694 3693 3692 3691 3689 3687 3684 3678 3666>,
				<3644 3684 3691 3691 3690 3689 3687 3685 3682 3676 3663>,
				<3631 3674 3685 3686 3686 3685 3682 3680 3676 3669 3650>,
				<3612 3657 3671 3672 3671 3668 3665 3661 3656 3645 3616>,
				<3584 3627 3636 3634 3631 3626 3622 3617 3611 3598 3565>,
				<3544 3578 3579 3575 3571 3566 3561 3555 3550 3535 3500>,
				<3478 3502 3497 3493 3488 3483 3478 3472 3466 3449 3407>,
				<3356 3376 3367 3361 3355 3347 3341 3334 3327 3308 3248>,
				<3000 3000 3000 3000 3000 3000 3000 3000 3000 3000 3000>;
	};
};
