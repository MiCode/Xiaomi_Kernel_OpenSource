/* Copyright (c) 2013, The Linux Foundation. All rights reserved.
 * Copyright (C) 2015 XiaoMi, Inc.
 *
 * This program is free software; you can redistribute it and/or modify
 * it under the terms of the GNU General Public License version 2 and
 * only version 2 as published by the Free Software Foundation.
 *
 * This program is distributed in the hope that it will be useful,
 * but WITHOUT ANY WARRANTY; without even the implied warranty of
 * MERCHANTABILITY or FITNESS FOR A PARTICULAR PURPOSE.  See the
 * GNU General Public License for more details.
 */

qcom,BM31-LG-2980mAh-data {
	qcom,fcc-mah = <2980>;
	qcom,default-rbatt-mohm = <150>;
	qcom,rbatt-capacitive-mohm = <0>;
	qcom,flat-ocv-threshold-uv = <3800000>;
	qcom,max-voltage-uv = <4350000>;
	qcom,v-cutoff-uv = <3400000>;
	qcom,chg-term-ua = <100000>;
	qcom,batt-id-kohm = <50>;
	xiaomi,batt-version = <3>;

	qcom,rbatt-sf-lut {
		qcom,lut-col-legend = <(-20) (-10) 0 5 10 15 20 25 30 40 60>;
		qcom,lut-row-legend = <100 95 90 85 80>,
				<75 70 65 60 55>,
				<50 45 40 35 30>,
				<25 20 16 13 11>,
				<10 9 8 7 6>,
				<5 4 3 2 1>;
		qcom,lut-data = <1324 620 278 204 156 129 110 100 91 83 76>,
				<1323 620 278 204 157 129 110 100 91 83 76>,
				<1265 630 288 211 163 135 117 104 96 86 78>,
				<1242 627 297 220 171 142 122 108 100 88 80>,
				<1214 646 302 227 179 148 128 114 103 92 82>,
				<1174 622 308 236 192 158 136 120 108 96 85>,
				<1187 609 293 224 192 163 141 124 113 99 87>,
				<1199 622 294 220 180 164 147 132 120 104 90>,
				<1220 628 296 218 172 146 140 130 120 106 92>,
				<1258 644 299 218 168 137 119 106 99 91 81>,
				<1307 672 306 221 170 138 118 105 96 86 79>,
				<1365 711 318 228 175 142 122 109 99 90 82>,
				<1433 757 340 240 181 147 126 112 103 93 84>,
				<1510 813 372 262 193 153 132 117 106 95 87>,
				<1591 875 409 290 214 165 138 122 109 94 86>,
				<1738 943 450 324 238 181 148 126 111 92 80>,
				<1953 1009 489 351 259 196 156 130 112 94 81>,
				<2120 1054 526 367 266 200 159 132 115 96 81>,
				<1875 1019 532 374 268 198 156 129 112 92 80>,
				<2033 1015 538 382 274 202 160 134 116 96 83>,
				<2174 1040 555 394 284 210 166 139 120 100 84>,
				<2354 1069 574 411 297 220 174 144 124 103 86>,
				<2568 1098 594 428 310 232 182 150 129 105 87>,
				<2847 1132 617 447 326 244 191 157 134 108 88>,
				<3188 1172 640 468 343 256 200 162 137 108 86>,
				<3624 1218 665 484 354 262 203 163 136 106 85>,
				<4210 1277 687 496 360 265 205 164 136 108 88>,
				<5007 1402 714 513 375 280 216 174 146 114 92>,
				<6188 1712 758 550 403 303 237 191 158 123 96>,
				<9667 2601 921 632 451 341 268 216 180 141 114>;
	};

	qcom,fcc-temp-lut {
		qcom,lut-col-legend = <(-20) (-10) 0 5 10 15 20 25 30 40 60>;
		qcom,lut-data = <2983 2972 2972 2970 2969 2966 2965 2963 2962 2960 2948>;
	};

	qcom,pc-temp-ocv-lut {
		qcom,lut-col-legend = <(-20) (-10) 0 5 10 15 20 25 30 40 60>;
		qcom,lut-row-legend = <100 95 90 85 80>,
				<75 70 65 60 55>,
				<50 45 40 35 30>,
				<25 20 16 13 11>,
				<10 9 8 7 6>,
				<5 4 3 2 1 0>;
		qcom,lut-data = <4319 4318 4318 4317 4317 4316 4315 4314 4313 4309 4301>,
				<4216 4229 4240 4243 4244 4245 4246 4246 4245 4244 4238>,
				<4144 4164 4180 4184 4187 4188 4189 4189 4189 4188 4183>,
				<4088 4101 4125 4130 4133 4135 4135 4136 4136 4135 4130>,
				<4025 4053 4071 4079 4082 4083 4084 4085 4084 4083 4079>,
				<3953 3991 4015 4026 4033 4035 4037 4037 4037 4036 4032>,
				<3909 3937 3961 3970 3983 3988 3990 3991 3992 3992 3988>,
				<3867 3896 3919 3927 3935 3946 3950 3952 3953 3953 3949>,
				<3834 3856 3880 3886 3891 3897 3906 3910 3911 3913 3910>,
				<3810 3823 3846 3852 3855 3857 3859 3860 3862 3863 3861>,
				<3789 3799 3817 3823 3827 3829 3830 3830 3831 3831 3830>,
				<3769 3782 3794 3800 3804 3806 3807 3808 3809 3810 3808>,
				<3750 3767 3779 3783 3786 3788 3789 3790 3790 3791 3789>,
				<3729 3751 3768 3773 3774 3774 3775 3776 3775 3775 3774>,
				<3706 3734 3755 3762 3765 3765 3765 3765 3764 3761 3756>,
				<3680 3716 3736 3746 3752 3753 3754 3753 3751 3746 3732>,
				<3651 3697 3710 3720 3727 3731 3732 3731 3729 3724 3710>,
				<3624 3681 3692 3695 3699 3701 3702 3702 3700 3695 3681>,
				<3603 3669 3681 3682 3682 3682 3681 3679 3677 3672 3662>,
				<3584 3659 3672 3675 3675 3676 3676 3675 3673 3669 3659>,
				<3572 3652 3668 3671 3672 3673 3673 3673 3672 3668 3657>,
				<3557 3643 3664 3667 3669 3670 3671 3671 3669 3666 3655>,
				<3539 3632 3658 3662 3665 3667 3667 3668 3666 3663 3652>,
				<3519 3617 3649 3656 3659 3662 3662 3663 3662 3658 3647>,
				<3494 3597 3635 3645 3649 3652 3653 3653 3652 3647 3632>,
				<3466 3571 3612 3623 3628 3630 3630 3629 3626 3618 3598>,
				<3431 3537 3575 3583 3587 3587 3586 3583 3580 3571 3549>,
				<3389 3486 3517 3523 3527 3527 3524 3522 3519 3509 3487>,
				<3327 3408 3433 3441 3445 3445 3443 3441 3437 3427 3403>,
				<3220 3282 3307 3317 3323 3324 3321 3318 3313 3298 3271>,
				<3000 3000 3000 3000 3000 3000 3000 3000 3000 3000 3000>;
	};
};
