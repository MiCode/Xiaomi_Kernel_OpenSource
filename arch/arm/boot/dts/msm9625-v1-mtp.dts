/* Copyright (c) 2012-2013, The Linux Foundation. All rights reserved.
 *
 * This program is free software; you can redistribute it and/or modify
 * it under the terms of the GNU General Public License version 2 and
 * only version 2 as published by the Free Software Foundation.
 *
 * This program is distributed in the hope that it will be useful,
 * but WITHOUT ANY WARRANTY; without even the implied warranty of
 * MERCHANTABILITY or FITNESS FOR A PARTICULAR PURPOSE.  See the
 * GNU General Public License for more details.
 */

/dts-v1/;

/include/ "msm9625-v1.dtsi"
/include/ "msm9625-mtp.dtsi"

/ {
	model = "Qualcomm MSM 9625V1 MTP";
	compatible = "qcom,msm9625-mtp", "qcom,msm9625", "qcom,mtp";
	qcom,msm-id = <134 7 0>, <152 7 0>, <149 7 0>, <150 7 0>,
		      <151 7 0>, <148 7 0>, <173 7 0>, <174 7 0>,
		      <175 7 0>;
};
