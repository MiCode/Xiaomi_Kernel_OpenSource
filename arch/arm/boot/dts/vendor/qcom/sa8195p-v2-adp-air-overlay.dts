/dts-v1/;
/plugin/;

#include "sa8195p-v2-adp-air.dtsi"
#include "display/sa8195p-adp-star-display-shd.dtsi"

/ {
	model = "ADP-AIR";
	compatible = "qcom,sa8195p-v2-adp-air", "qcom,sa8195p",
		"qcom,adp-air";
	qcom,msm-id = <405 0x20000>;
	qcom,board-id = <0x02010019 0>;
};

