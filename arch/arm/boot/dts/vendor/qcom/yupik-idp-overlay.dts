/dts-v1/;
/plugin/;

#include "yupik-idp.dtsi"

/ {
	model = "Qualcomm Technologies, Inc. Yupik IDP";
	compatible = "qcom,yupik-idp", "qcom,yupik", "qcom,idp";
	qcom,msm-id = <475 0x10000>, <515 0x10000>;
	qcom,board-id = <34 0>;
};
