/dts-v1/;

#include "lahaina-v2.dtsi"
#include "lahaina-mtp.dtsi"

/ {
	model = "Qualcomm Technologies, Inc. Lahaina V2 MTP";
	compatible = "qcom,lahaina-mtp", "qcom,lahaina", "qcom,mtp";
	qcom,board-id = <0x10008 0>;
};
