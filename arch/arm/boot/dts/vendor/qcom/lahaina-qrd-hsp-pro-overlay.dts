/dts-v1/;
/plugin/;

#include "lahaina-qrd-hsp-pro.dtsi"

/ {
	model = "Qualcomm Technologies, Inc. Lahaina QRD-HSP-PRO";
	compatible = "qcom,lahaina-qrd", "qcom,lahaina", "qcom,qrd";
	qcom,board-id = <0x201000B 0>;
};
