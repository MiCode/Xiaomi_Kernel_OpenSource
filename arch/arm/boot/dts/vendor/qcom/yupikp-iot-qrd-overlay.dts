/dts-v1/;
/plugin/;

#include "yupikp-iot-qrd.dtsi"

/ {
	model = "Qualcomm Technologies, Inc. YUPIKP-IOT QRD";
	compatible = "qcom,yupikp-iot-qrd", "qcom,yupikp-iot", "qcom,qrd";
	qcom,msm-id = <498 0x10000>;
	qcom,board-id = <0x1000B 0>;
};
