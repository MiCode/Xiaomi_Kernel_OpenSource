#include "sdx-audio-lpass-elite.dtsi"

&audio_apr {
	q6core: qcom,q6core-audio {
		compatible = "qcom,q6core-audio";
		#address-cells = <1>;
		#size-cells = <1>;
	};
};

&soc {
	snd_9335: sound-tasha {
		compatible = "qcom,mdm-audio-tasha";
		qcom,model = "sdx-tasha-i2s-snd-card";
		qcom,pri-mi2s-gpio = <&prim_master>;
		qcom,sec-mi2s-gpio = <&sec_master>;

		qcom,audio-routing =
			"RX_BIAS", "MCLK",
			"MADINPUT", "MCLK",
			"AMIC2", "Headset Mic",
			"Headset Mic", "MIC BIAS2",
			"AMIC3", "ANCRight Headset Mic",
			"ANCRight Headset Mic", "MIC BIAS2",
			"AMIC4", "ANCLeft Headset Mic",
			"ANCLeft Headset Mic", "MIC BIAS2",
			"AMIC5", "Handset Mic",
			"Handset Mic", "MIC BIAS3",
			"DMIC0", "Digital Mic0",
			"DMIC0", "MIC BIAS1",
			"DMIC1", "Digital Mic1",
			"DMIC1", "MIC BIAS1",
			"DMIC2", "Digital Mic2",
			"DMIC2", "MIC BIAS3",
			"DMIC3", "Digital Mic3",
			"DMIC3", "MIC BIAS3",
			"DMIC4", "Digital Mic4",
			"DMIC4", "MIC BIAS4",
			"DMIC5", "Digital Mic5",
			"DMIC5", "MIC BIAS4",
			"SpkrLeft IN", "SPK1 OUT";

		qcom,tasha-mclk-clk-freq = <12288000>;
		qcom,msm-mbhc-hphl-swh = <0>;
		qcom,msm-mbhc-gnd-swh = <0>;
		qcom,msm-mbhc-hs-mic-max-threshold-mv = <1700>;
		qcom,msm-mbhc-hs-mic-min-threshold-mv = <50>;

		asoc-platform = <&pcm0>, <&pcm1>, <&pcm2>, <&voip>, <&voice>,
				<&loopback>, <&hostless>, <&afe>, <&routing>,
				<&pcm_dtmf>, <&host_pcm>;
		asoc-platform-names = "msm-pcm-dsp.0", "msm-pcm-dsp.1",
				"msm-pcm-dsp.2",
				"msm-voip-dsp", "msm-pcm-voice",
				"msm-pcm-loopback", "msm-pcm-hostless",
				"msm-pcm-afe", "msm-pcm-routing",
				"msm-pcm-dtmf", "msm-voice-host-pcm";
		asoc-cpu = <&dai_pri_auxpcm>, <&mi2s_prim>, <&mi2s_sec>,
				<&dtmf_tx>,
				<&rx_capture_tx>, <&rx_playback_rx>,
				<&tx_capture_tx>, <&tx_playback_rx>,
				<&afe_pcm_rx>, <&afe_pcm_tx>, <&afe_proxy_rx>,
				<&afe_proxy_tx>, <&incall_record_rx>,
				<&incall_record_tx>, <&incall_music_rx>,
				<&dai_sec_auxpcm>;
		asoc-cpu-names = "msm-dai-q6-auxpcm.1",
				"msm-dai-q6-mi2s.0", "msm-dai-q6-mi2s.1",
				"msm-dai-stub-dev.4", "msm-dai-stub-dev.5",
				"msm-dai-stub-dev.6", "msm-dai-stub-dev.7",
				"msm-dai-stub-dev.8", "msm-dai-q6-dev.224",
				"msm-dai-q6-dev.225", "msm-dai-q6-dev.241",
				"msm-dai-q6-dev.240", "msm-dai-q6-dev.32771",
				"msm-dai-q6-dev.32772", "msm-dai-q6-dev.32773",
				"msm-dai-q6-auxpcm.2";
		asoc-codec = <&stub_codec>, <&wsa881x_211>;
		asoc-codec-names = "msm-stub-codec.1", "wsa-codec.1";
		qcom,wsa-max-devs = <1>;
		qcom,swr-num-dev = <1>;
		qcom,wsa-aux-dev-prefix = "SpkrLeft";
		qcom,wsa-devs = <&wsa881x_211>;
		qcom,msm_audio_ssr_devs = <&audio_apr>, <&q6core>, <&tasha_codec>;
	};
};
