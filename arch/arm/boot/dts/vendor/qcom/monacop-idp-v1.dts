/dts-v1/;

#include "monacop.dtsi"
#include "monaco-idp-v1.dtsi"

/ {
	model = "Qualcomm Technologies, Inc. MonacoP IDP V1.0";
	compatible = "qcom,monaco", "qcom,idp";
	qcom,board-id = <0x010022 0x0>;
};
