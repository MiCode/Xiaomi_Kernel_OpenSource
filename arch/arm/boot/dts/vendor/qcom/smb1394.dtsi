#include <dt-bindings/pinctrl/qcom,pmic-gpio.h>
#include <dt-bindings/interrupt-controller/irq.h>

smb1394: qcom,smb1394@34 {
	compatible = "qcom,i2c-pmic";
	reg = <0x34>;
	#address-cells = <1>;
	#size-cells = <0>;
	interrupt-controller;
	#interrupt-cells = <3>;
	qcom,periph-map = <0x6 0x26 0x27>;
	status = "disabled";

	smb1394_div2_cp_primary: qcom,div2_cp_pry {
		compatible = "qcom,smb1394-div2-cp-primary";
		#io-channel-cells = <1>;
		interrupts = <0x26 0x1 IRQ_TYPE_EDGE_RISING>,
			     <0x26 0x3 IRQ_TYPE_EDGE_RISING>,
			     <0x26 0x5 IRQ_TYPE_EDGE_RISING>,
			     <0x26 0x7 IRQ_TYPE_EDGE_RISING>,
			     <0x27 0x5 IRQ_TYPE_EDGE_RISING>,
			     <0x27 0x6 IRQ_TYPE_EDGE_RISING>,
			     <0x27 0x7 IRQ_TYPE_EDGE_RISING>;
		interrupt-names = "temp-shdwn",
				  "div2-irev",
				  "usbin-uv",
				  "usbin-ov",
				  "div2-ilim",
				  "div2-win-uv",
				  "div2-win-ov";
		qcom,div2-cp-min-ilim-ua = <1000000>;
		status = "disabled";
	};
};
