/dts-v1/;

#include "yupik.dtsi"
#include "yupik-idp.dtsi"

/ {
	model = "Qualcomm Technologies, Inc. Yupik IDP";
	compatible = "qcom,yupik-idp", "qcom,yupik", "qcom,idp";
	qcom,board-id = <34 0>;
};
