&mdss_mdp {
	dsi_nt36672e_fhd_plus_90hz_video: qcom,mdss_dsi_nt36672e_fhd_plus_90hz_video {
		qcom,mdss-dsi-panel-name =
			"nt36672e 90Hz fhd plus video mode panel with DSC";
		qcom,mdss-dsi-panel-type = "dsi_video_mode";
		qcom,dsi-ctrl-num = <0>;
		qcom,dsi-phy-num = <0>;
		qcom,mdss-dsi-virtual-channel-id = <0>;
		qcom,mdss-dsi-stream = <0>;
		qcom,mdss-dsi-bpp = <24>;
		qcom,mdss-dsi-border-color = <0>;
		qcom,mdss-dsi-traffic-mode = "burst_mode";
		qcom,mdss-dsi-bllp-power-mode;
		qcom,mdss-dsi-bllp-eof-power-mode;
		qcom,mdss-dsi-lane-0-state;
		qcom,mdss-dsi-lane-1-state;
		qcom,mdss-dsi-lane-2-state;
		qcom,mdss-dsi-lane-3-state;
		qcom,mdss-dsi-dma-trigger = "trigger_sw";
		qcom,mdss-dsi-mdp-trigger = "none";
		qcom,mdss-dsi-reset-sequence = <1 10>, <0 10>, <1 10>;
		qcom,mdss-dsi-tx-eot-append;
		qcom,adjust-timer-wakeup-ms = <1>;
		qcom,mdss-dsi-panel-hdr-enabled;
		qcom,mdss-dsi-panel-hdr-color-primaries = <39000 16000 33750
						 39800 13250 34450 7500 3000>;
		qcom,mdss-dsi-panel-peak-brightness = <6450000>;
		qcom,mdss-dsi-panel-blackness-level = <4961>;

		qcom,mdss-dsi-display-timings {
			timing@0 {
				qcom,mdss-dsi-panel-width = <1080>;
				qcom,mdss-dsi-panel-height = <2408>;
				qcom,mdss-dsi-h-front-porch = <76>;
				qcom,mdss-dsi-h-back-porch = <68>;
				qcom,mdss-dsi-h-pulse-width = <10>;
				qcom,mdss-dsi-h-sync-skew = <0>;
				qcom,mdss-dsi-v-back-porch = <10>;
				qcom,mdss-dsi-v-front-porch = <46>;
				qcom,mdss-dsi-v-pulse-width = <10>;
				qcom,mdss-dsi-panel-framerate = <90>;
				qcom,mdss-dsi-on-command = [
					39 01 00 00 00 00 02 FF 10
					39 01 00 00 00 00 02 FB 01
					39 01 00 00 00 00 02 B0 00
					39 01 00 00 00 00 02 C0 03
					39 01 00 00 00 00 11 C1 89 28 00 08 00 AA 02 0E 00 2B 00 07 0D B7 0C B7
					39 01 00 00 00 00 03 C2 1B A0

					39 01 00 00 00 00 02 FF 20
					39 01 00 00 00 00 02 FB 01
					39 01 00 00 00 00 02 01 66
					39 01 00 00 00 00 02 06 40
					39 01 00 00 00 00 02 07 38
					39 01 00 00 00 00 02 18 66
					39 01 00 00 00 00 02 1B 01
					39 01 00 00 00 00 02 5C 90
					39 01 00 00 00 00 02 5E AA
					39 01 00 00 00 00 02 69 91

					39 01 00 00 00 00 02 89 0D
					39 01 00 00 00 00 02 8A 0D
					39 01 00 00 00 00 02 8D 0D
					39 01 00 00 00 00 02 8E 0D
					39 01 00 00 00 00 02 8F 0D
					39 01 00 00 00 00 02 91 0D

					39 01 00 00 00 00 02 95 D1
					39 01 00 00 00 00 02 96 D1
					39 01 00 00 00 00 02 F2 65
					39 01 00 00 00 00 02 F3 64
					39 01 00 00 00 00 02 F4 65
					39 01 00 00 00 00 02 F5 64
					39 01 00 00 00 00 02 F6 65
					39 01 00 00 00 00 02 F7 64
					39 01 00 00 00 00 02 F8 65
					39 01 00 00 00 00 02 F9 64

					39 01 00 00 00 00 02 FF 24
					39 01 00 00 00 00 02 FB 01
					39 01 00 00 00 00 02 01 0F
					39 01 00 00 00 00 02 03 0C
					39 01 00 00 00 00 02 05 1D
					39 01 00 00 00 00 02 08 2F
					39 01 00 00 00 00 02 09 2E
					39 01 00 00 00 00 02 0A 2D
					39 01 00 00 00 00 02 0B 2C
					39 01 00 00 00 00 02 11 17
					39 01 00 00 00 00 02 12 13
					39 01 00 00 00 00 02 13 15
					39 01 00 00 00 00 02 15 14
					39 01 00 00 00 00 02 16 16
					39 01 00 00 00 00 02 17 18
					39 01 00 00 00 00 02 1B 01
					39 01 00 00 00 00 02 1D 1D
					39 01 00 00 00 00 02 20 2F
					39 01 00 00 00 00 02 21 2E
					39 01 00 00 00 00 02 22 2D
					39 01 00 00 00 00 02 23 2C
					39 01 00 00 00 00 02 29 17
					39 01 00 00 00 00 02 2A 13
					39 01 00 00 00 00 02 2B 15
					39 01 00 00 00 00 02 2F 14
					39 01 00 00 00 00 02 30 16
					39 01 00 00 00 00 02 31 18
					39 01 00 00 00 00 02 32 04
					39 01 00 00 00 00 02 34 10
					39 01 00 00 00 00 02 35 1F
					39 01 00 00 00 00 02 36 1F
					39 01 00 00 00 00 02 4D 19
					39 01 00 00 00 00 02 4E 45
					39 01 00 00 00 00 02 4F 45
					39 01 00 00 00 00 02 53 45
					39 01 00 00 00 00 02 71 30
					39 01 00 00 00 00 02 79 11
					39 01 00 00 00 00 02 7A 82
					39 01 00 00 00 00 02 7B 94
					39 01 00 00 00 00 02 7D 04
					39 01 00 00 00 00 02 80 04
					39 01 00 00 00 00 02 81 04
					39 01 00 00 00 00 02 82 13
					39 01 00 00 00 00 02 84 31
					39 01 00 00 00 00 02 85 00
					39 01 00 00 00 00 02 86 00
					39 01 00 00 00 00 02 87 00
					39 01 00 00 00 00 02 90 13
					39 01 00 00 00 00 02 92 31
					39 01 00 00 00 00 02 93 00
					39 01 00 00 00 00 02 94 00
					39 01 00 00 00 00 02 95 00
					39 01 00 00 00 00 02 9C F4
					39 01 00 00 00 00 02 9D 01
					39 01 00 00 00 00 02 A0 14
					39 01 00 00 00 00 02 A2 14
					39 01 00 00 00 00 02 A3 02
					39 01 00 00 00 00 02 A4 04
					39 01 00 00 00 00 02 A5 04
					39 01 00 00 00 00 02 C4 40
					39 01 00 00 00 00 02 C6 C0
					39 01 00 00 00 00 02 C9 00
					39 01 00 00 00 00 02 D9 80
					39 01 00 00 00 00 02 E9 02

					39 01 00 00 00 00 02 FF 25
					39 01 00 00 00 00 02 FB 01
					39 01 00 00 00 00 02 0F 1B
					39 01 00 00 00 00 02 19 E4
					39 01 00 00 00 00 02 21 40
					39 01 00 00 00 00 02 66 D8
					39 01 00 00 00 00 02 68 50
					39 01 00 00 00 00 02 69 10
					39 01 00 00 00 00 02 6B 00
					39 01 00 00 00 00 02 6D 0D
					39 01 00 00 00 00 02 6E 48
					39 01 00 00 00 00 02 72 41
					39 01 00 00 00 00 02 73 4A
					39 01 00 00 00 00 02 74 D0
					39 01 00 00 00 00 02 77 62
					39 01 00 00 00 00 02 79 7F
					39 01 00 00 00 00 02 7D 40
					39 01 00 00 00 00 02 7F 00
					39 01 00 00 00 00 02 80 04
					39 01 00 00 00 00 02 84 0D
					39 01 00 00 00 00 02 CF 80
					39 01 00 00 00 00 02 D6 80
					39 01 00 00 00 00 02 D7 80
					39 01 00 00 00 00 02 EF 20
					39 01 00 00 00 00 02 F0 84

					39 01 00 00 00 00 02 FF 26
					39 01 00 00 00 00 02 FB 01
					39 01 00 00 00 00 02 15 04
					39 01 00 00 00 00 02 81 14
					39 01 00 00 00 00 02 83 02
					39 01 00 00 00 00 02 84 03
					39 01 00 00 00 00 02 85 01
					39 01 00 00 00 00 02 86 03
					39 01 00 00 00 00 02 87 01
					39 01 00 00 00 00 02 88 06
					39 01 00 00 00 00 02 8A 1A
					39 01 00 00 00 00 02 8B 11
					39 01 00 00 00 00 02 8C 24
					39 01 00 00 00 00 02 8E 42
					39 01 00 00 00 00 02 8F 11
					39 01 00 00 00 00 02 90 11
					39 01 00 00 00 00 02 91 11
					39 01 00 00 00 00 02 9A 81
					39 01 00 00 00 00 02 9B 03
					39 01 00 00 00 00 02 9C 00
					39 01 00 00 00 00 02 9D 00
					39 01 00 00 00 00 02 9E 00

					39 01 00 00 00 00 02 FF 27
					39 01 00 00 00 00 02 FB 01
					39 01 00 00 00 00 02 01 68
					39 01 00 00 00 00 02 20 81
					39 01 00 00 00 00 02 21 EA
					39 01 00 00 00 00 02 25 82
					39 01 00 00 00 00 02 26 1F
					39 01 00 00 00 00 02 6E 00
					39 01 00 00 00 00 02 6F 00
					39 01 00 00 00 00 02 70 00
					39 01 00 00 00 00 02 71 00
					39 01 00 00 00 00 02 72 00
					39 01 00 00 00 00 02 75 00
					39 01 00 00 00 00 02 76 00
					39 01 00 00 00 00 02 77 00
					39 01 00 00 00 00 02 7D 09
					39 01 00 00 00 00 02 7E 67
					39 01 00 00 00 00 02 80 23
					39 01 00 00 00 00 02 82 09
					39 01 00 00 00 00 02 83 67
					39 01 00 00 00 00 02 88 01
					39 01 00 00 00 00 02 89 10
					39 01 00 00 00 00 02 A5 10
					39 01 00 00 00 00 02 A6 23
					39 01 00 00 00 00 02 A7 01
					39 01 00 00 00 00 02 B6 40
					39 01 00 00 00 00 02 E3 02
					39 01 00 00 00 00 02 E4 E0
					39 01 00 00 00 00 02 E5 01
					39 01 00 00 00 00 02 E6 70
					39 01 00 00 00 00 02 E9 03
					39 01 00 00 00 00 02 EA 2F
					39 01 00 00 00 00 02 EB 01
					39 01 00 00 00 00 02 EC 98

					39 01 00 00 00 00 02 FF 2A
					39 01 00 00 00 00 02 FB 01
					39 01 00 00 00 00 02 00 91
					39 01 00 00 00 00 02 03 20
					39 01 00 00 00 00 02 07 5A
					39 01 00 00 00 00 02 0A 70
					39 01 00 00 00 00 02 0D 40
					39 01 00 00 00 00 02 0E 02
					39 01 00 00 00 00 02 11 F0
					39 01 00 00 00 00 02 15 0F
					39 01 00 00 00 00 02 16 65
					39 01 00 00 00 00 02 19 0F
					39 01 00 00 00 00 02 1A 39
					39 01 00 00 00 00 02 1B 14
					39 01 00 00 00 00 02 1D 36
					39 01 00 00 00 00 02 1E 4F
					39 01 00 00 00 00 02 1F 4F
					39 01 00 00 00 00 02 20 4F
					39 01 00 00 00 00 02 28 E4
					39 01 00 00 00 00 02 29 17
					39 01 00 00 00 00 02 2A F5
					39 01 00 00 00 00 02 2D 06
					39 01 00 00 00 00 02 2F 04
					39 01 00 00 00 00 02 30 54
					39 01 00 00 00 00 02 33 04
					39 01 00 00 00 00 02 34 E6
					39 01 00 00 00 00 02 35 32
					39 01 00 00 00 00 02 36 02
					39 01 00 00 00 00 02 37 E1
					39 01 00 00 00 00 02 38 36
					39 01 00 00 00 00 02 39 FE
					39 01 00 00 00 00 02 3A 14
					39 01 00 00 00 00 02 46 40
					39 01 00 00 00 00 02 47 02
					39 01 00 00 00 00 02 4A F0
					39 01 00 00 00 00 02 4E 0F
					39 01 00 00 00 00 02 4F 65
					39 01 00 00 00 00 02 52 0F
					39 01 00 00 00 00 02 53 39
					39 01 00 00 00 00 02 54 14
					39 01 00 00 00 00 02 56 36
					39 01 00 00 00 00 02 57 7E
					39 01 00 00 00 00 02 58 7E
					39 01 00 00 00 00 02 59 7E
					39 01 00 00 00 00 02 60 80
					39 01 00 00 00 00 02 61 C9
					39 01 00 00 00 00 02 62 03
					39 01 00 00 00 00 02 63 FB
					39 01 00 00 00 00 02 64 03
					39 01 00 00 00 00 02 65 05
					39 01 00 00 00 00 02 66 01
					39 01 00 00 00 00 02 67 04
					39 01 00 00 00 00 02 68 91
					39 01 00 00 00 00 02 6A 19
					39 01 00 00 00 00 02 6B CB
					39 01 00 00 00 00 02 6C 20
					39 01 00 00 00 00 02 6D E5
					39 01 00 00 00 00 02 6E C8
					39 01 00 00 00 00 02 6F 22
					39 01 00 00 00 00 02 70 E3
					39 01 00 00 00 00 02 71 04
					39 01 00 00 00 00 02 7A 07
					39 01 00 00 00 00 02 7B 40
					39 01 00 00 00 00 02 7D 01
					39 01 00 00 00 00 02 7F 2C
					39 01 00 00 00 00 02 83 0F
					39 01 00 00 00 00 02 84 65
					39 01 00 00 00 00 02 87 0F
					39 01 00 00 00 00 02 88 39
					39 01 00 00 00 00 02 89 14
					39 01 00 00 00 00 02 8B 36
					39 01 00 00 00 00 02 8C 39
					39 01 00 00 00 00 02 8D 39
					39 01 00 00 00 00 02 8E 39
					39 01 00 00 00 00 02 95 80
					39 01 00 00 00 00 02 96 FD
					39 01 00 00 00 00 02 97 14
					39 01 00 00 00 00 02 98 B3
					39 01 00 00 00 00 02 99 01
					39 01 00 00 00 00 02 9A 08
					39 01 00 00 00 00 02 9B 02
					39 01 00 00 00 00 02 9C 4C
					39 01 00 00 00 00 02 9D BC
					39 01 00 00 00 00 02 9F AC
					39 01 00 00 00 00 02 A0 FF
					39 01 00 00 00 00 02 A2 44
					39 01 00 00 00 00 02 A3 78
					39 01 00 00 00 00 02 A4 F8
					39 01 00 00 00 00 02 A5 4A
					39 01 00 00 00 00 02 A6 72
					39 01 00 00 00 00 02 A7 4C

					39 01 00 00 00 00 02 FF 2C
					39 01 00 00 00 00 02 FB 01
					39 01 00 00 00 00 02 00 02
					39 01 00 00 00 00 02 01 02
					39 01 00 00 00 00 02 02 02
					39 01 00 00 00 00 02 03 16
					39 01 00 00 00 00 02 04 16
					39 01 00 00 00 00 02 05 16
					39 01 00 00 00 00 02 0D 1F
					39 01 00 00 00 00 02 0E 1F
					39 01 00 00 00 00 02 16 1B
					39 01 00 00 00 00 02 17 4B
					39 01 00 00 00 00 02 18 4B
					39 01 00 00 00 00 02 19 4B
					39 01 00 00 00 00 02 2A 03
					39 01 00 00 00 00 02 4D 16
					39 01 00 00 00 00 02 4E 02
					39 01 00 00 00 00 02 4F 2F
					39 01 00 00 00 00 02 53 02
					39 01 00 00 00 00 02 54 02
					39 01 00 00 00 00 02 55 02
					39 01 00 00 00 00 02 56 0E
					39 01 00 00 00 00 02 58 0E
					39 01 00 00 00 00 02 59 0E
					39 01 00 00 00 00 02 61 1F
					39 01 00 00 00 00 02 62 1F
					39 01 00 00 00 00 02 6A 14
					39 01 00 00 00 00 02 6B 34
					39 01 00 00 00 00 02 6C 34
					39 01 00 00 00 00 02 6D 34
					39 01 00 00 00 00 02 7E 03
					39 01 00 00 00 00 02 9D 0E
					39 01 00 00 00 00 02 9E 02
					39 01 00 00 00 00 02 9F 02

					39 01 00 00 00 00 02 FF 20
					39 01 00 00 00 00 02 FB 01
					39 01 00 00 00 00 11 B0 00 00 00 15 00 3F 00 5F 00 7E 00 97 00 AF 00 C3
					39 01 00 00 00 00 11 B1 00 D7 01 0A 01 32 01 6F 01 9E 01 E5 02 1D 02 1E
					39 01 00 00 00 00 11 B2 02 56 02 94 02 BC 02 F1 03 13 03 41 03 4F 03 5F
					39 01 00 00 00 00 0F B3 03 71 03 84 03 99 03 B0 03 CA 03 D7 00 00
					39 01 00 00 00 00 11 B4 00 00 00 17 00 46 00 69 00 8C 00 A5 00 BE 00 D1
					39 01 00 00 00 00 11 B5 00 E4 01 18 01 40 01 7C 01 AA 01 F0 02 27 02 28
					39 01 00 00 00 00 11 B6 02 5E 02 9B 02 C3 02 F6 03 18 03 45 03 54 03 63
					39 01 00 00 00 00 0F B7 03 75 03 87 03 9C 03 B2 03 CA 03 D7 00 00
					39 01 00 00 00 00 11 B8 00 00 00 18 00 49 00 6B 00 8E 00 A8 00 C1 00 D3
					39 01 00 00 00 00 11 B9 00 E5 01 18 01 3F 01 7B 01 A8 01 EC 02 24 02 26
					39 01 00 00 00 00 11 BA 02 5A 02 97 02 C0 02 F4 03 15 03 43 03 51 03 61
					39 01 00 00 00 00 0F BB 03 72 03 85 03 9A 03 B1 03 CA 03 D7 00 00

					39 01 00 00 00 00 02 C6 00
					39 01 00 00 00 00 02 C7 00
					39 01 00 00 00 00 02 C8 00
					39 01 00 00 00 00 02 C9 00
					39 01 00 00 00 00 02 CA 00

					39 01 00 00 00 00 02 CB 00
					39 01 00 00 00 00 02 CC 00
					39 01 00 00 00 00 02 CD 00
					39 01 00 00 00 00 02 CE 00
					39 01 00 00 00 00 02 CF 00

					39 01 00 00 00 00 02 D0 00
					39 01 00 00 00 00 02 D1 00
					39 01 00 00 00 00 02 D2 00
					39 01 00 00 00 00 02 D3 00
					39 01 00 00 00 00 02 D4 00

					39 01 00 00 00 00 02 D5 00
					39 01 00 00 00 00 02 D6 00
					39 01 00 00 00 00 02 D7 00
					39 01 00 00 00 00 02 D8 00
					39 01 00 00 00 00 02 D9 00

					39 01 00 00 00 00 02 DA 00
					39 01 00 00 00 00 02 DB 00
					39 01 00 00 00 00 02 DC 00
					39 01 00 00 00 00 02 DD 00
					39 01 00 00 00 00 02 DE 00

					39 01 00 00 00 00 02 DF 00
					39 01 00 00 00 00 02 E0 00
					39 01 00 00 00 00 02 E1 00
					39 01 00 00 00 00 02 E2 00
					39 01 00 00 00 00 02 E3 00

					39 01 00 00 00 00 02 E4 00
					39 01 00 00 00 00 02 E5 00
					39 01 00 00 00 00 02 E6 00
					39 01 00 00 00 00 02 E7 00
					39 01 00 00 00 00 02 E8 00
					39 01 00 00 00 00 02 E9 00


					39 01 00 00 00 00 02 FF 21
					39 01 00 00 00 00 02 FB 01
					39 01 00 00 00 00 11 B0 00 00 00 15 00 3F 00 5F 00 7E 00 97 00 AF 00 C3
					39 01 00 00 00 00 11 B1 00 D7 01 0A 01 32 01 6F 01 9E 01 E5 02 1D 02 1E
					39 01 00 00 00 00 11 B2 02 56 02 94 02 BC 02 F1 03 13 03 41 03 4F 03 5F
					39 01 00 00 00 00 0F B3 03 71 03 84 03 99 03 B0 03 CA 03 D7 00 00
					39 01 00 00 00 00 11 B4 00 00 00 17 00 46 00 69 00 8C 00 A5 00 BE 00 D1
					39 01 00 00 00 00 11 B5 00 E4 01 18 01 40 01 7C 01 AA 01 F0 02 27 02 28
					39 01 00 00 00 00 11 B6 02 5E 02 9B 02 C3 02 F6 03 18 03 45 03 54 03 63
					39 01 00 00 00 00 0F B7 03 75 03 87 03 9C 03 B2 03 CA 03 D7 00 00
					39 01 00 00 00 00 11 B8 00 00 00 18 00 49 00 6B 00 8E 00 A8 00 C1 00 D3
					39 01 00 00 00 00 11 B9 00 E5 01 18 01 3F 01 7B 01 A8 01 EC 02 24 02 26
					39 01 00 00 00 00 11 BA 02 5A 02 97 02 C0 02 F4 03 15 03 43 03 51 03 61
					39 01 00 00 00 00 0F BB 03 72 03 85 03 9A 03 B1 03 CA 03 D7 00 00

					39 01 00 00 00 00 02 FF E0
					39 01 00 00 00 00 02 FB 01
					39 01 00 00 00 00 02 35 82
					39 01 00 00 00 00 02 85 32

					39 01 00 00 00 00 02 FF F0
					39 01 00 00 00 00 02 FB 01
					39 01 00 00 00 00 02 1C 01
					39 01 00 00 00 00 02 33 01
					39 01 00 00 00 00 02 5A 00

					39 01 00 00 00 00 02 FF D0
					39 01 00 00 00 00 02 FB 01
					39 01 00 00 00 00 02 53 22
					39 01 00 00 00 00 02 54 02

					39 01 00 00 00 00 02 FF C0
					39 01 00 00 00 00 02 FB 01
					39 01 00 00 00 00 02 9C 11
					39 01 00 00 00 00 02 9D 11

					39 01 00 00 00 00 02 FF 2B
					39 01 00 00 00 00 02 FB 01
					39 01 00 00 00 00 02 B7 0A
					39 01 00 00 00 00 02 B8 1C
					39 01 00 00 00 00 02 C0 01

					39 01 00 00 00 00 02 FF 10
					39 01 00 00 00 00 02 35 01
					39 01 00 00 00 00 02 51 FF
					39 01 00 00 00 00 02 53 0C
					39 01 00 00 00 00 02 55 00
					05 01 00 00 78 00 01 11
					05 01 00 00 28 00 01 29
				];
				qcom,mdss-dsi-on-command-state = "dsi_lp_mode";
				qcom,mdss-dsi-off-command = [
					05 01 00 00 10 00 01 28
					05 01 00 00 32 00 01 10
				];
				qcom,mdss-dsi-off-command-state = "dsi_lp_mode";
				qcom,compression-mode = "dsc";
				qcom,mdss-dsc-slice-height = <8>;
				qcom,mdss-dsc-slice-width = <540>;
				qcom,mdss-dsc-slice-per-pkt = <1>;
				qcom,mdss-dsc-bit-per-component = <8>;
				qcom,mdss-dsc-bit-per-pixel = <8>;
				qcom,mdss-dsc-block-prediction-enable;
			};
		};
	};
};
