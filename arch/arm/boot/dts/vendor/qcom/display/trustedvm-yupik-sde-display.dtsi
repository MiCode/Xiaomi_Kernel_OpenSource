#include "yupik-sde-display-common.dtsi"

&sde_dsi {
	clocks = <&clock_cpucc BYTECLK_MUX_0_CLK>,
			 <&clock_cpucc PCLK_MUX_0_CLK>,
			 <&clock_cpucc CPHY_BYTECLK_SRC_0_CLK>,
			 <&clock_cpucc CPHY_PCLK_SRC_0_CLK>,
			 <&clock_cpucc BYTECLK_SRC_0_CLK>,
			 <&clock_cpucc PCLK_SRC_0_CLK>,
			 <&clock_cpucc SHADOW_BYTECLK_SRC_0_CLK>,
			 <&clock_cpucc SHADOW_PCLK_SRC_0_CLK>,
			 <&clock_cpucc SHADOW_CPHY_BYTECLK_SRC_0_CLK>,
			 <&clock_cpucc SHADOW_CPHY_PCLK_SRC_0_CLK>;
	clock-names = "mux_byte_clk0", "mux_pixel_clk0",
			"cphy_byte_clk0", "cphy_pixel_clk0",
			"src_byte_clk0", "src_pixel_clk0",
			"shadow_byte_clk0", "shadow_pixel_clk0",
			"shadow_cphybyte_clk0", "shadow_cphypixel_clk0";
	qcom,panel-te-source = <0>;
	qcom,dsi-default-panel = <&dsi_nt36672e_fhd_plus_120_video>;
};


&mdss_mdp {
	connectors = <&sde_dsi>;
};
