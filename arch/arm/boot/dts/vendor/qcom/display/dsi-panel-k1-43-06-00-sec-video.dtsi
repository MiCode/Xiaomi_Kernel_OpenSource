&mdss_mdp {
	dsi_k1_43_06_00_sec_video: qcom,mdss_dsi_k1_43_06_00_sec_video {
		qcom,mdss-dsi-panel-name = "xiaomi 43 06 00 cmd mode secondary dsi panel";
		qcom,mdss-dsi-panel-type = "dsi_video_mode";
		qcom,mdss-dsi-virtual-channel-id = <0>;
		qcom,mdss-dsi-stream = <0>;
		qcom,mdss-dsi-bpp = <24>;
		qcom,mdss-dsi-color-order = "rgb_swap_rgb";
		qcom,mdss-dsi-underflow-color = <0xff>;
		qcom,mdss-dsi-border-color = <0>;

		qcom,dsi-sec-ctrl-num = <1>;
		qcom,dsi-sec-phy-num = <1>;

		qcom,mdss-dsi-traffic-mode = "burst_mode";
		qcom,mdss-dsi-lane-map = "lane_map_0123";
		qcom,mdss-dsi-bllp-eof-power-mode;
		qcom,mdss-dsi-bllp-power-mode;
		qcom,mdss-dsi-lane-0-state;
		/*qcom,mdss-dsi-lane-1-state;*/
		/*qcom,mdss-dsi-lane-2-state;*/
		/*qcom,mdss-dsi-lane-3-state;*/
		qcom,mdss-dsi-dma-trigger = "trigger_sw";
		qcom,mdss-dsi-mdp-trigger = "none";
		qcom,mdss-dsi-reset-sequence = <1 1>, <0 1>, <1 15>;
		qcom,mdss-pan-physical-width-dimension = <109>;
		qcom,mdss-pan-physical-height-dimension = <256>;
		qcom,mdss-dsi-te-pin-select = <1>;
		qcom,mdss-dsi-wr-mem-start = <0x2c>;
		qcom,mdss-dsi-wr-mem-continue = <0x3c>;
		qcom,mdss-dsi-te-dcs-command = <1>;
		/*qcom,mdss-dsi-te-check-enable;*/
		//qcom,mdss-dsi-te-using-te-pin;
		//qcom,mdss-dsi-tx-eot-append;
		/*qcom,mdss-dsi-lp11-init;*/

		/*qcom,mdss-dsi-te-using-wd;*/

		qcom,mdss-dsi-panel-peak-brightness = <4200000>;
		qcom,mdss-dsi-panel-blackness-level = <3230>;

		qcom,bl-update-flag = "delay_until_first_frame";

		qcom,mdss-dsi-display-timings {
			timing@0{
				qcom,mdss-dsi-panel-framerate = <60>;
				qcom,mdss-dsi-panel-width = <126>;
				qcom,mdss-dsi-panel-height = <294>;
				qcom,mdss-dsi-h-front-porch = <16>;
				qcom,mdss-dsi-h-back-porch = <8>;
				qcom,mdss-dsi-h-pulse-width = <8>;
				qcom,mdss-dsi-h-sync-skew = <0>;
				qcom,mdss-dsi-v-back-porch = <32>;
				qcom,mdss-dsi-v-front-porch = <32>;
				qcom,mdss-dsi-v-pulse-width = <32>;
				qcom,mdss-dsi-h-sync-pulse = <0>;
				qcom,mdss-dsi-h-left-border = <0>;
				qcom,mdss-dsi-h-right-border = <0>;
				qcom,mdss-dsi-v-top-border = <0>;
				qcom,mdss-dsi-v-bottom-border = <0>;
				qcom,mdss-dsi-panel-clockrate = <88730000>;
				qcom,mdss-dsi-panel-jitter = <0x5 0x1>;
				/*qcom,mdss-mdp-transfer-time-us = <9500>;*/
				qcom,mdss-dsi-on-command = [
					15 01 00 00 00 00 02 FE 01
					15 01 00 00 00 00 02 04 20
					15 01 00 00 00 00 02 69 02
					15 01 00 00 00 00 02 6A 11
					15 01 00 00 00 00 02 6B 3D
					15 01 00 00 00 00 02 6E 00
					15 01 00 00 00 00 02 FE 00
					15 01 00 00 00 00 02 C4 00
					15 01 00 00 00 00 02 35 00
					39 01 00 00 00 00 05 2A 00 00 00 7D
					15 01 00 00 00 00 02 51 FF
					05 01 00 00 78 00 02 11 00  /* Sleep Out */
					05 01 00 00 1E 00 02 29 00  /* Display On */
					];
				qcom,mdss-dsi-off-command = [
					05 01 00 00 14 00 02 28 00
					05 01 00 00 78 00 02 10 00];
				qcom,mdss-dsi-on-command-state = "dsi_lp_mode";
				qcom,mdss-dsi-off-command-state = "dsi_lp_mode";
			};
		};
	};
};

