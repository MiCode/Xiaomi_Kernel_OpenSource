&mdss_mdp {
	dsi_nt36672e_fhd_plus_60_video: qcom,mdss_dsi_nt36672e_fhd_plus_60_video {
		qcom,mdss-dsi-panel-name =
			"nt36672e 60 Hz fhd plus video mode panel without DSC";
		qcom,mdss-dsi-panel-type = "dsi_video_mode";
		qcom,dsi-ctrl-num = <0>;
		qcom,dsi-phy-num = <0>;
		qcom,mdss-dsi-virtual-channel-id = <0>;
		qcom,mdss-dsi-stream = <0>;
		qcom,mdss-dsi-bpp = <24>;
		qcom,mdss-dsi-border-color = <0>;
		qcom,mdss-dsi-traffic-mode = "burst_mode";
		qcom,mdss-dsi-bllp-power-mode;
		qcom,mdss-dsi-bllp-eof-power-mode;
		qcom,mdss-dsi-lane-0-state;
		qcom,mdss-dsi-lane-1-state;
		qcom,mdss-dsi-lane-2-state;
		qcom,mdss-dsi-lane-3-state;
		qcom,mdss-dsi-dma-trigger = "trigger_sw";
		qcom,mdss-dsi-mdp-trigger = "none";
		qcom,mdss-dsi-reset-sequence = <1 10>, <0 10>, <1 10>;
		qcom,mdss-dsi-tx-eot-append;
		qcom,adjust-timer-wakeup-ms = <1>;
		qcom,mdss-dsi-panel-hdr-enabled;
		qcom,mdss-dsi-panel-hdr-color-primaries = <39000 16000 33750
						 39800 13250 34450 7500 3000>;
		qcom,mdss-dsi-panel-peak-brightness = <6450000>;
		qcom,mdss-dsi-panel-blackness-level = <4961>;

		qcom,mdss-dsi-display-timings {
			timing@0 {
				qcom,mdss-dsi-panel-width = <1080>;
				qcom,mdss-dsi-panel-height = <2408>;
				qcom,mdss-dsi-h-front-porch = <76>;
				qcom,mdss-dsi-h-back-porch = <56>;
				qcom,mdss-dsi-h-pulse-width = <12>;
				qcom,mdss-dsi-h-sync-skew = <0>;
				qcom,mdss-dsi-v-back-porch = <10>;
				qcom,mdss-dsi-v-front-porch = <46>;
				qcom,mdss-dsi-v-pulse-width = <10>;
				qcom,mdss-dsi-panel-framerate = <60>;
				qcom,mdss-dsi-on-command = [
					39 01 00 00 00 00 02 FF 10
					39 01 00 00 00 00 02 FB 01
					39 01 00 00 00 00 02 B0 00
					39 01 00 00 00 00 02 C0 00
					39 01 00 00 00 00 11 C1 89 28 00 08 00 AA 02 0E 00 2B 00 07 0D B7 0C B7
					39 01 00 00 00 00 03 C2 1B A0
					39 01 00 00 00 00 02 FF 20
					39 01 00 00 00 00 02 FB 01
					39 01 00 00 00 00 02 01 66
					39 01 00 00 00 00 02 06 40
					39 01 00 00 00 00 02 07 38
					39 01 00 00 00 00 02 2F 83
					39 01 00 00 00 00 02 69 91
					39 01 00 00 00 00 02 95 D1
					39 01 00 00 00 00 02 96 D1
					39 01 00 00 00 00 02 F2 64
					39 01 00 00 00 00 02 F3 54
					39 01 00 00 00 00 02 F4 64
					39 01 00 00 00 00 02 F5 54
					39 01 00 00 00 00 02 F6 64
					39 01 00 00 00 00 02 F7 54
					39 01 00 00 00 00 02 F8 64
					39 01 00 00 00 00 02 F9 54
					39 01 00 00 00 00 02 FF 24
					39 01 00 00 00 00 02 FB 01
					39 01 00 00 00 00 02 01 0F
					39 01 00 00 00 00 02 03 0C
					39 01 00 00 00 00 02 05 1D
					39 01 00 00 00 00 02 08 2F
					39 01 00 00 00 00 02 09 2E
					39 01 00 00 00 00 02 0A 2D
					39 01 00 00 00 00 02 0B 2C
					39 01 00 00 00 00 02 11 17
					39 01 00 00 00 00 02 12 13
					39 01 00 00 00 00 02 13 15
					39 01 00 00 00 00 02 15 14
					39 01 00 00 00 00 02 16 16
					39 01 00 00 00 00 02 17 18
					39 01 00 00 00 00 02 1B 01
					39 01 00 00 00 00 02 1D 1D
					39 01 00 00 00 00 02 20 2F
					39 01 00 00 00 00 02 21 2E
					39 01 00 00 00 00 02 22 2D
					39 01 00 00 00 00 02 23 2C
					39 01 00 00 00 00 02 29 17
					39 01 00 00 00 00 02 2A 13
					39 01 00 00 00 00 02 2B 15
					39 01 00 00 00 00 02 2F 14
					39 01 00 00 00 00 02 30 16
					39 01 00 00 00 00 02 31 18
					39 01 00 00 00 00 02 32 04
					39 01 00 00 00 00 02 34 10
					39 01 00 00 00 00 02 35 1F
					39 01 00 00 00 00 02 36 1F
					39 01 00 00 00 00 02 4D 14
					39 01 00 00 00 00 02 4E 36
					39 01 00 00 00 00 02 4F 36
					39 01 00 00 00 00 02 53 36
					39 01 00 00 00 00 02 71 30
					39 01 00 00 00 00 02 79 11
					39 01 00 00 00 00 02 7A 82
					39 01 00 00 00 00 02 7B 8F
					39 01 00 00 00 00 02 7D 04
					39 01 00 00 00 00 02 80 04
					39 01 00 00 00 00 02 81 04
					39 01 00 00 00 00 02 82 13
					39 01 00 00 00 00 02 84 31
					39 01 00 00 00 00 02 85 00
					39 01 00 00 00 00 02 86 00
					39 01 00 00 00 00 02 87 00
					39 01 00 00 00 00 02 90 13
					39 01 00 00 00 00 02 92 31
					39 01 00 00 00 00 02 93 00
					39 01 00 00 00 00 02 94 00
					39 01 00 00 00 00 02 95 00
					39 01 00 00 00 00 02 9C F4
					39 01 00 00 00 00 02 9D 01
					39 01 00 00 00 00 02 A0 0F
					39 01 00 00 00 00 02 A2 0F
					39 01 00 00 00 00 02 A3 02
					39 01 00 00 00 00 02 A4 04
					39 01 00 00 00 00 02 A5 04
					39 01 00 00 00 00 02 C6 C0
					39 01 00 00 00 00 02 C9 00
					39 01 00 00 00 00 02 D9 80
					39 01 00 00 00 00 02 E9 02
					39 01 00 00 00 00 02 FF 25
					39 01 00 00 00 00 02 FB 01
					39 01 00 00 00 00 02 18 22
					39 01 00 00 00 00 02 19 E4
					39 01 00 00 00 00 02 21 40
					39 01 00 00 00 00 02 66 D8
					39 01 00 00 00 00 02 68 50
					39 01 00 00 00 00 02 69 10
					39 01 00 00 00 00 02 6B 00
					39 01 00 00 00 00 02 6D 0D
					39 01 00 00 00 00 02 6E 48
					39 01 00 00 00 00 02 72 41
					39 01 00 00 00 00 02 73 4A
					39 01 00 00 00 00 02 74 D0
					39 01 00 00 00 00 02 77 62
					39 01 00 00 00 00 02 79 7E
					39 01 00 00 00 00 02 7D 03
					39 01 00 00 00 00 02 7E 15
					39 01 00 00 00 00 02 7F 00
					39 01 00 00 00 00 02 84 4D
					39 01 00 00 00 00 02 CF 80
					39 01 00 00 00 00 02 D6 80
					39 01 00 00 00 00 02 D7 80
					39 01 00 00 00 00 02 EF 20
					39 01 00 00 00 00 02 F0 84
					39 01 00 00 00 00 02 FF 26
					39 01 00 00 00 00 02 FB 01
					39 01 00 00 00 00 02 81 0F
					39 01 00 00 00 00 02 83 01
					39 01 00 00 00 00 02 84 03
					39 01 00 00 00 00 02 85 01
					39 01 00 00 00 00 02 86 03
					39 01 00 00 00 00 02 87 01
					39 01 00 00 00 00 02 88 05
					39 01 00 00 00 00 02 8A 1A
					39 01 00 00 00 00 02 8B 11
					39 01 00 00 00 00 02 8C 24
					39 01 00 00 00 00 02 8E 42
					39 01 00 00 00 00 02 8F 11
					39 01 00 00 00 00 02 90 11
					39 01 00 00 00 00 02 91 11
					39 01 00 00 00 00 02 9A 80
					39 01 00 00 00 00 02 9B 04
					39 01 00 00 00 00 02 9C 00
					39 01 00 00 00 00 02 9D 00
					39 01 00 00 00 00 02 9E 00
					39 01 00 00 00 00 02 FF 27
					39 01 00 00 00 00 02 FB 01
					39 01 00 00 00 00 02 01 68
					39 01 00 00 00 00 02 20 81
					39 01 00 00 00 00 02 21 6A
					39 01 00 00 00 00 02 25 81
					39 01 00 00 00 00 02 26 94
					39 01 00 00 00 00 02 6E 00
					39 01 00 00 00 00 02 6F 00
					39 01 00 00 00 00 02 70 00
					39 01 00 00 00 00 02 71 00
					39 01 00 00 00 00 02 72 00
					39 01 00 00 00 00 02 75 00
					39 01 00 00 00 00 02 76 00
					39 01 00 00 00 00 02 77 00
					39 01 00 00 00 00 02 7D 09
					39 01 00 00 00 00 02 7E 67
					39 01 00 00 00 00 02 80 23
					39 01 00 00 00 00 02 82 09
					39 01 00 00 00 00 02 83 67
					39 01 00 00 00 00 02 88 01
					39 01 00 00 00 00 02 89 10
					39 01 00 00 00 00 02 A5 10
					39 01 00 00 00 00 02 A6 23
					39 01 00 00 00 00 02 A7 01
					39 01 00 00 00 00 02 B6 40
					39 01 00 00 00 00 02 E5 02
					39 01 00 00 00 00 02 E6 D3
					39 01 00 00 00 00 02 EB 03
					39 01 00 00 00 00 02 EC 28
					39 01 00 00 00 00 02 FF 2A
					39 01 00 00 00 00 02 FB 01
					39 01 00 00 00 00 02 00 91
					39 01 00 00 00 00 02 03 20
					39 01 00 00 00 00 02 07 50
					39 01 00 00 00 00 02 0A 70
					39 01 00 00 00 00 02 0C 04
					39 01 00 00 00 00 02 0D 40
					39 01 00 00 00 00 02 0F 01
					39 01 00 00 00 00 02 11 E0
					39 01 00 00 00 00 02 15 0F
					39 01 00 00 00 00 02 16 A4
					39 01 00 00 00 00 02 19 0F
					39 01 00 00 00 00 02 1A 78
					39 01 00 00 00 00 02 1B 23
					39 01 00 00 00 00 02 1D 36
					39 01 00 00 00 00 02 1E 3E
					39 01 00 00 00 00 02 1F 3E
					39 01 00 00 00 00 02 20 3E
					39 01 00 00 00 00 02 28 FD
					39 01 00 00 00 00 02 29 12
					39 01 00 00 00 00 02 2A E1
					39 01 00 00 00 00 02 2D 0A
					39 01 00 00 00 00 02 30 49
					39 01 00 00 00 00 02 33 96
					39 01 00 00 00 00 02 34 FF
					39 01 00 00 00 00 02 35 40
					39 01 00 00 00 00 02 36 DE
					39 01 00 00 00 00 02 37 F9
					39 01 00 00 00 00 02 38 45
					39 01 00 00 00 00 02 39 D9
					39 01 00 00 00 00 02 3A 49
					39 01 00 00 00 00 02 4A F0
					39 01 00 00 00 00 02 7A 09
					39 01 00 00 00 00 02 7B 40
					39 01 00 00 00 00 02 7F F0
					39 01 00 00 00 00 02 83 0F
					39 01 00 00 00 00 02 84 A4
					39 01 00 00 00 00 02 87 0F
					39 01 00 00 00 00 02 88 78
					39 01 00 00 00 00 02 89 23
					39 01 00 00 00 00 02 8B 36
					39 01 00 00 00 00 02 8C 7D
					39 01 00 00 00 00 02 8D 7D
					39 01 00 00 00 00 02 8E 7D
					39 01 00 00 00 00 02 FF 20
					39 01 00 00 00 00 02 FB 01
					39 01 00 00 00 00 11 B0 00 00 00 17 00 49 00 6A 00 89 00 9F 00 B6 00 C8
					39 01 00 00 00 00 11 B1 00 D9 01 10 01 3A 01 7A 01 A9 01 F2 02 2D 02 2E
					39 01 00 00 00 00 11 B2 02 64 02 A3 02 CA 03 00 03 1E 03 4A 03 59 03 6A
					39 01 00 00 00 00 0F B3 03 7D 03 93 03 AB 03 C8 03 EC 03 FE 00 00
					39 01 00 00 00 00 11 B4 00 00 00 1B 00 51 00 71 00 90 00 A7 00 BF 00 D1
					39 01 00 00 00 00 11 B5 00 E2 01 1A 01 43 01 83 01 B2 01 FA 02 34 02 36
					39 01 00 00 00 00 11 B6 02 6B 02 A8 02 D0 03 03 03 21 03 4D 03 5B 03 6B
					39 01 00 00 00 00 0F B7 03 7E 03 94 03 AC 03 C8 03 EC 03 FE 00 00
					39 01 00 00 00 00 11 B8 00 00 00 1B 00 51 00 72 00 92 00 A8 00 BF 00 D1
					39 01 00 00 00 00 11 B9 00 E2 01 18 01 42 01 81 01 AF 01 F5 02 2F 02 31
					39 01 00 00 00 00 11 BA 02 68 02 A6 02 CD 03 01 03 1F 03 4A 03 59 03 6A
					39 01 00 00 00 00 0F BB 03 7D 03 93 03 AB 03 C8 03 EC 03 FE 00 00
					39 01 00 00 00 00 02 FF 21
					39 01 00 00 00 00 02 FB 01
					39 01 00 00 00 00 11 B0 00 00 00 17 00 49 00 6A 00 89 00 9F 00 B6 00 C8
					39 01 00 00 00 00 11 B1 00 D9 01 10 01 3A 01 7A 01 A9 01 F2 02 2D 02 2E
					39 01 00 00 00 00 11 B2 02 64 02 A3 02 CA 03 00 03 1E 03 4A 03 59 03 6A
					39 01 00 00 00 00 0F B3 03 7D 03 93 03 AB 03 C8 03 EC 03 FE 00 00
					39 01 00 00 00 00 11 B4 00 00 00 1B 00 51 00 71 00 90 00 A7 00 BF 00 D1
					39 01 00 00 00 00 11 B5 00 E2 01 1A 01 43 01 83 01 B2 01 FA 02 34 02 36
					39 01 00 00 00 00 11 B6 02 6B 02 A8 02 D0 03 03 03 21 03 4D 03 5B 03 6B
					39 01 00 00 00 00 0F B7 03 7E 03 94 03 AC 03 C8 03 EC 03 FE 00 00
					39 01 00 00 00 00 11 B8 00 00 00 1B 00 51 00 72 00 92 00 A8 00 BF 00 D1
					39 01 00 00 00 00 11 B9 00 E2 01 18 01 42 01 81 01 AF 01 F5 02 2F 02 31
					39 01 00 00 00 00 11 BA 02 68 02 A6 02 CD 03 01 03 1F 03 4A 03 59 03 6A
					39 01 00 00 00 00 0F BB 03 7D 03 93 03 AB 03 C8 03 EC 03 FE 00 00
					39 01 00 00 00 00 02 FF 2C
					39 01 00 00 00 00 02 FB 01
					39 01 00 00 00 00 02 61 1F
					39 01 00 00 00 00 02 62 1F
					39 01 00 00 00 00 02 7E 03
					39 01 00 00 00 00 02 6A 14
					39 01 00 00 00 00 02 6B 36
					39 01 00 00 00 00 02 6C 36
					39 01 00 00 00 00 02 6D 36
					39 01 00 00 00 00 02 53 04
					39 01 00 00 00 00 02 54 04
					39 01 00 00 00 00 02 55 04
					39 01 00 00 00 00 02 56 0F
					39 01 00 00 00 00 02 58 0F
					39 01 00 00 00 00 02 59 0F
					39 01 00 00 00 00 02 FF F0
					39 01 00 00 00 00 02 FB 01
					39 01 00 00 00 00 02 5A 00
					15 01 00 00 00 00 02 FF 10
					15 01 00 00 00 00 02 FB 01
					15 01 00 00 00 00 02 51 FF
					15 01 00 00 00 00 02 53 24
					15 01 00 00 00 00 02 55 01
					05 01 00 00 78 00 01 11
					05 01 00 00 64 00 01 29
				];
				qcom,mdss-dsi-on-command-state = "dsi_lp_mode";
				qcom,mdss-dsi-off-command = [
					05 01 00 00 10 00 01 28
					05 01 00 00 32 00 01 10
				];
			};
		};
	};
};
