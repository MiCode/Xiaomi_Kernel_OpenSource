&mdss_mdp {
	dsi_nt36672e_fhd_plus_144_video: qcom,mdss_dsi_nt36672e_fhd_plus_144_video {
		qcom,mdss-dsi-panel-name =
			"nt36672e fhd plus 144Hz video panel";
		qcom,mdss-dsi-panel-type = "dsi_video_mode";
		qcom,dsi-ctrl-num = <0>;
		qcom,dsi-phy-num = <0>;
		qcom,mdss-dsi-virtual-channel-id = <0>;
		qcom,mdss-dsi-stream = <0>;
		qcom,mdss-dsi-bpp = <24>;
		qcom,mdss-dsi-border-color = <0>;
		qcom,mdss-dsi-traffic-mode = "burst_mode";
		qcom,mdss-dsi-bllp-power-mode;
		qcom,mdss-dsi-bllp-eof-power-mode;
		qcom,mdss-dsi-lane-0-state;
		qcom,mdss-dsi-lane-1-state;
		qcom,mdss-dsi-lane-2-state;
		qcom,mdss-dsi-lane-3-state;
		qcom,mdss-dsi-dma-trigger = "trigger_sw";
		qcom,mdss-dsi-mdp-trigger = "none";
		qcom,mdss-dsi-reset-sequence = <1 10>, <0 10>, <1 10>;
		qcom,mdss-dsi-tx-eot-append;
		qcom,adjust-timer-wakeup-ms = <1>;
		qcom,mdss-dsi-panel-hdr-enabled;
		qcom,mdss-dsi-panel-hdr-color-primaries = <15000 16000 33750
						 15800 13250 34450 7500 3000>;
		qcom,mdss-dsi-panel-peak-brightness = <6450000>;
		qcom,mdss-dsi-panel-blackness-level = <4961>;

		qcom,mdss-dsi-display-timings {
			timing@0 {
				qcom,mdss-dsi-panel-width = <1080>;
				qcom,mdss-dsi-panel-height = <2408>;
				qcom,mdss-dsi-h-front-porch = <30>;
				qcom,mdss-dsi-h-back-porch = <36>;
				qcom,mdss-dsi-h-pulse-width = <20>;
				qcom,mdss-dsi-h-sync-skew = <0>;
				qcom,mdss-dsi-v-back-porch = <10>;
				qcom,mdss-dsi-v-front-porch = <46>;
				qcom,mdss-dsi-v-pulse-width = <10>;
				qcom,mdss-dsi-panel-framerate = <144>;
				qcom,mdss-dsi-on-command = [
					29 01 00 00 00 00 02 FF 10
					29 01 00 00 00 00 02 FB 01
					29 01 00 00 00 00 02 B0 00
					29 01 00 00 00 00 11 C1 89 28 00 08 00 AA 02 0E 00 2B 00 07 0D B7 0C B7
					29 01 00 00 00 00 03 C2 1B A0
					29 01 00 00 00 00 02 E9 01

					29 01 00 00 00 00 02 FF 20
					29 01 00 00 00 00 02 FB 01
					29 01 00 00 00 00 02 01 66
					29 01 00 00 00 00 02 06 40
					29 01 00 00 00 00 02 07 38
					29 01 00 00 00 00 02 1B 01
					29 01 00 00 00 00 02 2D 00
					29 01 00 00 00 00 02 2F 83
					29 01 00 00 00 00 02 69 91
					29 01 00 00 00 00 02 95 D1
					29 01 00 00 00 00 02 96 D1
					29 01 00 00 00 00 02 F2 64
					29 01 00 00 00 00 02 F4 64
					29 01 00 00 00 00 02 F6 64
					29 01 00 00 00 00 02 F8 64

					29 01 00 00 00 00 02 FF 23
					29 01 00 00 00 00 02 FB 01
					29 01 00 00 00 00 02 00 00
					29 01 00 00 00 00 02 04 05
					29 01 00 00 00 00 02 05 2D
					29 01 00 00 00 00 02 06 01
					29 01 00 00 00 00 02 07 60
					29 01 00 00 00 00 02 08 01
					29 01 00 00 00 00 02 09 C7
					29 01 00 00 00 00 02 11 01
					29 01 00 00 00 00 02 12 95
					29 01 00 00 00 00 02 15 68
					29 01 00 00 00 00 02 16 0B
					29 01 00 00 00 00 02 A0 00
					29 01 00 00 00 00 02 30 FF
					29 01 00 00 00 00 02 31 F0
					29 01 00 00 00 00 02 32 EB
					29 01 00 00 00 00 02 33 E5
					29 01 00 00 00 00 02 34 DD
					29 01 00 00 00 00 02 35 DA
					29 01 00 00 00 00 02 36 D5
					29 01 00 00 00 00 02 37 D0
					29 01 00 00 00 00 02 38 CE
					29 01 00 00 00 00 02 39 CD
					29 01 00 00 00 00 02 3A CD
					29 01 00 00 00 00 02 3B CD
					29 01 00 00 00 00 02 3D CB
					29 01 00 00 00 00 02 3F CB
					29 01 00 00 00 00 02 40 C6
					29 01 00 00 00 00 02 41 BF
					29 01 00 00 00 00 02 45 FF
					29 01 00 00 00 00 02 46 F0
					29 01 00 00 00 00 02 47 E8
					29 01 00 00 00 00 02 48 CE
					29 01 00 00 00 00 02 49 BC
					29 01 00 00 00 00 02 4A B8
					29 01 00 00 00 00 02 4B B5
					29 01 00 00 00 00 02 4C B0
					29 01 00 00 00 00 02 4D A8
					29 01 00 00 00 00 02 4E A0
					29 01 00 00 00 00 02 4F 9B
					29 01 00 00 00 00 02 50 98
					29 01 00 00 00 00 02 51 98
					29 01 00 00 00 00 02 52 88
					29 01 00 00 00 00 02 53 80
					29 01 00 00 00 00 02 54 7F
					29 01 00 00 00 00 02 58 FF
					29 01 00 00 00 00 02 59 F6
					29 01 00 00 00 00 02 5A ED
					29 01 00 00 00 00 02 5B E6
					29 01 00 00 00 00 02 5C DF
					29 01 00 00 00 00 02 5D D8
					29 01 00 00 00 00 02 5E D3
					29 01 00 00 00 00 02 5F CE
					29 01 00 00 00 00 02 60 C9
					29 01 00 00 00 00 02 61 C4
					29 01 00 00 00 00 02 62 C1
					29 01 00 00 00 00 02 63 BE
					29 01 00 00 00 00 02 64 BB
					29 01 00 00 00 00 02 65 B8
					29 01 00 00 00 00 02 66 B6
					29 01 00 00 00 00 02 67 B5

					29 01 00 00 00 00 02 FF 24
					29 01 00 00 00 00 02 FB 01
					29 01 00 00 00 00 02 01 0F
					29 01 00 00 00 00 02 03 0C
					29 01 00 00 00 00 02 05 1D
					29 01 00 00 00 00 02 08 2F
					29 01 00 00 00 00 02 09 2E
					29 01 00 00 00 00 02 0A 2D
					29 01 00 00 00 00 02 0B 2C
					29 01 00 00 00 00 02 11 17
					29 01 00 00 00 00 02 12 13
					29 01 00 00 00 00 02 13 15
					29 01 00 00 00 00 02 15 14
					29 01 00 00 00 00 02 16 16
					29 01 00 00 00 00 02 17 18
					29 01 00 00 00 00 02 1B 01
					29 01 00 00 00 00 02 1D 1D
					29 01 00 00 00 00 02 20 2F
					29 01 00 00 00 00 02 21 2E
					29 01 00 00 00 00 02 22 2D
					29 01 00 00 00 00 02 23 2C
					29 01 00 00 00 00 02 29 17
					29 01 00 00 00 00 02 2A 13
					29 01 00 00 00 00 02 2B 15
					29 01 00 00 00 00 02 2F 14
					29 01 00 00 00 00 02 30 16
					29 01 00 00 00 00 02 31 18
					29 01 00 00 00 00 02 32 04
					29 01 00 00 00 00 02 34 10
					29 01 00 00 00 00 02 35 19
					29 01 00 00 00 00 02 36 19
					29 01 00 00 00 00 02 4D 11
					29 01 00 00 00 00 02 4E 2B
					29 01 00 00 00 00 02 4F 2B
					29 01 00 00 00 00 02 53 2B
					29 01 00 00 00 00 02 71 30
					29 01 00 00 00 00 02 79 11
					29 01 00 00 00 00 02 7A 82
					29 01 00 00 00 00 02 7B 8B
					29 01 00 00 00 00 02 7D 04
					29 01 00 00 00 00 02 80 04
					29 01 00 00 00 00 02 81 04
					29 01 00 00 00 00 02 82 13
					29 01 00 00 00 00 02 84 31
					29 01 00 00 00 00 02 85 00
					29 01 00 00 00 00 02 86 00
					29 01 00 00 00 00 02 87 00
					29 01 00 00 00 00 02 90 13
					29 01 00 00 00 00 02 92 31
					29 01 00 00 00 00 02 93 00
					29 01 00 00 00 00 02 94 00
					29 01 00 00 00 00 02 95 00
					29 01 00 00 00 00 02 9C F4
					29 01 00 00 00 00 02 9D 01
					29 01 00 00 00 00 02 A0 0B
					29 01 00 00 00 00 02 A2 0B
					29 01 00 00 00 00 02 A3 02
					29 01 00 00 00 00 02 A4 04
					29 01 00 00 00 00 02 A5 04
					29 01 00 00 00 00 02 C6 C0
					29 01 00 00 00 00 02 C9 00
					29 01 00 00 00 00 02 D9 80
					29 01 00 00 00 00 02 E9 02

					29 01 00 00 00 00 02 FF 25
					29 01 00 00 00 00 02 FB 01
					29 01 00 00 00 00 02 19 E4
					29 01 00 00 00 00 02 21 00
					29 01 00 00 00 00 02 66 D8
					29 01 00 00 00 00 02 68 50
					29 01 00 00 00 00 02 69 10
					29 01 00 00 00 00 02 6B 00
					29 01 00 00 00 00 02 6D 0D
					29 01 00 00 00 00 02 6E 48
					29 01 00 00 00 00 02 72 41
					29 01 00 00 00 00 02 73 4A
					29 01 00 00 00 00 02 74 D0
					29 01 00 00 00 00 02 77 62
					29 01 00 00 00 00 02 79 81
					29 01 00 00 00 00 02 7D 03
					29 01 00 00 00 00 02 7E 15
					29 01 00 00 00 00 02 7F 00
					29 01 00 00 00 00 02 84 4D
					29 01 00 00 00 00 02 CF 00
					29 01 00 00 00 00 02 D6 80
					29 01 00 00 00 00 02 D7 80
					29 01 00 00 00 00 02 EF 20
					29 01 00 00 00 00 02 F0 84

					29 01 00 00 00 00 02 FF 26
					29 01 00 00 00 00 02 FB 01
					29 01 00 00 00 00 02 80 05
					29 01 00 00 00 00 02 81 0B
					29 01 00 00 00 00 02 83 01
					29 01 00 00 00 00 02 84 03
					29 01 00 00 00 00 02 85 01
					29 01 00 00 00 00 02 86 03
					29 01 00 00 00 00 02 87 01
					29 01 00 00 00 00 02 88 06
					29 01 00 00 00 00 02 8A 1A
					29 01 00 00 00 00 02 8B 11
					29 01 00 00 00 00 02 8C 24
					29 01 00 00 00 00 02 8E 42
					29 01 00 00 00 00 02 8F 11
					29 01 00 00 00 00 02 90 11
					29 01 00 00 00 00 02 91 11
					29 01 00 00 00 00 02 9A 80
					29 01 00 00 00 00 02 9B 04
					29 01 00 00 00 00 02 9C 00
					29 01 00 00 00 00 02 9D 00
					29 01 00 00 00 00 02 9E 00

					29 01 00 00 00 00 02 FF 27
					29 01 00 00 00 00 02 FB 01
					29 01 00 00 00 00 02 01 68
					29 01 00 00 00 00 02 20 81
					29 01 00 00 00 00 02 21 30
					29 01 00 00 00 00 02 25 81
					29 01 00 00 00 00 02 26 67
					29 01 00 00 00 00 02 6E 00
					29 01 00 00 00 00 02 6F 00
					29 01 00 00 00 00 02 70 00
					29 01 00 00 00 00 02 71 00
					29 01 00 00 00 00 02 72 00
					29 01 00 00 00 00 02 75 00
					29 01 00 00 00 00 02 76 00
					29 01 00 00 00 00 02 77 00
					29 01 00 00 00 00 02 7D 09
					29 01 00 00 00 00 02 7E 67
					29 01 00 00 00 00 02 80 23
					29 01 00 00 00 00 02 82 09
					29 01 00 00 00 00 02 83 67
					29 01 00 00 00 00 02 88 01
					29 01 00 00 00 00 02 89 10
					29 01 00 00 00 00 02 A5 10
					29 01 00 00 00 00 02 A6 23
					29 01 00 00 00 00 02 A7 01
					29 01 00 00 00 00 02 B6 40

					29 01 00 00 00 00 02 FF 2A
					29 01 00 00 00 00 02 FB 01
					29 01 00 00 00 00 02 00 91
					29 01 00 00 00 00 02 03 20
					29 01 00 00 00 00 02 04 78
					29 01 00 00 00 00 02 07 60
					29 01 00 00 00 00 02 0A 70
					29 01 00 00 00 00 02 0C 04
					29 01 00 00 00 00 02 0D 40
					29 01 00 00 00 00 02 0F 01
					29 01 00 00 00 00 02 11 E0
					29 01 00 00 00 00 02 15 0F
					29 01 00 00 00 00 02 16 03
					29 01 00 00 00 00 02 19 0E
					29 01 00 00 00 00 02 1A D7
					29 01 00 00 00 00 02 1B 14
					29 01 00 00 00 00 02 1D 2E
					29 01 00 00 00 00 02 1E 33
					29 01 00 00 00 00 02 1F 33
					29 01 00 00 00 00 02 20 33
					29 01 00 00 00 00 02 28 FD
					29 01 00 00 00 00 02 29 0D
					29 01 00 00 00 00 02 2A B7
					29 01 00 00 00 00 02 2D 09
					29 01 00 00 00 00 02 2F 02
					29 01 00 00 00 00 02 30 47
					29 01 00 00 00 00 02 33 D8
					29 01 00 00 00 00 02 34 FF
					29 01 00 00 00 00 02 35 40
					29 01 00 00 00 00 02 36 B8
					29 01 00 00 00 00 02 37 F9
					29 01 00 00 00 00 02 38 45
					29 01 00 00 00 00 02 39 B3
					29 01 00 00 00 00 02 3A 47
					29 01 00 00 00 00 02 4A F0

					29 01 00 00 00 00 02 FF 20
					29 01 00 00 00 00 02 FB 01
					29 01 00 00 00 00 11 B0 00 E2 00 E9 00 F6 01 01 01 0C 01 15 01 20 01 28
					29 01 00 00 00 00 11 B1 01 33 01 51 01 6E 01 9A 01 C0 01 FD 02 34 02 35
					29 01 00 00 00 00 11 B2 02 6B 02 A9 02 D1 03 04 03 25 03 51 03 5F 03 6D
					29 01 00 00 00 00 0F B3 03 7D 03 90 03 A7 03 BB 03 D4 03 D8 00 00
					29 01 00 00 00 00 11 B4 00 AA 00 B3 00 C4 00 D4 00 E2 00 F0 00 FC 01 08
					29 01 00 00 00 00 11 B5 01 12 01 39 01 58 01 8C 01 B5 01 F7 02 30 02 31
					29 01 00 00 00 00 11 B6 02 68 02 A6 02 CE 03 01 03 23 03 4E 03 5C 03 6A
					29 01 00 00 00 00 0F B7 03 7B 03 8E 03 A5 03 BB 03 D4 03 D8 00 00
					29 01 00 00 00 00 11 B8 00 00 00 20 00 47 00 65 00 85 00 99 00 AD 00 C0
					29 01 00 00 00 00 11 B9 00 D2 01 06 01 30 01 70 01 9F 01 E8 02 25 02 26
					29 01 00 00 00 00 11 BA 02 5F 02 9F 02 C7 02 FD 03 20 03 52 03 63 03 67
					29 01 00 00 00 00 0F BB 03 78 03 8B 03 A3 03 B9 03 D4 03 D8 00 00
					29 01 00 00 00 00 02 FF 21
					29 01 00 00 00 00 02 FB 01
					29 01 00 00 00 00 11 B0 00 E2 00 E9 00 F6 01 01 01 0C 01 15 01 20 01 28
					29 01 00 00 00 00 11 B1 01 33 01 51 01 6E 01 9A 01 C0 01 FD 02 34 02 35
					29 01 00 00 00 00 11 B2 02 6B 02 A9 02 D1 03 04 03 25 03 51 03 5F 03 6D
					29 01 00 00 00 00 0F B3 03 7D 03 90 03 A7 03 BB 03 D4 03 D8 00 00
					29 01 00 00 00 00 11 B4 00 AA 00 B3 00 C4 00 D4 00 E2 00 F0 00 FC 01 08
					29 01 00 00 00 00 11 B5 01 12 01 39 01 58 01 8C 01 B5 01 F7 02 30 02 31
					29 01 00 00 00 00 11 B6 02 68 02 A6 02 CE 03 01 03 23 03 4E 03 5C 03 6A
					29 01 00 00 00 00 0F B7 03 7B 03 8E 03 A5 03 BB 03 D4 03 D8 00 00
					29 01 00 00 00 00 11 B8 00 00 00 20 00 47 00 65 00 85 00 99 00 AD 00 C0
					29 01 00 00 00 00 11 B9 00 D2 01 06 01 30 01 70 01 9F 01 E8 02 25 02 26
					29 01 00 00 00 00 11 BA 02 5F 02 9F 02 C7 02 FD 03 20 03 52 03 63 03 67
					29 01 00 00 00 00 0F BB 03 78 03 8B 03 A3 03 B9 03 D4 03 D8 00 00

					29 01 00 00 00 00 02 FF C0
					29 01 00 00 00 00 02 FB 01
					29 01 00 00 00 00 02 9C 11
					29 01 00 00 00 00 02 9D 11

					29 01 00 00 00 00 02 FF F0
					29 01 00 00 00 00 02 FB 01
					29 01 00 00 00 00 02 5A 00
					29 01 00 00 00 00 02 9F 0C

					29 01 00 00 00 00 02 FF D0
					29 01 00 00 00 00 02 FB 01
					29 01 00 00 00 00 02 53 22
					29 01 00 00 00 00 02 54 02

					29 01 00 00 00 00 02 FF E0
					29 01 00 00 00 00 02 FB 01
					29 01 00 00 00 00 02 35 82

					29 01 00 00 00 00 02 FF 10
					29 01 00 00 00 00 02 FB 01

					15 01 00 00 00 00 02 35 01	//TE

					05 01 00 00 C8 00 01 11
					05 01 00 00 96 00 01 29
				];
				qcom,mdss-dsi-on-command-state = "dsi_lp_mode";
				qcom,mdss-dsi-off-command = [
					05 01 00 00 10 00 01 28
					05 01 00 00 32 00 01 10
				];
				qcom,mdss-dsi-off-command-state = "dsi_lp_mode";
				qcom,compression-mode = "dsc";
				qcom,mdss-dsc-slice-height = <8>;
				qcom,mdss-dsc-slice-width = <540>;
				qcom,mdss-dsc-slice-per-pkt = <1>;
				qcom,mdss-dsc-bit-per-component = <8>;
				qcom,mdss-dsc-bit-per-pixel = <8>;
				qcom,mdss-dsc-block-prediction-enable;
			};
		};
	};
};
