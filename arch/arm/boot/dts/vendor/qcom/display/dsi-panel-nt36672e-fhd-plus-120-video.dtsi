&mdss_mdp {
	dsi_nt36672e_fhd_plus_120_video: qcom,mdss_dsi_nt36672e_fhd_plus_120_video {
		qcom,mdss-dsi-panel-name =
			"nt36672e fhd plus 120Hz Video panel";
		qcom,mdss-dsi-panel-type = "dsi_video_mode";
		qcom,dsi-ctrl-num = <0>;
		qcom,dsi-phy-num = <0>;
		qcom,mdss-dsi-virtual-channel-id = <0>;
		qcom,mdss-dsi-stream = <0>;
		qcom,mdss-dsi-bpp = <24>;
		qcom,mdss-dsi-border-color = <0>;
		qcom,mdss-dsi-traffic-mode = "burst_mode";
		qcom,mdss-dsi-bllp-power-mode;
		qcom,mdss-dsi-bllp-eof-power-mode;
		qcom,mdss-dsi-lane-0-state;
		qcom,mdss-dsi-lane-1-state;
		qcom,mdss-dsi-lane-2-state;
		qcom,mdss-dsi-lane-3-state;
		qcom,mdss-dsi-dma-trigger = "trigger_sw";
		qcom,mdss-dsi-mdp-trigger = "none";
		qcom,mdss-dsi-reset-sequence = <1 10>, <0 10>, <1 10>;
		qcom,mdss-dsi-tx-eot-append;
		qcom,adjust-timer-wakeup-ms = <1>;
		qcom,mdss-dsi-panel-hdr-enabled;
		qcom,mdss-dsi-panel-hdr-color-primaries = <15000 16000 33750
						 15800 13250 34450 7500 3000>;
		qcom,mdss-dsi-panel-peak-brightness = <6450000>;
		qcom,mdss-dsi-panel-blackness-level = <4961>;

		qcom,mdss-dsi-display-timings {
			timing@0 {
				qcom,mdss-dsi-panel-width = <1080>;
				qcom,mdss-dsi-panel-height = <2408>;
				qcom,mdss-dsi-h-front-porch = <76>;
				qcom,mdss-dsi-h-back-porch = <60>;
				qcom,mdss-dsi-h-pulse-width = <10>;
				qcom,mdss-dsi-h-sync-skew = <0>;
				qcom,mdss-dsi-v-back-porch = <10>;
				qcom,mdss-dsi-v-front-porch = <46>;
				qcom,mdss-dsi-v-pulse-width = <10>;
				qcom,mdss-dsi-panel-framerate = <120>;
				qcom,mdss-dsi-on-command = [
					15 01 00 00 00 00 02 FB 01
					15 01 00 00 00 00 02 B0 00
					15 01 00 00 00 00 02 C0 03
					39 01 00 00 00 00 11 C1 89 28 00 08 00 AA 02 0E 00 2B 00 07
											 0D B7 0C B7
					39 01 00 00 00 00 03 C2 1B A0
					15 01 00 00 00 00 02 FF 20
					15 01 00 00 00 00 02 FB 01
					15 01 00 00 00 00 02 01 66
					15 01 00 00 00 00 02 06 40
					15 01 00 00 00 00 02 07 38
					15 01 00 00 00 00 02 2F 83
					15 01 00 00 00 00 02 69 91
					15 01 00 00 00 00 02 95 D1
					15 01 00 00 00 00 02 96 D1
					15 01 00 00 00 00 02 F2 64
					15 01 00 00 00 00 02 F4 64
					15 01 00 00 00 00 02 F6 64
					15 01 00 00 00 00 02 F8 64

					15 01 00 00 00 00 02 89 1C
					15 01 00 00 00 00 02 8A 1C
					15 01 00 00 00 00 02 8B 1C
					15 01 00 00 00 00 02 8C 1C

					15 01 00 00 00 00 02 FF 24
					15 01 00 00 00 00 02 FB 01
					15 01 00 00 00 00 02 01 0F
					15 01 00 00 00 00 02 03 0C
					15 01 00 00 00 00 02 05 1D

					15 01 00 00 00 00 02 08 2F
					15 01 00 00 00 00 02 09 2E
					15 01 00 00 00 00 02 0A 2D
					15 01 00 00 00 00 02 0B 2C

					15 01 00 00 00 00 02 11 17
					15 01 00 00 00 00 02 12 13
					15 01 00 00 00 00 02 13 15
					15 01 00 00 00 00 02 15 14
					15 01 00 00 00 00 02 16 16
					15 01 00 00 00 00 02 17 18
					15 01 00 00 00 00 02 1B 01
					15 01 00 00 00 00 02 1D 1D

					15 01 00 00 00 00 02 20 2F
					15 01 00 00 00 00 02 21 2E
					15 01 00 00 00 00 02 22 2D
					15 01 00 00 00 00 02 23 2C

					15 01 00 00 00 00 02 29 17
					15 01 00 00 00 00 02 2A 13
					15 01 00 00 00 00 02 2B 15
					15 01 00 00 00 00 02 2F 14
					15 01 00 00 00 00 02 30 16
					15 01 00 00 00 00 02 31 18
					15 01 00 00 00 00 02 32 04
					15 01 00 00 00 00 02 34 10
					15 01 00 00 00 00 02 35 1F
					15 01 00 00 00 00 02 36 1F
					15 01 00 00 00 00 02 4D 14
					15 01 00 00 00 00 02 4E 36
					15 01 00 00 00 00 02 4F 36
					15 01 00 00 00 00 02 53 36
					15 01 00 00 00 00 02 71 30
					15 01 00 00 00 00 02 79 11
					15 01 00 00 00 00 02 7A 82
					15 01 00 00 00 00 02 7B 8F
					15 01 00 00 00 00 02 7D 04
					15 01 00 00 00 00 02 80 04
					15 01 00 00 00 00 02 81 04
					15 01 00 00 00 00 02 82 13
					15 01 00 00 00 00 02 84 31
					15 01 00 00 00 00 02 85 00
					15 01 00 00 00 00 02 86 00
					15 01 00 00 00 00 02 87 00

					15 01 00 00 00 00 02 90 13
					15 01 00 00 00 00 02 92 31
					15 01 00 00 00 00 02 93 00
					15 01 00 00 00 00 02 94 00
					15 01 00 00 00 00 02 95 00
					15 01 00 00 00 00 02 9C F4
					15 01 00 00 00 00 02 9D 01
					15 01 00 00 00 00 02 A0 0F
					15 01 00 00 00 00 02 A2 0F
					15 01 00 00 00 00 02 A3 02
					15 01 00 00 00 00 02 A4 04
					15 01 00 00 00 00 02 A5 04
					15 01 00 00 00 00 02 C4 40
					15 01 00 00 00 00 02 C6 C0
					15 01 00 00 00 00 02 C9 00
					15 01 00 00 00 00 02 D9 80
					15 01 00 00 00 00 02 E9 02

					15 01 00 00 00 00 02 FF 25
					15 01 00 00 00 00 02 FB 01
					15 01 00 00 00 00 02 19 E4
					15 01 00 00 00 00 02 21 40
					15 01 00 00 00 00 02 66 D8
					15 01 00 00 00 00 02 68 50
					15 01 00 00 00 00 02 69 10
					15 01 00 00 00 00 02 6B 00
					15 01 00 00 00 00 02 6D 0D
					15 01 00 00 00 00 02 6E 48

					15 01 00 00 00 00 02 72 41
					15 01 00 00 00 00 02 73 4A
					15 01 00 00 00 00 02 74 D0
					15 01 00 00 00 00 02 77 62
					15 01 00 00 00 00 02 79 81
					15 01 00 00 00 00 02 7D 03
					15 01 00 00 00 00 02 7E 15
					15 01 00 00 00 00 02 7F 00
					15 01 00 00 00 00 02 84 4D
					15 01 00 00 00 00 02 CF 80
					15 01 00 00 00 00 02 D6 80
					15 01 00 00 00 00 02 D7 80
					15 01 00 00 00 00 02 EF 20
					15 01 00 00 00 00 02 F0 84

					15 01 00 00 00 00 02 FF 26
					15 01 00 00 00 00 02 FB 01
					15 01 00 00 00 00 02 80 05
					15 01 00 00 00 00 02 81 0F
					15 01 00 00 00 00 02 83 01
					15 01 00 00 00 00 02 84 03
					15 01 00 00 00 00 02 85 01
					15 01 00 00 00 00 02 86 03
					15 01 00 00 00 00 02 87 01
					15 01 00 00 00 00 02 88 05
					15 01 00 00 00 00 02 8A 1A
					15 01 00 00 00 00 02 8B 11
					15 01 00 00 00 00 02 8C 24
					15 01 00 00 00 00 02 8E 42
					15 01 00 00 00 00 02 8F 11
					15 01 00 00 00 00 02 90 11
					15 01 00 00 00 00 02 91 11
					15 01 00 00 00 00 02 9A 80
					15 01 00 00 00 00 02 9B 04
					15 01 00 00 00 00 02 9C 00
					15 01 00 00 00 00 02 9D 00
					15 01 00 00 00 00 02 9E 00

					15 01 00 00 00 00 02 FF 27
					15 01 00 00 00 00 02 FB 01
					15 01 00 00 00 00 02 01 68
					15 01 00 00 00 00 02 20 81
					15 01 00 00 00 00 02 21 6A
					15 01 00 00 00 00 02 25 81
					15 01 00 00 00 00 02 26 94
					15 01 00 00 00 00 02 6E 00
					15 01 00 00 00 00 02 6F 00
					15 01 00 00 00 00 02 70 00
					15 01 00 00 00 00 02 71 00
					15 01 00 00 00 00 02 72 00
					15 01 00 00 00 00 02 75 00
					15 01 00 00 00 00 02 76 00
					15 01 00 00 00 00 02 77 00
					15 01 00 00 00 00 02 7D 09
					15 01 00 00 00 00 02 7E 67
					15 01 00 00 00 00 02 80 23
					15 01 00 00 00 00 02 82 09
					15 01 00 00 00 00 02 83 67
					15 01 00 00 00 00 02 88 01
					15 01 00 00 00 00 02 89 10
					15 01 00 00 00 00 02 A5 10
					15 01 00 00 00 00 02 A6 23
					15 01 00 00 00 00 02 A7 01
					15 01 00 00 00 00 02 B6 40

					15 01 00 00 00 00 02 FF 2A
					15 01 00 00 00 00 02 FB 01
					15 01 00 00 00 00 02 00 91
					15 01 00 00 00 00 02 03 20
					15 01 00 00 00 00 02 07 50
					15 01 00 00 00 00 02 0A 70
					15 01 00 00 00 00 02 0C 04
					15 01 00 00 00 00 02 0D 40
					15 01 00 00 00 00 02 0F 01
					15 01 00 00 00 00 02 11 E0
					15 01 00 00 00 00 02 15 0F
					15 01 00 00 00 00 02 16 A4
					15 01 00 00 00 00 02 19 0F
					15 01 00 00 00 00 02 1A 78
					15 01 00 00 00 00 02 1B 23
					15 01 00 00 00 00 02 1D 36
					15 01 00 00 00 00 02 1E 3E
					15 01 00 00 00 00 02 1F 3E
					15 01 00 00 00 00 02 20 3E
					15 01 00 00 00 00 02 28 FD
					15 01 00 00 00 00 02 29 12
					15 01 00 00 00 00 02 2A E1
					15 01 00 00 00 00 02 2D 0A
					15 01 00 00 00 00 02 30 49
					15 01 00 00 00 00 02 33 96
					15 01 00 00 00 00 02 34 FF
					15 01 00 00 00 00 02 35 40
					15 01 00 00 00 00 02 36 DE
					15 01 00 00 00 00 02 37 F9
					15 01 00 00 00 00 02 38 45
					15 01 00 00 00 00 02 39 D9
					15 01 00 00 00 00 02 3A 49
					15 01 00 00 00 00 02 4A F0

					15 01 00 00 00 00 02 FF 20
					15 01 00 00 00 00 02 FB 01
					39 01 00 00 00 00 11 B0 00 00 00 17 00 46 00 63 00 81 00 96
										 00 AB 00 BD
					39 01 00 00 00 00 11 B1 00 CF 01 03 01 2F 01 6E 01 9D 01 E7
										 02 22 02 24
					39 01 00 00 00 00 11 B2 02 5D 02 9B 02 C4 02 F9 03 1B 03 48
										 03 56 03 65
					39 01 00 00 00 00 0F B3 03 75 03 87 03 9B 03 B1 03 CA 03 D7
										 00 00
					39 01 00 00 00 00 11 B4 00 00 00 19 00 4B 00 69 00 87 00 9C
										 00 B2 00 C3
					39 01 00 00 00 00 11 B5 00 D5 01 0B 01 35 01 73 01 A3 01 EC
										 02 27 02 29
					39 01 00 00 00 00 11 B6 02 60 02 9F 02 C7 02 FB 03 1D 03 4C
										 03 5A 03 69
					39 01 00 00 00 00 0F B7 03 7A 03 8C 03 A0 03 B5 03 CB 03 D7
										 00 00
					39 01 00 00 00 00 11 B8 00 00 00 19 00 4D 00 6A 00 87 00 9C
										 00 B1 00 C2
					39 01 00 00 00 00 11 B9 00 D3 01 08 01 32 01 70 01 9F 01 E8
										 02 23 02 25
					39 01 00 00 00 00 11 BA 02 5C 02 9B 02 C3 02 F8 03 1A 03 4C
										 03 5B 03 6B
					39 01 00 00 00 00 0F BB 03 7D 03 92 03 A7 03 BB 03 CE 03 D7
										 00 00

					15 01 00 00 00 00 02 FF 21
					15 01 00 00 00 00 02 FB 01
					39 01 00 00 00 00 11 B0 00 00 00 17 00 46 00 63 00 81 00 96
										 00 AB 00 BD
					39 01 00 00 00 00 11 B1 00 CF 01 03 01 2F 01 6E 01 9D 01 E7
										 02 22 02 24
					39 01 00 00 00 00 11 B2 02 5D 02 9B 02 C4 02 F9 03 1B 03 48
										 03 56 03 65
					39 01 00 00 00 00 0F B3 03 75 03 87 03 9B 03 B1 03 CA 03 D7
										 00 00
					39 01 00 00 00 00 11 B4 00 00 00 19 00 4B 00 69 00 87 00 9C
										 00 B2 00 C3
					39 01 00 00 00 00 11 B5 00 D5 01 0B 01 35 01 73 01 A3 01 EC
										 02 27 02 29
					39 01 00 00 00 00 11 B6 02 60 02 9F 02 C7 02 FB 03 1D 03 4C
										 03 5A 03 69
					39 01 00 00 00 00 0F B7 03 7A 03 8C 03 A0 03 B5 03 CB 03 D7
										 00 00
					39 01 00 00 00 00 11 B8 00 00 00 19 00 4D 00 6A 00 87 00 9C
										 00 B1 00 C2
					39 01 00 00 00 00 11 B9 00 D3 01 08 01 32 01 70 01 9F 01 E8
										 02 23 02 25
					39 01 00 00 00 00 11 BA 02 5C 02 9B 02 C3 02 F8 03 1A 03 4C
										 03 5B 03 6B
					39 01 00 00 00 00 0F BB 03 7D 03 92 03 A7 03 BB 03 CE 03 D7
										 00 00

					15 01 00 00 00 00 02 FF 10
					15 01 00 00 00 00 02 FF F0
					15 01 00 00 00 00 02 FB 01
					15 01 00 00 00 00 02 5A 00
					15 01 00 00 00 00 02 FF 10

					15 01 00 00 00 00 02 FF 10
					15 01 00 00 00 00 02 FB 01

					15 01 00 00 00 00 02 51 FF   //CABC
					15 01 00 00 00 00 02 53 2C
					15 01 00 00 00 00 02 55 01

					05 01 00 00 C8 00 01 11
					05 01 00 00 96 00 01 29
				];
				qcom,mdss-dsi-on-command-state = "dsi_lp_mode";
				qcom,mdss-dsi-off-command = [
					05 01 00 00 10 00 01 28
					05 01 00 00 32 00 01 10
				];
				qcom,mdss-dsi-off-command-state = "dsi_lp_mode";
				qcom,compression-mode = "dsc";
				qcom,mdss-dsc-slice-height = <8>;
				qcom,mdss-dsc-slice-width = <540>;
				qcom,mdss-dsc-slice-per-pkt = <1>;
				qcom,mdss-dsc-bit-per-component = <8>;
				qcom,mdss-dsc-bit-per-pixel = <8>;
				qcom,mdss-dsc-block-prediction-enable;
			};
		};
	};
};
