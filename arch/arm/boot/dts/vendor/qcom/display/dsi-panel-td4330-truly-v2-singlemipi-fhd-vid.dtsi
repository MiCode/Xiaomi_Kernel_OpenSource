&mdss_mdp {
	dsi_td4330_truly_v2_video: qcom,mdss_dsi_td4330_truly_v2_video {
		qcom,mdss-dsi-panel-name =
			"td4330 v2 video mode dsi truly panel";
		qcom,mdss-dsi-panel-type = "dsi_video_mode";

		qcom,dsi-ctrl-num = <0>;
		qcom,dsi-phy-num = <0>;

		qcom,mdss-dsi-virtual-channel-id = <0>;
		qcom,mdss-dsi-stream = <0>;
		qcom,mdss-dsi-h-left-border = <0>;
		qcom,mdss-dsi-h-right-border = <0>;
		qcom,mdss-dsi-v-top-border = <0>;
		qcom,mdss-dsi-v-bottom-border = <0>;
		qcom,mdss-dsi-bpp = <24>;
		qcom,mdss-dsi-color-order = "rgb_swap_rgb";
		qcom,mdss-dsi-underflow-color = <0xff>;
		qcom,mdss-dsi-border-color = <0>;
		qcom,mdss-dsi-h-sync-pulse = <0>;
		qcom,mdss-dsi-traffic-mode = "non_burst_sync_event";
		qcom,mdss-dsi-lane-map = "lane_map_0123";
		qcom,mdss-dsi-bllp-eof-power-mode;
		qcom,mdss-dsi-bllp-power-mode;
		qcom,mdss-dsi-tx-eot-append;
		qcom,mdss-dsi-lane-0-state;
		qcom,mdss-dsi-lane-1-state;
		qcom,mdss-dsi-lane-2-state;
		qcom,mdss-dsi-lane-3-state;
		qcom,mdss-dsi-dma-trigger = "trigger_sw";
		qcom,mdss-dsi-mdp-trigger = "none";
		qcom,mdss-dsi-lp11-init;
		qcom,mdss-dsi-bl-pmic-control-type = "bl_ctrl_wled";
		qcom,mdss-dsi-bl-min-level = <1>;
		qcom,mdss-dsi-bl-max-level = <4095>;
		qcom,mdss-dsi-reset-sequence = <1 10>, <0 10>, <1 10>;
		qcom,mdss-pan-physical-width-dimension = <65>;
		qcom,mdss-pan-physical-height-dimension = <129>;

		qcom,mdss-dsi-display-timings {
			timing@0 {
				qcom,mdss-dsi-panel-width = <1080>;
				qcom,mdss-dsi-panel-height = <2280>;
				qcom,mdss-dsi-h-front-porch = <40>;
				qcom,mdss-dsi-h-back-porch = <40>;
				qcom,mdss-dsi-h-pulse-width = <20>;
				qcom,mdss-dsi-h-sync-skew = <0>;
				qcom,mdss-dsi-v-back-porch = <16>;
				qcom,mdss-dsi-v-front-porch = <10>;
				qcom,mdss-dsi-v-pulse-width = <2>;
				qcom,mdss-dsi-panel-framerate = <60>;
				qcom,mdss-dsi-on-command = [
					29 01 00 00 00 00 02
						B0 00
					29 01 00 00 00 00 0D
						B6 30 6B 00 06 03 0A 13 1A 6C
						18 19 02
					29 01 00 00 00 00 05
						B7 51 00 00 00
					29 01 00 00 00 00 08
						B8 57 3D 19 BE 1E 0A 0A
					29 01 00 00 00 00 08
						B9 6F 3D 28 BE 3C 14 0A
					29 01 00 00 00 00 08
						BA B5 33 41 BE 64 23 0A
					29 01 00 00 00 00 0C
						BB 44 26 C3 1F 19 06 03 C0 00
						00 10
					29 01 00 00 00 00 0C
						BC 32 4C C3 52 32 1F 03 F2 00
						00 13
					29 01 00 00 00 00 0C
						BD 24 68 C3 AA 3F 32 03 FF 00
						00 25
					29 01 00 00 00 00 0D
						BE 00 00 00 00 00 00 00 00 00
						00 00 00
					29 01 00 00 00 00 0D
						C0 00 DC 00 DC 04 08 E8 00 04
						00 03 78
					29 01 00 00 00 00 24
						C1 30 00 00 11 11 00 00 00 22
						00 05 20 FA 00 08 00 00 00 00
						00 00 00 00 00 00 00 00 00 00
						00 00 00 00 00 00
					29 01 00 00 00 00 79
						C2 06 E0 6E 01 03 00 02 00 00
						00 00 00 00 00 00 00 00 00 00
						00 00 00 00 00 00 00 00 00 00
						00 00 00 00 00 00 00 00 00 00
						00 00 11 00 00 00 00 04 A0 C9
						00 00 00 00 00 00 48 EB 00 00
						01 00 00 00 11 00 00 00 00 00
						00 00 00 00 00 00 00 00 00 00
						00 00 00 00 00 11 00 00 00 00
						00 00 DC 00 00 00 00 04 00 08
						EF 00 00 00 00 00 11 00 00 00
						00 00 00 00 00 00 00 00 00 00
						00
					29 01 00 00 00 00 6D
						C3 00 00 00 00 00 00 00 00 00
						00 00 00 00 00 00 00 00 00 00
						00 00 00 00 00 00 00 00 00 00
						00 00 00 00 00 00 00 00 00 00
						00 00 00 00 00 00 00 00 00 00
						00 00 00 00 00 00 00 00 00 00
						00 00 00 AA AA AA 00 00 00 00
						00 00 00 00 00 00 00 00 00 00
						00 00 00 00 00 00 00 00 00 00
						00 00 00 00 00 00 00 00 00 00
						00 00 00 00 00 00 00 00 00
					29 01 00 00 00 00 62
						C4 00 4C 00 3F 00 83 00 00 87
						86 85 84 00 00 00 00 00 61 5D
						5F 00 5E 60 62 00 00 00 02 00
						83 00 00 87 86 85 84 00 00 00
						00 00 61 5D 5F 00 5E 60 62 FF
						FF FF FF FF FF 00 0F 0E 00 0F
						0E 00 00 00 00 00 00 00 0F EE
						00 0F EE 00 00 E0 00 00 E0 0E
						00 00 00 0E 00 00 00 00 00 FF
						57 00 00 00 00 00 00 00
					29 01 00 00 00 00 06
						C5 08 00 00 00 00
					29 01 00 00 00 00 3A
						C6 02 0A 08 FC FF FF FF 00 00
						13 01 F0 0C 06 01 43 43 43 00
						00 00 01 77 09 28 28 06 01 43
						43 43 00 00 00 01 61 00 00 00
						1C 01 00 00 00 00 00 00 00 00
						00 00 00 00 20 20 00 00
					29 01 00 00 00 00 4D
						C7 00 00 00 E0 01 E9 02 7E 02
						05 02 90 02 F6 02 40 02 5C 02
						77 02 C8 02 1B 02 5B 02 BD 02
						27 02 C3 03 54 03 D8 03 FF 00
						00 00 E0 01 E9 02 7E 02 05 02
						90 02 F6 02 40 02 5C 02 77 02
						C8 02 1B 02 5B 02 BD 02 27 02
						C3 03 54 03 D8 03 FF
					29 01 00 00 00 00 42
						C8 41 00 FF FA 00 FF 00 00 FE
						F6 FE E9 00 00 FF F7 FB E1 00
						00 00 00 00 FF 00 00 FF FA 00
						FF 00 FE F6 FE E9 00 FF F7 FB
						E1 00 00 00 00 FF 00 FF FA 00
						FF 00 FE F6 FE E9 00 FF F7 FB
						E1 00 00 00 00 FF
					29 01 00 00 00 00 19
						C9 00 FF FA 00 FF 00 00 FE F6
						FE E9 00 00 FF F7 FB E1 00 00
						00 00 00 FF 00
					29 01 00 00 00 00 42
						CA 1C FC FC FC 00 00 00 00 00
						00 00 00 00 00 00 00 00 00 00
						00 00 00 00 00 00 00 00 00 00
						00 00 00 00 00 00 00 00 00 00
						00 00 00 00 00 00 00 00 00 00
						00 00 00 00 00 00 00 00 00 00
						00 00 00 00 00 00
					29 01 00 00 00 00 0B
						CC 00 00 4D 8B 55 4D 8B AA 4D
						8B
					29 01 00 00 00 00 02
						CD 00
					29 01 00 00 00 00 24
						CE 5D 40 49 53 59 5E 63 68 6E
						74 7E 8A 98 A8 BB D0 E7 FF 04
						00 04 04 42 04 69 5A 40 11 F4
						00 00 84 FA 00 00
					29 01 00 00 00 00 07
						CF 00 00 80 46 61 00
					29 01 00 00 00 00 12
						D0 F6 95 11 B1 55 CF 00 F6 D3
						11 F0 01 12 CF 02 20 11
					29 01 00 00 00 00 23
						D1 D3 D3 33 33 07 03 3B 33 77
						37 77 37 35 77 07 77 F7 33 73
						07 33 33 03 33 1B 03 32 3D 0A
						30 13 13 20 00
					29 01 00 00 00 00 05
						D2 00 00 07 00
					29 01 00 00 00 00 9A
						D3 03 00 00 00 00 00 00 0F 00
						57 00 00 32 00 00 1A 70 01 19
						80 01 01 F0 02 00 E0 06 FF F7
						FF FF F7 FF FF F7 FF FF F7 FF
						FF F7 FF FF F7 FF FF F7 FF FF
						F7 FF FF F7 FF FF F7 FF FF F7
						FF FF F7 FF FF F7 FF FF F7 FF
						FF F7 FF FF F7 FF FF F7 FF FF
						F7 FF FF F7 FF FF F7 FF FF F7
						FF FF F7 FF FF F7 FF FF F7 FF
						FF F7 FF FF F7 FF FF F7 FF FF
						F7 FF FF F7 FF FF F7 FF FF F7
						FF FF F7 FF FF F7 FF FF F7 FF
						FF F7 FF FF F7 FF FF F7 FF FF
						F7 FF FF F7 FF FF F7 FF FF F7
						FF FF F7 FF
					29 01 00 00 00 00 05
						E5 03 00 00 00
					29 01 00 00 00 00 09
						D5 02 42 02 42 02 DC 02 DC
					29 01 00 00 00 00 02
						D6 C0
					29 01 00 00 00 00 32
						D7 21 10 52 52 00 B6 04 FD 00
						B6 04 FD 00 82 80 83 84 85 83
						80 84 45 85 85 85 87 04 06 02
						04 04 07 10 0C 0B 0A 0A 07 06
						00 08 00 00 00 00 00 00 00 00
					29 01 00 00 00 00 05
						DD 30 06 23 65
					29 01 00 00 00 00 0D
						DE 00 00 00 0F FF 00 00 00 00
						00 00 10
					29 01 00 00 00 00 02
						E3 FF
					29 01 00 00 00 00 07
						E6 00 00 00 00 00 00
					29 01 00 00 00 00 0B
						E7 50 04 00 00 00 00 00 00 00
						00
					29 01 00 00 00 00 05
						E8 00 01 23 00
					29 01 00 00 00 00 1E
						EA 01 02 47 80 47 00 00 00 05
						00 13 60 02 47 80 47 00 00 00
						00 13 60 00 11 00 30 10 21 02
					29 01 00 00 00 00 08
						EB 00 00 00 00 01 00 11
					29 01 00 00 00 00 04
						EC 00 00 00
					29 01 00 00 00 00 21
						ED 01 01 02 02 02 02 00 00 00
						00 00 00 0A 00 00 00 00 10 00
						18 00 18 00 B0 00 00 00 00 00
						DA 10 00
					29 01 00 00 00 00 61
						EE 03 0F 00 00 00 00 40 1F 00
						00 0F F2 3F 00 00 00 00 00 00
						00 00 00 00 00 00 00 00 00 10
						01 00 09 01 8C D8 EF 00 00 00
						00 00 00 00 00 00 00 00 00 00
						00 00 00 00 00 50 1F 00 00 00
						00 00 00 00 00 00 00 00 00 00
						00 00 00 00 00 00 00 00 00 00
						00 00 00 00 00 00 00 00 00 00
						00 00 00 00 00 00 00
					29 01 00 00 00 00 8C
						EF 00 70 4A 08 D0 00 00 00 00
						3C 3C 3C 00 00 00 00 00 00 00
						00 00 00 00 00 00 00 00 00 70
						4A 08 D0 00 00 00 00 3C 3C 3C
						00 00 00 00 00 00 00 00 00 00
						00 00 00 00 00 00 00 00 00 00
						00 00 00 00 00 00 00 00 00 00
						00 00 00 00 00 00 00 00 00 00
						00 00 00 00 00 00 00 00 00 00
						00 00 00 03 08 EC 50 10 00 10
						00 0A 0A 00 00 00 00 10 0F 00
						03 51 00 50 00 00 00 00 00 00
						00 00 00 00 00 00 00 00 00 00
						00 00 00 00 00 00 00 03 08 EC
					29 01 00 00 00 00 02
						B0 03
					29 01 00 00 00 00 02
						B0 04
					29 01 00 00 00 00 02
						D6 00
					39 01 00 00 00 00 03
						51 FF F0
					39 01 00 00 00 00 02
						53 0C
					39 01 00 00 00 00 02
						55 00
					39 01 00 00 00 00 02
						35 00
					39 01 00 00 00 00 05
						2A 00 00 04 37
					39 01 00 00 00 00 05
						2B 00 00 08 E7
					05 01 00 00 FF 00 02
						29 00
					05 01 00 00 FF 00 02
						11 00];
				qcom,mdss-dsi-off-command = [
					05 01 00 00 32 00 02 28 00
					05 01 00 00 96 00 02 10 00];
				qcom,mdss-dsi-on-command-state = "dsi_lp_mode";
				qcom,mdss-dsi-off-command-state = "dsi_hs_mode";
			};
		};
	};
};
