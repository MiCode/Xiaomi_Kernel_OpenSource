&mdss_mdp {
	dsi_k1_43_06_00_sec_cmd: qcom,mdss_dsi_k1_43_06_00_sec_cmd {
		qcom,mdss-dsi-panel-name = "xiaomi 43 06 00 cmd mode secondary dsi panel";
		qcom,mdss-dsi-panel-type = "dsi_cmd_mode";
		qcom,mdss-dsi-virtual-channel-id = <0>;
		qcom,mdss-dsi-stream = <0>;
		qcom,mdss-dsi-bpp = <24>;
		qcom,mdss-dsi-color-order = "rgb_swap_rgb";
		qcom,mdss-dsi-underflow-color = <0xff>;
		qcom,mdss-dsi-border-color = <0>;

		qcom,dsi-sec-ctrl-num = <1>;
		qcom,dsi-sec-phy-num = <1>;

		qcom,mdss-dsi-traffic-mode = "burst_mode";
		qcom,mdss-dsi-lane-map = "lane_map_0123";
		qcom,mdss-dsi-bllp-eof-power-mode;
		qcom,mdss-dsi-bllp-power-mode;
		qcom,mdss-dsi-lane-0-state;
		qcom,mdss-dsi-dma-trigger = "trigger_sw";
		qcom,mdss-dsi-mdp-trigger = "none";
		qcom,mdss-dsi-reset-sequence = <1 1>, <0 1>, <1 15>;
		qcom,mdss-pan-physical-width-dimension = <109>;
		qcom,mdss-pan-physical-height-dimension = <256>;
		qcom,mdss-dsi-te-pin-select = <1>;
		qcom,mdss-dsi-wr-mem-start = <0x2c>;
		qcom,mdss-dsi-wr-mem-continue = <0x3c>;
		qcom,mdss-dsi-te-dcs-command = <1>;
		qcom,mdss-dsi-te-check-enable;
		qcom,mdss-dsi-te-using-te-pin;
		qcom,mdss-dsi-tx-eot-append;
		qcom,mdss-dsi-lp11-init;

		qcom,mdss-dsi-panel-peak-brightness = <4200000>;
		qcom,mdss-dsi-panel-blackness-level = <3230>;

		qcom,bl-update-flag = "delay_until_first_frame";

		qcom,mdss-dsi-display-timings {
			timing@0{
				qcom,mdss-dsi-panel-framerate = <60>;
				qcom,mdss-dsi-panel-width = <126>;
				qcom,mdss-dsi-panel-height = <294>;
				qcom,mdss-dsi-h-front-porch = <16>;
				qcom,mdss-dsi-h-back-porch = <8>;
				qcom,mdss-dsi-h-pulse-width = <8>;
				qcom,mdss-dsi-h-sync-skew = <0>;
				qcom,mdss-dsi-v-back-porch = <32>;
				qcom,mdss-dsi-v-front-porch = <32>;
				qcom,mdss-dsi-v-pulse-width = <32>;
				qcom,mdss-dsi-h-sync-pulse = <0>;
				qcom,mdss-dsi-h-left-border = <0>;
				qcom,mdss-dsi-h-right-border = <0>;
				qcom,mdss-dsi-v-top-border = <0>;
				qcom,mdss-dsi-v-bottom-border = <0>;
				qcom,mdss-dsi-panel-clockrate = <88730000>;
				qcom,mdss-dsi-panel-jitter = <0x5 0x1>;
				qcom,mdss-mdp-transfer-time-us = <14000>;
				qcom,mdss-dsi-on-command = [
					15 01 00 00 00 00 02 FE 0A
					15 01 00 00 00 00 02 3A 06
					15 01 00 00 00 00 02 FE 00
					39 01 00 00 00 00 05 2A 00 00 00 7D
					15 01 00 00 00 00 02 35 00
					15 01 00 00 00 00 02 51 FF
					05 01 00 00 3C 00 02 11 00  /* Sleep Out */
					05 01 00 00 00 00 02 29 00  /* Display On */
					];
				qcom,mdss-dsi-off-command = [
					05 01 00 00 00 00 02 28 00
					05 01 00 00 78 00 02 10 00];
				qcom,mdss-dsi-on-command-state = "dsi_lp_mode";
				qcom,mdss-dsi-off-command-state = "dsi_lp_mode";
			};
		};
	};
};

&dsi_k1_43_06_00_sec_cmd {
	qcom,mdss-dsi-panel-status-check-mode = "reg_read";
	qcom,mdss-dsi-panel-status-command = [06 01 00 01 00 00 01 0a];
	qcom,mdss-dsi-panel-status-command-state = "dsi_lp_mode";
	qcom,mdss-dsi-panel-status-value = <0x9c>;
	qcom,mdss-dsi-panel-status-read-length = <1>;
	qcom,esd-check-enabled;

	/*mi,panel-on-dimming-delay = <120>;*/

	/* Nolp code customized */
	mi,aod-nolp-command-enabled;

	qcom,mdss-dsi-display-timings {
		timing@0{
			mi,mdss-dsi-dimmingon-command = [15 01 00 00 00 00 02 53 28];
			mi,mdss-dsi-dimmingon-command-state = "dsi_hs_mode";
			mi,mdss-dsi-dimmingoff-command = [15 01 00 00 00 00 02 53 20];
			mi,mdss-dsi-dimmingoff-command-state = "dsi_hs_mode";

			mi,mdss-dsi-doze-hbm-command = [
				05 01 00 00 00 00 02 39 00
				15 01 00 00 00 00 02 51 80
			];

			mi,mdss-dsi-doze-lbm-command = [
				05 01 00 00 00 00 02 39 00
				15 01 00 00 00 00 02 51 40
			];
			mi,mdss-dsi-doze-hbm-command-state = "dsi_lp_mode";
			mi,mdss-dsi-doze-lbm-command-state = "dsi_lp_mode";

			mi,mdss-dsi-doze-hbm-nolp-command = [
				05 01 00 00 00 00 02 38 00
			];
			mi,mdss-dsi-doze-hbm-nolp-command-state = "dsi_lp_mode";
			mi,mdss-dsi-doze-lbm-nolp-command = [
				05 01 00 00 00 00 02 38 00
			];
			mi,mdss-dsi-doze-lbm-nolp-command-state = "dsi_lp_mode";
		};
	};
};
