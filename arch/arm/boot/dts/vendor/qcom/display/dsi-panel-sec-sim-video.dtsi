&mdss_mdp {
	dsi_sec_sim_vid: qcom,mdss_dsi_sec_sim_video {
		qcom,mdss-dsi-panel-name = "Secondary Simulator video mode dsi panel";
		qcom,mdss-dsi-panel-type = "dsi_video_mode";

		qcom,dsi-sec-ctrl-num = <1>;
		qcom,dsi-sec-phy-num = <1>;

		qcom,mdss-dsi-virtual-channel-id = <0>;
		qcom,mdss-dsi-stream = <0>;
		qcom,mdss-dsi-bpp = <24>;
		qcom,mdss-dsi-underflow-color = <0xff>;
		qcom,mdss-dsi-border-color = <0>;
		qcom,mdss-dsi-panel-hdr-enabled;
		qcom,mdss-dsi-panel-hdr-color-primaries = <14500 15500 32000
			17000 15500 30000 8000 3000>;
		qcom,mdss-dsi-panel-peak-brightness = <4200000>;
		qcom,mdss-dsi-panel-blackness-level = <3230>;
		qcom,mdss-dsi-traffic-mode = "non_burst_sync_event";
		qcom,mdss-dsi-bllp-eof-power-mode;
		qcom,mdss-dsi-bllp-power-mode;
		qcom,mdss-dsi-lane-0-state;
		qcom,mdss-dsi-lane-1-state;
		qcom,mdss-dsi-lane-2-state;
		qcom,mdss-dsi-lane-3-state;
		qcom,mdss-dsi-t-clk-post = <0x04>;
		qcom,mdss-dsi-t-clk-pre = <0x1b>;
		qcom,mdss-dsi-dma-trigger = "trigger_sw";
		qcom,mdss-dsi-mdp-trigger = "none";
		qcom,mdss-dsi-reset-sequence = <1 0>, <0 0>, <1 0>;
		qcom,panel-ack-disabled;

		qcom,mdss-dsi-display-timings {
			timing@0 {
				qcom,mdss-dsi-panel-width = <640>;
				qcom,mdss-dsi-panel-height = <480>;
				qcom,mdss-dsi-h-front-porch = <8>;
				qcom,mdss-dsi-h-back-porch = <8>;
				qcom,mdss-dsi-h-pulse-width = <8>;
				qcom,mdss-dsi-h-sync-skew = <0>;
				qcom,mdss-dsi-v-back-porch = <6>;
				qcom,mdss-dsi-v-front-porch = <6>;
				qcom,mdss-dsi-v-pulse-width = <2>;
				qcom,mdss-dsi-h-left-border = <0>;
				qcom,mdss-dsi-h-right-border = <0>;
				qcom,mdss-dsi-v-top-border = <0>;
				qcom,mdss-dsi-v-bottom-border = <0>;
				qcom,mdss-dsi-panel-framerate = <60>;
				qcom,mdss-dsi-panel-timings =
					[00 00 00 00 00 00 00 00 00 00 00 00];
				qcom,mdss-dsi-on-command =
					[32 01 00 00 00 00 02 00 00];
				qcom,mdss-dsi-off-command =
					[22 01 00 00 00 00 02 00 00];
				qcom,mdss-dsi-on-command-state = "dsi_lp_mode";
				qcom,mdss-dsi-off-command-state = "dsi_lp_mode";
				qcom,mdss-dsi-h-sync-pulse = <0>;
			};
		};
	};
};
