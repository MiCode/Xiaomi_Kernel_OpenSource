/dts-v1/;

//#include "qrb2210-rb1.dtsi"
//#include <dt-bindings/interrupt-controller/arm-gic.h>
//#include "qrb2210-rb1-idp.dtsi"

/ {
	model = "Qualcomm Technologies, Inc. Scuba IOT SoC";
	compatible = "qcom,scuba-iot";
	qcom,board-id = <0 0>;
};
