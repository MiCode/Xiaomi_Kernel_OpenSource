/dts-v1/;

#include "sdxlemur-v2.dtsi"
#include "sdxlemur-mtp.dtsi"
#include "sdxlemur-1024mb.dtsi"

/ {
	model = "Qualcomm Technologies, Inc. SDXLEMUR MTP V2";
	compatible = "qcom,sdxlemur-mtp",
		"qcom,sdxlemur", "qcom,mtp";
	qcom,board-id = <0x20008 0x300>;
};
