/dts-v1/;

#include "holi.dtsi"
#include "holi-pm6125-overlay.dtsi"
#include "holi-regulators-pm6125.dtsi"
#include "holi-cdp-pm6125.dtsi"
/ {
	model = "Qualcomm Technologies, Inc. Holi CDP PM6125";
	compatible = "qcom,holi-cdp", "qcom,holi", "qcom,cdp";
	qcom,board-id = <1 0>;
	qcom,pmic-id-size = <4>;
	qcom,pmic-id = <0x2D 0x0 0x2E 0x0>;
};
