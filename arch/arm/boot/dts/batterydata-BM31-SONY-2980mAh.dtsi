/* Copyright (c) 2013, The Linux Foundation. All rights reserved.
 * Copyright (C) 2015 XiaoMi, Inc.
 *
 * This program is free software; you can redistribute it and/or modify
 * it under the terms of the GNU General Public License version 2 and
 * only version 2 as published by the Free Software Foundation.
 *
 * This program is distributed in the hope that it will be useful,
 * but WITHOUT ANY WARRANTY; without even the implied warranty of
 * MERCHANTABILITY or FITNESS FOR A PARTICULAR PURPOSE.  See the
 * GNU General Public License for more details.
 */

qcom,BM31-SONY-2980mAh-data {
	qcom,fcc-mah = <2980>;
	qcom,default-rbatt-mohm = <149>;
	qcom,rbatt-capacitive-mohm = <0>;
	qcom,flat-ocv-threshold-uv = <3800000>;
	qcom,max-voltage-uv = <4350000>;
	qcom,v-cutoff-uv = <3400000>;
	qcom,chg-term-ua = <100000>;
	qcom,batt-id-kohm = <9>;
	xiaomi,batt-version = <3>;

	qcom,rbatt-sf-lut {
		qcom,lut-col-legend = <(-20) (-10) 0 5 10 15 20 25 30 40 60>;
		qcom,lut-row-legend = <100 95 90 85 80>,
				<75 70 65 60 55>,
				<50 45 40 35 30>,
				<25 20 16 13 11>,
				<10 9 8 7 6>,
				<5 4 3 2 1>;
		qcom,lut-data = <777 355 206 156 131 115 104 100 92 89 85>,
                                <777 364 212 161 136 119 108 102 94 90 86>,
                                <792 364 212 161 136 119 108 102 94 90 86>,
                                <798 369 217 169 141 124 112 107 97 93 87>,
                                <816 375 221 173 149 132 118 112 102 95 89>,
                                <807 372 218 171 148 135 124 117 106 99 91>,
                                <820 372 218 167 145 134 126 121 110 102 93>,
                                <837 375 217 165 140 126 118 116 110 106 97>,
                                <848 375 217 164 137 121 110 107 100 97 93>,
                                <865 379 219 165 138 120 108 103 95 91 89>,
                                <881 384 222 167 139 121 109 104 95 91 87>,
                                <898 389 225 169 141 123 110 106 97 93 88>,
                                <921 396 227 172 143 126 114 108 99 95 89>,
                                <950 405 231 174 146 128 116 111 102 97 92>,
                                <989 418 234 177 147 128 115 110 100 94 89>,
                                <1045 436 234 178 147 126 112 107 97 92 88>,
                                <1126 468 233 179 146 125 112 107 97 93 89>,
                                <1157 497 240 176 145 126 112 107 98 94 90>,
                                <1127 512 253 177 144 124 112 107 97 93 90>,
                                <1025 508 259 183 146 126 112 108 99 95 91>,
                                <875 493 248 186 149 128 115 110 100 96 92>,
                                <888 442 244 185 151 130 118 112 102 97 93>,
                                <905 432 250 189 155 134 120 114 105 99 95>,
                                <934 442 256 194 161 137 123 116 106 99 93>,
                                <969 453 259 195 160 137 121 114 104 97 93>,
                                <1024 461 259 193 158 135 121 116 104 99 93>,
                                <1140 477 261 196 161 139 125 118 107 101 95>,
                                <1575 498 270 204 169 146 130 123 111 104 97>,
                                <2512 539 285 215 177 153 137 130 118 112 105>,
                                <4557 640 320 238 196 170 155 151 134 138 124>;
	};

	qcom,fcc-temp-lut {
		qcom,lut-col-legend = <(-20) (-10) 0 5 10 15 20 25 30 40 60>;
		qcom,lut-data = <2983 2941 2968 2942 2941 2939 2937 2966 2936 2963 2948>;
	};

	qcom,pc-temp-ocv-lut {
		qcom,lut-col-legend = <(-20) (-10) 0 5 10 15 20 25 30 40 60>;
		qcom,lut-row-legend = <100 95 90 85 80>,
				<75 70 65 60 55>,
				<50 45 40 35 30>,
				<25 20 16 13 11>,
				<10 9 8 7 6>,
				<5 4 3 2 1 0>;
		qcom,lut-data = <4323 4320 4318 4318 4317 4315 4314 4312 4311 4305 4296>,
                                <4220 4231 4228 4234 4234 4233 4233 4228 4232 4225 4220>,
                                <4156 4170 4168 4174 4175 4175 4175 4170 4174 4168 4163>,
                                <4096 4112 4111 4120 4121 4121 4121 4117 4121 4115 4111>,
                                <4045 4064 4064 4071 4073 4073 4072 4068 4071 4065 4061>,
                                <3967 3992 3993 4005 4010 4015 4018 4014 4021 4018 4015>,
                                <3920 3943 3948 3956 3962 3969 3974 3972 3978 3974 3973>,
                                <3886 3909 3911 3918 3921 3924 3929 3927 3935 3933 3933>,
                                <3849 3873 3875 3882 3884 3886 3887 3884 3890 3887 3889>,
                                <3817 3840 3844 3851 3853 3853 3854 3850 3855 3851 3850>,
                                <3788 3812 3817 3824 3826 3827 3828 3825 3828 3824 3822>,
                                <3763 3788 3794 3801 3804 3805 3806 3804 3806 3803 3801>,
                                <3745 3767 3776 3783 3785 3787 3788 3786 3789 3786 3784>,
                                <3729 3753 3763 3768 3770 3772 3773 3772 3773 3772 3770>,
                                <3713 3741 3753 3759 3760 3760 3760 3760 3758 3755 3745>,
                                <3695 3729 3740 3747 3748 3747 3745 3743 3740 3735 3722>,
                                <3671 3714 3721 3729 3730 3729 3726 3725 3721 3716 3702>,
                                <3645 3698 3705 3708 3709 3708 3706 3703 3700 3694 3681>,
                                <3618 3681 3689 3690 3689 3688 3685 3681 3680 3672 3661>,
                                <3594 3665 3674 3677 3675 3674 3672 3668 3667 3661 3650>,
                                <3582 3655 3665 3669 3668 3667 3666 3662 3662 3655 3645>,
                                <3565 3643 3654 3661 3661 3661 3660 3654 3657 3648 3639>,
                                <3542 3628 3640 3650 3651 3651 3651 3643 3648 3637 3629>,
                                <3514 3606 3620 3634 3636 3636 3636 3625 3633 3618 3609>,
                                <3479 3577 3589 3606 3608 3608 3608 3592 3603 3584 3573>,
                                <3437 3536 3545 3562 3563 3563 3563 3544 3559 3536 3526>,
                                <3388 3480 3485 3502 3503 3505 3505 3483 3503 3476 3468>,
                                <3329 3408 3411 3427 3429 3431 3433 3408 3432 3401 3396>,
                                <3255 3317 3320 3332 3335 3339 3341 3313 3342 3305 3305>,
                                <3156 3196 3199 3206 3209 3213 3216 3184 3217 3178 3185>,
                                <3000 3000 3000 3000 3000 3000 3000 3000 3000 3000 3000>;
	};
};
