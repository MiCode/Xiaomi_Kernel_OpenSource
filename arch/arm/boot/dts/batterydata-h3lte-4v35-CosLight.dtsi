/* Copyright (c) 2013, The Linux Foundation. All rights reserved.
 * Copyright (C) 2015 XiaoMi, Inc.
 *
 * This program is free software; you can redistribute it and/or modify
 * it under the terms of the GNU General Public License version 2 and
 * only version 2 as published by the Free Software Foundation.
 *
 * This program is distributed in the hope that it will be useful,
 * but WITHOUT ANY WARRANTY; without even the implied warranty of
 * MERCHANTABILITY or FITNESS FOR A PARTICULAR PURPOSE.  See the
 * GNU General Public License for more details.
 */

qcom,h3lte-4v35-CosLight {
	qcom,fcc-mah = <3200>;
	qcom,default-rbatt-mohm = <156>;
	qcom,rbatt-capacitive-mohm = <0>;
	qcom,flat-ocv-threshold-uv = <3800000>;
	qcom,max-voltage-uv = <4350000>;
	qcom,v-cutoff-uv = <3400000>;
	qcom,chg-term-ua = <150000>;
	qcom,batt-id-kohm = <12>;

	qcom,rbatt-sf-lut {
		qcom,lut-col-legend = <(-20) (-10) 0 5 10 15 20 25 30 40 60>;
		qcom,lut-row-legend = <100 95 90 85 80>,
				<75 70 65 60 55>,
				<50 45 40 35 30>,
				<25 20 16 13 11>,
				<10 9 8 7 6>,
				<5 4 3 2 1>;
		qcom,lut-data = 	<1467 535 255 191 151 125 109 100 92 85 82>,
				<1337 539 264 196 153 126 110 101 93 86 82>,
				<1345 539 263 195 153 126 110 100 93 86 82>,
				<1291 524 269 203 158 130 113 102 95 87 83>,
				<1159 547 271 206 163 135 117 104 98 89 83>,
				<1117 501 276 219 175 144 124 110 101 92 84>,
				<1091 488 241 193 166 144 126 113 104 95 85>,
				<1078 498 241 186 158 141 129 117 110 98 89>,
				<1094 504 244 183 147 128 115 105 100 92 85>,
				<1123 505 244 183 144 122 107 100 93 86 83>,
				<1153 509 247 185 146 123 108 99 92 85 82>,
				<1187 525 249 187 149 125 109 100 94 86 83>,
				<1223 553 255 189 150 127 111 101 94 88 84>,
				<1265 593 266 194 151 128 112 103 96 89 85>,
				<1312 639 281 203 156 128 112 102 95 87 84>,
				<1383 693 299 214 161 130 112 101 94 85 82>,
				<1536 762 314 224 167 133 114 102 93 85 82>,
				<1730 835 335 232 171 136 114 102 94 86 82>,
				<1928 896 367 243 175 136 114 102 94 87 82>,
				<2094 932 396 261 182 141 117 103 96 88 83>,
				<2175 948 411 271 188 144 119 105 97 89 85>,
				<2261 953 419 281 194 148 122 108 99 91 87>,
				<2248 934 415 284 198 152 125 110 101 92 89>,
				<2314 910 401 278 200 155 129 113 103 94 89>,
				<2433 934 401 275 198 154 126 110 100 91 85>,
				<2731 977 414 276 193 149 122 107 98 89 85>,
				<3134 1033 435 287 197 150 123 108 99 90 86>,
				<3670 1136 467 307 207 155 128 112 101 93 88>,
				<4502 1405 512 338 225 167 135 118 108 98 94>,
				<6993 2150 683 442 260 192 157 141 132 125 135>;
	};

	qcom,fcc-temp-lut {
		qcom,lut-col-legend = <(-20) (-10) 0 5 10 15 20 25 30 40 60>;
		qcom,lut-data = <3100 3112 3112 3111 3109 3107 3105 3104 3103 3101 3093>;
	};

	qcom,pc-temp-ocv-lut {
		qcom,lut-col-legend = <(-20) (-10) 0 5 10 15 20 25 30 40 60>;
		qcom,lut-row-legend = <100 95 90 85 80>,
				<75 70 65 60 55>,
				<50 45 40 35 30>,
				<25 20 16 13 11>,
				<10 9 8 7 6>,
				<5 4 3 2 1>,
				<0>;
		qcom,lut-data = 	<4321 4323 4323 4323 4322 4321 4320 4319 4318 4314 4307>,
				<4206 4237 4246 4249 4251 4253 4253 4253 4253 4251 4248>,
				<4130 4176 4191 4194 4196 4198 4198 4198 4197 4196 4193>,
				<4087 4113 4139 4143 4144 4145 4145 4145 4145 4143 4140>,
				<3991 4072 4090 4093 4095 4094 4094 4094 4093 4092 4090>,
				<3934 3994 4035 4045 4049 4051 4051 4051 4050 4048 4042>,
				<3885 3936 3956 3966 3976 3982 3986 3988 3991 3997 3998>,
				<3845 3899 3918 3925 3934 3942 3948 3951 3954 3957 3956>,
				<3819 3865 3887 3891 3895 3900 3903 3905 3906 3907 3907>,
				<3802 3833 3856 3860 3862 3864 3866 3867 3867 3868 3867>,
				<3786 3805 3827 3832 3835 3837 3838 3839 3839 3840 3839>,
				<3773 3784 3803 3808 3813 3815 3816 3817 3818 3817 3817>,
				<3760 3768 3786 3789 3794 3796 3798 3798 3799 3799 3798>,
				<3747 3755 3772 3776 3778 3780 3782 3782 3782 3782 3781>,
				<3734 3743 3760 3765 3766 3767 3767 3767 3766 3763 3756>,
				<3719 3733 3746 3751 3753 3753 3752 3751 3748 3743 3731>,
				<3699 3721 3726 3731 3733 3734 3733 3731 3728 3722 3709>,
				<3679 3709 3710 3712 3713 3713 3712 3710 3707 3702 3688>,
				<3659 3697 3702 3700 3699 3697 3695 3694 3691 3686 3674>,
				<3641 3685 3696 3695 3693 3692 3690 3689 3687 3682 3670>,
				<3630 3677 3692 3692 3691 3690 3689 3687 3685 3680 3668>,
				<3618 3669 3687 3689 3689 3688 3687 3685 3683 3679 3666>,
				<3606 3659 3681 3685 3686 3686 3685 3684 3681 3676 3663>,
				<3590 3645 3671 3676 3680 3681 3680 3679 3676 3669 3654>,
				<3571 3626 3652 3659 3664 3665 3664 3662 3658 3649 3628>,
				<3545 3599 3624 3629 3632 3633 3631 3627 3623 3612 3589>,
				<3511 3564 3583 3586 3587 3587 3583 3580 3575 3563 3539>,
				<3464 3513 3527 3528 3528 3526 3523 3519 3513 3502 3476>,
				<3393 3438 3447 3447 3446 3445 3442 3438 3431 3419 3391>,
				<3265 3310 3320 3320 3323 3322 3319 3314 3306 3290 3260>,
				<3000 3000 3000 3000 3000 3000 3000 3000 3000 3000 3000>;
	};
};
