/* Copyright (c) 2013, The Linux Foundation. All rights reserved.
 * Copyright (C) 2015 XiaoMi, Inc.
 *
 * This program is free software; you can redistribute it and/or modify
 * it under the terms of the GNU General Public License version 2 and
 * only version 2 as published by the Free Software Foundation.
 *
 * This program is distributed in the hope that it will be useful,
 * but WITHOUT ANY WARRANTY; without even the implied warranty of
 * MERCHANTABILITY or FITNESS FOR A PARTICULAR PURPOSE.  See the
 * GNU General Public License for more details.
 */

qcom,BM31-SDI-3020mAh-data {
	qcom,fcc-mah = <3020>;
	qcom,default-rbatt-mohm = <163>;
	qcom,rbatt-capacitive-mohm = <0>;
	qcom,flat-ocv-threshold-uv = <3800000>;
	qcom,max-voltage-uv = <4350000>;
	qcom,v-cutoff-uv = <3400000>;
	qcom,chg-term-ua = <200000>;
	qcom,batt-id-kohm = <29>;
	xiaomi,batt-version = <4>;

	qcom,rbatt-sf-lut {
		qcom,lut-col-legend = <(-20) (-10) 0 5 10 15 20 25 30 40 60>;
		qcom,lut-row-legend = <100 95 90 85 80>,
				<75 70 65 60 55>,
				<50 45 40 35 30>,
				<25 20 16 13 11>,
				<10 9 8 7 6>,
				<5 4 3 2 1>;
		qcom,lut-data = <926 525 260 195 150 125 109 100 93 85 79>,
				<925 526 261 195 151 126 110 100 93 85 79>,
				<846 496 259 195 153 126 111 101 93 86 80>,
				<803 474 257 197 155 129 114 103 95 87 80>,
				<739 466 258 198 158 132 116 105 98 90 84>,
				<728 430 261 209 170 142 125 113 106 95 88>,
				<717 429 238 188 157 136 122 112 104 95 88>,
				<718 428 246 192 160 142 130 119 111 101 93>,
				<719 420 237 182 149 130 119 112 107 100 90>,
				<726 417 231 175 140 119 105 96 91 85 78>,
				<742 425 231 176 139 117 103 94 88 82 76>,
				<768 436 234 177 140 118 104 95 89 83 77>,
				<826 450 241 180 142 120 106 98 92 85 79>,
				<912 468 249 186 146 123 109 100 93 87 81>,
				<1017 492 262 194 152 126 110 101 95 88 82>,
				<1151 520 279 203 158 131 114 103 96 88 81>,
				<1323 555 303 214 165 135 117 106 98 90 84>,
				<1512 584 327 228 169 138 120 108 100 91 85>,
				<1685 602 344 243 176 139 119 107 99 90 84>,
				<1694 584 336 247 180 143 122 109 101 93 87>,
				<1812 583 341 249 183 146 123 111 103 95 88>,
				<1948 597 353 257 190 150 127 114 106 96 92>,
				<2124 615 364 268 198 157 133 119 110 101 96>,
				<2338 635 379 280 209 166 139 125 115 106 101>,
				<2576 655 393 292 220 174 147 131 122 111 106>,
				<2901 707 406 300 225 177 149 133 123 111 103>,
				<3236 782 419 307 227 177 148 130 119 107 100>,
				<3758 901 441 321 236 182 152 133 122 110 103>,
				<4696 1079 476 347 257 198 164 144 133 120 112>,
				<11973 1603 904 397 300 239 202 183 175 166 573>;
	};

	qcom,fcc-temp-lut {
		qcom,lut-col-legend = <(-20) (-10) 0 5 10 15 20 25 30 40 60>;
		qcom,lut-data = <3050 3020 3030 3025 3024 3021 3020 3019 3017 3015 3010>;
	};

	qcom,pc-temp-ocv-lut {
		qcom,lut-col-legend = <(-20) (-10) 0 5 10 15 20 25 30 40 60>;
		qcom,lut-row-legend = <100 95 90 85 80>,
				<75 70 65 60 55>,
				<50 45 40 35 30>,
				<25 20 16 13 11>,
				<10 9 8 7 6>,
				<5 4 3 2 1 0>;
		qcom,lut-data = <4298 4295 4302 4301 4301 4301 4301 4300 4300 4298 4294>,
				<4223 4231 4242 4245 4247 4249 4250 4250 4250 4250 4248>,
				<4159 4170 4185 4188 4191 4193 4194 4195 4195 4195 4193>,
				<4107 4116 4132 4136 4140 4141 4142 4142 4142 4142 4141>,
				<4031 4069 4082 4087 4089 4090 4091 4092 4092 4092 4090>,
				<3986 4001 4033 4042 4047 4049 4051 4051 4051 4048 4046>,
				<3933 3954 3966 3973 3979 3983 3986 3988 3990 3993 3993>,
				<3900 3918 3934 3940 3945 3951 3955 3957 3958 3958 3957>,
				<3866 3877 3893 3898 3902 3906 3910 3912 3914 3916 3915>,
				<3837 3844 3857 3861 3864 3865 3867 3868 3868 3869 3869>,
				<3813 3820 3829 3833 3835 3837 3837 3838 3838 3839 3839>,
				<3794 3800 3806 3810 3812 3814 3815 3815 3816 3816 3816>,
				<3776 3784 3788 3791 3794 3795 3796 3797 3797 3798 3797>,
				<3760 3770 3773 3777 3779 3779 3780 3781 3781 3781 3781>,
				<3745 3757 3760 3764 3767 3767 3767 3768 3768 3767 3764>,
				<3728 3744 3747 3750 3754 3755 3755 3755 3754 3751 3746>,
				<3708 3727 3731 3731 3734 3736 3737 3736 3735 3732 3726>,
				<3685 3708 3713 3712 3712 3713 3714 3714 3713 3710 3703>,
				<3665 3692 3699 3699 3698 3696 3695 3695 3693 3691 3684>,
				<3655 3683 3692 3693 3692 3690 3689 3688 3687 3684 3678>,
				<3649 3678 3689 3690 3689 3688 3687 3687 3685 3683 3677>,
				<3642 3673 3686 3687 3687 3687 3686 3685 3684 3682 3676>,
				<3633 3667 3681 3684 3685 3685 3684 3683 3682 3680 3674>,
				<3623 3659 3675 3680 3681 3682 3682 3681 3680 3677 3671>,
				<3609 3646 3665 3672 3675 3676 3675 3675 3673 3671 3664>,
				<3585 3626 3646 3654 3658 3659 3659 3658 3656 3652 3642>,
				<3547 3591 3612 3620 3623 3623 3622 3620 3618 3612 3600>,
				<3494 3541 3561 3568 3569 3568 3566 3562 3559 3553 3540>,
				<3416 3469 3487 3494 3493 3489 3486 3482 3478 3471 3457>,
				<3290 3354 3369 3379 3376 3370 3366 3361 3355 3346 3328>,
				<3000 3000 3000 3000 3000 3000 3000 3000 3000 3000 3000>;
	};
};
