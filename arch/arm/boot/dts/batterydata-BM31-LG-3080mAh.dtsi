/* Copyright (c) 2013, The Linux Foundation. All rights reserved.
 * Copyright (C) 2015 XiaoMi, Inc.
 *
 * This program is free software; you can redistribute it and/or modify
 * it under the terms of the GNU General Public License version 2 and
 * only version 2 as published by the Free Software Foundation.
 *
 * This program is distributed in the hope that it will be useful,
 * but WITHOUT ANY WARRANTY; without even the implied warranty of
 * MERCHANTABILITY or FITNESS FOR A PARTICULAR PURPOSE.  See the
 * GNU General Public License for more details.
 */

qcom,BM31-LG-3080mAh-data {
	qcom,fcc-mah = <3080>;
	qcom,default-rbatt-mohm = <114>;
	qcom,rbatt-capacitive-mohm = <0>;
	qcom,flat-ocv-threshold-uv = <3800000>;
	qcom,max-voltage-uv = <4350000>;
	qcom,v-cutoff-uv = <3400000>;
	qcom,chg-term-ua = <200000>;
	qcom,batt-id-kohm = <50>;
	xiaomi,batt-version = <5>;

	qcom,rbatt-sf-lut {
		qcom,lut-col-legend = <(-20) (-10) 0 5 10 15 20 25 30 40 60>;
		qcom,lut-row-legend = <100 95 90 85 80>,
				<75 70 65 60 55>,
				<50 45 40 35 30>,
				<25 20 16 13 11>,
				<10 9 8 7 6>,
				<5 4 3 2 1>;
		qcom,lut-data = <1464 825 353 233 170 135 114 101 91 80 71>,
				<1464 825 353 233 170 135 114 101 91 80 71>,
				<1360 812 360 242 179 141 121 106 95 84 72>,
				<1340 775 370 251 187 149 127 111 100 88 75>,
				<1331 800 377 261 197 160 134 118 105 92 79>,
				<1253 772 398 281 212 171 143 125 112 96 82>,
				<1260 722 373 270 218 178 152 133 118 101 86>,
				<1251 725 364 253 206 182 161 142 127 107 89>,
				<1271 712 363 247 189 160 146 141 131 116 96>,
				<1323 720 359 239 182 142 121 107 98 87 75>,
				<1381 756 361 244 179 143 121 106 96 84 74>,
				<1456 807 367 247 186 148 125 110 99 89 79>,
				<1531 866 385 254 191 154 130 115 105 96 83>,
				<1601 940 416 270 196 158 137 121 110 96 86>,
				<1704 1021 462 296 216 167 142 126 112 96 80>,
				<1811 1102 530 335 239 182 148 129 112 93 78>,
				<1946 1188 625 375 261 190 153 128 111 93 79>,
				<2135 1273 710 422 275 196 154 129 112 93 77>,
				<2492 1354 776 475 301 205 156 127 110 90 77>,
				<2751 1405 771 504 325 223 168 137 119 97 81>,
				<2678 1382 794 514 336 231 174 145 123 101 82>,
				<2847 1423 826 540 357 244 184 152 129 105 83>,
				<3189 1475 861 570 380 261 195 160 133 108 84>,
				<3604 1533 900 599 402 279 205 167 139 110 83>,
				<4132 1600 937 626 421 290 211 168 139 106 81>,
				<4825 1674 970 654 439 302 215 168 137 104 83>,
				<5754 1775 1016 690 465 318 221 172 139 109 86>,
				<7106 2177 1077 739 503 340 240 186 151 114 91>,
				<9183 2839 1189 807 558 386 272 209 169 129 99>,
				<13100 4018 1695 931 652 461 335 258 214 170 120>;
	};

	qcom,fcc-temp-lut {
		qcom,lut-col-legend = <(-20) (-10) 0 5 10 15 20 25 30 40 60>;
		qcom,lut-data = <2821 2828 2860 2848 2850 2848 2846 2844 2842 2838 2818>;
	};

	qcom,pc-temp-ocv-lut {
		qcom,lut-col-legend = <(-20) (-10) 0 5 10 15 20 25 30 40 60>;
		qcom,lut-row-legend = <100 95 90 85 80>,
				<75 70 65 60 55>,
				<50 45 40 35 30>,
				<25 20 16 13 11>,
				<10 9 8 7 6>,
				<5 4 3 2 1 0>;
		qcom,lut-data = <4338 4338 4334 4332 4333 4332 4331 4330 4328 4324 4316>,
				<4234 4250 4258 4260 4264 4264 4264 4264 4264 4260 4254>,
				<4162 4183 4198 4202 4206 4208 4208 4208 4207 4204 4198>,
				<4104 4122 4142 4146 4150 4152 4152 4152 4152 4150 4144>,
				<4050 4076 4088 4093 4097 4099 4100 4100 4100 4098 4092>,
				<3966 4016 4036 4042 4048 4050 4051 4052 4051 4049 4044>,
				<3922 3954 3978 3986 3997 4000 4002 4003 4004 4004 3999>,
				<3877 3912 3932 3938 3950 3959 3962 3964 3964 3963 3959>,
				<3846 3870 3891 3895 3901 3908 3913 3920 3922 3924 3920>,
				<3826 3834 3855 3859 3864 3865 3867 3868 3868 3869 3868>,
				<3810 3814 3825 3830 3834 3836 3837 3838 3838 3839 3837>,
				<3794 3801 3800 3806 3811 3814 3814 3815 3815 3816 3815>,
				<3778 3787 3782 3787 3791 3794 3796 3796 3796 3797 3796>,
				<3762 3773 3770 3774 3776 3778 3780 3780 3780 3779 3778>,
				<3745 3757 3758 3764 3768 3767 3768 3768 3767 3764 3756>,
				<3728 3740 3742 3751 3756 3757 3756 3756 3754 3748 3734>,
				<3708 3723 3722 3726 3732 3734 3734 3733 3730 3724 3712>,
				<3688 3706 3703 3702 3702 3702 3702 3700 3698 3692 3678>,
				<3669 3690 3687 3687 3686 3684 3683 3681 3678 3674 3664>,
				<3654 3678 3676 3679 3679 3678 3678 3677 3675 3671 3660>,
				<3646 3672 3672 3675 3676 3676 3676 3675 3673 3669 3658>,
				<3636 3664 3666 3670 3672 3673 3674 3673 3671 3667 3656>,
				<3624 3656 3658 3664 3668 3669 3670 3669 3668 3664 3652>,
				<3610 3645 3648 3655 3659 3662 3663 3662 3660 3657 3644>,
				<3592 3628 3632 3637 3642 3645 3646 3646 3643 3638 3620>,
				<3568 3603 3601 3607 3612 3614 3614 3612 3608 3599 3580>,
				<3534 3562 3556 3564 3568 3568 3566 3563 3558 3548 3530>,
				<3484 3504 3496 3506 3507 3506 3502 3499 3493 3482 3464>,
				<3408 3422 3406 3428 3424 3422 3418 3414 3408 3396 3378>,
				<3288 3294 3270 3304 3300 3296 3292 3286 3278 3260 3245>,
				<3000 3000 3000 3000 3000 3000 3000 3000 3000 3000 3000>;
	};
};
