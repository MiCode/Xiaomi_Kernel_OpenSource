/*
 * Copyright (C) 2010 - 2021 Novatek, Inc.
 *
 * $Revision$
 * $Date$
 *
 * This program is free software; you can redistribute it and/or modify
 * it under the terms of the GNU General Public License as published by
 * the Free Software Foundation; either version 2 of the License, or
 * (at your option) any later version.
 *
 * This program is distributed in the hope that it will be useful, but WITHOUT
 * ANY WARRANTY; without even the implied warranty of MERCHANTABILITY or
 * FITNESS FOR A PARTICULAR PURPOSE.  See the GNU General Public License for
 * more details.
 *
 */


&spi3 {

	#address-cells = <1>;
	#size-cells = <0>;
	status = "ok";

	/* Novatek device tree node */
	touch@0 {
		compatible = "novatek,NVT-ts-spi","chipone-tddi","focaltech,fts","mediatek,cap_touch";
		reg = <0>; //Same as CS ID
		status = "ok";

		spi-max-frequency = <9600000>;	//4800000,9600000,15000000,19200000

		/*[IC Vendor]Focaltech [IC Name]FT8006s - device tree
		 *********************************************************************/
		/* Focaltech GPIO Configuration */
		interrupt-parent = <&pio>;
		interrupts = <13 0x02>;
		focaltech,reset-gpio = <&pio 174 0x01>;
		focaltech,irq-gpio = <&pio 0 0x02>;
		focaltech,max-touch-number = <10>;
		focaltech,display-coords =  <0 0 719 1599>;
		/* Chipone TDDI touchscreen driver device tree source include file*/
		//interrupt-parent = <&pio>;
		//interrupts = <0 IRQ_TYPE_EDGE_FALLING 0 0>;
		chipone,rst-gpio = <&pio 174 0x00>;
		chipone,irq-gpio = <&pio 0 0x00>;
		chipone,x-res = <719>;
		chipone,y-res = <1599>;
		/* selftest settings */
		chipone,test-reset-pin;
		chipone,test-int-pin;
		chipone,test-rawdata;
		chipone,test-rawdata-frames = <1>;
		chipone,rawdata-min = <1222>;
		chipone,rawdata-max = <2902>;
		chipone,rawdata-min-holitech = <1290>;//base 2000
		chipone,rawdata-max-holitech = <2833>;
		chipone,rawdata-min-ctc = <1283>;//base 2000
		chipone,rawdata-max-ctc = <2846>;
		chipone,test-noise;
		chipone,test-noise-frames = <16>;
		chipone,noise-max = <89>;
		chipone,test-open;
		chipone,open-min = <2400>;
		chipone,open-min-holitech = <3674>;
		chipone,open-min-ctc = <3465>;
		chipone,test-short;
		chipone,short-min = <1850>;
		chipone,short-min-holitech = <500>;
		chipone,short-min-ctc = <800>;
		chipone,test-compensate-cap;
		chipone,compensate-cap-min = <1>;
		chipone,compensate-cap-max = <126>;
		/* Charger detect */
		chipone,touch-charger-detect-enable;
		chipone,touch-charger-detect-type = "notify"; /* notify, poll */
		chipone,touch-charger-detect-psy-name = "mtk_charger_type";
		chipone,touch-charger-detect-psp = "POWER_SUPPLY_PROP_ONLINE";
		chipone,touch-charger-detect-psp-poll-interval = <1000>;
		/* Earjack detect */
		chipone,touch-earjack-detect-enable;
		/* MTK:  /sys/bus/platform/drivers/Accdet_Driver/state,
		Sprd: /sys/kernel/headset/state
		QCOM: None, and disable it */
		chipone,touch-earjack-state-filepath = "/sys/bus/platform/drivers/pmic-codec-accdet/state";
		chipone,touch-earjack-poll-interval = <1000>;


		/*[IC Vendor]NOVATEK [IC Name]Nt36525b - device tree */
		novatek,reset-gpio = <&pio 174 0x00>;
		novatek,irq-gpio = <&pio 0 0x2001>;

		//novatek,pen-support;
		//novatek,stylus-resol-double;

		/* 525 */
		//novatek,swrst-n8-addr = <0x01F01A>;

		/* 672A, 525B, 675, 526, 672C, 523 */
		novatek,swrst-n8-addr = <0x03F0FE>;
		novatek,spi-rd-fast-addr = <0x03F310>;

		/* MP */
		novatek,mp-support-dt;

		/* for Xiaomi C3S 525B Truly 6.517" module */
		novatek-mp-criteria-596B@0 {
			#address-cells = <1>;
			#size-cells = <0>;
			compatible = "novatek-mp-criteria-596B";

			/* MP Config */
			IC_X_CFG_SIZE = <18>;
			IC_Y_CFG_SIZE = <32>;
			IC_KEY_CFG_SIZE = <4>;
			X_Channel = <18>;
			Y_Channel = <32>;
			AIN_X = <0 1 2 3 4 5 6 7 8 9 10 11 12 13 14 15 16 17>;
			AIN_Y = <0 1 2 3 4 5 6 7 8 9 10 11 12 13 14 15 16 17 18 19 20 21 22 23 24 25 26 27 28 29 30 31>;
			//AIN_X = <0 1 2 3 4 5 6 7 8 9 10 11 12 13 14 15 16 17 18 19 20 21 22 23 24 25 26 27 28 29 30 31>;
			//AIN_Y = <0 1 2 3 4 5 6 7 8 9 10 11 12 13 14 15 16 17 18 19 20 21 22 23 24 25 26 27 28 29 30 31 32 33 34 35 36 37 38 39 40 41 42 43 44 45 46 47 48 49>;
			AIN_KEY = <0 1 2 0xFF>;

			/* MP Criteria */
			PS_Config_Lmt_Short_Rawdata_P = <
				14008	14008	14008	14008	14008	14008	14008	14008	14008	14008	14008	14008	14008	14008	14008	14008	14008	14008
				14008	14008	14008	14008	14008	14008	14008	14008	14008	14008	14008	14008	14008	14008	14008	14008	14008	14008
				14008	14008	14008	14008	14008	14008	14008	14008	14008	14008	14008	14008	14008	14008	14008	14008	14008	14008
				14008	14008	14008	14008	14008	14008	14008	14008	14008	14008	14008	14008	14008	14008	14008	14008	14008	14008
				14008	14008	14008	14008	14008	14008	14008	14008	14008	14008	14008	14008	14008	14008	14008	14008	14008	14008
				14008	14008	14008	14008	14008	14008	14008	14008	14008	14008	14008	14008	14008	14008	14008	14008	14008	14008
				14008	14008	14008	14008	14008	14008	14008	14008	14008	14008	14008	14008	14008	14008	14008	14008	14008	14008
				14008	14008	14008	14008	14008	14008	14008	14008	14008	14008	14008	14008	14008	14008	14008	14008	14008	14008
				14008	14008	14008	14008	14008	14008	14008	14008	14008	14008	14008	14008	14008	14008	14008	14008	14008	14008
				14008	14008	14008	14008	14008	14008	14008	14008	14008	14008	14008	14008	14008	14008	14008	14008	14008	14008
				14008	14008	14008	14008	14008	14008	14008	14008	14008	14008	14008	14008	14008	14008	14008	14008	14008	14008
				14008	14008	14008	14008	14008	14008	14008	14008	14008	14008	14008	14008	14008	14008	14008	14008	14008	14008
				14008	14008	14008	14008	14008	14008	14008	14008	14008	14008	14008	14008	14008	14008	14008	14008	14008	14008
				14008	14008	14008	14008	14008	14008	14008	14008	14008	14008	14008	14008	14008	14008	14008	14008	14008	14008
				14008	14008	14008	14008	14008	14008	14008	14008	14008	14008	14008	14008	14008	14008	14008	14008	14008	14008
				14008	14008	14008	14008	14008	14008	14008	14008	14008	14008	14008	14008	14008	14008	14008	14008	14008	14008
				14008	14008	14008	14008	14008	14008	14008	14008	14008	14008	14008	14008	14008	14008	14008	14008	14008	14008
				14008	14008	14008	14008	14008	14008	14008	14008	14008	14008	14008	14008	14008	14008	14008	14008	14008	14008
				14008	14008	14008	14008	14008	14008	14008	14008	14008	14008	14008	14008	14008	14008	14008	14008	14008	14008
				14008	14008	14008	14008	14008	14008	14008	14008	14008	14008	14008	14008	14008	14008	14008	14008	14008	14008
				14008	14008	14008	14008	14008	14008	14008	14008	14008	14008	14008	14008	14008	14008	14008	14008	14008	14008
				14008	14008	14008	14008	14008	14008	14008	14008	14008	14008	14008	14008	14008	14008	14008	14008	14008	14008
				14008	14008	14008	14008	14008	14008	14008	14008	14008	14008	14008	14008	14008	14008	14008	14008	14008	14008
				14008	14008	14008	14008	14008	14008	14008	14008	14008	14008	14008	14008	14008	14008	14008	14008	14008	14008
				14008	14008	14008	14008	14008	14008	14008	14008	14008	14008	14008	14008	14008	14008	14008	14008	14008	14008
				14008	14008	14008	14008	14008	14008	14008	14008	14008	14008	14008	14008	14008	14008	14008	14008	14008	14008
				14008	14008	14008	14008	14008	14008	14008	14008	14008	14008	14008	14008	14008	14008	14008	14008	14008	14008
				14008	14008	14008	14008	14008	14008	14008	14008	14008	14008	14008	14008	14008	14008	14008	14008	14008	14008
				14008	14008	14008	14008	14008	14008	14008	14008	14008	14008	14008	14008	14008	14008	14008	14008	14008	14008
				14008	14008	14008	14008	14008	14008	14008	14008	14008	14008	14008	14008	14008	14008	14008	14008	14008	14008
				14008	14008	14008	14008	14008	14008	14008	14008	14008	14008	14008	14008	14008	14008	14008	14008	14008	14008
				14008	14008	14008	14008	14008	14008	14008	14008	14008	14008	14008	14008	14008	14008	14008	14008	14008	14008
				14008 14008 14008>;

			PS_Config_Lmt_Short_Rawdata_N = <
				11376	11376	11376	11376	11376	11376	11376	11376	11376	11376	11376	11376	11376	11376	11376	11376	11376	11376
				11376	11376	11376	11376	11376	11376	11376	11376	11376	11376	11376	11376	11376	11376	11376	11376	11376	11376
				11376	11376	11376	11376	11376	11376	11376	11376	11376	11376	11376	11376	11376	11376	11376	11376	11376	11376
				11376	11376	11376	11376	11376	11376	11376	11376	11376	11376	11376	11376	11376	11376	11376	11376	11376	11376
				11376	11376	11376	11376	11376	11376	11376	11376	11376	11376	11376	11376	11376	11376	11376	11376	11376	11376
				11376	11376	11376	11376	11376	11376	11376	11376	11376	11376	11376	11376	11376	11376	11376	11376	11376	11376
				11376	11376	11376	11376	11376	11376	11376	11376	11376	11376	11376	11376	11376	11376	11376	11376	11376	11376
				11376	11376	11376	11376	11376	11376	11376	11376	11376	11376	11376	11376	11376	11376	11376	11376	11376	11376
				11376	11376	11376	11376	11376	11376	11376	11376	11376	11376	11376	11376	11376	11376	11376	11376	11376	11376
				11376	11376	11376	11376	11376	11376	11376	11376	11376	11376	11376	11376	11376	11376	11376	11376	11376	11376
				11376	11376	11376	11376	11376	11376	11376	11376	11376	11376	11376	11376	11376	11376	11376	11376	11376	11376
				11376	11376	11376	11376	11376	11376	11376	11376	11376	11376	11376	11376	11376	11376	11376	11376	11376	11376
				11376	11376	11376	11376	11376	11376	11376	11376	11376	11376	11376	11376	11376	11376	11376	11376	11376	11376
				11376	11376	11376	11376	11376	11376	11376	11376	11376	11376	11376	11376	11376	11376	11376	11376	11376	11376
				11376	11376	11376	11376	11376	11376	11376	11376	11376	11376	11376	11376	11376	11376	11376	11376	11376	11376
				11376	11376	11376	11376	11376	11376	11376	11376	11376	11376	11376	11376	11376	11376	11376	11376	11376	11376
				11376	11376	11376	11376	11376	11376	11376	11376	11376	11376	11376	11376	11376	11376	11376	11376	11376	11376
				11376	11376	11376	11376	11376	11376	11376	11376	11376	11376	11376	11376	11376	11376	11376	11376	11376	11376
				11376	11376	11376	11376	11376	11376	11376	11376	11376	11376	11376	11376	11376	11376	11376	11376	11376	11376
				11376	11376	11376	11376	11376	11376	11376	11376	11376	11376	11376	11376	11376	11376	11376	11376	11376	11376
				11376	11376	11376	11376	11376	11376	11376	11376	11376	11376	11376	11376	11376	11376	11376	11376	11376	11376
				11376	11376	11376	11376	11376	11376	11376	11376	11376	11376	11376	11376	11376	11376	11376	11376	11376	11376
				11376	11376	11376	11376	11376	11376	11376	11376	11376	11376	11376	11376	11376	11376	11376	11376	11376	11376
				11376	11376	11376	11376	11376	11376	11376	11376	11376	11376	11376	11376	11376	11376	11376	11376	11376	11376
				11376	11376	11376	11376	11376	11376	11376	11376	11376	11376	11376	11376	11376	11376	11376	11376	11376	11376
				11376	11376	11376	11376	11376	11376	11376	11376	11376	11376	11376	11376	11376	11376	11376	11376	11376	11376
				11376	11376	11376	11376	11376	11376	11376	11376	11376	11376	11376	11376	11376	11376	11376	11376	11376	11376
				11376	11376	11376	11376	11376	11376	11376	11376	11376	11376	11376	11376	11376	11376	11376	11376	11376	11376
				11376	11376	11376	11376	11376	11376	11376	11376	11376	11376	11376	11376	11376	11376	11376	11376	11376	11376
				11376	11376	11376	11376	11376	11376	11376	11376	11376	11376	11376	11376	11376	11376	11376	11376	11376	11376
				11376	11376	11376	11376	11376	11376	11376	11376	11376	11376	11376	11376	11376	11376	11376	11376	11376	11376
				11376	11376	11376	11376	11376	11376	11376	11376	11376	11376	11376	11376	11376	11376	11376	11376	11376	11376
				10000 10000 10000>;

			PS_Config_Lmt_Open_Rawdata_P = <
				2703	2735	2748	2804	2853	2823	2830	2912	65535	65535	2816	2735	2741	2763	2783	2798	2788	2704
				2499	2521	2571	2651	2732	2745	2753	2758	2723	2699	2738	2724	2725	2710	2704	2696	2646	2578
				2543	2571	2619	2707	2790	2809	2811	2819	2777	2709	2741	2732	2727	2716	2709	2703	2651	2588
				2571	2591	2640	2723	2809	2828	2830	2840	2794	2756	2798	2788	2788	2783	2770	2763	2718	2660
				2595	2619	2676	2769	2857	2872	2872	2878	2828	2721	2760	2753	2749	2742	2730	2724	2681	2622
				2592	2612	2662	2751	2847	2881	2881	2891	2835	2809	2857	2850	2844	2836	2819	2812	2773	2709
				2651	2700	2735	2770	2801	2811	2847	2853	2849	2976	2963	2959	2921	2892	2791	2682	2611	2535
				2707	2755	2794	2835	2857	2878	2896	2906	2893	3040	3029	3010	2982	2955	2851	2741	2668	2591
				2716	2766	2808	2851	2868	2891	2902	2916	2903	3033	3024	3005	2989	2963	2864	2745	2675	2595
				2774	2825	2875	2917	2944	2969	2989	2993	2979	3110	3102	3094	3073	3052	2941	2825	2758	2675
				2814	2864	2917	2958	2977	3001	3019	3025	3022	3117	3105	3098	3085	3066	2972	2853	2783	2699
				2843	2898	2954	3000	3024	3045	3047	3054	3052	3201	3194	3187	3183	3158	3061	2937	2863	2777
				2896	2944	3033	3070	3101	3116	3123	3127	3133	3220	3203	3192	3185	3165	3066	2944	2843	2760
				2917	2969	3056	3106	3126	3148	3157	3166	3173	3284	3269	3255	3253	3232	3148	3028	2926	2836
				2986	3040	3127	3176	3200	3217	3228	3239	3238	3313	3304	3292	3280	3274	3186	3067	2958	2871
				3045	3103	3193	3255	3269	3290	3291	3304	3299	3399	3390	3381	3375	3360	3285	3165	3057	2969
				3045	3094	3187	3241	3267	3285	3290	3302	3299	3390	3381	3369	3362	3355	3281	3165	3052	2963
				3113	3168	3257	3313	3337	3354	3353	3362	3353	3438	3431	3423	3413	3409	3339	3228	3119	3032
				3190	3238	3334	3381	3416	3432	3442	3442	3437	3494	3501	3495	3494	3476	3417	3304	3203	3105
				3232	3280	3374	3427	3452	3472	3484	3495	3487	3544	3553	3542	3543	3535	3486	3368	3257	3159
				3271	3312	3410	3473	3495	3518	3522	3525	3514	3540	3553	3542	3543	3535	3497	3381	3273	3178
				3327	3365	3467	3535	3549	3568	3577	3579	3560	3619	3630	3617	3616	3602	3577	3470	3362	3277
				3406	3453	3537	3647	3675	3694	3691	3698	3673	3617	3637	3623	3627	3613	3607	3530	3432	3343
				3431	3474	3556	3663	3700	3714	3715	3719	3693	3725	3747	3740	3750	3743	3732	3670	3561	3466
				3526	3563	3644	3736	3777	3787	3794	3796	3775	3722	3733	3729	3726	3712	3701	3654	3551	3459
				3530	3563	3644	3732	3771	3782	3792	3792	3771	3802	3823	3815	3808	3792	3785	3739	3628	3544
				3621	3649	3728	3822	3864	3878	3908	3908	3893	3836	3847	3837	3809	3803	3792	3753	3656	3575
				3651	3673	3750	3820	3864	3873	3901	3893	3872	3893	3910	3900	3876	3882	3878	3861	3771	3691
				3698	3725	3792	3875	3920	3927	3953	3962	3935	3887	3907	3893	3879	3882	3885	3864	3780	3700
				3729	3754	3831	3900	3952	3966	3987	3990	3964	3969	3991	3978	3964	3970	3966	3964	3879	3801
				3171	3834	3899	3957	4004	4008	4026	4030	4008	3971	3990	3981	3969	3974	3977	3983	3913	3171
				3291	3788	3906	3946	3977	3978	3995	4009	4020	4022	4023	4005	3994	4002	4013	4029	3907	3325
				5120 5120 5120>;

			PS_Config_Lmt_Open_Rawdata_N = <
				1158	1172	1177	1201	1222	1210	1213	1248	(-65535)	(-65535)	1207	1172	1174	1184	1192	1199	1195	1159
				1071	1080	1102	1136	1171	1176	1180	1182	1167	1156	1173	1167	1168	1161	1159	1155	1134	1105        
				1090	1102	1122	1160	1195	1204	1204	1208	1190	1161	1174	1171	1168	1164	1161	1158	1136	1109        
				1102	1110	1131	1167	1204	1212	1213	1217	1197	1181	1199	1195	1195	1192	1187	1184	1165	1140        
				1112	1122	1147	1186	1224	1231	1231	1233	1212	1166	1183	1180	1178	1175	1170	1167	1149	1123        
				1111	1119	1141	1179	1220	1234	1234	1239	1215	1204	1224	1221	1219	1215	1208	1205	1188	1161        
				1136	1157	1172	1187	1200	1204	1220	1222	1221	1275	1270	1268	1252	1239	1196	1149	1119	1086        
				1160	1180	1197	1215	1224	1233	1241	1245	1240	1303	1298	1290	1278	1266	1222	1174	1143	1110        
				1164	1185	1203	1222	1229	1239	1243	1249	1244	1300	1296	1288	1281	1270	1227	1176	1146	1112        
				1189	1210	1232	1250	1261	1272	1281	1282	1276	1333	1329	1326	1317	1308	1260	1210	1182	1146        
				1206	1227	1250	1267	1276	1286	1294	1296	1295	1336	1330	1327	1322	1314	1273	1222	1192	1156        
				1218	1242	1266	1285	1296	1305	1306	1309	1308	1372	1369	1366	1364	1353	1312	1258	1227	1190        
				1241	1261	1300	1315	1329	1335	1338	1340	1342	1380	1372	1368	1365	1356	1314	1261	1218	1183        
				1250	1272	1309	1331	1339	1349	1353	1357	1360	1407	1401	1395	1394	1385	1349	1297	1254	1215        
				1279	1303	1340	1361	1371	1378	1383	1388	1387	1420	1416	1411	1405	1403	1365	1314	1267	1230        
				1305	1330	1368	1395	1401	1410	1410	1416	1414	1456	1453	1449	1446	1440	1408	1356	1310	1272        
				1305	1326	1366	1389	1400	1408	1410	1415	1414	1453	1449	1444	1441	1438	1406	1356	1308	1270        
				1334	1357	1396	1420	1430	1437	1437	1441	1437	1473	1470	1467	1462	1461	1431	1383	1336	1299        
				1367	1387	1429	1449	1464	1471	1475	1475	1473	1497	1500	1498	1497	1489	1464	1416	1372	1330        
				1385	1405	1446	1468	1479	1488	1493	1498	1494	1519	1522	1518	1518	1515	1494	1443	1396	1354        
				1402	1419	1461	1488	1498	1507	1509	1510	1506	1517	1522	1518	1518	1515	1498	1449	1402	1362        
				1426	1442	1486	1515	1521	1529	1533	1534	1525	1551	1555	1550	1549	1543	1533	1487	1441	1404        
				1459	1480	1516	1563	1575	1583	1582	1585	1574	1550	1558	1552	1554	1548	1546	1513	1471	1432        
				1470	1489	1524	1570	1585	1591	1592	1594	1582	1596	1606	1603	1607	1604	1599	1573	1526	1485        
				1511	1527	1561	1601	1618	1623	1626	1627	1618	1595	1600	1598	1597	1591	1586	1566	1522	1482        
				1513	1527	1561	1599	1616	1621	1625	1625	1616	1629	1638	1635	1632	1625	1622	1602	1555	1519        
				1552	1564	1597	1638	1656	1662	1675	1675	1668	1644	1648	1644	1632	1630	1625	1608	1567	1532        
				1564	1574	1607	1637	1656	1660	1672	1668	1659	1668	1675	1671	1661	1663	1662	1654	1616	1582        
				1585	1596	1625	1660	1680	1683	1694	1698	1686	1666	1674	1668	1662	1663	1665	1656	1620	1585        
				1598	1609	1642	1671	1693	1699	1708	1710	1699	1701	1710	1705	1699	1701	1699	1699	1662	1629        
				1359	1643	1671	1696	1716	1717	1725	1727	1717	1702	1710	1706	1701	1703	1704	1707	1677	1359        
				1410	1623	1674	1691	1704	1705	1712	1718	1723	1723	1724	1716	1711	1715	1720	1726	1674	1425
				(-511) (-511) (-511)>;

			PS_Config_Lmt_FW_Rawdata_P = <
				3351	3320	3350	3367	3379	3343	3333	3334	65535	65535	3357	3400	3383	3263	3299	3437	3348	3358
				3396	3332	3354	3333	3376	3364	3375	3386	3367	3347	3353	3381	3375	3348	3361	3348	3388	3354
				3347	3369	3329	3301	3313	3298	3309	3343	3288	3382	3320	3332	3320	3378	3360	3312	3360	3343
				3360	3292	3313	3357	3355	3343	3385	3393	3353	3369	3367	3341	3336	3421	3430	3396	3389	3374
				3357	3392	3369	3410	3437	3425	3403	3295	3390	3381	3336	3346	3343	3358	3364	3355	3379	3353
				3357	3283	3305	3344	3383	3353	3413	3357	3441	3371	3358	3329	3390	3378	3374	3389	3330	3278
				3312	3368	3347	3376	3358	3385	3327	3350	3378	3406	3381	3375	3420	3350	3270	3369	3382	3320
				3350	3351	3371	3326	3332	3334	3322	3337	3340	3301	3375	3343	3357	3297	3376	3333	3358	3347
				3368	3354	3295	3365	3327	3327	3367	3386	3381	3355	3318	3315	3350	3386	3339	3403	3442	3388
				3358	3379	3341	3336	3341	3308	3383	3425	3365	3390	3344	3350	3371	3388	3357	3320	3304	3389
				3323	3364	3351	3353	3395	3397	3337	3386	3371	3327	3372	3371	3326	3309	3346	3396	3424	3354
				3378	3383	3341	3339	3319	3313	3381	3397	3361	3355	3316	3340	3344	3337	3353	3365	3369	3327
				3427	3315	3322	3343	3355	3348	3381	3330	3360	3382	3334	3347	3355	3376	3376	3294	3309	3358
				3277	3399	3374	3413	3367	3379	3358	3343	3369	3382	3284	3284	3396	3374	3329	3371	3361	3339
				3354	3358	3367	3360	3395	3374	3301	3332	3299	3386	3330	3333	3344	3343	3341	3378	3308	3390
				3382	3311	3301	3351	3343	3344	3357	3336	3371	3312	3404	3400	3399	3327	3308	3371	3388	3360
				3344	3336	3344	3417	3410	3416	3453	3399	3441	3315	3390	3402	3386	3336	3361	3344	3362	3325
				3304	3348	3367	3351	3378	3355	3376	3369	3340	3378	3334	3334	3341	3448	3399	3309	3332	3355
				3336	3364	3318	3390	3360	3372	3375	3378	3385	3337	3357	3364	3355	3292	3297	3372	3357	3337
				3386	3390	3364	3327	3351	3330	3381	3326	3350	3353	3316	3346	3339	3259	3334	3343	3354	3354
				3365	3322	3357	3311	3354	3346	3329	3318	3330	3320	3309	3309	3333	3367	3351	3329	3308	3375
				3358	3375	3379	3361	3334	3332	3344	3341	3327	3392	3364	3360	3350	3375	3353	3411	3406	3353
				3376	3362	3347	3294	3305	3322	3298	3326	3308	3354	3253	3262	3271	3392	3403	3378	3346	3357
				3374	3309	3320	3302	3320	3306	3320	3330	3336	3333	3406	3392	3418	3397	3410	3397	3375	3355
				3438	3319	3403	3292	3333	3403	3346	3292	3364	3374	3336	3327	3320	3309	3329	3350	3327	3383
				3386	3308	3302	3326	3337	3327	3353	3369	3346	3305	3339	3355	3316	3355	3339	3319	3361	3343
				3396	3361	3446	3376	3385	3420	3390	3362	3423	3364	3337	3357	3346	3400	3403	3386	3329	3343
				3389	3337	3326	3323	3295	3281	3304	3337	3326	3369	3327	3284	3306	3371	3382	3348	3274	3337
				3301	3439	3362	3364	3368	3339	3346	3395	3313	3367	3407	3388	3420	3367	3368	3371	3271	3357
				3406	3417	3383	3395	3397	3383	3385	3389	3323	3336	3343	3376	3357	3336	3358	3378	3341	3378
				3340	3318	3348	3351	3347	3358	3341	3337	3374	3371	3381	3372	3379	3400	3407	3434	3383	3311
				3382	3348	3334	3327	3355	3354	3346	3347	3378	3343	3336	3346	3313	3376	3320	3371	3304	3350
				3840 3840 3840>;

			PS_Config_Lmt_FW_Rawdata_N = <
				1436	1423	1435	1443	1448	1432	1428	1429	(-65535)	(-65535)	1438	1457	1450	1398	1414	1473	1435	1439
				1455	1428	1437	1428	1447	1441	1446	1451	1443	1434	1437	1449	1446	1435	1440	1435	1452	1437        
				1434	1444	1426	1414	1420	1413	1418	1432	1409	1449	1423	1428	1423	1447	1440	1419	1440	1432        
				1440	1411	1420	1438	1438	1432	1450	1454	1437	1444	1443	1432	1429	1466	1470	1455	1452	1446        
				1438	1453	1444	1461	1473	1468	1458	1412	1453	1449	1429	1434	1432	1439	1441	1438	1448	1437        
				1438	1407	1416	1433	1450	1437	1462	1438	1474	1444	1439	1426	1453	1447	1446	1452	1427	1405        
				1419	1443	1434	1447	1439	1450	1426	1435	1447	1459	1449	1446	1465	1435	1401	1444	1449	1423        
				1435	1436	1444	1425	1428	1429	1423	1430	1431	1414	1446	1432	1438	1413	1447	1428	1439	1434        
				1443	1437	1412	1442	1426	1426	1443	1451	1449	1438	1422	1420	1435	1451	1431	1458	1475	1452        
				1439	1448	1432	1429	1432	1417	1450	1468	1442	1453	1433	1435	1444	1452	1438	1423	1416	1452        
				1424	1441	1436	1437	1455	1456	1430	1451	1444	1426	1445	1444	1425	1418	1434	1455	1467	1437        
				1447	1450	1432	1431	1422	1420	1449	1456	1440	1438	1421	1431	1433	1430	1437	1442	1444	1426        
				1468	1420	1423	1432	1438	1435	1449	1427	1440	1449	1429	1434	1438	1447	1447	1411	1418	1439        
				1404	1456	1446	1462	1443	1448	1439	1432	1444	1449	1407	1407	1455	1446	1426	1444	1440	1431        
				1437	1439	1443	1440	1455	1446	1414	1428	1414	1451	1427	1428	1433	1432	1432	1447	1417	1453        
				1449	1419	1414	1436	1432	1433	1438	1429	1444	1419	1459	1457	1456	1426	1417	1444	1452	1440        
				1433	1429	1433	1464	1461	1464	1480	1456	1474	1420	1453	1458	1451	1429	1440	1433	1441	1425        
				1416	1435	1443	1436	1447	1438	1447	1444	1431	1447	1429	1429	1432	1477	1456	1418	1428	1438        
				1429	1441	1422	1453	1440	1445	1446	1447	1450	1430	1438	1441	1438	1411	1413	1445	1438	1430        
				1451	1453	1441	1426	1436	1427	1449	1425	1435	1437	1421	1434	1431	1396	1429	1432	1437	1437        
				1442	1423	1438	1419	1437	1434	1426	1422	1427	1423	1418	1418	1428	1443	1436	1426	1417	1446        
				1439	1446	1448	1440	1429	1428	1433	1432	1426	1453	1441	1440	1435	1446	1437	1462	1459	1437        
				1447	1441	1434	1411	1416	1423	1413	1425	1417	1437	1394	1398	1402	1453	1458	1447	1434	1438        
				1446	1418	1423	1415	1423	1417	1423	1427	1429	1428	1459	1453	1465	1456	1461	1456	1446	1438        
				1473	1422	1458	1411	1428	1458	1434	1411	1441	1446	1429	1426	1423	1418	1426	1435	1426	1450        
				1451	1417	1415	1425	1430	1426	1437	1444	1434	1416	1431	1438	1421	1438	1431	1422	1440	1432        
				1455	1440	1477	1447	1450	1465	1453	1441	1467	1441	1430	1438	1434	1457	1458	1451	1426	1432        
				1452	1430	1425	1424	1412	1406	1416	1430	1425	1444	1426	1407	1417	1444	1449	1435	1403	1430        
				1414	1474	1441	1441	1443	1431	1434	1455	1420	1443	1460	1452	1465	1443	1443	1444	1402	1438        
				1459	1464	1450	1455	1456	1450	1450	1452	1424	1429	1432	1447	1438	1429	1439	1447	1432	1447        
				1431	1422	1435	1436	1434	1439	1432	1430	1446	1444	1449	1445	1448	1457	1460	1471	1450	1419        
				1449	1435	1429	1426	1438	1437	1434	1434	1447	1432	1429	1434	1420	1447	1423	1444	1416	1435        
				240 240 240>;

			PS_Config_Lmt_FW_CC_P = <
				86	86	88	88	89	89	91	89	65535	65535	93	95	93	93	92	92	91	91
				92	92	92	92	92	92	92	92	95	96	95	95	95	95	95	95	95	96    
				92	91	91	92	92	92	92	92	95	96	95	95	95	95	95	95	95	96    
				92	92	92	92	92	92	92	93	95	97	96	96	96	95	95	95	96	97    
				93	92	92	92	92	92	92	93	96	99	96	96	96	96	96	96	96	97    
				95	93	93	93	95	95	95	95	97	97	96	96	96	95	95	95	96	97    
				93	92	92	92	92	92	92	93	95	100	97	97	97	96	96	95	95	96    
				97	96	95	96	96	96	96	96	99	104	102	102	102	102	100	99	99	100   
				95	93	93	93	93	93	93	93	96	97	96	96	96	95	95	93	95	95    
				97	96	96	96	96	96	96	96	99	103	100	100	100	100	99	99	99	100   
				95	93	93	93	93	93	93	93	96	100	97	97	97	97	96	96	96	97    
				96	95	95	95	95	95	95	96	97	104	102	102	102	102	100	100	100	102   
				95	95	95	95	95	95	95	95	97	102	99	99	99	99	99	97	97	99    
				97	96	96	96	96	96	97	97	99	106	104	104	103	103	103	102	102	103   
				95	93	93	93	93	93	93	93	96	100	99	99	99	99	97	97	97	99    
				99	97	97	97	97	97	97	99	100	104	103	103	103	102	102	100	102	102   
				96	95	95	95	95	95	95	95	97	102	100	100	100	100	99	99	99	100   
				100	99	99	99	99	99	99	99	102	106	103	103	103	103	103	102	102	103   
				96	95	95	95	95	95	95	95	97	102	100	100	100	100	100	99	99	100   
				100	99	99	100	100	100	100	100	103	106	104	104	104	104	104	103	103	104   
				96	96	95	96	96	96	96	96	99	104	102	102	102	102	102	100	100	102   
				102	100	100	100	100	100	100	100	103	104	103	103	103	103	103	102	103	104   
				96	96	95	96	96	96	96	96	99	102	99	99	99	99	99	99	99	100   
				97	97	97	97	97	97	97	97	100	102	100	100	100	99	99	99	100	102   
				96	95	95	96	95	95	95	96	97	103	100	100	100	100	100	100	100	102   
				99	97	97	97	97	97	97	97	100	103	102	102	102	100	102	102	102	103   
				99	97	96	97	96	96	97	97	100	103	102	102	102	100	100	100	102	103   
				97	96	96	96	96	96	96	97	99	104	102	102	102	102	102	102	102	104   
				97	95	95	95	95	95	95	95	97	103	102	102	102	102	102	102	102	103   
				99	97	97	97	97	97	97	97	100	103	100	100	100	100	100	100	102	103   
				93	97	96	96	96	96	96	96	99	103	100	100	100	100	100	100	102	96    
				93	97	97	97	97	96	96	97	100	103	100	100	100	100	100	100	102	97    
				314 314 314>;

			PS_Config_Lmt_FW_CC_N = <
				39	39	39	39	40	40	40	40	(-65535)	(-65535)	42	42	42	42	41	41	40	40
				41	41	41	41	41	41	41	41	42	43	42	42	42	42	42	42	42	43            
				41	40	40	41	41	41	41	41	42	43	42	42	42	42	42	42	42	43            
				41	41	41	41	41	41	41	42	42	44	43	43	43	42	42	42	43	44            
				42	41	41	41	41	41	41	42	43	44	43	43	43	43	43	43	43	44            
				42	42	42	42	42	42	42	42	44	44	43	43	43	42	42	42	43	44            
				42	41	41	41	41	41	41	42	42	45	44	44	44	43	43	42	42	43            
				44	43	42	43	43	43	43	43	44	47	45	45	45	45	45	44	44	45            
				42	42	42	42	42	42	42	42	43	44	43	43	43	42	42	42	42	42            
				44	43	43	43	43	43	43	43	44	46	45	45	45	45	44	44	44	45            
				42	42	42	42	42	42	42	42	43	45	44	44	44	44	43	43	43	44            
				43	42	42	42	42	42	42	43	44	47	45	45	45	45	45	45	45	45            
				42	42	42	42	42	42	42	42	44	45	44	44	44	44	44	44	44	44            
				44	43	43	43	43	43	44	44	44	47	47	47	46	46	46	45	45	46            
				42	42	42	42	42	42	42	42	43	45	44	44	44	44	44	44	44	44            
				44	44	44	44	44	44	44	44	45	47	46	46	46	45	45	45	45	45            
				43	42	42	42	42	42	42	42	44	45	45	45	45	45	44	44	44	45            
				45	44	44	44	44	44	44	44	45	47	46	46	46	46	46	45	45	46            
				43	42	42	42	42	42	42	42	44	45	45	45	45	45	45	44	44	45            
				45	44	44	45	45	45	45	45	46	47	47	47	47	47	47	46	46	47            
				43	43	42	43	43	43	43	43	44	47	45	45	45	45	45	45	45	45            
				45	45	45	45	45	45	45	45	46	47	46	46	46	46	46	45	46	47            
				43	43	42	43	43	43	43	43	44	45	44	44	44	44	44	44	44	45            
				44	44	44	44	44	44	44	44	45	45	45	45	45	44	44	44	45	45            
				43	42	42	43	42	42	42	43	44	46	45	45	45	45	45	45	45	45            
				44	44	44	44	44	44	44	44	45	46	45	45	45	45	45	45	45	46            
				44	44	43	44	43	43	44	44	45	46	45	45	45	45	45	45	45	46            
				44	43	43	43	43	43	43	44	44	47	45	45	45	45	45	45	45	47            
				44	42	42	42	42	42	42	42	44	46	45	45	45	45	45	45	45	46            
				44	44	44	44	44	44	44	44	45	46	45	45	45	45	45	45	45	46            
				42	44	43	43	43	43	43	43	44	46	45	45	45	45	45	45	45	43            
				42	44	44	44	44	43	43	44	45	46	45	45	45	45	45	45	45	44            
				0 0 0>;

			PS_Config_Lmt_FW_Diff_P = <
				50	50	50	50	50	50	50	50	65535	65535	50	50	50	50	50	50	50	50 
				50	50	50	50	50	50	50	50	50	50	50	50	50	50	50	50	50	50     
				50	50	50	50	50	50	50	50	50	50	50	50	50	50	50	50	50	50     
				50	50	50	50	50	50	50	50	50	50	50	50	50	50	50	50	50	50     
				50	50	50	50	50	50	50	50	50	50	50	50	50	50	50	50	50	50     
				50	50	50	50	50	50	50	50	50	50	50	50	50	50	50	50	50	50     
				50	50	50	50	50	50	50	50	50	50	50	50	50	50	50	50	50	50     
				50	50	50	50	50	50	50	50	50	50	50	50	50	50	50	50	50	50     
				50	50	50	50	50	50	50	50	50	50	50	50	50	50	50	50	50	50     
				50	50	50	50	50	50	50	50	50	50	50	50	50	50	50	50	50	50     
				50	50	50	50	50	50	50	50	50	50	50	50	50	50	50	50	50	50     
				50	50	50	50	50	50	50	50	50	50	50	50	50	50	50	50	50	50     
				50	50	50	50	50	50	50	50	50	50	50	50	50	50	50	50	50	50     
				50	50	50	50	50	50	50	50	50	50	50	50	50	50	50	50	50	50     
				50	50	50	50	50	50	50	50	50	50	50	50	50	50	50	50	50	50     
				50	50	50	50	50	50	50	50	50	50	50	50	50	50	50	50	50	50     
				50	50	50	50	50	50	50	50	50	50	50	50	50	50	50	50	50	50     
				50	50	50	50	50	50	50	50	50	50	50	50	50	50	50	50	50	50     
				50	50	50	50	50	50	50	50	50	50	50	50	50	50	50	50	50	50     
				50	50	50	50	50	50	50	50	50	50	50	50	50	50	50	50	50	50     
				50	50	50	50	50	50	50	50	50	50	50	50	50	50	50	50	50	50     
				50	50	50	50	50	50	50	50	50	50	50	50	50	50	50	50	50	50     
				50	50	50	50	50	50	50	50	50	50	50	50	50	50	50	50	50	50     
				50	50	50	50	50	50	50	50	50	50	50	50	50	50	50	50	50	50     
				50	50	50	50	50	50	50	50	50	50	50	50	50	50	50	50	50	50     
				50	50	50	50	50	50	50	50	50	50	50	50	50	50	50	50	50	50     
				50	50	50	50	50	50	50	50	50	50	50	50	50	50	50	50	50	50     
				50	50	50	50	50	50	50	50	50	50	50	50	50	50	50	50	50	50     
				50	50	50	50	50	50	50	50	50	50	50	50	50	50	50	50	50	50     
				50	50	50	50	50	50	50	50	50	50	50	50	50	50	50	50	50	50     
				50	50	50	50	50	50	50	50	50	50	50	50	50	50	50	50	50	50     
				50	50	50	50	50	50	50	50	50	50	50	50	50	50	50	50	50	50     
				75 75 75>;

			PS_Config_Lmt_FW_Diff_N = <
				(-50)	(-50)	(-50)	(-50)	(-50)	(-50)	(-50)	(-50)	(-65535)	(-65535)	(-50)	(-50)	(-50)	(-50)	(-50)	(-50)	(-50)	(-50)
				(-50)	(-50)	(-50)	(-50)	(-50)	(-50)	(-50)	(-50)	(-50)	(-50)	(-50)	(-50)	(-50)	(-50)	(-50)	(-50)	(-50)	(-50)        
				(-50)	(-50)	(-50)	(-50)	(-50)	(-50)	(-50)	(-50)	(-50)	(-50)	(-50)	(-50)	(-50)	(-50)	(-50)	(-50)	(-50)	(-50)        
				(-50)	(-50)	(-50)	(-50)	(-50)	(-50)	(-50)	(-50)	(-50)	(-50)	(-50)	(-50)	(-50)	(-50)	(-50)	(-50)	(-50)	(-50)        
				(-50)	(-50)	(-50)	(-50)	(-50)	(-50)	(-50)	(-50)	(-50)	(-50)	(-50)	(-50)	(-50)	(-50)	(-50)	(-50)	(-50)	(-50)        
				(-50)	(-50)	(-50)	(-50)	(-50)	(-50)	(-50)	(-50)	(-50)	(-50)	(-50)	(-50)	(-50)	(-50)	(-50)	(-50)	(-50)	(-50)        
				(-50)	(-50)	(-50)	(-50)	(-50)	(-50)	(-50)	(-50)	(-50)	(-50)	(-50)	(-50)	(-50)	(-50)	(-50)	(-50)	(-50)	(-50)        
				(-50)	(-50)	(-50)	(-50)	(-50)	(-50)	(-50)	(-50)	(-50)	(-50)	(-50)	(-50)	(-50)	(-50)	(-50)	(-50)	(-50)	(-50)        
				(-50)	(-50)	(-50)	(-50)	(-50)	(-50)	(-50)	(-50)	(-50)	(-50)	(-50)	(-50)	(-50)	(-50)	(-50)	(-50)	(-50)	(-50)        
				(-50)	(-50)	(-50)	(-50)	(-50)	(-50)	(-50)	(-50)	(-50)	(-50)	(-50)	(-50)	(-50)	(-50)	(-50)	(-50)	(-50)	(-50)        
				(-50)	(-50)	(-50)	(-50)	(-50)	(-50)	(-50)	(-50)	(-50)	(-50)	(-50)	(-50)	(-50)	(-50)	(-50)	(-50)	(-50)	(-50)        
				(-50)	(-50)	(-50)	(-50)	(-50)	(-50)	(-50)	(-50)	(-50)	(-50)	(-50)	(-50)	(-50)	(-50)	(-50)	(-50)	(-50)	(-50)        
				(-50)	(-50)	(-50)	(-50)	(-50)	(-50)	(-50)	(-50)	(-50)	(-50)	(-50)	(-50)	(-50)	(-50)	(-50)	(-50)	(-50)	(-50)        
				(-50)	(-50)	(-50)	(-50)	(-50)	(-50)	(-50)	(-50)	(-50)	(-50)	(-50)	(-50)	(-50)	(-50)	(-50)	(-50)	(-50)	(-50)        
				(-50)	(-50)	(-50)	(-50)	(-50)	(-50)	(-50)	(-50)	(-50)	(-50)	(-50)	(-50)	(-50)	(-50)	(-50)	(-50)	(-50)	(-50)        
				(-50)	(-50)	(-50)	(-50)	(-50)	(-50)	(-50)	(-50)	(-50)	(-50)	(-50)	(-50)	(-50)	(-50)	(-50)	(-50)	(-50)	(-50)        
				(-50)	(-50)	(-50)	(-50)	(-50)	(-50)	(-50)	(-50)	(-50)	(-50)	(-50)	(-50)	(-50)	(-50)	(-50)	(-50)	(-50)	(-50)        
				(-50)	(-50)	(-50)	(-50)	(-50)	(-50)	(-50)	(-50)	(-50)	(-50)	(-50)	(-50)	(-50)	(-50)	(-50)	(-50)	(-50)	(-50)        
				(-50)	(-50)	(-50)	(-50)	(-50)	(-50)	(-50)	(-50)	(-50)	(-50)	(-50)	(-50)	(-50)	(-50)	(-50)	(-50)	(-50)	(-50)        
				(-50)	(-50)	(-50)	(-50)	(-50)	(-50)	(-50)	(-50)	(-50)	(-50)	(-50)	(-50)	(-50)	(-50)	(-50)	(-50)	(-50)	(-50)        
				(-50)	(-50)	(-50)	(-50)	(-50)	(-50)	(-50)	(-50)	(-50)	(-50)	(-50)	(-50)	(-50)	(-50)	(-50)	(-50)	(-50)	(-50)        
				(-50)	(-50)	(-50)	(-50)	(-50)	(-50)	(-50)	(-50)	(-50)	(-50)	(-50)	(-50)	(-50)	(-50)	(-50)	(-50)	(-50)	(-50)        
				(-50)	(-50)	(-50)	(-50)	(-50)	(-50)	(-50)	(-50)	(-50)	(-50)	(-50)	(-50)	(-50)	(-50)	(-50)	(-50)	(-50)	(-50)        
				(-50)	(-50)	(-50)	(-50)	(-50)	(-50)	(-50)	(-50)	(-50)	(-50)	(-50)	(-50)	(-50)	(-50)	(-50)	(-50)	(-50)	(-50)        
				(-50)	(-50)	(-50)	(-50)	(-50)	(-50)	(-50)	(-50)	(-50)	(-50)	(-50)	(-50)	(-50)	(-50)	(-50)	(-50)	(-50)	(-50)        
				(-50)	(-50)	(-50)	(-50)	(-50)	(-50)	(-50)	(-50)	(-50)	(-50)	(-50)	(-50)	(-50)	(-50)	(-50)	(-50)	(-50)	(-50)        
				(-50)	(-50)	(-50)	(-50)	(-50)	(-50)	(-50)	(-50)	(-50)	(-50)	(-50)	(-50)	(-50)	(-50)	(-50)	(-50)	(-50)	(-50)        
				(-50)	(-50)	(-50)	(-50)	(-50)	(-50)	(-50)	(-50)	(-50)	(-50)	(-50)	(-50)	(-50)	(-50)	(-50)	(-50)	(-50)	(-50)        
				(-50)	(-50)	(-50)	(-50)	(-50)	(-50)	(-50)	(-50)	(-50)	(-50)	(-50)	(-50)	(-50)	(-50)	(-50)	(-50)	(-50)	(-50)        
				(-50)	(-50)	(-50)	(-50)	(-50)	(-50)	(-50)	(-50)	(-50)	(-50)	(-50)	(-50)	(-50)	(-50)	(-50)	(-50)	(-50)	(-50)        
				(-50)	(-50)	(-50)	(-50)	(-50)	(-50)	(-50)	(-50)	(-50)	(-50)	(-50)	(-50)	(-50)	(-50)	(-50)	(-50)	(-50)	(-50)        
				(-50)	(-50)	(-50)	(-50)	(-50)	(-50)	(-50)	(-50)	(-50)	(-50)	(-50)	(-50)	(-50)	(-50)	(-50)	(-50)	(-50)	(-50)        
				(-75) (-75) (-75)>;

			PS_Config_Lmt_PenTipX_FW_Raw_P = <
				1050 1050 1050 1050 1050 1050 1050 1050 1050 1050 1050 1050 1050 1050 1050 1050 1050 1050 1050 1050 1050 1050 1050 1050 1050 1050 1050 1050 1050 1050 1050 1050
				1050 1050 1050 1050 1050 1050 1050 1050 1050 1050 1050 1050 1050 1050 1050 1050 1050 1050 1050 1050 1050 1050 1050 1050 1050 1050 1050 1050 1050 1050 1050 1050
				1050 1050 1050 1050 1050 1050 1050 1050 1050 1050 1050 1050 1050 1050 1050 1050 1050 1050 1050 1050 1050 1050 1050 1050 1050 1050 1050 1050 1050 1050 1050 1050
				1050 1050 1050 1050 1050 1050 1050 1050 1050 1050 1050 1050 1050 1050 1050 1050 1050 1050 1050 1050 1050 1050 1050 1050 1050 1050 1050 1050 1050 1050 1050 1050
				1050 1050 1050 1050 1050 1050 1050 1050 1050 1050 1050 1050 1050 1050 1050 1050 1050 1050 1050 1050 1050 1050 1050 1050 1050 1050 1050 1050 1050 1050 1050 1050
				1050 1050 1050 1050 1050 1050 1050 1050 1050 1050 1050 1050 1050 1050 1050 1050 1050 1050 1050 1050 1050 1050 1050 1050 1050 1050 1050 1050 1050 1050 1050 1050>;

			PS_Config_Lmt_PenTipX_FW_Raw_N = <
				(-1050) (-1050) (-1050) (-1050) (-1050) (-1050) (-1050) (-1050) (-1050) (-1050) (-1050) (-1050) (-1050) (-1050) (-1050) (-1050) (-1050) (-1050) (-1050) (-1050) (-1050) (-1050) (-1050) (-1050) (-1050) (-1050) (-1050) (-1050) (-1050) (-1050) (-1050) (-1050)
				(-1050) (-1050) (-1050) (-1050) (-1050) (-1050) (-1050) (-1050) (-1050) (-1050) (-1050) (-1050) (-1050) (-1050) (-1050) (-1050) (-1050) (-1050) (-1050) (-1050) (-1050) (-1050) (-1050) (-1050) (-1050) (-1050) (-1050) (-1050) (-1050) (-1050) (-1050) (-1050)
				(-1050) (-1050) (-1050) (-1050) (-1050) (-1050) (-1050) (-1050) (-1050) (-1050) (-1050) (-1050) (-1050) (-1050) (-1050) (-1050) (-1050) (-1050) (-1050) (-1050) (-1050) (-1050) (-1050) (-1050) (-1050) (-1050) (-1050) (-1050) (-1050) (-1050) (-1050) (-1050)
				(-1050) (-1050) (-1050) (-1050) (-1050) (-1050) (-1050) (-1050) (-1050) (-1050) (-1050) (-1050) (-1050) (-1050) (-1050) (-1050) (-1050) (-1050) (-1050) (-1050) (-1050) (-1050) (-1050) (-1050) (-1050) (-1050) (-1050) (-1050) (-1050) (-1050) (-1050) (-1050)
				(-1050) (-1050) (-1050) (-1050) (-1050) (-1050) (-1050) (-1050) (-1050) (-1050) (-1050) (-1050) (-1050) (-1050) (-1050) (-1050) (-1050) (-1050) (-1050) (-1050) (-1050) (-1050) (-1050) (-1050) (-1050) (-1050) (-1050) (-1050) (-1050) (-1050) (-1050) (-1050)
				(-1050) (-1050) (-1050) (-1050) (-1050) (-1050) (-1050) (-1050) (-1050) (-1050) (-1050) (-1050) (-1050) (-1050) (-1050) (-1050) (-1050) (-1050) (-1050) (-1050) (-1050) (-1050) (-1050) (-1050) (-1050) (-1050) (-1050) (-1050) (-1050) (-1050) (-1050) (-1050)>;

			PS_Config_Lmt_PenTipY_FW_Raw_P = <
				1050 1050 1050 1050
				1050 1050 1050 1050
				1050 1050 1050 1050
				1050 1050 1050 1050
				1050 1050 1050 1050
				1050 1050 1050 1050
				1050 1050 1050 1050
				1050 1050 1050 1050
				1050 1050 1050 1050
				1050 1050 1050 1050
				1050 1050 1050 1050
				1050 1050 1050 1050
				1050 1050 1050 1050
				1050 1050 1050 1050
				1050 1050 1050 1050
				1050 1050 1050 1050
				1050 1050 1050 1050
				1050 1050 1050 1050
				1050 1050 1050 1050
				1050 1050 1050 1050
				1050 1050 1050 1050
				1050 1050 1050 1050
				1050 1050 1050 1050
				1050 1050 1050 1050
				1050 1050 1050 1050
				1050 1050 1050 1050
				1050 1050 1050 1050
				1050 1050 1050 1050
				1050 1050 1050 1050
				1050 1050 1050 1050
				1050 1050 1050 1050
				1050 1050 1050 1050
				1050 1050 1050 1050
				1050 1050 1050 1050
				1050 1050 1050 1050
				1050 1050 1050 1050
				1050 1050 1050 1050
				1050 1050 1050 1050
				1050 1050 1050 1050
				1050 1050 1050 1050
				1050 1050 1050 1050
				1050 1050 1050 1050
				1050 1050 1050 1050
				1050 1050 1050 1050
				1050 1050 1050 1050
				1050 1050 1050 1050
				1050 1050 1050 1050
				1050 1050 1050 1050
				1050 1050 1050 1050
				1050 1050 1050 1050>;

			PS_Config_Lmt_PenTipY_FW_Raw_N = <
				(-1050) (-1050) (-1050) (-1050)
				(-1050) (-1050) (-1050) (-1050)
				(-1050) (-1050) (-1050) (-1050)
				(-1050) (-1050) (-1050) (-1050)
				(-1050) (-1050) (-1050) (-1050)
				(-1050) (-1050) (-1050) (-1050)
				(-1050) (-1050) (-1050) (-1050)
				(-1050) (-1050) (-1050) (-1050)
				(-1050) (-1050) (-1050) (-1050)
				(-1050) (-1050) (-1050) (-1050)
				(-1050) (-1050) (-1050) (-1050)
				(-1050) (-1050) (-1050) (-1050)
				(-1050) (-1050) (-1050) (-1050)
				(-1050) (-1050) (-1050) (-1050)
				(-1050) (-1050) (-1050) (-1050)
				(-1050) (-1050) (-1050) (-1050)
				(-1050) (-1050) (-1050) (-1050)
				(-1050) (-1050) (-1050) (-1050)
				(-1050) (-1050) (-1050) (-1050)
				(-1050) (-1050) (-1050) (-1050)
				(-1050) (-1050) (-1050) (-1050)
				(-1050) (-1050) (-1050) (-1050)
				(-1050) (-1050) (-1050) (-1050)
				(-1050) (-1050) (-1050) (-1050)
				(-1050) (-1050) (-1050) (-1050)
				(-1050) (-1050) (-1050) (-1050)
				(-1050) (-1050) (-1050) (-1050)
				(-1050) (-1050) (-1050) (-1050)
				(-1050) (-1050) (-1050) (-1050)
				(-1050) (-1050) (-1050) (-1050)
				(-1050) (-1050) (-1050) (-1050)
				(-1050) (-1050) (-1050) (-1050)
				(-1050) (-1050) (-1050) (-1050)
				(-1050) (-1050) (-1050) (-1050)
				(-1050) (-1050) (-1050) (-1050)
				(-1050) (-1050) (-1050) (-1050)
				(-1050) (-1050) (-1050) (-1050)
				(-1050) (-1050) (-1050) (-1050)
				(-1050) (-1050) (-1050) (-1050)
				(-1050) (-1050) (-1050) (-1050)
				(-1050) (-1050) (-1050) (-1050)
				(-1050) (-1050) (-1050) (-1050)
				(-1050) (-1050) (-1050) (-1050)
				(-1050) (-1050) (-1050) (-1050)
				(-1050) (-1050) (-1050) (-1050)
				(-1050) (-1050) (-1050) (-1050)
				(-1050) (-1050) (-1050) (-1050)
				(-1050) (-1050) (-1050) (-1050)
				(-1050) (-1050) (-1050) (-1050)
				(-1050) (-1050) (-1050) (-1050)>;

			PS_Config_Lmt_PenRingX_FW_Raw_P = <
				1050 1050 1050 1050 1050 1050 1050 1050 1050 1050 1050 1050 1050 1050 1050 1050 1050 1050 1050 1050 1050 1050 1050 1050 1050 1050 1050 1050 1050 1050 1050 1050
				1050 1050 1050 1050 1050 1050 1050 1050 1050 1050 1050 1050 1050 1050 1050 1050 1050 1050 1050 1050 1050 1050 1050 1050 1050 1050 1050 1050 1050 1050 1050 1050
				1050 1050 1050 1050 1050 1050 1050 1050 1050 1050 1050 1050 1050 1050 1050 1050 1050 1050 1050 1050 1050 1050 1050 1050 1050 1050 1050 1050 1050 1050 1050 1050
				1050 1050 1050 1050 1050 1050 1050 1050 1050 1050 1050 1050 1050 1050 1050 1050 1050 1050 1050 1050 1050 1050 1050 1050 1050 1050 1050 1050 1050 1050 1050 1050
				1050 1050 1050 1050 1050 1050 1050 1050 1050 1050 1050 1050 1050 1050 1050 1050 1050 1050 1050 1050 1050 1050 1050 1050 1050 1050 1050 1050 1050 1050 1050 1050
				1050 1050 1050 1050 1050 1050 1050 1050 1050 1050 1050 1050 1050 1050 1050 1050 1050 1050 1050 1050 1050 1050 1050 1050 1050 1050 1050 1050 1050 1050 1050 1050>;

			PS_Config_Lmt_PenRingX_FW_Raw_N = <
				(-1050) (-1050) (-1050) (-1050) (-1050) (-1050) (-1050) (-1050) (-1050) (-1050) (-1050) (-1050) (-1050) (-1050) (-1050) (-1050) (-1050) (-1050) (-1050) (-1050) (-1050) (-1050) (-1050) (-1050) (-1050) (-1050) (-1050) (-1050) (-1050) (-1050) (-1050) (-1050)
				(-1050) (-1050) (-1050) (-1050) (-1050) (-1050) (-1050) (-1050) (-1050) (-1050) (-1050) (-1050) (-1050) (-1050) (-1050) (-1050) (-1050) (-1050) (-1050) (-1050) (-1050) (-1050) (-1050) (-1050) (-1050) (-1050) (-1050) (-1050) (-1050) (-1050) (-1050) (-1050)
				(-1050) (-1050) (-1050) (-1050) (-1050) (-1050) (-1050) (-1050) (-1050) (-1050) (-1050) (-1050) (-1050) (-1050) (-1050) (-1050) (-1050) (-1050) (-1050) (-1050) (-1050) (-1050) (-1050) (-1050) (-1050) (-1050) (-1050) (-1050) (-1050) (-1050) (-1050) (-1050)
				(-1050) (-1050) (-1050) (-1050) (-1050) (-1050) (-1050) (-1050) (-1050) (-1050) (-1050) (-1050) (-1050) (-1050) (-1050) (-1050) (-1050) (-1050) (-1050) (-1050) (-1050) (-1050) (-1050) (-1050) (-1050) (-1050) (-1050) (-1050) (-1050) (-1050) (-1050) (-1050)
				(-1050) (-1050) (-1050) (-1050) (-1050) (-1050) (-1050) (-1050) (-1050) (-1050) (-1050) (-1050) (-1050) (-1050) (-1050) (-1050) (-1050) (-1050) (-1050) (-1050) (-1050) (-1050) (-1050) (-1050) (-1050) (-1050) (-1050) (-1050) (-1050) (-1050) (-1050) (-1050)
				(-1050) (-1050) (-1050) (-1050) (-1050) (-1050) (-1050) (-1050) (-1050) (-1050) (-1050) (-1050) (-1050) (-1050) (-1050) (-1050) (-1050) (-1050) (-1050) (-1050) (-1050) (-1050) (-1050) (-1050) (-1050) (-1050) (-1050) (-1050) (-1050) (-1050) (-1050) (-1050)>;

			PS_Config_Lmt_PenRingY_FW_Raw_P = <
				1050 1050 1050 1050
				1050 1050 1050 1050
				1050 1050 1050 1050
				1050 1050 1050 1050
				1050 1050 1050 1050
				1050 1050 1050 1050
				1050 1050 1050 1050
				1050 1050 1050 1050
				1050 1050 1050 1050
				1050 1050 1050 1050
				1050 1050 1050 1050
				1050 1050 1050 1050
				1050 1050 1050 1050
				1050 1050 1050 1050
				1050 1050 1050 1050
				1050 1050 1050 1050
				1050 1050 1050 1050
				1050 1050 1050 1050
				1050 1050 1050 1050
				1050 1050 1050 1050
				1050 1050 1050 1050
				1050 1050 1050 1050
				1050 1050 1050 1050
				1050 1050 1050 1050
				1050 1050 1050 1050
				1050 1050 1050 1050
				1050 1050 1050 1050
				1050 1050 1050 1050
				1050 1050 1050 1050
				1050 1050 1050 1050
				1050 1050 1050 1050
				1050 1050 1050 1050
				1050 1050 1050 1050
				1050 1050 1050 1050
				1050 1050 1050 1050
				1050 1050 1050 1050
				1050 1050 1050 1050
				1050 1050 1050 1050
				1050 1050 1050 1050
				1050 1050 1050 1050
				1050 1050 1050 1050
				1050 1050 1050 1050
				1050 1050 1050 1050
				1050 1050 1050 1050
				1050 1050 1050 1050
				1050 1050 1050 1050
				1050 1050 1050 1050
				1050 1050 1050 1050
				1050 1050 1050 1050
				1050 1050 1050 1050>;

			PS_Config_Lmt_PenRingY_FW_Raw_N = <
				(-1050) (-1050) (-1050) (-1050)
				(-1050) (-1050) (-1050) (-1050)
				(-1050) (-1050) (-1050) (-1050)
				(-1050) (-1050) (-1050) (-1050)
				(-1050) (-1050) (-1050) (-1050)
				(-1050) (-1050) (-1050) (-1050)
				(-1050) (-1050) (-1050) (-1050)
				(-1050) (-1050) (-1050) (-1050)
				(-1050) (-1050) (-1050) (-1050)
				(-1050) (-1050) (-1050) (-1050)
				(-1050) (-1050) (-1050) (-1050)
				(-1050) (-1050) (-1050) (-1050)
				(-1050) (-1050) (-1050) (-1050)
				(-1050) (-1050) (-1050) (-1050)
				(-1050) (-1050) (-1050) (-1050)
				(-1050) (-1050) (-1050) (-1050)
				(-1050) (-1050) (-1050) (-1050)
				(-1050) (-1050) (-1050) (-1050)
				(-1050) (-1050) (-1050) (-1050)
				(-1050) (-1050) (-1050) (-1050)
				(-1050) (-1050) (-1050) (-1050)
				(-1050) (-1050) (-1050) (-1050)
				(-1050) (-1050) (-1050) (-1050)
				(-1050) (-1050) (-1050) (-1050)
				(-1050) (-1050) (-1050) (-1050)
				(-1050) (-1050) (-1050) (-1050)
				(-1050) (-1050) (-1050) (-1050)
				(-1050) (-1050) (-1050) (-1050)
				(-1050) (-1050) (-1050) (-1050)
				(-1050) (-1050) (-1050) (-1050)
				(-1050) (-1050) (-1050) (-1050)
				(-1050) (-1050) (-1050) (-1050)
				(-1050) (-1050) (-1050) (-1050)
				(-1050) (-1050) (-1050) (-1050)
				(-1050) (-1050) (-1050) (-1050)
				(-1050) (-1050) (-1050) (-1050)
				(-1050) (-1050) (-1050) (-1050)
				(-1050) (-1050) (-1050) (-1050)
				(-1050) (-1050) (-1050) (-1050)
				(-1050) (-1050) (-1050) (-1050)
				(-1050) (-1050) (-1050) (-1050)
				(-1050) (-1050) (-1050) (-1050)
				(-1050) (-1050) (-1050) (-1050)
				(-1050) (-1050) (-1050) (-1050)
				(-1050) (-1050) (-1050) (-1050)
				(-1050) (-1050) (-1050) (-1050)
				(-1050) (-1050) (-1050) (-1050)
				(-1050) (-1050) (-1050) (-1050)
				(-1050) (-1050) (-1050) (-1050)
				(-1050) (-1050) (-1050) (-1050)>;

			PS_Config_Lmt_PenTipX_FW_Diff_P = <
				1050 1050 1050 1050 1050 1050 1050 1050 1050 1050 1050 1050 1050 1050 1050 1050 1050 1050 1050 1050 1050 1050 1050 1050 1050 1050 1050 1050 1050 1050 1050 1050
				1050 1050 1050 1050 1050 1050 1050 1050 1050 1050 1050 1050 1050 1050 1050 1050 1050 1050 1050 1050 1050 1050 1050 1050 1050 1050 1050 1050 1050 1050 1050 1050
				1050 1050 1050 1050 1050 1050 1050 1050 1050 1050 1050 1050 1050 1050 1050 1050 1050 1050 1050 1050 1050 1050 1050 1050 1050 1050 1050 1050 1050 1050 1050 1050
				1050 1050 1050 1050 1050 1050 1050 1050 1050 1050 1050 1050 1050 1050 1050 1050 1050 1050 1050 1050 1050 1050 1050 1050 1050 1050 1050 1050 1050 1050 1050 1050
				1050 1050 1050 1050 1050 1050 1050 1050 1050 1050 1050 1050 1050 1050 1050 1050 1050 1050 1050 1050 1050 1050 1050 1050 1050 1050 1050 1050 1050 1050 1050 1050
				1050 1050 1050 1050 1050 1050 1050 1050 1050 1050 1050 1050 1050 1050 1050 1050 1050 1050 1050 1050 1050 1050 1050 1050 1050 1050 1050 1050 1050 1050 1050 1050>;

			PS_Config_Lmt_PenTipX_FW_Diff_N = <
				(-1050) (-1050) (-1050) (-1050) (-1050) (-1050) (-1050) (-1050) (-1050) (-1050) (-1050) (-1050) (-1050) (-1050) (-1050) (-1050) (-1050) (-1050) (-1050) (-1050) (-1050) (-1050) (-1050) (-1050) (-1050) (-1050) (-1050) (-1050) (-1050) (-1050) (-1050) (-1050)
				(-1050) (-1050) (-1050) (-1050) (-1050) (-1050) (-1050) (-1050) (-1050) (-1050) (-1050) (-1050) (-1050) (-1050) (-1050) (-1050) (-1050) (-1050) (-1050) (-1050) (-1050) (-1050) (-1050) (-1050) (-1050) (-1050) (-1050) (-1050) (-1050) (-1050) (-1050) (-1050)
				(-1050) (-1050) (-1050) (-1050) (-1050) (-1050) (-1050) (-1050) (-1050) (-1050) (-1050) (-1050) (-1050) (-1050) (-1050) (-1050) (-1050) (-1050) (-1050) (-1050) (-1050) (-1050) (-1050) (-1050) (-1050) (-1050) (-1050) (-1050) (-1050) (-1050) (-1050) (-1050)
				(-1050) (-1050) (-1050) (-1050) (-1050) (-1050) (-1050) (-1050) (-1050) (-1050) (-1050) (-1050) (-1050) (-1050) (-1050) (-1050) (-1050) (-1050) (-1050) (-1050) (-1050) (-1050) (-1050) (-1050) (-1050) (-1050) (-1050) (-1050) (-1050) (-1050) (-1050) (-1050)
				(-1050) (-1050) (-1050) (-1050) (-1050) (-1050) (-1050) (-1050) (-1050) (-1050) (-1050) (-1050) (-1050) (-1050) (-1050) (-1050) (-1050) (-1050) (-1050) (-1050) (-1050) (-1050) (-1050) (-1050) (-1050) (-1050) (-1050) (-1050) (-1050) (-1050) (-1050) (-1050)
				(-1050) (-1050) (-1050) (-1050) (-1050) (-1050) (-1050) (-1050) (-1050) (-1050) (-1050) (-1050) (-1050) (-1050) (-1050) (-1050) (-1050) (-1050) (-1050) (-1050) (-1050) (-1050) (-1050) (-1050) (-1050) (-1050) (-1050) (-1050) (-1050) (-1050) (-1050) (-1050)>;

			PS_Config_Lmt_PenTipY_FW_Diff_P = <
				1050 1050 1050 1050
				1050 1050 1050 1050
				1050 1050 1050 1050
				1050 1050 1050 1050
				1050 1050 1050 1050
				1050 1050 1050 1050
				1050 1050 1050 1050
				1050 1050 1050 1050
				1050 1050 1050 1050
				1050 1050 1050 1050
				1050 1050 1050 1050
				1050 1050 1050 1050
				1050 1050 1050 1050
				1050 1050 1050 1050
				1050 1050 1050 1050
				1050 1050 1050 1050
				1050 1050 1050 1050
				1050 1050 1050 1050
				1050 1050 1050 1050
				1050 1050 1050 1050
				1050 1050 1050 1050
				1050 1050 1050 1050
				1050 1050 1050 1050
				1050 1050 1050 1050
				1050 1050 1050 1050
				1050 1050 1050 1050
				1050 1050 1050 1050
				1050 1050 1050 1050
				1050 1050 1050 1050
				1050 1050 1050 1050
				1050 1050 1050 1050
				1050 1050 1050 1050
				1050 1050 1050 1050
				1050 1050 1050 1050
				1050 1050 1050 1050
				1050 1050 1050 1050
				1050 1050 1050 1050
				1050 1050 1050 1050
				1050 1050 1050 1050
				1050 1050 1050 1050
				1050 1050 1050 1050
				1050 1050 1050 1050
				1050 1050 1050 1050
				1050 1050 1050 1050
				1050 1050 1050 1050
				1050 1050 1050 1050
				1050 1050 1050 1050
				1050 1050 1050 1050
				1050 1050 1050 1050
				1050 1050 1050 1050>;

			PS_Config_Lmt_PenTipY_FW_Diff_N = <
				(-1050) (-1050) (-1050) (-1050)
				(-1050) (-1050) (-1050) (-1050)
				(-1050) (-1050) (-1050) (-1050)
				(-1050) (-1050) (-1050) (-1050)
				(-1050) (-1050) (-1050) (-1050)
				(-1050) (-1050) (-1050) (-1050)
				(-1050) (-1050) (-1050) (-1050)
				(-1050) (-1050) (-1050) (-1050)
				(-1050) (-1050) (-1050) (-1050)
				(-1050) (-1050) (-1050) (-1050)
				(-1050) (-1050) (-1050) (-1050)
				(-1050) (-1050) (-1050) (-1050)
				(-1050) (-1050) (-1050) (-1050)
				(-1050) (-1050) (-1050) (-1050)
				(-1050) (-1050) (-1050) (-1050)
				(-1050) (-1050) (-1050) (-1050)
				(-1050) (-1050) (-1050) (-1050)
				(-1050) (-1050) (-1050) (-1050)
				(-1050) (-1050) (-1050) (-1050)
				(-1050) (-1050) (-1050) (-1050)
				(-1050) (-1050) (-1050) (-1050)
				(-1050) (-1050) (-1050) (-1050)
				(-1050) (-1050) (-1050) (-1050)
				(-1050) (-1050) (-1050) (-1050)
				(-1050) (-1050) (-1050) (-1050)
				(-1050) (-1050) (-1050) (-1050)
				(-1050) (-1050) (-1050) (-1050)
				(-1050) (-1050) (-1050) (-1050)
				(-1050) (-1050) (-1050) (-1050)
				(-1050) (-1050) (-1050) (-1050)
				(-1050) (-1050) (-1050) (-1050)
				(-1050) (-1050) (-1050) (-1050)
				(-1050) (-1050) (-1050) (-1050)
				(-1050) (-1050) (-1050) (-1050)
				(-1050) (-1050) (-1050) (-1050)
				(-1050) (-1050) (-1050) (-1050)
				(-1050) (-1050) (-1050) (-1050)
				(-1050) (-1050) (-1050) (-1050)
				(-1050) (-1050) (-1050) (-1050)
				(-1050) (-1050) (-1050) (-1050)
				(-1050) (-1050) (-1050) (-1050)
				(-1050) (-1050) (-1050) (-1050)
				(-1050) (-1050) (-1050) (-1050)
				(-1050) (-1050) (-1050) (-1050)
				(-1050) (-1050) (-1050) (-1050)
				(-1050) (-1050) (-1050) (-1050)
				(-1050) (-1050) (-1050) (-1050)
				(-1050) (-1050) (-1050) (-1050)
				(-1050) (-1050) (-1050) (-1050)
				(-1050) (-1050) (-1050) (-1050)>;

			PS_Config_Lmt_PenRingX_FW_Diff_P = <
				1050 1050 1050 1050 1050 1050 1050 1050 1050 1050 1050 1050 1050 1050 1050 1050 1050 1050 1050 1050 1050 1050 1050 1050 1050 1050 1050 1050 1050 1050 1050 1050
				1050 1050 1050 1050 1050 1050 1050 1050 1050 1050 1050 1050 1050 1050 1050 1050 1050 1050 1050 1050 1050 1050 1050 1050 1050 1050 1050 1050 1050 1050 1050 1050
				1050 1050 1050 1050 1050 1050 1050 1050 1050 1050 1050 1050 1050 1050 1050 1050 1050 1050 1050 1050 1050 1050 1050 1050 1050 1050 1050 1050 1050 1050 1050 1050
				1050 1050 1050 1050 1050 1050 1050 1050 1050 1050 1050 1050 1050 1050 1050 1050 1050 1050 1050 1050 1050 1050 1050 1050 1050 1050 1050 1050 1050 1050 1050 1050
				1050 1050 1050 1050 1050 1050 1050 1050 1050 1050 1050 1050 1050 1050 1050 1050 1050 1050 1050 1050 1050 1050 1050 1050 1050 1050 1050 1050 1050 1050 1050 1050
				1050 1050 1050 1050 1050 1050 1050 1050 1050 1050 1050 1050 1050 1050 1050 1050 1050 1050 1050 1050 1050 1050 1050 1050 1050 1050 1050 1050 1050 1050 1050 1050>;

			PS_Config_Lmt_PenRingX_FW_Diff_N = <
				(-1050) (-1050) (-1050) (-1050) (-1050) (-1050) (-1050) (-1050) (-1050) (-1050) (-1050) (-1050) (-1050) (-1050) (-1050) (-1050) (-1050) (-1050) (-1050) (-1050) (-1050) (-1050) (-1050) (-1050) (-1050) (-1050) (-1050) (-1050) (-1050) (-1050) (-1050) (-1050)
				(-1050) (-1050) (-1050) (-1050) (-1050) (-1050) (-1050) (-1050) (-1050) (-1050) (-1050) (-1050) (-1050) (-1050) (-1050) (-1050) (-1050) (-1050) (-1050) (-1050) (-1050) (-1050) (-1050) (-1050) (-1050) (-1050) (-1050) (-1050) (-1050) (-1050) (-1050) (-1050)
				(-1050) (-1050) (-1050) (-1050) (-1050) (-1050) (-1050) (-1050) (-1050) (-1050) (-1050) (-1050) (-1050) (-1050) (-1050) (-1050) (-1050) (-1050) (-1050) (-1050) (-1050) (-1050) (-1050) (-1050) (-1050) (-1050) (-1050) (-1050) (-1050) (-1050) (-1050) (-1050)
				(-1050) (-1050) (-1050) (-1050) (-1050) (-1050) (-1050) (-1050) (-1050) (-1050) (-1050) (-1050) (-1050) (-1050) (-1050) (-1050) (-1050) (-1050) (-1050) (-1050) (-1050) (-1050) (-1050) (-1050) (-1050) (-1050) (-1050) (-1050) (-1050) (-1050) (-1050) (-1050)
				(-1050) (-1050) (-1050) (-1050) (-1050) (-1050) (-1050) (-1050) (-1050) (-1050) (-1050) (-1050) (-1050) (-1050) (-1050) (-1050) (-1050) (-1050) (-1050) (-1050) (-1050) (-1050) (-1050) (-1050) (-1050) (-1050) (-1050) (-1050) (-1050) (-1050) (-1050) (-1050)
				(-1050) (-1050) (-1050) (-1050) (-1050) (-1050) (-1050) (-1050) (-1050) (-1050) (-1050) (-1050) (-1050) (-1050) (-1050) (-1050) (-1050) (-1050) (-1050) (-1050) (-1050) (-1050) (-1050) (-1050) (-1050) (-1050) (-1050) (-1050) (-1050) (-1050) (-1050) (-1050)>;

			PS_Config_Lmt_PenRingY_FW_Diff_P = <
				1050 1050 1050 1050
				1050 1050 1050 1050
				1050 1050 1050 1050
				1050 1050 1050 1050
				1050 1050 1050 1050
				1050 1050 1050 1050
				1050 1050 1050 1050
				1050 1050 1050 1050
				1050 1050 1050 1050
				1050 1050 1050 1050
				1050 1050 1050 1050
				1050 1050 1050 1050
				1050 1050 1050 1050
				1050 1050 1050 1050
				1050 1050 1050 1050
				1050 1050 1050 1050
				1050 1050 1050 1050
				1050 1050 1050 1050
				1050 1050 1050 1050
				1050 1050 1050 1050
				1050 1050 1050 1050
				1050 1050 1050 1050
				1050 1050 1050 1050
				1050 1050 1050 1050
				1050 1050 1050 1050
				1050 1050 1050 1050
				1050 1050 1050 1050
				1050 1050 1050 1050
				1050 1050 1050 1050
				1050 1050 1050 1050
				1050 1050 1050 1050
				1050 1050 1050 1050
				1050 1050 1050 1050
				1050 1050 1050 1050
				1050 1050 1050 1050
				1050 1050 1050 1050
				1050 1050 1050 1050
				1050 1050 1050 1050
				1050 1050 1050 1050
				1050 1050 1050 1050
				1050 1050 1050 1050
				1050 1050 1050 1050
				1050 1050 1050 1050
				1050 1050 1050 1050
				1050 1050 1050 1050
				1050 1050 1050 1050
				1050 1050 1050 1050
				1050 1050 1050 1050
				1050 1050 1050 1050
				1050 1050 1050 1050>;

			PS_Config_Lmt_PenRingY_FW_Diff_N = <
				(-1050) (-1050) (-1050) (-1050)
				(-1050) (-1050) (-1050) (-1050)
				(-1050) (-1050) (-1050) (-1050)
				(-1050) (-1050) (-1050) (-1050)
				(-1050) (-1050) (-1050) (-1050)
				(-1050) (-1050) (-1050) (-1050)
				(-1050) (-1050) (-1050) (-1050)
				(-1050) (-1050) (-1050) (-1050)
				(-1050) (-1050) (-1050) (-1050)
				(-1050) (-1050) (-1050) (-1050)
				(-1050) (-1050) (-1050) (-1050)
				(-1050) (-1050) (-1050) (-1050)
				(-1050) (-1050) (-1050) (-1050)
				(-1050) (-1050) (-1050) (-1050)
				(-1050) (-1050) (-1050) (-1050)
				(-1050) (-1050) (-1050) (-1050)
				(-1050) (-1050) (-1050) (-1050)
				(-1050) (-1050) (-1050) (-1050)
				(-1050) (-1050) (-1050) (-1050)
				(-1050) (-1050) (-1050) (-1050)
				(-1050) (-1050) (-1050) (-1050)
				(-1050) (-1050) (-1050) (-1050)
				(-1050) (-1050) (-1050) (-1050)
				(-1050) (-1050) (-1050) (-1050)
				(-1050) (-1050) (-1050) (-1050)
				(-1050) (-1050) (-1050) (-1050)
				(-1050) (-1050) (-1050) (-1050)
				(-1050) (-1050) (-1050) (-1050)
				(-1050) (-1050) (-1050) (-1050)
				(-1050) (-1050) (-1050) (-1050)
				(-1050) (-1050) (-1050) (-1050)
				(-1050) (-1050) (-1050) (-1050)
				(-1050) (-1050) (-1050) (-1050)
				(-1050) (-1050) (-1050) (-1050)
				(-1050) (-1050) (-1050) (-1050)
				(-1050) (-1050) (-1050) (-1050)
				(-1050) (-1050) (-1050) (-1050)
				(-1050) (-1050) (-1050) (-1050)
				(-1050) (-1050) (-1050) (-1050)
				(-1050) (-1050) (-1050) (-1050)
				(-1050) (-1050) (-1050) (-1050)
				(-1050) (-1050) (-1050) (-1050)
				(-1050) (-1050) (-1050) (-1050)
				(-1050) (-1050) (-1050) (-1050)
				(-1050) (-1050) (-1050) (-1050)
				(-1050) (-1050) (-1050) (-1050)
				(-1050) (-1050) (-1050) (-1050)
				(-1050) (-1050) (-1050) (-1050)
				(-1050) (-1050) (-1050) (-1050)
				(-1050) (-1050) (-1050) (-1050)>;

			PS_Config_Diff_Test_Frame = <50>;
		};
	};
};
