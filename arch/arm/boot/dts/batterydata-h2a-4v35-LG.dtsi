/* Copyright (c) 2013, The Linux Foundation. All rights reserved.
 * Copyright (C) 2015 XiaoMi, Inc.
 *
 * This program is free software; you can redistribute it and/or modify
 * it under the terms of the GNU General Public License version 2 and
 * only version 2 as published by the Free Software Foundation.
 *
 * This program is distributed in the hope that it will be useful,
 * but WITHOUT ANY WARRANTY; without even the implied warranty of
 * MERCHANTABILITY or FITNESS FOR A PARTICULAR PURPOSE.  See the
 * GNU General Public License for more details.
 */

qcom,h2a-4v35-LG {
	qcom,fcc-mah = <2050>;
	qcom,default-rbatt-mohm = <195>;
	qcom,rbatt-capacitive-mohm = <0>;
	qcom,flat-ocv-threshold-uv = <3800000>;
	qcom,max-voltage-uv = <4350000>;
	qcom,v-cutoff-uv = <3400000>;
	qcom,chg-term-ua = <100000>;
	qcom,batt-id-kohm = <12>;

	qcom,rbatt-sf-lut {
		qcom,lut-col-legend = <(-20) (-10) 0 5 10 15 20 25 30 40 60>;
		qcom,lut-row-legend = <100 95 90 85 80>,
				<75 70 65 60 55>,
				<50 45 40 35 30>,
				<25 20 16 13 11>,
				<10 9 8 7 6>,
				<5 4 3 2 1>;
		qcom,lut-data = 				<1464 720 350 252 185 141 114 100 85 71 63>,
				<1353 713 350 252 186 141 115 100 86 72 64>,
				<1358 713 349 251 186 141 115 100 86 72 64>,
				<1313 694 344 251 188 143 117 102 87 74 65>,
				<1218 706 347 251 187 145 120 105 90 75 66>,
				<1178 661 346 258 197 155 128 111 96 81 68>,
				<1158 644 316 233 178 145 124 109 97 83 70>,
				<1147 644 321 235 180 144 121 104 93 82 71>,
				<1157 645 318 232 173 135 112 96 85 74 66>,
				<1178 641 314 228 171 133 109 94 83 72 64>,
				<1205 652 314 228 171 134 109 94 83 72 65>,
				<1243 676 313 228 172 135 111 96 85 73 66>,
				<1330 707 320 229 172 136 113 97 87 76 68>,
				<1453 743 333 235 174 135 112 98 89 78 69>,
				<1608 782 352 246 180 138 112 96 85 73 66>,
				<1812 828 376 259 187 142 114 96 84 72 64>,
				<2097 884 412 276 195 149 118 98 86 73 64>,
				<2405 934 452 301 205 151 120 100 88 74 65>,
				<2715 972 486 328 219 156 122 101 88 74 65>,
				<2969 994 504 346 232 163 125 102 88 75 67>,
				<3101 999 506 351 239 168 127 105 90 76 68>,
				<3193 963 475 330 230 166 128 106 91 77 69>,
				<3082 933 452 313 222 165 129 107 93 78 70>,
				<3395 963 465 317 222 166 131 108 93 78 69>,
				<3768 1020 480 323 223 166 130 105 91 76 67>,
				<4269 1115 500 333 227 165 129 105 91 76 67>,
				<4927 1263 528 350 236 169 130 108 92 77 69>,
				<5927 1468 562 375 248 177 136 113 97 81 71>,
				<7943 1814 610 409 269 191 147 125 106 88 77>,
				<19173 4741 889 511 330 230 181 184 136 107 98>;
	};

	qcom,fcc-temp-lut {
		qcom,lut-col-legend = <(-20) (-10) 0 5 10 15 20 25 30 40 60>;
		qcom,lut-data = <2007 2015 2016 2017 2017 2017 2017 2016 2018 2018 2015>;
	};

	qcom,pc-temp-ocv-lut {
		qcom,lut-col-legend = <(-20) (-10) 0 5 10 15 20 25 30 40 60>;
		qcom,lut-row-legend = <100 95 90 85 80>,
				<75 70 65 60 55>,
				<50 45 40 35 30>,
				<25 20 16 13 11>,
				<10 9 8 7 6>,
				<5 4 3 2 1>,
				<0>;
		qcom,lut-data = 				<4317 4326 4321 4322 4319 4323 4317 4312 4314 4317 4311>,
				<4208 4238 4247 4251 4252 4255 4254 4252 4254 4255 4250>,
				<4134 4176 4190 4194 4196 4199 4199 4197 4199 4199 4195>,
				<4091 4116 4136 4141 4144 4146 4146 4144 4146 4146 4142>,
				<4002 4076 4087 4091 4093 4094 4094 4092 4094 4094 4091>,
				<3942 3997 4033 4042 4047 4052 4052 4049 4052 4051 4043>,
				<3894 3939 3958 3966 3971 3978 3982 3982 3988 3996 3998>,
				<3854 3900 3920 3927 3932 3939 3941 3940 3946 3951 3951>,
				<3828 3863 3887 3892 3896 3898 3900 3899 3901 3903 3903>,
				<3808 3828 3853 3859 3862 3864 3865 3866 3867 3868 3867>,
				<3791 3806 3824 3830 3834 3837 3838 3839 3840 3841 3840>,
				<3774 3789 3799 3806 3810 3814 3815 3816 3818 3818 3817>,
				<3758 3775 3781 3786 3790 3794 3796 3797 3798 3799 3798>,
				<3741 3761 3766 3771 3773 3776 3777 3778 3780 3781 3779>,
				<3722 3748 3751 3757 3759 3761 3761 3760 3760 3758 3750>,
				<3699 3732 3736 3740 3744 3746 3745 3743 3742 3738 3725>,
				<3673 3714 3721 3722 3724 3728 3727 3725 3724 3719 3705>,
				<3645 3695 3709 3709 3708 3709 3708 3706 3705 3700 3687>,
				<3618 3676 3697 3700 3698 3696 3695 3693 3691 3686 3674>,
				<3597 3660 3687 3692 3692 3691 3689 3686 3684 3680 3668>,
				<3584 3650 3680 3687 3689 3688 3686 3684 3683 3678 3667>,
				<3570 3640 3672 3680 3684 3685 3684 3682 3681 3676 3664>,
				<3554 3626 3661 3671 3677 3680 3680 3678 3677 3672 3659>,
				<3534 3609 3645 3657 3664 3669 3670 3667 3667 3662 3646>,
				<3510 3586 3624 3636 3642 3648 3648 3642 3644 3639 3619>,
				<3479 3558 3595 3607 3612 3615 3614 3605 3607 3602 3581>,
				<3439 3521 3557 3567 3571 3572 3570 3558 3561 3555 3535>,
				<3386 3471 3506 3514 3516 3516 3512 3497 3502 3497 3476>,
				<3304 3398 3433 3439 3440 3439 3435 3418 3425 3421 3397>,
				<3174 3282 3316 3322 3322 3323 3319 3302 3310 3304 3273>,
				<3000 3000 3000 3000 3000 3000 3000 3000 3000 3000 3000>;
	};
};
