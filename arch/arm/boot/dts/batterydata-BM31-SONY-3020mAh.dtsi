/* Copyright (c) 2013, The Linux Foundation. All rights reserved.
 * Copyright (C) 2015 XiaoMi, Inc.
 *
 * This program is free software; you can redistribute it and/or modify
 * it under the terms of the GNU General Public License version 2 and
 * only version 2 as published by the Free Software Foundation.
 *
 * This program is distributed in the hope that it will be useful,
 * but WITHOUT ANY WARRANTY; without even the implied warranty of
 * MERCHANTABILITY or FITNESS FOR A PARTICULAR PURPOSE.  See the
 * GNU General Public License for more details.
 */

qcom,BM31-SONY-3020mAh-data {
	qcom,fcc-mah = <3020>;
	qcom,default-rbatt-mohm = <123>;
	qcom,rbatt-capacitive-mohm = <0>;
	qcom,flat-ocv-threshold-uv = <3800000>;
	qcom,max-voltage-uv = <4350000>;
	qcom,v-cutoff-uv = <3400000>;
	qcom,chg-term-ua = <200000>;
	qcom,batt-id-kohm = <9>;
	xiaomi,batt-version = <4>;

	qcom,rbatt-sf-lut {
		qcom,lut-col-legend = <(-20) (-10) 0 5 10 15 20 25 30 40 60>;
		qcom,lut-row-legend = <100 95 90 85 80>,
				<75 70 65 60 55>,
				<50 45 40 35 30>,
				<25 20 16 13 11>,
				<10 9 8 7 6>,
				<5 4 3 2 1>;
		qcom,lut-data = <1321 545 272 204 166 138 118 100 95 79 70>,
			<1322 554 272 211 172 143 123 101 99 82 71>,
			<1347 553 278 211 172 143 122 103 98 82 71>,
			<1355 557 284 217 178 148 127 108 101 85 73>,
			<1356 560 286 224 186 155 132 113 106 87 75>,
			<1360 560 286 227 190 160 139 120 110 91 78>,
			<1368 564 284 223 189 165 144 127 116 96 80>,
			<1375 568 282 217 182 159 143 131 119 103 84>,
			<1390 575 283 215 175 150 134 117 113 100 86>,
			<1419 585 286 216 173 146 125 105 104 85 75>,
			<1456 597 291 219 175 146 124 104 99 82 73>,
			<1508 613 297 224 179 149 126 108 101 84 73>,
			<1573 632 303 229 184 153 130 111 104 86 76>,
			<1657 657 312 235 189 157 135 114 107 90 78>,
			<1798 690 325 242 194 160 137 115 109 89 76>,
			<2077 741 338 251 199 161 135 112 106 86 74>,
			<2501 824 352 259 203 164 135 113 105 86 75>,
			<3026 926 373 265 206 165 137 113 105 87 76>,
			<3552 1030 408 272 209 166 139 111 107 85 75>,
			<3551 1109 405 287 216 169 140 113 108 86 75>,
			<4131 1141 424 299 224 173 143 115 110 88 78>,
			<4951 1122 453 313 233 182 148 117 113 90 82>,
			<6202 1085 491 326 245 190 156 121 117 92 84>,
			<7943 1140 541 327 258 200 160 126 120 96 87>,
			<10735 1262 608 334 264 204 162 127 121 95 81>,
			<15583 1455 700 350 257 195 156 122 116 91 78>,
			<24185 1883 843 369 253 190 150 124 111 91 79>,
			<38683 2744 1141 410 273 195 155 130 114 94 82>,
			<61940 4595 2000 482 311 216 169 143 121 101 86>,
			<90335 8856 4509 926 511 272 513 477 347 129 104>;
	};

	qcom,fcc-temp-lut {
		qcom,lut-col-legend = <(-20) (-10) 0 5 10 15 20 25 30 40 60>;
		qcom,lut-data = <3079 2961 3062 2918 2863 2838 2828 3010 2818 2991 2966>;
	};

	qcom,pc-temp-ocv-lut {
		qcom,lut-col-legend = <(-20) (-10) 0 5 10 15 20 25 30 40 60>;
		qcom,lut-row-legend = <100 95 90 85 80>,
				<75 70 65 60 55>,
				<50 45 40 35 30>,
				<25 20 16 13 11>,
				<10 9 8 7 6>,
				<5 4 3 2 1 0>;
		qcom,lut-data = <4314 4315 4312 4313 4312 4310 4309 4307 4306 4301 4293>,
			<4223 4250 4246 4259 4261 4262 4262 4253 4261 4251 4247>,
			<4149 4186 4185 4201 4204 4206 4206 4195 4206 4195 4192>,
			<4083 4127 4127 4146 4150 4152 4153 4141 4153 4142 4139>,
			<4022 4070 4070 4093 4098 4101 4102 4089 4103 4090 4088>,
			<3967 4015 4016 4041 4048 4053 4054 4041 4056 4043 4042>,
			<3918 3966 3967 3990 3999 4006 4009 3997 4012 3999 3998>,
			<3876 3922 3923 3943 3952 3959 3963 3954 3969 3959 3958>,
			<3840 3883 3884 3904 3910 3915 3919 3907 3925 3915 3917>,
			<3811 3850 3852 3870 3875 3879 3881 3868 3885 3872 3873>,
			<3787 3820 3824 3841 3846 3849 3851 3840 3853 3842 3843>,
			<3767 3794 3800 3816 3821 3824 3826 3817 3828 3820 3819>,
			<3749 3773 3781 3794 3799 3802 3805 3798 3807 3800 3800>,
			<3733 3756 3765 3776 3780 3783 3786 3782 3788 3784 3783>,
			<3715 3739 3752 3761 3765 3767 3769 3766 3771 3766 3759>,
			<3696 3722 3736 3746 3750 3751 3751 3749 3750 3744 3733>,
			<3674 3704 3714 3726 3730 3732 3731 3729 3729 3723 3710>,
			<3651 3687 3693 3705 3708 3709 3709 3706 3706 3701 3688>,
			<3631 3672 3677 3685 3688 3690 3690 3684 3689 3681 3670>,
			<3617 3660 3666 3673 3675 3676 3677 3674 3678 3671 3660>,
			<3607 3652 3660 3667 3669 3671 3672 3670 3673 3668 3658>,
			<3595 3643 3653 3661 3663 3666 3667 3667 3668 3665 3655>,
			<3581 3633 3646 3654 3657 3660 3661 3661 3662 3660 3650>,
			<3561 3619 3636 3646 3647 3651 3652 3653 3652 3652 3642>,
			<3535 3602 3622 3633 3633 3634 3634 3635 3637 3634 3620>,
			<3503 3578 3600 3608 3606 3605 3600 3599 3600 3599 3581>,
			<3455 3541 3562 3567 3560 3560 3554 3547 3554 3549 3531>,
			<3383 3487 3503 3507 3498 3497 3490 3481 3491 3485 3468>,
			<3287 3399 3408 3422 3414 3414 3405 3392 3407 3401 3383>,
			<3165 3249 3247 3275 3280 3285 3272 3254 3278 3273 3252>,
			<3000 3000 3000 3000 3000 3000 3000 3000 3000 3000 3000>;
	};
};
