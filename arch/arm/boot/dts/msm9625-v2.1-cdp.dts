/* Copyright (c) 2013, The Linux Foundation. All rights reserved.
 *
 * This program is free software; you can redistribute it and/or modify
 * it under the terms of the GNU General Public License version 2 and
 * only version 2 as published by the Free Software Foundation.
 *
 * This program is distributed in the hope that it will be useful,
 * but WITHOUT ANY WARRANTY; without even the implied warranty of
 * MERCHANTABILITY or FITNESS FOR A PARTICULAR PURPOSE.  See the
 * GNU General Public License for more details.
 */

/dts-v1/;

/include/ "msm9625-v2.1.dtsi"
/include/ "msm9625-cdp.dtsi"

/ {
	model = "Qualcomm MSM 9625V2.1 CDP";
	compatible = "qcom,msm9625-cdp", "qcom,msm9625", "qcom,cdp";
	qcom,msm-id = <134 1 0x20001>, <152 1 0x20001>, <149 1 0x20001>,
		      <150 1 0x20001>, <151 1 0x20001>, <148 1 0x20001>,
		      <173 1 0x20001>, <174 1 0x20001>, <175 1 0x20001>;
};
