/* Copyright (c) 2013, The Linux Foundation. All rights reserved.
 *
 * This program is free software; you can redistribute it and/or modify
 * it under the terms of the GNU General Public License version 2 and
 * only version 2 as published by the Free Software Foundation.
 *
 * This program is distributed in the hope that it will be useful,
 * but WITHOUT ANY WARRANTY; without even the implied warranty of
 * MERCHANTABILITY or FITNESS FOR A PARTICULAR PURPOSE.  See the
 * GNU General Public License for more details.
 */

/*---------------------------------------------------------------------------
 * This file is autogenerated file using gcdb parser. Please do not edit it.
 * Update input XML file to add a new entry or update variable in this file
 * VERSION = "1.0"
 *---------------------------------------------------------------------------*/
&mdss_mdp {
	dsi_nt35596_1080_vid: qcom,mdss_dsi_nt35596_1080p_video {
		qcom,mdss-dsi-panel-name = "nt35596 1080p video mode dsi panel";
		qcom,mdss-dsi-panel-controller = <&mdss_dsi0>;
		qcom,mdss-dsi-panel-type = "dsi_video_mode";
		qcom,mdss-dsi-panel-destination = "display_1";
		qcom,mdss-dsi-panel-framerate = <60>;
		qcom,mdss-dsi-virtual-channel-id = <0>;
		qcom,mdss-dsi-stream = <0>;
		qcom,mdss-dsi-panel-width = <1080>;
		qcom,mdss-dsi-panel-height = <1920>;
		qcom,mdss-dsi-h-front-porch = <32>;
		qcom,mdss-dsi-h-back-porch = <32>;
		qcom,mdss-dsi-h-pulse-width = <8>;
		qcom,mdss-dsi-h-sync-skew = <0>;
		qcom,mdss-dsi-v-back-porch = <18>;
		qcom,mdss-dsi-v-front-porch = <2>;
		qcom,mdss-dsi-v-pulse-width = <2>;
		qcom,mdss-dsi-h-left-border = <0>;
		qcom,mdss-dsi-h-right-border = <0>;
		qcom,mdss-dsi-v-top-border = <0>;
		qcom,mdss-dsi-v-bottom-border = <0>;
		qcom,mdss-dsi-bpp = <24>;
		qcom,mdss-dsi-underflow-color = <0xff>;
		qcom,mdss-dsi-border-color = <0>;
		qcom,mdss-dsi-on-command = [29 01 00 00 00 00 02 FF EE
			29 01 00 00 00 00 02 FB 01
			29 01 00 00 00 00 02 1F 45
			29 01 00 00 00 00 02 24 4F
			29 01 00 00 00 00 02 38 C8
			29 01 00 00 00 00 02 39 2C
			29 01 00 00 00 00 02 1E BB
			29 01 00 00 00 00 02 1D 0F
			29 01 00 00 00 00 02 7E B1
			29 01 00 00 00 00 02 FF 00
			29 01 00 00 00 00 02 FB 01
			29 01 00 00 00 00 02 35 01
			29 01 00 00 00 00 02 BA 03
			29 01 00 00 00 00 02 FF 01
			29 01 00 00 00 00 02 FB 01
			29 01 00 00 00 00 02 00 01
			29 01 00 00 00 00 02 01 55
			29 01 00 00 00 00 02 02 40
			29 01 00 00 00 00 02 05 00
			29 01 00 00 00 00 02 06 1B
			29 01 00 00 00 00 02 07 24
			29 01 00 00 00 00 02 08 0C
			29 01 00 00 00 00 02 0B 87
			29 01 00 00 00 00 02 0C 87
			29 01 00 00 00 00 02 0E B0
			29 01 00 00 00 00 02 0F B3
			29 01 00 00 00 00 02 11 10
			29 01 00 00 00 00 02 12 10
			29 01 00 00 00 00 02 13 05
			29 01 00 00 00 00 02 14 4A
			29 01 00 00 00 00 02 15 18
			29 01 00 00 00 00 02 16 18
			29 01 00 00 00 00 02 18 00
			29 01 00 00 00 00 02 19 77
			29 01 00 00 00 00 02 1A 55
			29 01 00 00 00 00 02 1B 13
			29 01 00 00 00 00 02 1C 00
			29 01 00 00 00 00 02 1D 00
			29 01 00 00 00 00 02 1E 13
			29 01 00 00 00 00 02 1F 00
			29 01 00 00 00 00 02 23 00
			29 01 00 00 00 00 02 24 00
			29 01 00 00 00 00 02 25 00
			29 01 00 00 00 00 02 26 00
			29 01 00 00 00 00 02 27 00
			29 01 00 00 00 00 02 28 00
			29 01 00 00 00 00 02 35 00
			29 01 00 00 00 00 02 66 00
			29 01 00 00 00 00 02 58 82
			29 01 00 00 00 00 02 59 02
			29 01 00 00 00 00 02 5A 02
			29 01 00 00 00 00 02 5B 02
			29 01 00 00 00 00 02 5C 82
			29 01 00 00 00 00 02 5D 82
			29 01 00 00 00 00 02 5E 02
			29 01 00 00 00 00 02 5F 02
			29 01 00 00 00 00 02 72 31
			29 01 00 00 00 00 02 FF 05
			29 01 00 00 00 00 02 FB 01
			29 01 00 00 00 00 02 00 01
			29 01 00 00 00 00 02 01 0B
			29 01 00 00 00 00 02 02 0C
			29 01 00 00 00 00 02 03 09
			29 01 00 00 00 00 02 04 0A
			29 01 00 00 00 00 02 05 00
			29 01 00 00 00 00 02 06 0F
			29 01 00 00 00 00 02 07 10
			29 01 00 00 00 00 02 08 00
			29 01 00 00 00 00 02 09 00
			29 01 00 00 00 00 02 0A 00
			29 01 00 00 00 00 02 0B 00
			29 01 00 00 00 00 02 0C 00
			29 01 00 00 00 00 02 0D 13
			29 01 00 00 00 00 02 0E 15
			29 01 00 00 00 00 02 0F 17
			29 01 00 00 00 00 02 10 01
			29 01 00 00 00 00 02 11 0B
			29 01 00 00 00 00 02 12 0C
			29 01 00 00 00 00 02 13 09
			29 01 00 00 00 00 02 14 0A
			29 01 00 00 00 00 02 15 00
			29 01 00 00 00 00 02 16 0F
			29 01 00 00 00 00 02 17 10
			29 01 00 00 00 00 02 18 00
			29 01 00 00 00 00 02 19 00
			29 01 00 00 00 00 02 1A 00
			29 01 00 00 00 00 02 1B 00
			29 01 00 00 00 00 02 1C 00
			29 01 00 00 00 00 02 1D 13
			29 01 00 00 00 00 02 1E 15
			29 01 00 00 00 00 02 1F 17
			29 01 00 00 00 00 02 20 00
			29 01 00 00 00 00 02 21 03
			29 01 00 00 00 00 02 22 01
			29 01 00 00 00 00 02 23 40
			29 01 00 00 00 00 02 24 40
			29 01 00 00 00 00 02 25 ED
			29 01 00 00 00 00 02 29 58
			29 01 00 00 00 00 02 2A 12
			29 01 00 00 00 00 02 2B 01
			29 01 00 00 00 00 02 4B 06
			29 01 00 00 00 00 02 4C 11
			29 01 00 00 00 00 02 4D 20
			29 01 00 00 00 00 02 4E 02
			29 01 00 00 00 00 02 4F 02
			29 01 00 00 00 00 02 50 20
			29 01 00 00 00 00 02 51 61
			29 01 00 00 00 00 02 52 01
			29 01 00 00 00 00 02 53 63
			29 01 00 00 00 00 02 54 77
			29 01 00 00 00 00 02 55 ED
			29 01 00 00 00 00 02 5B 00
			29 01 00 00 00 00 02 5C 00
			29 01 00 00 00 00 02 5D 00
			29 01 00 00 00 00 02 5E 00
			29 01 00 00 00 00 02 5F 15
			29 01 00 00 00 00 02 60 75
			29 01 00 00 00 00 02 61 00
			29 01 00 00 00 00 02 62 00
			29 01 00 00 00 00 02 63 00
			29 01 00 00 00 00 02 64 00
			29 01 00 00 00 00 02 65 00
			29 01 00 00 00 00 02 66 00
			29 01 00 00 00 00 02 67 00
			29 01 00 00 00 00 02 68 04
			29 01 00 00 00 00 02 69 00
			29 01 00 00 00 00 02 6A 00
			29 01 00 00 00 00 02 6C 40
			29 01 00 00 00 00 02 75 01
			29 01 00 00 00 00 02 76 01
			29 01 00 00 00 00 02 7A 80
			29 01 00 00 00 00 02 7B C5
			29 01 00 00 00 00 02 7C D8
			29 01 00 00 00 00 02 7D 60
			29 01 00 00 00 00 02 7F 10
			29 01 00 00 00 00 02 80 81
			29 01 00 00 00 00 02 83 05
			29 01 00 00 00 00 02 93 08
			29 01 00 00 00 00 02 94 10
			29 01 00 00 00 00 02 8A 00
			29 01 00 00 00 00 02 9B 0F
			29 01 00 00 00 00 02 EA FF
			29 01 00 00 00 00 02 EC 00
			29 01 00 00 00 00 02 FF 01
			29 01 00 00 00 00 02 FB 01
			29 01 00 00 00 00 02 75 00
			29 01 00 00 00 00 02 76 8E
			29 01 00 00 00 00 02 77 00
			29 01 00 00 00 00 02 78 90
			29 01 00 00 00 00 02 79 00
			29 01 00 00 00 00 02 7A B2
			29 01 00 00 00 00 02 7B 00
			29 01 00 00 00 00 02 7C C7
			29 01 00 00 00 00 02 7D 00
			29 01 00 00 00 00 02 7E D7
			29 01 00 00 00 00 02 7F 00
			29 01 00 00 00 00 02 80 E9
			29 01 00 00 00 00 02 81 00
			29 01 00 00 00 00 02 82 F9
			29 01 00 00 00 00 02 83 01
			29 01 00 00 00 00 02 84 01
			29 01 00 00 00 00 02 85 01
			29 01 00 00 00 00 02 86 0B
			29 01 00 00 00 00 02 87 01
			29 01 00 00 00 00 02 88 3A
			29 01 00 00 00 00 02 89 01
			29 01 00 00 00 00 02 8A 5D
			29 01 00 00 00 00 02 8B 01
			29 01 00 00 00 00 02 8C 94
			29 01 00 00 00 00 02 8D 01
			29 01 00 00 00 00 02 8E BC
			29 01 00 00 00 00 02 8F 02
			29 01 00 00 00 00 02 90 00
			29 01 00 00 00 00 02 91 02
			29 01 00 00 00 00 02 92 39
			29 01 00 00 00 00 02 93 02
			29 01 00 00 00 00 02 94 3A
			29 01 00 00 00 00 02 95 02
			29 01 00 00 00 00 02 96 6B
			29 01 00 00 00 00 02 97 02
			29 01 00 00 00 00 02 98 A2
			29 01 00 00 00 00 02 99 02
			29 01 00 00 00 00 02 9A C7
			29 01 00 00 00 00 02 9B 02
			29 01 00 00 00 00 02 9C FB
			29 01 00 00 00 00 02 9D 03
			29 01 00 00 00 00 02 9E 20
			29 01 00 00 00 00 02 9F 03
			29 01 00 00 00 00 02 A0 54
			29 01 00 00 00 00 02 A2 03
			29 01 00 00 00 00 02 A3 6D
			29 01 00 00 00 00 02 A4 03
			29 01 00 00 00 00 02 A5 80
			29 01 00 00 00 00 02 A6 03
			29 01 00 00 00 00 02 A7 81
			29 01 00 00 00 00 02 A9 03
			29 01 00 00 00 00 02 AA C7
			29 01 00 00 00 00 02 AB 03
			29 01 00 00 00 00 02 AC F0
			29 01 00 00 00 00 02 AD 03
			29 01 00 00 00 00 02 AE F8
			29 01 00 00 00 00 02 AF 03
			29 01 00 00 00 00 02 B0 FD
			29 01 00 00 00 00 02 B1 03
			29 01 00 00 00 00 02 B2 FE
			29 01 00 00 00 00 02 B3 00
			29 01 00 00 00 00 02 B4 8E
			29 01 00 00 00 00 02 B5 00
			29 01 00 00 00 00 02 B6 90
			29 01 00 00 00 00 02 B7 00
			29 01 00 00 00 00 02 B8 B2
			29 01 00 00 00 00 02 B9 00
			29 01 00 00 00 00 02 BA C7
			29 01 00 00 00 00 02 BB 00
			29 01 00 00 00 00 02 BC D7
			29 01 00 00 00 00 02 BD 00
			29 01 00 00 00 00 02 BE E9
			29 01 00 00 00 00 02 BF 00
			29 01 00 00 00 00 02 C0 F9
			29 01 00 00 00 00 02 C1 01
			29 01 00 00 00 00 02 C2 01
			29 01 00 00 00 00 02 C3 01
			29 01 00 00 00 00 02 C4 0B
			29 01 00 00 00 00 02 C5 01
			29 01 00 00 00 00 02 C6 3A
			29 01 00 00 00 00 02 C7 01
			29 01 00 00 00 00 02 C8 5D
			29 01 00 00 00 00 02 C9 01
			29 01 00 00 00 00 02 CA 94
			29 01 00 00 00 00 02 CB 01
			29 01 00 00 00 00 02 CC BC
			29 01 00 00 00 00 02 CD 02
			29 01 00 00 00 00 02 CE 00
			29 01 00 00 00 00 02 CF 02
			29 01 00 00 00 00 02 D0 39
			29 01 00 00 00 00 02 D1 02
			29 01 00 00 00 00 02 D2 3A
			29 01 00 00 00 00 02 D3 02
			29 01 00 00 00 00 02 D4 6B
			29 01 00 00 00 00 02 D5 02
			29 01 00 00 00 00 02 D6 A2
			29 01 00 00 00 00 02 D7 02
			29 01 00 00 00 00 02 D8 C7
			29 01 00 00 00 00 02 D9 02
			29 01 00 00 00 00 02 DA FB
			29 01 00 00 00 00 02 DB 03
			29 01 00 00 00 00 02 DC 20
			29 01 00 00 00 00 02 DD 03
			29 01 00 00 00 00 02 DE 54
			29 01 00 00 00 00 02 DF 03
			29 01 00 00 00 00 02 E0 6D
			29 01 00 00 00 00 02 E1 03
			29 01 00 00 00 00 02 E2 80
			29 01 00 00 00 00 02 E3 03
			29 01 00 00 00 00 02 E4 81
			29 01 00 00 00 00 02 E5 03
			29 01 00 00 00 00 02 E6 C7
			29 01 00 00 00 00 02 E7 03
			29 01 00 00 00 00 02 E8 F0
			29 01 00 00 00 00 02 E9 03
			29 01 00 00 00 00 02 EA F8
			29 01 00 00 00 00 02 EB 03
			29 01 00 00 00 00 02 EC FD
			29 01 00 00 00 00 02 ED 03
			29 01 00 00 00 00 02 EE FE
			29 01 00 00 00 00 02 EF 00
			29 01 00 00 00 00 02 F0 03
			29 01 00 00 00 00 02 F1 00
			29 01 00 00 00 00 02 F2 0B
			29 01 00 00 00 00 02 F3 00
			29 01 00 00 00 00 02 F4 0D
			29 01 00 00 00 00 02 F5 00
			29 01 00 00 00 00 02 F6 4A
			29 01 00 00 00 00 02 F7 00
			29 01 00 00 00 00 02 F8 71
			29 01 00 00 00 00 02 F9 00
			29 01 00 00 00 00 02 FA 8C
			29 01 00 00 00 00 02 FF 02
			29 01 00 00 00 00 02 FB 01
			29 01 00 00 00 00 02 00 00
			29 01 00 00 00 00 02 01 A1
			29 01 00 00 00 00 02 02 00
			29 01 00 00 00 00 02 03 B6
			29 01 00 00 00 00 02 04 00
			29 01 00 00 00 00 02 05 C9
			29 01 00 00 00 00 02 06 00
			29 01 00 00 00 00 02 07 FD
			29 01 00 00 00 00 02 08 01
			29 01 00 00 00 00 02 09 29
			29 01 00 00 00 00 02 0A 01
			29 01 00 00 00 00 02 0B 6B
			29 01 00 00 00 00 02 0C 01
			29 01 00 00 00 00 02 0D 9E
			29 01 00 00 00 00 02 0E 01
			29 01 00 00 00 00 02 0F EB
			29 01 00 00 00 00 02 10 02
			29 01 00 00 00 00 02 11 25
			29 01 00 00 00 00 02 12 02
			29 01 00 00 00 00 02 13 27
			29 01 00 00 00 00 02 14 02
			29 01 00 00 00 00 02 15 5C
			29 01 00 00 00 00 02 16 02
			29 01 00 00 00 00 02 17 95
			29 01 00 00 00 00 02 18 02
			29 01 00 00 00 00 02 19 BA
			29 01 00 00 00 00 02 1A 02
			29 01 00 00 00 00 02 1B EC
			29 01 00 00 00 00 02 1C 03
			29 01 00 00 00 00 02 1D 0C
			29 01 00 00 00 00 02 1E 03
			29 01 00 00 00 00 02 1F 34
			29 01 00 00 00 00 02 20 03
			29 01 00 00 00 00 02 21 3F
			29 01 00 00 00 00 02 22 03
			29 01 00 00 00 00 02 23 48
			29 01 00 00 00 00 02 24 03
			29 01 00 00 00 00 02 25 49
			29 01 00 00 00 00 02 26 03
			29 01 00 00 00 00 02 27 6B
			29 01 00 00 00 00 02 28 03
			29 01 00 00 00 00 02 29 7E
			29 01 00 00 00 00 02 2A 03
			29 01 00 00 00 00 02 2B 8F
			29 01 00 00 00 00 02 2D 03
			29 01 00 00 00 00 02 2F 9E
			29 01 00 00 00 00 02 30 03
			29 01 00 00 00 00 02 31 A0
			29 01 00 00 00 00 02 32 00
			29 01 00 00 00 00 02 33 03
			29 01 00 00 00 00 02 34 00
			29 01 00 00 00 00 02 35 0B
			29 01 00 00 00 00 02 36 00
			29 01 00 00 00 00 02 37 0D
			29 01 00 00 00 00 02 38 00
			29 01 00 00 00 00 02 39 4A
			29 01 00 00 00 00 02 3A 00
			29 01 00 00 00 00 02 3B 71
			29 01 00 00 00 00 02 3D 00
			29 01 00 00 00 00 02 3F 8C
			29 01 00 00 00 00 02 40 00
			29 01 00 00 00 00 02 41 A1
			29 01 00 00 00 00 02 42 00
			29 01 00 00 00 00 02 43 B6
			29 01 00 00 00 00 02 44 00
			29 01 00 00 00 00 02 45 C9
			29 01 00 00 00 00 02 46 00
			29 01 00 00 00 00 02 47 FD
			29 01 00 00 00 00 02 48 01
			29 01 00 00 00 00 02 49 29
			29 01 00 00 00 00 02 4A 01
			29 01 00 00 00 00 02 4B 6B
			29 01 00 00 00 00 02 4C 01
			29 01 00 00 00 00 02 4D 9E
			29 01 00 00 00 00 02 4E 01
			29 01 00 00 00 00 02 4F EB
			29 01 00 00 00 00 02 50 02
			29 01 00 00 00 00 02 51 25
			29 01 00 00 00 00 02 52 02
			29 01 00 00 00 00 02 53 27
			29 01 00 00 00 00 02 54 02
			29 01 00 00 00 00 02 55 5C
			29 01 00 00 00 00 02 56 02
			29 01 00 00 00 00 02 58 95
			29 01 00 00 00 00 02 59 02
			29 01 00 00 00 00 02 5A BA
			29 01 00 00 00 00 02 5B 02
			29 01 00 00 00 00 02 5C EC
			29 01 00 00 00 00 02 5D 03
			29 01 00 00 00 00 02 5E 0C
			29 01 00 00 00 00 02 5F 03
			29 01 00 00 00 00 02 60 34
			29 01 00 00 00 00 02 61 03
			29 01 00 00 00 00 02 62 3F
			29 01 00 00 00 00 02 63 03
			29 01 00 00 00 00 02 64 48
			29 01 00 00 00 00 02 65 03
			29 01 00 00 00 00 02 66 49
			29 01 00 00 00 00 02 67 03
			29 01 00 00 00 00 02 68 6B
			29 01 00 00 00 00 02 69 03
			29 01 00 00 00 00 02 6A 7E
			29 01 00 00 00 00 02 6B 03
			29 01 00 00 00 00 02 6C 8F
			29 01 00 00 00 00 02 6D 03
			29 01 00 00 00 00 02 6E 9E
			29 01 00 00 00 00 02 6F 03
			29 01 00 00 00 00 02 70 A0
			29 01 00 00 00 00 02 71 00
			29 01 00 00 00 00 02 72 FB
			29 01 00 00 00 00 02 73 00
			29 01 00 00 00 00 02 74 FD
			29 01 00 00 00 00 02 75 01
			29 01 00 00 00 00 02 76 05
			29 01 00 00 00 00 02 77 01
			29 01 00 00 00 00 02 78 0D
			29 01 00 00 00 00 02 79 01
			29 01 00 00 00 00 02 7A 17
			29 01 00 00 00 00 02 7B 01
			29 01 00 00 00 00 02 7C 1F
			29 01 00 00 00 00 02 7D 01
			29 01 00 00 00 00 02 7E 28
			29 01 00 00 00 00 02 7F 01
			29 01 00 00 00 00 02 80 32
			29 01 00 00 00 00 02 81 01
			29 01 00 00 00 00 02 82 38
			29 01 00 00 00 00 02 83 01
			29 01 00 00 00 00 02 84 53
			29 01 00 00 00 00 02 85 01
			29 01 00 00 00 00 02 86 72
			29 01 00 00 00 00 02 87 01
			29 01 00 00 00 00 02 88 9B
			29 01 00 00 00 00 02 89 01
			29 01 00 00 00 00 02 8A C3
			29 01 00 00 00 00 02 8B 02
			29 01 00 00 00 00 02 8C 01
			29 01 00 00 00 00 02 8D 02
			29 01 00 00 00 00 02 8E 36
			29 01 00 00 00 00 02 8F 02
			29 01 00 00 00 00 02 90 37
			29 01 00 00 00 00 02 91 02
			29 01 00 00 00 00 02 92 69
			29 01 00 00 00 00 02 93 02
			29 01 00 00 00 00 02 94 A1
			29 01 00 00 00 00 02 95 02
			29 01 00 00 00 00 02 96 C8
			29 01 00 00 00 00 02 97 02
			29 01 00 00 00 00 02 98 FF
			29 01 00 00 00 00 02 99 03
			29 01 00 00 00 00 02 9A 26
			29 01 00 00 00 00 02 9B 03
			29 01 00 00 00 00 02 9C 69
			29 01 00 00 00 00 02 9D 03
			29 01 00 00 00 00 02 9E 88
			29 01 00 00 00 00 02 9F 03
			29 01 00 00 00 00 02 A0 F8
			29 01 00 00 00 00 02 A2 03
			29 01 00 00 00 00 02 A3 F9
			29 01 00 00 00 00 02 A4 03
			29 01 00 00 00 00 02 A5 FE
			29 01 00 00 00 00 02 A6 03
			29 01 00 00 00 00 02 A7 FE
			29 01 00 00 00 00 02 A9 03
			29 01 00 00 00 00 02 AA FE
			29 01 00 00 00 00 02 AB 03
			29 01 00 00 00 00 02 AC FE
			29 01 00 00 00 00 02 AD 03
			29 01 00 00 00 00 02 AE FE
			29 01 00 00 00 00 02 AF 00
			29 01 00 00 00 00 02 B0 FB
			29 01 00 00 00 00 02 B1 00
			29 01 00 00 00 00 02 B2 FD
			29 01 00 00 00 00 02 B3 01
			29 01 00 00 00 00 02 B4 05
			29 01 00 00 00 00 02 B5 01
			29 01 00 00 00 00 02 B6 0D
			29 01 00 00 00 00 02 B7 01
			29 01 00 00 00 00 02 B8 17
			29 01 00 00 00 00 02 B9 01
			29 01 00 00 00 00 02 BA 1F
			29 01 00 00 00 00 02 BB 01
			29 01 00 00 00 00 02 BC 28
			29 01 00 00 00 00 02 BD 01
			29 01 00 00 00 00 02 BE 32
			29 01 00 00 00 00 02 BF 01
			29 01 00 00 00 00 02 C0 38
			29 01 00 00 00 00 02 C1 01
			29 01 00 00 00 00 02 C2 53
			29 01 00 00 00 00 02 C3 01
			29 01 00 00 00 00 02 C4 72
			29 01 00 00 00 00 02 C5 01
			29 01 00 00 00 00 02 C6 9B
			29 01 00 00 00 00 02 C7 01
			29 01 00 00 00 00 02 C8 C3
			29 01 00 00 00 00 02 C9 02
			29 01 00 00 00 00 02 CA 01
			29 01 00 00 00 00 02 CB 02
			29 01 00 00 00 00 02 CC 36
			29 01 00 00 00 00 02 CD 02
			29 01 00 00 00 00 02 CE 37
			29 01 00 00 00 00 02 CF 02
			29 01 00 00 00 00 02 D0 69
			29 01 00 00 00 00 02 D1 02
			29 01 00 00 00 00 02 D2 A1
			29 01 00 00 00 00 02 D3 02
			29 01 00 00 00 00 02 D4 C8
			29 01 00 00 00 00 02 D5 02
			29 01 00 00 00 00 02 D6 FF
			29 01 00 00 00 00 02 D7 03
			29 01 00 00 00 00 02 D8 26
			29 01 00 00 00 00 02 D9 03
			29 01 00 00 00 00 02 DA 69
			29 01 00 00 00 00 02 DB 03
			29 01 00 00 00 00 02 DC 88
			29 01 00 00 00 00 02 DD 03
			29 01 00 00 00 00 02 DE F8
			29 01 00 00 00 00 02 DF 03
			29 01 00 00 00 00 02 E0 F9
			29 01 00 00 00 00 02 E1 03
			29 01 00 00 00 00 02 E2 FE
			29 01 00 00 00 00 02 E3 03
			29 01 00 00 00 00 02 E4 FE
			29 01 00 00 00 00 02 E5 03
			29 01 00 00 00 00 02 E6 FE
			29 01 00 00 00 00 02 E7 03
			29 01 00 00 00 00 02 E8 FE
			29 01 00 00 00 00 02 E9 03
			29 01 00 00 00 00 02 EA FE
			29 01 00 00 00 00 02 FF 01
			29 01 00 00 00 00 02 FB 01
			29 01 00 00 00 00 02 FF 02
			29 01 00 00 00 00 02 FB 01
			29 01 00 00 00 00 02 FF 04
			29 01 00 00 00 00 02 FB 01
			29 01 00 00 00 00 02 FF 00
			29 01 00 00 00 00 02 D3 14
			29 01 00 00 00 00 02 D4 14
			29 01 00 00 96 00 02 11 00
			29 01 00 00 00 00 02 FF 00
			29 01 00 00 00 00 02 35 00
			29 01 00 00 78 00 02 29 00];
		qcom,mdss-dsi-off-command = [05 01 00 00 32 00 02 28 00
					05 01 00 00 78 00 02 10 00];
		qcom,mdss-dsi-on-command-state = "dsi_lp_mode";
		qcom,mdss-dsi-off-command-state = "dsi_hs_mode";
		qcom,mdss-dsi-h-sync-pulse = <1>;
		qcom,mdss-dsi-traffic-mode = "burst_mode";
		qcom,mdss-dsi-bllp-eof-power-mode;
		qcom,mdss-dsi-bllp-power-mode;
		qcom,mdss-dsi-lane-0-state;
		qcom,mdss-dsi-lane-1-state;
		qcom,mdss-dsi-lane-2-state;
		qcom,mdss-dsi-lane-3-state;
		qcom,mdss-dsi-panel-timings = [f9 3d 34 00 58 4d 36 3f 53 03 04 00];
		qcom,mdss-dsi-t-clk-post = <0x1e>;
		qcom,mdss-dsi-t-clk-pre = <0x38>;
		qcom,mdss-dsi-bl-min-level = <1>;
		qcom,mdss-dsi-bl-max-level = <4095>;
		qcom,mdss-dsi-dma-trigger = "trigger_sw";
		qcom,mdss-dsi-mdp-trigger = "none";
		qcom,mdss-dsi-bl-pmic-control-type = "bl_ctrl_wled";
		qcom,mdss-dsi-reset-sequence = <1 20>, <0 1>, <1 20>;

	};
};
