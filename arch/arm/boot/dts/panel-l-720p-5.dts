/ {
	host1x {
		dsi {
			panel-l-720p-5 {
				compatible = "lg,720p-5";
				nvidia,n-data-lanes = <4>;
				nvidia,pixel-format = <3>;
				nvidia,refresh-rate = <60>;
				nvidia,video-data-type = <0>;
				nvidia,video-clock-mode = <0>;
				nvidia,video-burst-mode = <1>;
				nvidia,controller-vs = <1>;
				nvidia,virtual-channel = <0>;
				nvidia,panel-reset = <1>;
				nvidia,power-saving-suspend = <1>;
				nvidia,dsi-init-cmd = <0x0 0x29 0x6 0x0 0x0 0xe0 0x43 0x0 0x80 0x0 0x0 0x0 0x0>,
							<0x0 0x29 0x6 0x0 0x0 0xb5 0x34 0x20 0x40 0x0 0x20 0x0 0x0>,
							<0x0 0x29 0x6 0x0 0x0 0xb6 0x04 0x74 0x0f 0x16 0x13 0x0 0x0>,
							<0x0 0x29 0x3 0x0 0x0 0xc0 0x01 0x08 0x0 0x0>,
							<0x0 0x23 0xc1 0x0 0x0>,
							<0x0 0x29 0xa 0x0 0x0 0xc3 0x0 0x09 0x10 0x02 0x0 0x66 0x20 0x13 0x0 0x0 0x0>,
							<0x0 0x29 0x6 0x0 0x0 0xc4 0x23 0x24 0x17 0x17 0x59 0x0 0x0>,
							<0x0 0x29 0xa 0x0 0x0 0xd0 0x21 0x13 0x67 0x37 0x0c 0x06 0x62 0x23 0x03 0x0 0x0>,
							<0x0 0x29 0xa 0x0 0x0 0xd1 0x32 0x13 0x66 0x37 0x02 0x06 0x62 0x23 0x03 0x0 0x0>,
							<0x0 0x29 0xa 0x0 0x0 0xd2 0x41 0x14 0x56 0x37 0x0c 0x06 0x62 0x23 0x03 0x0 0x0>,
							<0x0 0x29 0xa 0x0 0x0 0xd3 0x52 0x14 0x55 0x37 0x02 0x06 0x62 0x23 0x03 0x0 0x0>,
							<0x0 0x29 0xa 0x0 0x0 0xd4 0x41 0x14 0x56 0x37 0x0c 0x06 0x62 0x23 0x03 0x0 0x0>,
							<0x0 0x29 0xa 0x0 0x0 0xd5 0x52 0x14 0x55 0x37 0x02 0x06 0x62 0x23 0x03 0x0 0x0>,
							<0x0 0x15 0x36 0x8 0x0>,
							<0x0 0x23 0xf9 0x0 0x0>,
							<0x0 0x23 0x70 0x0 0x0>,
							<0x0 0x29 0x5 0x0 0x0 0x71 0x0 0x0 0x01 0x01 0x0 0x0>,
							<0x0 0x29 0x3 0x0 0x0 0x72 0x01 0x0e 0x0 0x0>,
							<0x0 0x29 0x4 0x0 0x0 0x73 0x34 0x52 0x0 0x0 0x0>,
							<0x0 0x29 0x4 0x0 0x0 0x74 0x05 0x0 0x06 0x0 0x0>,
							<0x0 0x29 0x4 0x0 0x0 0x75 0x03 0x0 0x07 0x0 0x0>,
							<0x0 0x29 0x4 0x0 0x0 0x76 0x07 0x0 0x06 0x0 0x0>,
							<0x0 0x29 0x9 0x0 0x0 0x77 0x3f 0x3f 0x3f 0x3f 0x3f 0x3f 0x3f 0x3f 0x0 0x0>,
							<0x0 0x29 0x9 0x0 0x0 0x78 0x40 0x40 0x40 0x40 0x40 0x40 0x40 0x40 0x0 0x0>,
							<0x0 0x29 0x9 0x0 0x0 0x79 0x40 0x40 0x40 0x40 0x40 0x40 0x40 0x40 0x0 0x0>,
							<0x0 0x29 0x9 0x0 0x0 0x7a 0x0 0x0 0x0 0x0 0x0 0x0 0x0 0x0 0x0 0x0>,
							<0x0 0x29 0x9 0x0 0x0 0x7b 0x0 0x0 0x0 0x0 0x0 0x0 0x0 0x0 0x0 0x0>,
							<0x0 0x29 0x9 0x0 0x0 0x7c 0x0 0x0 0x0 0x0 0x0 0x0 0x0 0x0 0x0 0x0>,
							<0x0 0x23 0xc2 0x2 0x0>,
							<1 20>,
							<0x0 0x23 0xc2 0x6 0x0>,
							<1 20>,
							<0x0 0x23 0xc2 0x4e 0x0>,
							<1 100>,
							<0x0 0x5 0x11 0x0 0x0>,
							<1 20>,
							<0x0 0x23 0xf9 0x80 0x0>,
							<1 20>,
							<0x0 0x5 0x29 0x0 0x0>;
				nvidia,n-init-cmd = <39>;
				status = "disabled";
			};
		};
	};
};
