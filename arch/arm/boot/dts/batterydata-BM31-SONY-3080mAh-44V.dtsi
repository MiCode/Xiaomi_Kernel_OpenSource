/* Copyright (c) 2013, The Linux Foundation. All rights reserved.
 * Copyright (C) 2015 XiaoMi, Inc.
 *
 * This program is free software; you can redistribute it and/or modify
 * it under the terms of the GNU General Public License version 2 and
 * only version 2 as published by the Free Software Foundation.
 *
 * This program is distributed in the hope that it will be useful,
 * but WITHOUT ANY WARRANTY; without even the implied warranty of
 * MERCHANTABILITY or FITNESS FOR A PARTICULAR PURPOSE.  See the
 * GNU General Public License for more details.
 */

qcom,BM31-SONY-3080mAh-44V-data {
	qcom,fcc-mah = <3000>;
	qcom,default-rbatt-mohm = <148>;
	qcom,rbatt-capacitive-mohm = <0>;
	qcom,flat-ocv-threshold-uv = <3800000>;
	qcom,max-voltage-uv = <4400000>;
	qcom,v-cutoff-uv = <3400000>;
	qcom,chg-term-ua = <200000>;
	qcom,batt-id-kohm = <9>;
	xiaomi,batt-version = <5>;

	qcom,rbatt-sf-lut {
		qcom,lut-col-legend = <(-20) (-10) 0 10 20 25 35 40 45 60>;
		qcom,lut-row-legend = <100 95 90 85 80>,
				<75 70 65 60 55>,
				<50 45 40 35 30>,
				<25 20 16 13 11>,
				<10 9 8 7 6>,
				<5 4 3 2 1>;
		qcom,lut-data = <1111 443 236 150 111 100 88 84 82 200>,
				<1111 443 236 150 111 100 88 84 82 200>,
				<1112 441 249 161 119 107 93 88 85 200>,
				<1128 439 251 169 126 114 99 92 88 200>,
				<1168 446 238 177 132 120 104 96 91 200>,
				<1201 454 236 180 140 126 108 100 96 200>,
				<1222 457 241 164 145 132 109 105 99 200>,
				<1246 462 247 157 136 130 111 109 105 200>,
				<1274 468 251 157 120 114 99 101 96 200>,
				<1302 477 255 159 116 105 114 91 88 200>,
				<1334 487 260 162 119 106 95 89 86 200>,
				<1384 498 266 167 123 110 92 91 88 200>,
				<1446 509 273 171 126 114 95 95 92 200>,
				<1528 508 278 175 131 118 99 97 94 200>,
				<1677 539 282 180 131 118 101 95 91 200>,
				<1951 592 287 182 128 115 99 93 89 200>,
				<2333 666 284 180 126 112 95 92 89 200>,
				<2714 744 291 172 124 110 94 91 88 200>,
				<3105 820 312 170 122 108 94 89 86 200>,
				<3448 874 336 178 124 111 91 91 89 200>,
				<3585 901 349 184 127 113 93 92 90 200>,
				<3635 870 355 191 130 116 95 94 92 200>,
				<4157 859 344 192 132 119 97 96 93 200>,
				<5541 1009 359 197 135 120 99 97 95 200>,
				<8106 1370 391 201 134 118 101 95 91 200>,
				<13345 2436 444 203 131 115 98 93 89 200>,
				<25797 4873 582 216 135 118 98 95 91 200>,
				<51593 9746 1075 253 142 123 99 97 94 200>,
				<98205 19492 2150 335 156 131 105 101 99 200>,
				<151211 38984 4300 670 196 161 122 118 118 200>;
	};

	qcom,fcc-temp-lut {
		qcom,lut-col-legend = <(-20) (-10) 0 10 20 25 35 40 45 60>;
		qcom,lut-data = <2962 2949 2939 2934 2932 2929 3322 2917 2911 2914>;
	};

	qcom,pc-temp-ocv-lut {
		qcom,lut-col-legend = <(-20) (-10) 0 10 20 25 35 40 45 60>;
		qcom,lut-row-legend = <100 95 90 85 80>,
				<75 70 65 60 55>,
				<50 45 40 35 30>,
				<25 20 16 13 11>,
				<10 9 8 7 6>,
				<5 4 3 2 1 0>;
		qcom,lut-data = <4384 4382 4380 4378 4376 4375 4372 4370 4368 4367>,
				<4282 4301 4308 4310 4310 4310 4300 4306 4306 4308>,
				<4203 4230 4248 4252 4252 4252 4234 4250 4248 4252>,
				<4134 4166 4186 4192 4194 4194 4170 4192 4192 4196>,
				<4068 4106 4119 4136 4138 4138 4109 4138 4137 4140>,
				<4005 4048 4060 4080 4084 4084 4072 4085 4085 4088>,
				<3942 3992 4006 4018 4032 4034 4056 4036 4036 4038>,
				<3890 3944 3958 3964 3978 3984 4042 3989 3990 3992>,
				<3846 3900 3915 3921 3926 3930 4020 3937 3938 3941>,
				<3811 3862 3878 3884 3886 3888 3963 3892 3893 3895>,
				<3783 3830 3846 3852 3855 3856 3904 3859 3860 3862>,
				<3760 3800 3819 3826 3829 3830 3865 3833 3834 3835>,
				<3741 3774 3796 3803 3807 3808 3835 3812 3812 3812>,
				<3722 3743 3776 3783 3788 3789 3810 3792 3792 3791>,
				<3704 3723 3758 3766 3770 3771 3788 3770 3768 3763>,
				<3686 3707 3742 3750 3750 3750 3764 3746 3743 3734>,
				<3668 3691 3716 3726 3728 3726 3737 3720 3718 3708>,
				<3649 3678 3692 3701 3702 3702 3714 3696 3693 3683>,
				<3630 3666 3676 3682 3683 3682 3690 3677 3674 3665>,
				<3616 3656 3666 3672 3674 3674 3677 3670 3668 3660>,
				<3608 3648 3661 3667 3670 3672 3674 3668 3666 3657>,
				<3598 3640 3654 3662 3666 3668 3672 3664 3662 3653>,
				<3586 3630 3646 3656 3662 3663 3668 3660 3658 3648>,
				<3570 3616 3634 3646 3652 3654 3662 3650 3648 3635>,
				<3548 3594 3615 3626 3630 3632 3650 3626 3624 3608>,
				<3517 3564 3582 3590 3592 3594 3619 3588 3584 3564>,
				<3472 3514 3531 3536 3540 3540 3568 3535 3532 3510>,
				<3404 3440 3460 3466 3476 3473 3504 3468 3466 3441>,
				<3307 3334 3364 3375 3386 3382 3409 3384 3378 3348>,
				<3178 3196 3226 3238 3252 3246 3272 3254 3246 3210>,
				<3000 3000 3000 3000 3000 3000 3000 3000 3000 3000>;
	};
};
