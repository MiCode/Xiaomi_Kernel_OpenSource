/* Copyright (c) 2012-2013, The Linux Foundation. All rights reserved.
 * Copyright (C) 2015 XiaoMi, Inc.
 *
 * This program is free software; you can redistribute it and/or modify
 * it under the terms of the GNU General Public License version 2 and
 * only version 2 as published by the Free Software Foundation.
 *
 * This program is distributed in the hope that it will be useful,
 * but WITHOUT ANY WARRANTY; without even the implied warranty of
 * MERCHANTABILITY or FITNESS FOR A PARTICULAR PURPOSE.  See the
 * GNU General Public License for more details.
 */

/*---------------------------------------------------------------------------
 * This file is autogenerated file using gcdb parser. Please do not edit it.
 * Update input XML file to add a new entry or update variable in this file
 * VERSION = "1.0"
 *---------------------------------------------------------------------------*/
&soc {
	dsi_jdi_nt_fhd_xcmd: qcom,mdss_dsi_jdi_nt_fhd_xcmd {
		compatible = "qcom,mdss-dsi-panel";
		status = "okay";
		qcom,mdss-dsi-panel-name = "jdi fhd cmd incell dsi panel";
		qcom,mdss-dsi-panel-id = <2>;
		qcom,mdss-dsi-panel-sleepwrmod = <0>;
		qcom,mdss-dsi-panel-controller = <&mdss_dsi0>;
		qcom,mdss-dsi-panel-type = "dsi_cmd_mode";
		qcom,mdss-dsi-panel-destination = "display_1";
		qcom,mdss-dsi-panel-framerate = <60>;
		qcom,mdss-dsi-virtual-channel-id = <0>;
		qcom,mdss-dsi-stream = <0>;
		qcom,mdss-dsi-panel-width = <1080>;
		qcom,mdss-dsi-panel-height = <1920>;
		qcom,mdss-dsi-h-front-porch = <80>;
		qcom,mdss-dsi-h-back-porch = <40>;
		qcom,mdss-dsi-h-pulse-width = <10>;
		qcom,mdss-dsi-h-sync-skew = <0>;
		qcom,mdss-dsi-v-back-porch = <4>;
		qcom,mdss-dsi-v-front-porch = <4>;
		qcom,mdss-dsi-v-pulse-width = <2>;
		qcom,mdss-dsi-h-left-border = <0>;
		qcom,mdss-dsi-h-right-border = <0>;
		qcom,mdss-dsi-v-top-border = <0>;
		qcom,mdss-dsi-v-bottom-border = <0>;
		qcom,mdss-dsi-bpp = <24>;
		qcom,mdss-dsi-color-order = <0>;
		qcom,mdss-dsi-underflow-color = <0xff>;
		qcom,mdss-dsi-border-color = <0>;
		qcom,mdss-dsi-on-command = [
				15 00 00 00 00 00 02 FF 10
				15 00 00 00 00 00 02 35 00
				39 00 00 00 00 00 03 44 03 e8
				39 00 00 00 00 00 05 2A 00 00 04 37
				39 00 00 00 00 00 05 2B 00 00 07 7F

				15 00 00 00 00 00 02 FF 23
				15 00 00 00 00 00 02 FB 01
				15 00 00 00 00 00 02 13 FF
				15 00 00 00 00 00 02 14 F8
				15 00 00 00 00 00 02 15 F3
				15 00 00 00 00 00 02 16 EB

				15 00 00 00 00 00 02 17 FF
				15 00 00 00 00 00 02 18 FB
				15 00 00 00 00 00 02 19 F4
				15 00 00 00 00 00 02 1A EE
				15 00 00 00 00 00 02 1B DD
				15 00 00 00 00 00 02 1C C0
				15 00 00 00 00 00 02 1D C0
				15 00 00 00 00 00 02 1E A4
				15 00 00 00 00 00 02 1F 9B
				15 00 00 00 00 00 02 20 95

				15 00 00 00 00 00 02 39 01
				15 00 00 00 00 00 02 3B 4C
				15 00 00 00 00 00 02 FF 10
				15 00 00 00 00 00 02 FB 01

				15 01 00 00 00 00 02 FF E0
				15 00 00 00 00 00 02 B5 86
				15 00 00 00 00 00 02 B6 77
				15 00 00 00 00 00 02 B8 AD
				15 00 00 00 00 00 02 FB 01
				15 01 00 00 00 00 02 FF 10

				15 00 00 00 00 00 02 51 de
				15 00 00 00 00 00 02 53 2c
				15 01 00 00 00 00 02 55 00
				05 01 00 00 78 00 02 11 00
				05 01 00 00 14 00 02 29 00];
		qcom,mdss-dsi-off-command = [
				15 01 00 00 00 00 02 FF 10
				05 01 00 00 02 00 02 28 00
				05 01 00 00 78 00 02 10 00];
		qcom,mdss-dsi-on-command-state = "dsi_lp_mode";
		qcom,mdss-dsi-off-command-state = "dsi_hs_mode";
		qcom,mdss-dsi-h-sync-pulse = <0>;
		qcom,mdss-dsi-traffic-mode = <1>;
		qcom,mdss-dsi-lane-map = <0>;
		qcom,mdss-dsi-bllp-eof-power-mode;
		qcom,mdss-dsi-bllp-power-mode;
		qcom,mdss-dsi-lane-0-state;
		qcom,mdss-dsi-lane-1-state;
		qcom,mdss-dsi-lane-2-state;
		qcom,mdss-dsi-lane-3-state;
		qcom,mdss-dsi-te-pin-select = <1>;
		qcom,mdss-dsi-te-v-sync-rd-ptr-irq-line = <0x2c>;
		qcom,mdss-dsi-te-v-sync-continues-lines = <0x3c>;
		qcom,mdss-dsi-te-dcs-command = <1>;
		qcom,mdss-dsi-te-check-enable;
		qcom,mdss-dsi-te-using-te-pin;
		qcom,mdss-dsi-panel-timings = [e3 50 36 00 a9 a3 3a 50 3d 03 04 00];
		qcom,mdss-dsi-t-clk-post = <0x20>;
		qcom,mdss-dsi-t-clk-pre = <0x36>;
		qcom,mdss-dsi-bl-min-level = <8>;
		qcom,mdss-dsi-bl-max-level = <4095>;
		qcom,mdss-dsi-dma-trigger = <0x04>;
		qcom,mdss-dsi-mdp-trigger = <0x0>;
		qcom,mdss-dsi-bl-pmic-control-type = "bl_ctrl_wled";
		qcom,mdss-dsi-reset-sequence = <1 10>, <0 1>, <1 10>;
		qcom,mdss-pan-physical-width-dimension = <71>;
		qcom,mdss-pan-physical-height-dimension = <126>;
		qcom,dispparam-enabled;
		qcom,mdss-dsi-dispparam-ceon-command = [
			15 00 00 00 01 00 02 FF 10
			15 01 00 00 10 00 02 55 80
			];
		qcom,mdss-dsi-dispparam-ceon-command-state = "dsi_hs_mode";
		qcom,mdss-dsi-dispparam-ceoff-command = [
			15 00 00 00 01 00 02 FF 10
			15 01 00 00 10 00 02 55 00
			];
		qcom,mdss-dsi-dispparam-ceoff-command-state = "dsi_hs_mode";
		qcom,mdss-dsi-dispparam-cabcon-command = [
			15 00 00 00 01 00 02 FF 10
			15 00 00 00 01 00 02 51 DE
			15 00 00 00 01 00 02 53 2C
			15 01 00 00 01 00 02 55 02
			];
		qcom,mdss-dsi-dispparam-cabcguion-command = [
			15 00 00 00 01 00 02 FF 10
			15 01 00 00 01 00 02 55 01
			];
		qcom,mdss-dsi-dispparam-cabcstillon-command = [
			15 00 00 00 01 00 02 FF 10
			15 01 00 00 01 00 02 55 02
			];
		qcom,mdss-dsi-dispparam-cabcmovieon-command = [
			15 00 00 00 01 00 02 FF 10
			15 01 00 00 01 00 02 55 03
			];
		qcom,mdss-dsi-dispparam-cabcon-command-state = "dsi_hs_mode";
		qcom,mdss-dsi-dispparam-cabcoff-command = [
			15 00 00 00 01 00 02 FF 10
			15 01 00 00 01 00 02 55 00
			];
		qcom,mdss-dsi-dispparam-cabcoff-command-state = "dsi_hs_mode";
		qcom,mdss-dsi-dispparam-warm-command = [
			15 01 00 00 01 00 02 FF 20
			15 00 00 00 01 00 02 FB 01
			15 00 00 00 01 00 02 75 00
			15 00 00 00 01 00 02 76 00
			15 00 00 00 01 00 02 77 00
			15 00 00 00 01 00 02 78 19
			15 00 00 00 01 00 02 79 00
			15 00 00 00 01 00 02 7A 46
			15 00 00 00 01 00 02 7B 00
			15 00 00 00 01 00 02 7C 6A
			15 00 00 00 01 00 02 7D 00
			15 00 00 00 01 00 02 7E 86
			15 00 00 00 01 00 02 7F 00
			15 00 00 00 01 00 02 80 9F
			15 00 00 00 01 00 02 81 00
			15 00 00 00 01 00 02 82 B6
			15 00 00 00 01 00 02 83 00
			15 00 00 00 01 00 02 84 CB
			15 00 00 00 01 00 02 85 00
			15 00 00 00 01 00 02 86 DE
			15 00 00 00 01 00 02 87 01
			15 00 00 00 01 00 02 88 1B
			15 00 00 00 01 00 02 89 01
			15 00 00 00 01 00 02 8A 49
			15 00 00 00 01 00 02 8B 01
			15 00 00 00 01 00 02 8C 8E
			15 00 00 00 01 00 02 8D 01
			15 00 00 00 01 00 02 8E C3
			15 00 00 00 01 00 02 8F 02
			15 00 00 00 01 00 02 90 12
			15 00 00 00 01 00 02 91 02
			15 00 00 00 01 00 02 92 50
			15 00 00 00 01 00 02 93 02
			15 00 00 00 01 00 02 94 52
			15 00 00 00 01 00 02 95 02
			15 00 00 00 01 00 02 96 8C
			15 00 00 00 01 00 02 97 02
			15 00 00 00 01 00 02 98 CD
			15 00 00 00 01 00 02 99 02
			15 00 00 00 01 00 02 9A F3
			15 00 00 00 01 00 02 9B 03
			15 00 00 00 01 00 02 9C 23
			15 00 00 00 01 00 02 9D 03
			15 00 00 00 01 00 02 9E 44
			15 00 00 00 01 00 02 9F 03
			15 00 00 00 01 00 02 A0 71
			15 00 00 00 01 00 02 A2 03
			15 00 00 00 01 00 02 A3 7F
			15 00 00 00 01 00 02 A4 03
			15 00 00 00 01 00 02 A5 8E
			15 00 00 00 01 00 02 A6 03
			15 00 00 00 01 00 02 A7 9F
			15 00 00 00 01 00 02 A9 03
			15 00 00 00 01 00 02 AA B1
			15 00 00 00 01 00 02 AB 03
			15 00 00 00 01 00 02 AC C5
			15 00 00 00 01 00 02 AD 03
			15 00 00 00 01 00 02 AE DB
			15 00 00 00 01 00 02 AF 03
			15 00 00 00 01 00 02 B0 F3
			15 00 00 00 01 00 02 B1 03
			15 00 00 00 01 00 02 B2 FF
			15 00 00 00 01 00 02 B3 00
			15 00 00 00 01 00 02 B4 00
			15 00 00 00 01 00 02 B5 00
			15 00 00 00 01 00 02 B6 19
			15 00 00 00 01 00 02 B7 00
			15 00 00 00 01 00 02 B8 46
			15 00 00 00 01 00 02 B9 00
			15 00 00 00 01 00 02 BA 6A
			15 00 00 00 01 00 02 BB 00
			15 00 00 00 01 00 02 BC 86
			15 00 00 00 01 00 02 BD 00
			15 00 00 00 01 00 02 BE 9F
			15 00 00 00 01 00 02 BF 00
			15 00 00 00 01 00 02 C0 B6
			15 00 00 00 01 00 02 C1 00
			15 00 00 00 01 00 02 C2 CB
			15 00 00 00 01 00 02 C3 00
			15 00 00 00 01 00 02 C4 DE
			15 00 00 00 01 00 02 C5 01
			15 00 00 00 01 00 02 C6 1B
			15 00 00 00 01 00 02 C7 01
			15 00 00 00 01 00 02 C8 49
			15 00 00 00 01 00 02 C9 01
			15 00 00 00 01 00 02 CA 8E
			15 00 00 00 01 00 02 CB 01
			15 00 00 00 01 00 02 CC C3
			15 00 00 00 01 00 02 CD 02
			15 00 00 00 01 00 02 CE 12
			15 00 00 00 01 00 02 CF 02
			15 00 00 00 01 00 02 D0 50
			15 00 00 00 01 00 02 D1 02
			15 00 00 00 01 00 02 D2 52
			15 00 00 00 01 00 02 D3 02
			15 00 00 00 01 00 02 D4 8C
			15 00 00 00 01 00 02 D5 02
			15 00 00 00 01 00 02 D6 CD
			15 00 00 00 01 00 02 D7 02
			15 00 00 00 01 00 02 D8 F3
			15 00 00 00 01 00 02 D9 03
			15 00 00 00 01 00 02 DA 23
			15 00 00 00 01 00 02 DB 03
			15 00 00 00 01 00 02 DC 44
			15 00 00 00 01 00 02 DD 03
			15 00 00 00 01 00 02 DE 71
			15 00 00 00 01 00 02 DF 03
			15 00 00 00 01 00 02 E0 7F
			15 00 00 00 01 00 02 E1 03
			15 00 00 00 01 00 02 E2 8E
			15 00 00 00 01 00 02 E3 03
			15 00 00 00 01 00 02 E4 9F
			15 00 00 00 01 00 02 E5 03
			15 00 00 00 01 00 02 E6 B1
			15 00 00 00 01 00 02 E7 03
			15 00 00 00 01 00 02 E8 C5
			15 00 00 00 01 00 02 E9 03
			15 00 00 00 01 00 02 EA DB
			15 00 00 00 01 00 02 EB 03
			15 00 00 00 01 00 02 EC F3
			15 00 00 00 01 00 02 ED 03
			15 00 00 00 01 00 02 EE FF
			15 00 00 00 01 00 02 EF 00
			15 00 00 00 01 00 02 F0 E9
			15 00 00 00 01 00 02 F1 00
			15 00 00 00 01 00 02 F2 F0
			15 00 00 00 01 00 02 F3 00
			15 00 00 00 01 00 02 F4 FF
			15 00 00 00 01 00 02 F5 01
			15 00 00 00 01 00 02 F6 0C
			15 00 00 00 01 00 02 F7 01
			15 00 00 00 01 00 02 F8 19
			15 00 00 00 01 00 02 F9 01
			15 00 00 00 01 00 02 FA 25
			15 00 00 00 01 00 02 FB 01
			15 00 00 00 01 00 02 FF 21
			15 00 00 00 01 00 02 00 01
			15 00 00 00 01 00 02 01 31
			15 00 00 00 01 00 02 02 01
			15 00 00 00 01 00 02 03 3B
			15 00 00 00 01 00 02 04 01
			15 00 00 00 01 00 02 05 45
			15 00 00 00 01 00 02 06 01
			15 00 00 00 01 00 02 07 6A
			15 00 00 00 01 00 02 08 01
			15 00 00 00 01 00 02 09 88
			15 00 00 00 01 00 02 0A 01
			15 00 00 00 01 00 02 0B BA
			15 00 00 00 01 00 02 0C 01
			15 00 00 00 01 00 02 0D E3
			15 00 00 00 01 00 02 0E 02
			15 00 00 00 01 00 02 0F 26
			15 00 00 00 01 00 02 10 02
			15 00 00 00 01 00 02 11 5F
			15 00 00 00 01 00 02 12 02
			15 00 00 00 01 00 02 13 60
			15 00 00 00 01 00 02 14 02
			15 00 00 00 01 00 02 15 97
			15 00 00 00 01 00 02 16 02
			15 00 00 00 01 00 02 17 D6
			15 00 00 00 01 00 02 18 02
			15 00 00 00 01 00 02 19 FB
			15 00 00 00 01 00 02 1A 03
			15 00 00 00 01 00 02 1B 2B
			15 00 00 00 01 00 02 1C 03
			15 00 00 00 01 00 02 1D 4B
			15 00 00 00 01 00 02 1E 03
			15 00 00 00 01 00 02 1F 77
			15 00 00 00 01 00 02 20 03
			15 00 00 00 01 00 02 21 85
			15 00 00 00 01 00 02 22 03
			15 00 00 00 01 00 02 23 93
			15 00 00 00 01 00 02 24 03
			15 00 00 00 01 00 02 25 A3
			15 00 00 00 01 00 02 26 03
			15 00 00 00 01 00 02 27 B5
			15 00 00 00 01 00 02 28 03
			15 00 00 00 01 00 02 29 C8
			15 00 00 00 01 00 02 2A 03
			15 00 00 00 01 00 02 2B DD
			15 00 00 00 01 00 02 2D 03
			15 00 00 00 01 00 02 2F F3
			15 00 00 00 01 00 02 30 03
			15 00 00 00 01 00 02 31 FF
			15 00 00 00 01 00 02 32 00
			15 00 00 00 01 00 02 33 E9
			15 00 00 00 01 00 02 34 00
			15 00 00 00 01 00 02 35 F0
			15 00 00 00 01 00 02 36 00
			15 00 00 00 01 00 02 37 FF
			15 00 00 00 01 00 02 38 01
			15 00 00 00 01 00 02 39 0C
			15 00 00 00 01 00 02 3A 01
			15 00 00 00 01 00 02 3B 19
			15 00 00 00 01 00 02 3D 01
			15 00 00 00 01 00 02 3F 25
			15 00 00 00 01 00 02 40 01
			15 00 00 00 01 00 02 41 31
			15 00 00 00 01 00 02 42 01
			15 00 00 00 01 00 02 43 3B
			15 00 00 00 01 00 02 44 01
			15 00 00 00 01 00 02 45 45
			15 00 00 00 01 00 02 46 01
			15 00 00 00 01 00 02 47 6A
			15 00 00 00 01 00 02 48 01
			15 00 00 00 01 00 02 49 88
			15 00 00 00 01 00 02 4A 01
			15 00 00 00 01 00 02 4B BA
			15 00 00 00 01 00 02 4C 01
			15 00 00 00 01 00 02 4D E3
			15 00 00 00 01 00 02 4E 02
			15 00 00 00 01 00 02 4F 26
			15 00 00 00 01 00 02 50 02
			15 00 00 00 01 00 02 51 5F
			15 00 00 00 01 00 02 52 02
			15 00 00 00 01 00 02 53 60
			15 00 00 00 01 00 02 54 02
			15 00 00 00 01 00 02 55 97
			15 00 00 00 01 00 02 56 02
			15 00 00 00 01 00 02 58 D6
			15 00 00 00 01 00 02 59 02
			15 00 00 00 01 00 02 5A FB
			15 00 00 00 01 00 02 5B 03
			15 00 00 00 01 00 02 5C 2B
			15 00 00 00 01 00 02 5D 03
			15 00 00 00 01 00 02 5E 4B
			15 00 00 00 01 00 02 5F 03
			15 00 00 00 01 00 02 60 77
			15 00 00 00 01 00 02 61 03
			15 00 00 00 01 00 02 62 85
			15 00 00 00 01 00 02 63 03
			15 00 00 00 01 00 02 64 93
			15 00 00 00 01 00 02 65 03
			15 00 00 00 01 00 02 66 A3
			15 00 00 00 01 00 02 67 03
			15 00 00 00 01 00 02 68 B5
			15 00 00 00 01 00 02 69 03
			15 00 00 00 01 00 02 6A C8
			15 00 00 00 01 00 02 6B 03
			15 00 00 00 01 00 02 6C DD
			15 00 00 00 01 00 02 6D 03
			15 00 00 00 01 00 02 6E F3
			15 00 00 00 01 00 02 6F 03
			15 00 00 00 01 00 02 70 FF
			15 00 00 00 01 00 02 71 01
			15 00 00 00 01 00 02 72 18
			15 00 00 00 01 00 02 73 01
			15 00 00 00 01 00 02 74 1E
			15 00 00 00 01 00 02 75 01
			15 00 00 00 01 00 02 76 2A
			15 00 00 00 01 00 02 77 01
			15 00 00 00 01 00 02 78 35
			15 00 00 00 01 00 02 79 01
			15 00 00 00 01 00 02 7A 40
			15 00 00 00 01 00 02 7B 01
			15 00 00 00 01 00 02 7C 4A
			15 00 00 00 01 00 02 7D 01
			15 00 00 00 01 00 02 7E 54
			15 00 00 00 01 00 02 7F 01
			15 00 00 00 01 00 02 80 5D
			15 00 00 00 01 00 02 81 01
			15 00 00 00 01 00 02 82 66
			15 00 00 00 01 00 02 83 01
			15 00 00 00 01 00 02 84 85
			15 00 00 00 01 00 02 85 01
			15 00 00 00 01 00 02 86 A0
			15 00 00 00 01 00 02 87 01
			15 00 00 00 01 00 02 88 CD
			15 00 00 00 01 00 02 89 01
			15 00 00 00 01 00 02 8A F2
			15 00 00 00 01 00 02 8B 02
			15 00 00 00 01 00 02 8C 30
			15 00 00 00 01 00 02 8D 02
			15 00 00 00 01 00 02 8E 66
			15 00 00 00 01 00 02 8F 02
			15 00 00 00 01 00 02 90 68
			15 00 00 00 01 00 02 91 02
			15 00 00 00 01 00 02 92 9C
			15 00 00 00 01 00 02 93 02
			15 00 00 00 01 00 02 94 DA
			15 00 00 00 01 00 02 95 02
			15 00 00 00 01 00 02 96 FF
			15 00 00 00 01 00 02 97 03
			15 00 00 00 01 00 02 98 2D
			15 00 00 00 01 00 02 99 03
			15 00 00 00 01 00 02 9A 4C
			15 00 00 00 01 00 02 9B 03
			15 00 00 00 01 00 02 9C 77
			15 00 00 00 01 00 02 9D 03
			15 00 00 00 01 00 02 9E 84
			15 00 00 00 01 00 02 9F 03
			15 00 00 00 01 00 02 A0 92
			15 00 00 00 01 00 02 A2 03
			15 00 00 00 01 00 02 A3 A2
			15 00 00 00 01 00 02 A4 03
			15 00 00 00 01 00 02 A5 B4
			15 00 00 00 01 00 02 A6 03
			15 00 00 00 01 00 02 A7 C7
			15 00 00 00 01 00 02 A9 03
			15 00 00 00 01 00 02 AA DC
			15 00 00 00 01 00 02 AB 03
			15 00 00 00 01 00 02 AC F3
			15 00 00 00 01 00 02 AD 03
			15 00 00 00 01 00 02 AE FF
			15 00 00 00 01 00 02 AF 01
			15 00 00 00 01 00 02 B0 18
			15 00 00 00 01 00 02 B1 01
			15 00 00 00 01 00 02 B2 1E
			15 00 00 00 01 00 02 B3 01
			15 00 00 00 01 00 02 B4 2A
			15 00 00 00 01 00 02 B5 01
			15 00 00 00 01 00 02 B6 35
			15 00 00 00 01 00 02 B7 01
			15 00 00 00 01 00 02 B8 40
			15 00 00 00 01 00 02 B9 01
			15 00 00 00 01 00 02 BA 4A
			15 00 00 00 01 00 02 BB 01
			15 00 00 00 01 00 02 BC 54
			15 00 00 00 01 00 02 BD 01
			15 00 00 00 01 00 02 BE 5D
			15 00 00 00 01 00 02 BF 01
			15 00 00 00 01 00 02 C0 66
			15 00 00 00 01 00 02 C1 01
			15 00 00 00 01 00 02 C2 85
			15 00 00 00 01 00 02 C3 01
			15 00 00 00 01 00 02 C4 A0
			15 00 00 00 01 00 02 C5 01
			15 00 00 00 01 00 02 C6 CD
			15 00 00 00 01 00 02 C7 01
			15 00 00 00 01 00 02 C8 F2
			15 00 00 00 01 00 02 C9 02
			15 00 00 00 01 00 02 CA 30
			15 00 00 00 01 00 02 CB 02
			15 00 00 00 01 00 02 CC 66
			15 00 00 00 01 00 02 CD 02
			15 00 00 00 01 00 02 CE 68
			15 00 00 00 01 00 02 CF 02
			15 00 00 00 01 00 02 D0 9C
			15 00 00 00 01 00 02 D1 02
			15 00 00 00 01 00 02 D2 DA
			15 00 00 00 01 00 02 D3 02
			15 00 00 00 01 00 02 D4 FF
			15 00 00 00 01 00 02 D5 03
			15 00 00 00 01 00 02 D6 2D
			15 00 00 00 01 00 02 D7 03
			15 00 00 00 01 00 02 D8 4C
			15 00 00 00 01 00 02 D9 03
			15 00 00 00 01 00 02 DA 77
			15 00 00 00 01 00 02 DB 03
			15 00 00 00 01 00 02 DC 84
			15 00 00 00 01 00 02 DD 03
			15 00 00 00 01 00 02 DE 92
			15 00 00 00 01 00 02 DF 03
			15 00 00 00 01 00 02 E0 A2
			15 00 00 00 01 00 02 E1 03
			15 00 00 00 01 00 02 E2 B4
			15 00 00 00 01 00 02 E3 03
			15 00 00 00 01 00 02 E4 C7
			15 00 00 00 01 00 02 E5 03
			15 00 00 00 01 00 02 E6 DC
			15 00 00 00 01 00 02 E7 03
			15 00 00 00 01 00 02 E8 F3
			15 00 00 00 01 00 02 E9 03
			15 00 00 00 01 00 02 EA FF
			15 00 00 00 01 00 02 FB 01
			15 01 00 00 01 00 02 FF 10
			];
		qcom,mdss-dsi-dispparam-warm-command-state = "dsi_hs_mode";

		qcom,mdss-dsi-dispparam-default-command = [
			15 00 00 00 01 00 02 FF 20
			15 00 00 00 01 00 02 75 00
			15 00 00 00 01 00 02 76 00
			15 00 00 00 01 00 02 77 00
			15 00 00 00 01 00 02 78 16
			15 00 00 00 01 00 02 79 00
			15 00 00 00 01 00 02 7A 41
			15 00 00 00 01 00 02 7B 00
			15 00 00 00 01 00 02 7C 65
			15 00 00 00 01 00 02 7D 00
			15 00 00 00 01 00 02 7E 83
			15 00 00 00 01 00 02 7F 00
			15 00 00 00 01 00 02 80 9D
			15 00 00 00 01 00 02 81 00
			15 00 00 00 01 00 02 82 B4
			15 00 00 00 01 00 02 83 00
			15 00 00 00 01 00 02 84 C9
			15 00 00 00 01 00 02 85 00
			15 00 00 00 01 00 02 86 DD
			15 00 00 00 01 00 02 87 01
			15 00 00 00 01 00 02 88 19
			15 00 00 00 01 00 02 89 01
			15 00 00 00 01 00 02 8A 48
			15 00 00 00 01 00 02 8B 01
			15 00 00 00 01 00 02 8C 8D
			15 00 00 00 01 00 02 8D 01
			15 00 00 00 01 00 02 8E C1
			15 00 00 00 01 00 02 8F 02
			15 00 00 00 01 00 02 90 11
			15 00 00 00 01 00 02 91 02
			15 00 00 00 01 00 02 92 50
			15 00 00 00 01 00 02 93 02
			15 00 00 00 01 00 02 94 52
			15 00 00 00 01 00 02 95 02
			15 00 00 00 01 00 02 96 8C
			15 00 00 00 01 00 02 97 02
			15 00 00 00 01 00 02 98 CE
			15 00 00 00 01 00 02 99 02
			15 00 00 00 01 00 02 9A F5
			15 00 00 00 01 00 02 9B 03
			15 00 00 00 01 00 02 9C 26
			15 00 00 00 01 00 02 9D 03
			15 00 00 00 01 00 02 9E 47
			15 00 00 00 01 00 02 9F 03
			15 00 00 00 01 00 02 A0 74
			15 00 00 00 01 00 02 A2 03
			15 00 00 00 01 00 02 A3 81
			15 00 00 00 01 00 02 A4 03
			15 00 00 00 01 00 02 A5 90
			15 00 00 00 01 00 02 A6 03
			15 00 00 00 01 00 02 A7 A1
			15 00 00 00 01 00 02 A9 03
			15 00 00 00 01 00 02 AA B2
			15 00 00 00 01 00 02 AB 03
			15 00 00 00 01 00 02 AC C6
			15 00 00 00 01 00 02 AD 03
			15 00 00 00 01 00 02 AE DC
			15 00 00 00 01 00 02 AF 03
			15 00 00 00 01 00 02 B0 F3
			15 00 00 00 01 00 02 B1 03
			15 00 00 00 01 00 02 B2 FF
			15 00 00 00 01 00 02 B3 00
			15 00 00 00 01 00 02 B4 00
			15 00 00 00 01 00 02 B5 00
			15 00 00 00 01 00 02 B6 16
			15 00 00 00 01 00 02 B7 00
			15 00 00 00 01 00 02 B8 41
			15 00 00 00 01 00 02 B9 00
			15 00 00 00 01 00 02 BA 65
			15 00 00 00 01 00 02 BB 00
			15 00 00 00 01 00 02 BC 83
			15 00 00 00 01 00 02 BD 00
			15 00 00 00 01 00 02 BE 9D
			15 00 00 00 01 00 02 BF 00
			15 00 00 00 01 00 02 C0 B4
			15 00 00 00 01 00 02 C1 00
			15 00 00 00 01 00 02 C2 C9
			15 00 00 00 01 00 02 C3 00
			15 00 00 00 01 00 02 C4 DD
			15 00 00 00 01 00 02 C5 01
			15 00 00 00 01 00 02 C6 19
			15 00 00 00 01 00 02 C7 01
			15 00 00 00 01 00 02 C8 48
			15 00 00 00 01 00 02 C9 01
			15 00 00 00 01 00 02 CA 8D
			15 00 00 00 01 00 02 CB 01
			15 00 00 00 01 00 02 CC C1
			15 00 00 00 01 00 02 CD 02
			15 00 00 00 01 00 02 CE 11
			15 00 00 00 01 00 02 CF 02
			15 00 00 00 01 00 02 D0 50
			15 00 00 00 01 00 02 D1 02
			15 00 00 00 01 00 02 D2 52
			15 00 00 00 01 00 02 D3 02
			15 00 00 00 01 00 02 D4 8C
			15 00 00 00 01 00 02 D5 02
			15 00 00 00 01 00 02 D6 CE
			15 00 00 00 01 00 02 D7 02
			15 00 00 00 01 00 02 D8 F5
			15 00 00 00 01 00 02 D9 03
			15 00 00 00 01 00 02 DA 26
			15 00 00 00 01 00 02 DB 03
			15 00 00 00 01 00 02 DC 47
			15 00 00 00 01 00 02 DD 03
			15 00 00 00 01 00 02 DE 74
			15 00 00 00 01 00 02 DF 03
			15 00 00 00 01 00 02 E0 81
			15 00 00 00 01 00 02 E1 03
			15 00 00 00 01 00 02 E2 90
			15 00 00 00 01 00 02 E3 03
			15 00 00 00 01 00 02 E4 A1
			15 00 00 00 01 00 02 E5 03
			15 00 00 00 01 00 02 E6 B2
			15 00 00 00 01 00 02 E7 03
			15 00 00 00 01 00 02 E8 C6
			15 00 00 00 01 00 02 E9 03
			15 00 00 00 01 00 02 EA DC
			15 00 00 00 01 00 02 EB 03
			15 00 00 00 01 00 02 EC F3
			15 00 00 00 01 00 02 ED 03
			15 00 00 00 01 00 02 EE FF
			15 00 00 00 01 00 02 EF 00
			15 00 00 00 01 00 02 F0 B0
			15 00 00 00 01 00 02 F1 00
			15 00 00 00 01 00 02 F2 BA
			15 00 00 00 01 00 02 F3 00
			15 00 00 00 01 00 02 F4 CE
			15 00 00 00 01 00 02 F5 00
			15 00 00 00 01 00 02 F6 E0
			15 00 00 00 01 00 02 F7 00
			15 00 00 00 01 00 02 F8 F0
			15 00 00 00 01 00 02 F9 00
			15 00 00 00 01 00 02 FA FF
			15 00 00 00 01 00 02 FB 01
			15 00 00 00 01 00 02 FF 21
			15 00 00 00 01 00 02 00 01
			15 00 00 00 01 00 02 01 0C
			15 00 00 00 01 00 02 02 01
			15 00 00 00 01 00 02 03 1A
			15 00 00 00 01 00 02 04 01
			15 00 00 00 01 00 02 05 27
			15 00 00 00 01 00 02 06 01
			15 00 00 00 01 00 02 07 51
			15 00 00 00 01 00 02 08 01
			15 00 00 00 01 00 02 09 74
			15 00 00 00 01 00 02 0A 01
			15 00 00 00 01 00 02 0B AC
			15 00 00 00 01 00 02 0C 01
			15 00 00 00 01 00 02 0D D8
			15 00 00 00 01 00 02 0E 02
			15 00 00 00 01 00 02 0F 1E
			15 00 00 00 01 00 02 10 02
			15 00 00 00 01 00 02 11 58
			15 00 00 00 01 00 02 12 02
			15 00 00 00 01 00 02 13 5A
			15 00 00 00 01 00 02 14 02
			15 00 00 00 01 00 02 15 92
			15 00 00 00 01 00 02 16 02
			15 00 00 00 01 00 02 17 D2
			15 00 00 00 01 00 02 18 02
			15 00 00 00 01 00 02 19 F9
			15 00 00 00 01 00 02 1A 03
			15 00 00 00 01 00 02 1B 29
			15 00 00 00 01 00 02 1C 03
			15 00 00 00 01 00 02 1D 49
			15 00 00 00 01 00 02 1E 03
			15 00 00 00 01 00 02 1F 75
			15 00 00 00 01 00 02 20 03
			15 00 00 00 01 00 02 21 83
			15 00 00 00 01 00 02 22 03
			15 00 00 00 01 00 02 23 91
			15 00 00 00 01 00 02 24 03
			15 00 00 00 01 00 02 25 A2
			15 00 00 00 01 00 02 26 03
			15 00 00 00 01 00 02 27 B3
			15 00 00 00 01 00 02 28 03
			15 00 00 00 01 00 02 29 C6
			15 00 00 00 01 00 02 2A 03
			15 00 00 00 01 00 02 2B DC
			15 00 00 00 01 00 02 2D 03
			15 00 00 00 01 00 02 2F F3
			15 00 00 00 01 00 02 30 03
			15 00 00 00 01 00 02 31 FF
			15 00 00 00 01 00 02 32 00
			15 00 00 00 01 00 02 33 B0
			15 00 00 00 01 00 02 34 00
			15 00 00 00 01 00 02 35 BA
			15 00 00 00 01 00 02 36 00
			15 00 00 00 01 00 02 37 CE
			15 00 00 00 01 00 02 38 00
			15 00 00 00 01 00 02 39 E0
			15 00 00 00 01 00 02 3A 00
			15 00 00 00 01 00 02 3B F0
			15 00 00 00 01 00 02 3D 00
			15 00 00 00 01 00 02 3F FF
			15 00 00 00 01 00 02 40 01
			15 00 00 00 01 00 02 41 0C
			15 00 00 00 01 00 02 42 01
			15 00 00 00 01 00 02 43 1A
			15 00 00 00 01 00 02 44 01
			15 00 00 00 01 00 02 45 27
			15 00 00 00 01 00 02 46 01
			15 00 00 00 01 00 02 47 51
			15 00 00 00 01 00 02 48 01
			15 00 00 00 01 00 02 49 74
			15 00 00 00 01 00 02 4A 01
			15 00 00 00 01 00 02 4B AC
			15 00 00 00 01 00 02 4C 01
			15 00 00 00 01 00 02 4D D8
			15 00 00 00 01 00 02 4E 02
			15 00 00 00 01 00 02 4F 1E
			15 00 00 00 01 00 02 50 02
			15 00 00 00 01 00 02 51 58
			15 00 00 00 01 00 02 52 02
			15 00 00 00 01 00 02 53 5A
			15 00 00 00 01 00 02 54 02
			15 00 00 00 01 00 02 55 92
			15 00 00 00 01 00 02 56 02
			15 00 00 00 01 00 02 58 D2
			15 00 00 00 01 00 02 59 02
			15 00 00 00 01 00 02 5A F9
			15 00 00 00 01 00 02 5B 03
			15 00 00 00 01 00 02 5C 29
			15 00 00 00 01 00 02 5D 03
			15 00 00 00 01 00 02 5E 49
			15 00 00 00 01 00 02 5F 03
			15 00 00 00 01 00 02 60 75
			15 00 00 00 01 00 02 61 03
			15 00 00 00 01 00 02 62 83
			15 00 00 00 01 00 02 63 03
			15 00 00 00 01 00 02 64 91
			15 00 00 00 01 00 02 65 03
			15 00 00 00 01 00 02 66 A2
			15 00 00 00 01 00 02 67 03
			15 00 00 00 01 00 02 68 B3
			15 00 00 00 01 00 02 69 03
			15 00 00 00 01 00 02 6A C6
			15 00 00 00 01 00 02 6B 03
			15 00 00 00 01 00 02 6C DC
			15 00 00 00 01 00 02 6D 03
			15 00 00 00 01 00 02 6E F3
			15 00 00 00 01 00 02 6F 03
			15 00 00 00 01 00 02 70 FF
			15 00 00 00 01 00 02 71 00
			15 00 00 00 01 00 02 72 67
			15 00 00 00 01 00 02 73 00
			15 00 00 00 01 00 02 74 78
			15 00 00 00 01 00 02 75 00
			15 00 00 00 01 00 02 76 99
			15 00 00 00 01 00 02 77 00
			15 00 00 00 01 00 02 78 B3
			15 00 00 00 01 00 02 79 00
			15 00 00 00 01 00 02 7A C9
			15 00 00 00 01 00 02 7B 00
			15 00 00 00 01 00 02 7C DD
			15 00 00 00 01 00 02 7D 00
			15 00 00 00 01 00 02 7E F0
			15 00 00 00 01 00 02 7F 01
			15 00 00 00 01 00 02 80 00
			15 00 00 00 01 00 02 81 01
			15 00 00 00 01 00 02 82 0F
			15 00 00 00 01 00 02 83 01
			15 00 00 00 01 00 02 84 41
			15 00 00 00 01 00 02 85 01
			15 00 00 00 01 00 02 86 69
			15 00 00 00 01 00 02 87 01
			15 00 00 00 01 00 02 88 A6
			15 00 00 00 01 00 02 89 01
			15 00 00 00 01 00 02 8A D4
			15 00 00 00 01 00 02 8B 02
			15 00 00 00 01 00 02 8C 1C
			15 00 00 00 01 00 02 8D 02
			15 00 00 00 01 00 02 8E 57
			15 00 00 00 01 00 02 8F 02
			15 00 00 00 01 00 02 90 59
			15 00 00 00 01 00 02 91 02
			15 00 00 00 01 00 02 92 92
			15 00 00 00 01 00 02 93 02
			15 00 00 00 01 00 02 94 D1
			15 00 00 00 01 00 02 95 02
			15 00 00 00 01 00 02 96 F7
			15 00 00 00 01 00 02 97 03
			15 00 00 00 01 00 02 98 27
			15 00 00 00 01 00 02 99 03
			15 00 00 00 01 00 02 9A 47
			15 00 00 00 01 00 02 9B 03
			15 00 00 00 01 00 02 9C 73
			15 00 00 00 01 00 02 9D 03
			15 00 00 00 01 00 02 9E 7F
			15 00 00 00 01 00 02 9F 03
			15 00 00 00 01 00 02 A0 8E
			15 00 00 00 01 00 02 A2 03
			15 00 00 00 01 00 02 A3 9F
			15 00 00 00 01 00 02 A4 03
			15 00 00 00 01 00 02 A5 B1
			15 00 00 00 01 00 02 A6 03
			15 00 00 00 01 00 02 A7 C5
			15 00 00 00 01 00 02 A9 03
			15 00 00 00 01 00 02 AA DB
			15 00 00 00 01 00 02 AB 03
			15 00 00 00 01 00 02 AC F3
			15 00 00 00 01 00 02 AD 03
			15 00 00 00 01 00 02 AE FF
			15 00 00 00 01 00 02 AF 00
			15 00 00 00 01 00 02 B0 67
			15 00 00 00 01 00 02 B1 00
			15 00 00 00 01 00 02 B2 78
			15 00 00 00 01 00 02 B3 00
			15 00 00 00 01 00 02 B4 99
			15 00 00 00 01 00 02 B5 00
			15 00 00 00 01 00 02 B6 B3
			15 00 00 00 01 00 02 B7 00
			15 00 00 00 01 00 02 B8 C9
			15 00 00 00 01 00 02 B9 00
			15 00 00 00 01 00 02 BA DD
			15 00 00 00 01 00 02 BB 00
			15 00 00 00 01 00 02 BC F0
			15 00 00 00 01 00 02 BD 01
			15 00 00 00 01 00 02 BE 00
			15 00 00 00 01 00 02 BF 01
			15 00 00 00 01 00 02 C0 0F
			15 00 00 00 01 00 02 C1 01
			15 00 00 00 01 00 02 C2 41
			15 00 00 00 01 00 02 C3 01
			15 00 00 00 01 00 02 C4 69
			15 00 00 00 01 00 02 C5 01
			15 00 00 00 01 00 02 C6 A6
			15 00 00 00 01 00 02 C7 01
			15 00 00 00 01 00 02 C8 D4
			15 00 00 00 01 00 02 C9 02
			15 00 00 00 01 00 02 CA 1C
			15 00 00 00 01 00 02 CB 02
			15 00 00 00 01 00 02 CC 57
			15 00 00 00 01 00 02 CD 02
			15 00 00 00 01 00 02 CE 59
			15 00 00 00 01 00 02 CF 02
			15 00 00 00 01 00 02 D0 92
			15 00 00 00 01 00 02 D1 02
			15 00 00 00 01 00 02 D2 D1
			15 00 00 00 01 00 02 D3 02
			15 00 00 00 01 00 02 D4 F7
			15 00 00 00 01 00 02 D5 03
			15 00 00 00 01 00 02 D6 27
			15 00 00 00 01 00 02 D7 03
			15 00 00 00 01 00 02 D8 47
			15 00 00 00 01 00 02 D9 03
			15 00 00 00 01 00 02 DA 73
			15 00 00 00 01 00 02 DB 03
			15 00 00 00 01 00 02 DC 7F
			15 00 00 00 01 00 02 DD 03
			15 00 00 00 01 00 02 DE 8E
			15 00 00 00 01 00 02 DF 03
			15 00 00 00 01 00 02 E0 9F
			15 00 00 00 01 00 02 E1 03
			15 00 00 00 01 00 02 E2 B1
			15 00 00 00 01 00 02 E3 03
			15 00 00 00 01 00 02 E4 C5
			15 00 00 00 01 00 02 E5 03
			15 00 00 00 01 00 02 E6 DB
			15 00 00 00 01 00 02 E7 03
			15 00 00 00 01 00 02 E8 F3
			15 00 00 00 01 00 02 E9 03
			15 00 00 00 01 00 02 EA FF
			15 00 00 00 01 00 02 FB 01
			15 01 00 00 01 00 02 FF 10
			];
		qcom,mdss-dsi-dispparam-default-command-state = "dsi_hs_mode";
		qcom,mdss-dsi-dispparam-cold-command = [
			15 01 00 00 01 00 02 FF 20
			15 00 00 00 01 00 02 FB 01
			15 00 00 00 01 00 02 75 00
			15 00 00 00 01 00 02 76 BD
			15 00 00 00 01 00 02 77 00
			15 00 00 00 01 00 02 78 C8
			15 00 00 00 01 00 02 79 00
			15 00 00 00 01 00 02 7A DC
			15 00 00 00 01 00 02 7B 00
			15 00 00 00 01 00 02 7C EE
			15 00 00 00 01 00 02 7D 00
			15 00 00 00 01 00 02 7E FE
			15 00 00 00 01 00 02 7F 01
			15 00 00 00 01 00 02 80 0D
			15 00 00 00 01 00 02 81 01
			15 00 00 00 01 00 02 82 1B
			15 00 00 00 01 00 02 83 01
			15 00 00 00 01 00 02 84 28
			15 00 00 00 01 00 02 85 01
			15 00 00 00 01 00 02 86 35
			15 00 00 00 01 00 02 87 01
			15 00 00 00 01 00 02 88 5F
			15 00 00 00 01 00 02 89 01
			15 00 00 00 01 00 02 8A 82
			15 00 00 00 01 00 02 8B 01
			15 00 00 00 01 00 02 8C BA
			15 00 00 00 01 00 02 8D 01
			15 00 00 00 01 00 02 8E E7
			15 00 00 00 01 00 02 8F 02
			15 00 00 00 01 00 02 90 2D
			15 00 00 00 01 00 02 91 02
			15 00 00 00 01 00 02 92 68
			15 00 00 00 01 00 02 93 02
			15 00 00 00 01 00 02 94 6A
			15 00 00 00 01 00 02 95 02
			15 00 00 00 01 00 02 96 A3
			15 00 00 00 01 00 02 97 02
			15 00 00 00 01 00 02 98 E4
			15 00 00 00 01 00 02 99 03
			15 00 00 00 01 00 02 9A 0B
			15 00 00 00 01 00 02 9B 03
			15 00 00 00 01 00 02 9C 3C
			15 00 00 00 01 00 02 9D 03
			15 00 00 00 01 00 02 9E 5D
			15 00 00 00 01 00 02 9F 03
			15 00 00 00 01 00 02 A0 87
			15 00 00 00 01 00 02 A2 03
			15 00 00 00 01 00 02 A3 93
			15 00 00 00 01 00 02 A4 03
			15 00 00 00 01 00 02 A5 A1
			15 00 00 00 01 00 02 A6 03
			15 00 00 00 01 00 02 A7 AF
			15 00 00 00 01 00 02 A9 03
			15 00 00 00 01 00 02 AA BF
			15 00 00 00 01 00 02 AB 03
			15 00 00 00 01 00 02 AC CF
			15 00 00 00 01 00 02 AD 03
			15 00 00 00 01 00 02 AE E2
			15 00 00 00 01 00 02 AF 03
			15 00 00 00 01 00 02 B0 F5
			15 00 00 00 01 00 02 B1 03
			15 00 00 00 01 00 02 B2 FF
			15 00 00 00 01 00 02 B3 00
			15 00 00 00 01 00 02 B4 BD
			15 00 00 00 01 00 02 B5 00
			15 00 00 00 01 00 02 B6 C8
			15 00 00 00 01 00 02 B7 00
			15 00 00 00 01 00 02 B8 DC
			15 00 00 00 01 00 02 B9 00
			15 00 00 00 01 00 02 BA EE
			15 00 00 00 01 00 02 BB 00
			15 00 00 00 01 00 02 BC FE
			15 00 00 00 01 00 02 BD 01
			15 00 00 00 01 00 02 BE 0D
			15 00 00 00 01 00 02 BF 01
			15 00 00 00 01 00 02 C0 1B
			15 00 00 00 01 00 02 C1 01
			15 00 00 00 01 00 02 C2 28
			15 00 00 00 01 00 02 C3 01
			15 00 00 00 01 00 02 C4 35
			15 00 00 00 01 00 02 C5 01
			15 00 00 00 01 00 02 C6 5F
			15 00 00 00 01 00 02 C7 01
			15 00 00 00 01 00 02 C8 82
			15 00 00 00 01 00 02 C9 01
			15 00 00 00 01 00 02 CA BA
			15 00 00 00 01 00 02 CB 01
			15 00 00 00 01 00 02 CC E7
			15 00 00 00 01 00 02 CD 02
			15 00 00 00 01 00 02 CE 2D
			15 00 00 00 01 00 02 CF 02
			15 00 00 00 01 00 02 D0 68
			15 00 00 00 01 00 02 D1 02
			15 00 00 00 01 00 02 D2 6A
			15 00 00 00 01 00 02 D3 02
			15 00 00 00 01 00 02 D4 A3
			15 00 00 00 01 00 02 D5 02
			15 00 00 00 01 00 02 D6 E4
			15 00 00 00 01 00 02 D7 03
			15 00 00 00 01 00 02 D8 0B
			15 00 00 00 01 00 02 D9 03
			15 00 00 00 01 00 02 DA 3C
			15 00 00 00 01 00 02 DB 03
			15 00 00 00 01 00 02 DC 5D
			15 00 00 00 01 00 02 DD 03
			15 00 00 00 01 00 02 DE 87
			15 00 00 00 01 00 02 DF 03
			15 00 00 00 01 00 02 E0 93
			15 00 00 00 01 00 02 E1 03
			15 00 00 00 01 00 02 E2 A1
			15 00 00 00 01 00 02 E3 03
			15 00 00 00 01 00 02 E4 AF
			15 00 00 00 01 00 02 E5 03
			15 00 00 00 01 00 02 E6 BF
			15 00 00 00 01 00 02 E7 03
			15 00 00 00 01 00 02 E8 CF
			15 00 00 00 01 00 02 E9 03
			15 00 00 00 01 00 02 EA E2
			15 00 00 00 01 00 02 EB 03
			15 00 00 00 01 00 02 EC F5
			15 00 00 00 01 00 02 ED 03
			15 00 00 00 01 00 02 EE FF
			15 00 00 00 01 00 02 EF 00
			15 00 00 00 01 00 02 F0 B0
			15 00 00 00 01 00 02 F1 00
			15 00 00 00 01 00 02 F2 BB
			15 00 00 00 01 00 02 F3 00
			15 00 00 00 01 00 02 F4 D1
			15 00 00 00 01 00 02 F5 00
			15 00 00 00 01 00 02 F6 E4
			15 00 00 00 01 00 02 F7 00
			15 00 00 00 01 00 02 F8 F5
			15 00 00 00 01 00 02 F9 01
			15 00 00 00 01 00 02 FA 05
			15 00 00 00 01 00 02 FB 01
			15 00 00 00 01 00 02 FF 21
			15 00 00 00 01 00 02 00 01
			15 00 00 00 01 00 02 01 14
			15 00 00 00 01 00 02 02 01
			15 00 00 00 01 00 02 03 22
			15 00 00 00 01 00 02 04 01
			15 00 00 00 01 00 02 05 2E
			15 00 00 00 01 00 02 06 01
			15 00 00 00 01 00 02 07 5A
			15 00 00 00 01 00 02 08 01
			15 00 00 00 01 00 02 09 7E
			15 00 00 00 01 00 02 0A 01
			15 00 00 00 01 00 02 0B B7
			15 00 00 00 01 00 02 0C 01
			15 00 00 00 01 00 02 0D E4
			15 00 00 00 01 00 02 0E 02
			15 00 00 00 01 00 02 0F 2B
			15 00 00 00 01 00 02 10 02
			15 00 00 00 01 00 02 11 66
			15 00 00 00 01 00 02 12 02
			15 00 00 00 01 00 02 13 68
			15 00 00 00 01 00 02 14 02
			15 00 00 00 01 00 02 15 A2
			15 00 00 00 01 00 02 16 02
			15 00 00 00 01 00 02 17 E3
			15 00 00 00 01 00 02 18 03
			15 00 00 00 01 00 02 19 0B
			15 00 00 00 01 00 02 1A 03
			15 00 00 00 01 00 02 1B 3C
			15 00 00 00 01 00 02 1C 03
			15 00 00 00 01 00 02 1D 5D
			15 00 00 00 01 00 02 1E 03
			15 00 00 00 01 00 02 1F 87
			15 00 00 00 01 00 02 20 03
			15 00 00 00 01 00 02 21 93
			15 00 00 00 01 00 02 22 03
			15 00 00 00 01 00 02 23 A1
			15 00 00 00 01 00 02 24 03
			15 00 00 00 01 00 02 25 AF
			15 00 00 00 01 00 02 26 03
			15 00 00 00 01 00 02 27 BF
			15 00 00 00 01 00 02 28 03
			15 00 00 00 01 00 02 29 CF
			15 00 00 00 01 00 02 2A 03
			15 00 00 00 01 00 02 2B E2
			15 00 00 00 01 00 02 2D 03
			15 00 00 00 01 00 02 2F F5
			15 00 00 00 01 00 02 30 03
			15 00 00 00 01 00 02 31 FF
			15 00 00 00 01 00 02 32 00
			15 00 00 00 01 00 02 33 B0
			15 00 00 00 01 00 02 34 00
			15 00 00 00 01 00 02 35 BB
			15 00 00 00 01 00 02 36 00
			15 00 00 00 01 00 02 37 D1
			15 00 00 00 01 00 02 38 00
			15 00 00 00 01 00 02 39 E4
			15 00 00 00 01 00 02 3A 00
			15 00 00 00 01 00 02 3B F5
			15 00 00 00 01 00 02 3D 01
			15 00 00 00 01 00 02 3F 05
			15 00 00 00 01 00 02 40 01
			15 00 00 00 01 00 02 41 14
			15 00 00 00 01 00 02 42 01
			15 00 00 00 01 00 02 43 22
			15 00 00 00 01 00 02 44 01
			15 00 00 00 01 00 02 45 2E
			15 00 00 00 01 00 02 46 01
			15 00 00 00 01 00 02 47 5A
			15 00 00 00 01 00 02 48 01
			15 00 00 00 01 00 02 49 7E
			15 00 00 00 01 00 02 4A 01
			15 00 00 00 01 00 02 4B B7
			15 00 00 00 01 00 02 4C 01
			15 00 00 00 01 00 02 4D E4
			15 00 00 00 01 00 02 4E 02
			15 00 00 00 01 00 02 4F 2B
			15 00 00 00 01 00 02 50 02
			15 00 00 00 01 00 02 51 66
			15 00 00 00 01 00 02 52 02
			15 00 00 00 01 00 02 53 68
			15 00 00 00 01 00 02 54 02
			15 00 00 00 01 00 02 55 A2
			15 00 00 00 01 00 02 56 02
			15 00 00 00 01 00 02 58 E3
			15 00 00 00 01 00 02 59 03
			15 00 00 00 01 00 02 5A 0B
			15 00 00 00 01 00 02 5B 03
			15 00 00 00 01 00 02 5C 3C
			15 00 00 00 01 00 02 5D 03
			15 00 00 00 01 00 02 5E 5D
			15 00 00 00 01 00 02 5F 03
			15 00 00 00 01 00 02 60 87
			15 00 00 00 01 00 02 61 03
			15 00 00 00 01 00 02 62 93
			15 00 00 00 01 00 02 63 03
			15 00 00 00 01 00 02 64 A1
			15 00 00 00 01 00 02 65 03
			15 00 00 00 01 00 02 66 AF
			15 00 00 00 01 00 02 67 03
			15 00 00 00 01 00 02 68 BF
			15 00 00 00 01 00 02 69 03
			15 00 00 00 01 00 02 6A CF
			15 00 00 00 01 00 02 6B 03
			15 00 00 00 01 00 02 6C E2
			15 00 00 00 01 00 02 6D 03
			15 00 00 00 01 00 02 6E F5
			15 00 00 00 01 00 02 6F 03
			15 00 00 00 01 00 02 70 FF
			15 00 00 00 01 00 02 71 00
			15 00 00 00 01 00 02 72 00
			15 00 00 00 01 00 02 73 00
			15 00 00 00 01 00 02 74 20
			15 00 00 00 01 00 02 75 00
			15 00 00 00 01 00 02 76 5B
			15 00 00 00 01 00 02 77 00
			15 00 00 00 01 00 02 78 85
			15 00 00 00 01 00 02 79 00
			15 00 00 00 01 00 02 7A A4
			15 00 00 00 01 00 02 7B 00
			15 00 00 00 01 00 02 7C BF
			15 00 00 00 01 00 02 7D 00
			15 00 00 00 01 00 02 7E D7
			15 00 00 00 01 00 02 7F 00
			15 00 00 00 01 00 02 80 EB
			15 00 00 00 01 00 02 81 00
			15 00 00 00 01 00 02 82 FD
			15 00 00 00 01 00 02 83 01
			15 00 00 00 01 00 02 84 39
			15 00 00 00 01 00 02 85 01
			15 00 00 00 01 00 02 86 66
			15 00 00 00 01 00 02 87 01
			15 00 00 00 01 00 02 88 A8
			15 00 00 00 01 00 02 89 01
			15 00 00 00 01 00 02 8A D9
			15 00 00 00 01 00 02 8B 02
			15 00 00 00 01 00 02 8C 25
			15 00 00 00 01 00 02 8D 02
			15 00 00 00 01 00 02 8E 62
			15 00 00 00 01 00 02 8F 02
			15 00 00 00 01 00 02 90 64
			15 00 00 00 01 00 02 91 02
			15 00 00 00 01 00 02 92 9E
			15 00 00 00 01 00 02 93 02
			15 00 00 00 01 00 02 94 DF
			15 00 00 00 01 00 02 95 03
			15 00 00 00 01 00 02 96 07
			15 00 00 00 01 00 02 97 03
			15 00 00 00 01 00 02 98 39
			15 00 00 00 01 00 02 99 03
			15 00 00 00 01 00 02 9A 5B
			15 00 00 00 01 00 02 9B 03
			15 00 00 00 01 00 02 9C 86
			15 00 00 00 01 00 02 9D 03
			15 00 00 00 01 00 02 9E 93
			15 00 00 00 01 00 02 9F 03
			15 00 00 00 01 00 02 A0 A0
			15 00 00 00 01 00 02 A2 03
			15 00 00 00 01 00 02 A3 AF
			15 00 00 00 01 00 02 A4 03
			15 00 00 00 01 00 02 A5 BF
			15 00 00 00 01 00 02 A6 03
			15 00 00 00 01 00 02 A7 CF
			15 00 00 00 01 00 02 A9 03
			15 00 00 00 01 00 02 AA E2
			15 00 00 00 01 00 02 AB 03
			15 00 00 00 01 00 02 AC F5
			15 00 00 00 01 00 02 AD 03
			15 00 00 00 01 00 02 AE FF
			15 00 00 00 01 00 02 AF 00
			15 00 00 00 01 00 02 B0 00
			15 00 00 00 01 00 02 B1 00
			15 00 00 00 01 00 02 B2 20
			15 00 00 00 01 00 02 B3 00
			15 00 00 00 01 00 02 B4 5B
			15 00 00 00 01 00 02 B5 00
			15 00 00 00 01 00 02 B6 85
			15 00 00 00 01 00 02 B7 00
			15 00 00 00 01 00 02 B8 A4
			15 00 00 00 01 00 02 B9 00
			15 00 00 00 01 00 02 BA BF
			15 00 00 00 01 00 02 BB 00
			15 00 00 00 01 00 02 BC D7
			15 00 00 00 01 00 02 BD 00
			15 00 00 00 01 00 02 BE EB
			15 00 00 00 01 00 02 BF 00
			15 00 00 00 01 00 02 C0 FD
			15 00 00 00 01 00 02 C1 01
			15 00 00 00 01 00 02 C2 39
			15 00 00 00 01 00 02 C3 01
			15 00 00 00 01 00 02 C4 66
			15 00 00 00 01 00 02 C5 01
			15 00 00 00 01 00 02 C6 A8
			15 00 00 00 01 00 02 C7 01
			15 00 00 00 01 00 02 C8 D9
			15 00 00 00 01 00 02 C9 02
			15 00 00 00 01 00 02 CA 25
			15 00 00 00 01 00 02 CB 02
			15 00 00 00 01 00 02 CC 62
			15 00 00 00 01 00 02 CD 02
			15 00 00 00 01 00 02 CE 64
			15 00 00 00 01 00 02 CF 02
			15 00 00 00 01 00 02 D0 9E
			15 00 00 00 01 00 02 D1 02
			15 00 00 00 01 00 02 D2 DF
			15 00 00 00 01 00 02 D3 03
			15 00 00 00 01 00 02 D4 07
			15 00 00 00 01 00 02 D5 03
			15 00 00 00 01 00 02 D6 39
			15 00 00 00 01 00 02 D7 03
			15 00 00 00 01 00 02 D8 5B
			15 00 00 00 01 00 02 D9 03
			15 00 00 00 01 00 02 DA 86
			15 00 00 00 01 00 02 DB 03
			15 00 00 00 01 00 02 DC 93
			15 00 00 00 01 00 02 DD 03
			15 00 00 00 01 00 02 DE A0
			15 00 00 00 01 00 02 DF 03
			15 00 00 00 01 00 02 E0 AF
			15 00 00 00 01 00 02 E1 03
			15 00 00 00 01 00 02 E2 BF
			15 00 00 00 01 00 02 E3 03
			15 00 00 00 01 00 02 E4 CF
			15 00 00 00 01 00 02 E5 03
			15 00 00 00 01 00 02 E6 E2
			15 00 00 00 01 00 02 E7 03
			15 00 00 00 01 00 02 E8 F5
			15 00 00 00 01 00 02 E9 03
			15 00 00 00 01 00 02 EA FF
			15 00 00 00 01 00 02 FB 01
			15 01 00 00 01 00 02 FF 10
			];
		qcom,mdss-dsi-dispparam-cold-command-state = "dsi_hs_mode";
		qcom,mdss-dsi-dispparam-papermode-command = [
			15 01 00 00 01 00 02 FF 20
			15 00 00 00 01 00 02 FB 01
			15 00 00 00 01 00 02 75 00
			15 00 00 00 01 00 02 76 C8
			15 00 00 00 01 00 02 77 00
			15 00 00 00 01 00 02 78 D2
			15 00 00 00 01 00 02 79 00
			15 00 00 00 01 00 02 7A E5
			15 00 00 00 01 00 02 7B 00
			15 00 00 00 01 00 02 7C F6
			15 00 00 00 01 00 02 7D 01
			15 00 00 00 01 00 02 7E 06
			15 00 00 00 01 00 02 7F 01
			15 00 00 00 01 00 02 80 15
			15 00 00 00 01 00 02 81 01
			15 00 00 00 01 00 02 82 22
			15 00 00 00 01 00 02 83 01
			15 00 00 00 01 00 02 84 2F
			15 00 00 00 01 00 02 85 01
			15 00 00 00 01 00 02 86 3C
			15 00 00 00 01 00 02 87 01
			15 00 00 00 01 00 02 88 66
			15 00 00 00 01 00 02 89 01
			15 00 00 00 01 00 02 8A 89
			15 00 00 00 01 00 02 8B 01
			15 00 00 00 01 00 02 8C C2
			15 00 00 00 01 00 02 8D 01
			15 00 00 00 01 00 02 8E EE
			15 00 00 00 01 00 02 8F 02
			15 00 00 00 01 00 02 90 34
			15 00 00 00 01 00 02 91 02
			15 00 00 00 01 00 02 92 6D
			15 00 00 00 01 00 02 93 02
			15 00 00 00 01 00 02 94 6F
			15 00 00 00 01 00 02 95 02
			15 00 00 00 01 00 02 96 A6
			15 00 00 00 01 00 02 97 02
			15 00 00 00 01 00 02 98 E1
			15 00 00 00 01 00 02 99 03
			15 00 00 00 01 00 02 9A 04
			15 00 00 00 01 00 02 9B 03
			15 00 00 00 01 00 02 9C 33
			15 00 00 00 01 00 02 9D 03
			15 00 00 00 01 00 02 9E 4F
			15 00 00 00 01 00 02 9F 03
			15 00 00 00 01 00 02 A0 72
			15 00 00 00 01 00 02 A2 03
			15 00 00 00 01 00 02 A3 7C
			15 00 00 00 01 00 02 A4 03
			15 00 00 00 01 00 02 A5 88
			15 00 00 00 01 00 02 A6 03
			15 00 00 00 01 00 02 A7 95
			15 00 00 00 01 00 02 A9 03
			15 00 00 00 01 00 02 AA A3
			15 00 00 00 01 00 02 AB 03
			15 00 00 00 01 00 02 AC B4
			15 00 00 00 01 00 02 AD 03
			15 00 00 00 01 00 02 AE C3
			15 00 00 00 01 00 02 AF 03
			15 00 00 00 01 00 02 B0 CD
			15 00 00 00 01 00 02 B1 03
			15 00 00 00 01 00 02 B2 FF
			15 00 00 00 01 00 02 B3 00
			15 00 00 00 01 00 02 B4 C8
			15 00 00 00 01 00 02 B5 00
			15 00 00 00 01 00 02 B6 D2
			15 00 00 00 01 00 02 B7 00
			15 00 00 00 01 00 02 B8 E5
			15 00 00 00 01 00 02 B9 00
			15 00 00 00 01 00 02 BA F6
			15 00 00 00 01 00 02 BB 01
			15 00 00 00 01 00 02 BC 06
			15 00 00 00 01 00 02 BD 01
			15 00 00 00 01 00 02 BE 15
			15 00 00 00 01 00 02 BF 01
			15 00 00 00 01 00 02 C0 22
			15 00 00 00 01 00 02 C1 01
			15 00 00 00 01 00 02 C2 2F
			15 00 00 00 01 00 02 C3 01
			15 00 00 00 01 00 02 C4 3C
			15 00 00 00 01 00 02 C5 01
			15 00 00 00 01 00 02 C6 66
			15 00 00 00 01 00 02 C7 01
			15 00 00 00 01 00 02 C8 89
			15 00 00 00 01 00 02 C9 01
			15 00 00 00 01 00 02 CA C2
			15 00 00 00 01 00 02 CB 01
			15 00 00 00 01 00 02 CC EE
			15 00 00 00 01 00 02 CD 02
			15 00 00 00 01 00 02 CE 34
			15 00 00 00 01 00 02 CF 02
			15 00 00 00 01 00 02 D0 6D
			15 00 00 00 01 00 02 D1 02
			15 00 00 00 01 00 02 D2 6F
			15 00 00 00 01 00 02 D3 02
			15 00 00 00 01 00 02 D4 A6
			15 00 00 00 01 00 02 D5 02
			15 00 00 00 01 00 02 D6 E1
			15 00 00 00 01 00 02 D7 03
			15 00 00 00 01 00 02 D8 04
			15 00 00 00 01 00 02 D9 03
			15 00 00 00 01 00 02 DA 33
			15 00 00 00 01 00 02 DB 03
			15 00 00 00 01 00 02 DC 4F
			15 00 00 00 01 00 02 DD 03
			15 00 00 00 01 00 02 DE 72
			15 00 00 00 01 00 02 DF 03
			15 00 00 00 01 00 02 E0 7C
			15 00 00 00 01 00 02 E1 03
			15 00 00 00 01 00 02 E2 88
			15 00 00 00 01 00 02 E3 03
			15 00 00 00 01 00 02 E4 95
			15 00 00 00 01 00 02 E5 03
			15 00 00 00 01 00 02 E6 A3
			15 00 00 00 01 00 02 E7 03
			15 00 00 00 01 00 02 E8 B4
			15 00 00 00 01 00 02 E9 03
			15 00 00 00 01 00 02 EA C3
			15 00 00 00 01 00 02 EB 03
			15 00 00 00 01 00 02 EC CD
			15 00 00 00 01 00 02 ED 03
			15 00 00 00 01 00 02 EE FF
			15 00 00 00 01 00 02 EF 00
			15 00 00 00 01 00 02 F0 C8
			15 00 00 00 01 00 02 F1 00
			15 00 00 00 01 00 02 F2 D3
			15 00 00 00 01 00 02 F3 00
			15 00 00 00 01 00 02 F4 E6
			15 00 00 00 01 00 02 F5 00
			15 00 00 00 01 00 02 F6 F8
			15 00 00 00 01 00 02 F7 01
			15 00 00 00 01 00 02 F8 09
			15 00 00 00 01 00 02 F9 01
			15 00 00 00 01 00 02 FA 18
			15 00 00 00 01 00 02 FF 21
			15 00 00 00 01 00 02 FB 01
			15 00 00 00 01 00 02 00 01
			15 00 00 00 01 00 02 01 26
			15 00 00 00 01 00 02 02 01
			15 00 00 00 01 00 02 03 33
			15 00 00 00 01 00 02 04 01
			15 00 00 00 01 00 02 05 3F
			15 00 00 00 01 00 02 06 01
			15 00 00 00 01 00 02 07 6B
			15 00 00 00 01 00 02 08 01
			15 00 00 00 01 00 02 09 8E
			15 00 00 00 01 00 02 0A 01
			15 00 00 00 01 00 02 0B C7
			15 00 00 00 01 00 02 0C 01
			15 00 00 00 01 00 02 0D F2
			15 00 00 00 01 00 02 0E 02
			15 00 00 00 01 00 02 0F 37
			15 00 00 00 01 00 02 10 02
			15 00 00 00 01 00 02 11 70
			15 00 00 00 01 00 02 12 02
			15 00 00 00 01 00 02 13 72
			15 00 00 00 01 00 02 14 02
			15 00 00 00 01 00 02 15 A8
			15 00 00 00 01 00 02 16 02
			15 00 00 00 01 00 02 17 E3
			15 00 00 00 01 00 02 18 03
			15 00 00 00 01 00 02 19 05
			15 00 00 00 01 00 02 1A 03
			15 00 00 00 01 00 02 1B 34
			15 00 00 00 01 00 02 1C 03
			15 00 00 00 01 00 02 1D 50
			15 00 00 00 01 00 02 1E 03
			15 00 00 00 01 00 02 1F 73
			15 00 00 00 01 00 02 20 03
			15 00 00 00 01 00 02 21 7D
			15 00 00 00 01 00 02 22 03
			15 00 00 00 01 00 02 23 89
			15 00 00 00 01 00 02 24 03
			15 00 00 00 01 00 02 25 96
			15 00 00 00 01 00 02 26 03
			15 00 00 00 01 00 02 27 A5
			15 00 00 00 01 00 02 28 03
			15 00 00 00 01 00 02 29 B5
			15 00 00 00 01 00 02 2A 03
			15 00 00 00 01 00 02 2B C3
			15 00 00 00 01 00 02 2D 03
			15 00 00 00 01 00 02 2F CC
			15 00 00 00 01 00 02 30 03
			15 00 00 00 01 00 02 31 FF
			15 00 00 00 01 00 02 32 00
			15 00 00 00 01 00 02 33 C8
			15 00 00 00 01 00 02 34 00
			15 00 00 00 01 00 02 35 D3
			15 00 00 00 01 00 02 36 00
			15 00 00 00 01 00 02 37 E6
			15 00 00 00 01 00 02 38 00
			15 00 00 00 01 00 02 39 F8
			15 00 00 00 01 00 02 3A 01
			15 00 00 00 01 00 02 3B 09
			15 00 00 00 01 00 02 3D 01
			15 00 00 00 01 00 02 3F 18
			15 00 00 00 01 00 02 40 01
			15 00 00 00 01 00 02 41 26
			15 00 00 00 01 00 02 42 01
			15 00 00 00 01 00 02 43 33
			15 00 00 00 01 00 02 44 01
			15 00 00 00 01 00 02 45 3F
			15 00 00 00 01 00 02 46 01
			15 00 00 00 01 00 02 47 6B
			15 00 00 00 01 00 02 48 01
			15 00 00 00 01 00 02 49 8E
			15 00 00 00 01 00 02 4A 01
			15 00 00 00 01 00 02 4B C7
			15 00 00 00 01 00 02 4C 01
			15 00 00 00 01 00 02 4D F2
			15 00 00 00 01 00 02 4E 02
			15 00 00 00 01 00 02 4F 37
			15 00 00 00 01 00 02 50 02
			15 00 00 00 01 00 02 51 70
			15 00 00 00 01 00 02 52 02
			15 00 00 00 01 00 02 53 72
			15 00 00 00 01 00 02 54 02
			15 00 00 00 01 00 02 55 A8
			15 00 00 00 01 00 02 56 02
			15 00 00 00 01 00 02 58 E3
			15 00 00 00 01 00 02 59 03
			15 00 00 00 01 00 02 5A 05
			15 00 00 00 01 00 02 5B 03
			15 00 00 00 01 00 02 5C 34
			15 00 00 00 01 00 02 5D 03
			15 00 00 00 01 00 02 5E 50
			15 00 00 00 01 00 02 5F 03
			15 00 00 00 01 00 02 60 73
			15 00 00 00 01 00 02 61 03
			15 00 00 00 01 00 02 62 7D
			15 00 00 00 01 00 02 63 03
			15 00 00 00 01 00 02 64 89
			15 00 00 00 01 00 02 65 03
			15 00 00 00 01 00 02 66 96
			15 00 00 00 01 00 02 67 03
			15 00 00 00 01 00 02 68 A5
			15 00 00 00 01 00 02 69 03
			15 00 00 00 01 00 02 6A B5
			15 00 00 00 01 00 02 6B 03
			15 00 00 00 01 00 02 6C C3
			15 00 00 00 01 00 02 6D 03
			15 00 00 00 01 00 02 6E CC
			15 00 00 00 01 00 02 6F 03
			15 00 00 00 01 00 02 70 FF
			15 00 00 00 01 00 02 71 02
			15 00 00 00 01 00 02 72 58
			15 00 00 00 01 00 02 73 02
			15 00 00 00 01 00 02 74 59
			15 00 00 00 01 00 02 75 02
			15 00 00 00 01 00 02 76 5B
			15 00 00 00 01 00 02 77 02
			15 00 00 00 01 00 02 78 5D
			15 00 00 00 01 00 02 79 02
			15 00 00 00 01 00 02 7A 5F
			15 00 00 00 01 00 02 7B 02
			15 00 00 00 01 00 02 7C 61
			15 00 00 00 01 00 02 7D 02
			15 00 00 00 01 00 02 7E 63
			15 00 00 00 01 00 02 7F 02
			15 00 00 00 01 00 02 80 64
			15 00 00 00 01 00 02 81 02
			15 00 00 00 01 00 02 82 66
			15 00 00 00 01 00 02 83 02
			15 00 00 00 01 00 02 84 6E
			15 00 00 00 01 00 02 85 02
			15 00 00 00 01 00 02 86 76
			15 00 00 00 01 00 02 87 02
			15 00 00 00 01 00 02 88 85
			15 00 00 00 01 00 02 89 02
			15 00 00 00 01 00 02 8A 94
			15 00 00 00 01 00 02 8B 02
			15 00 00 00 01 00 02 8C B2
			15 00 00 00 01 00 02 8D 02
			15 00 00 00 01 00 02 8E D3
			15 00 00 00 01 00 02 8F 02
			15 00 00 00 01 00 02 90 D4
			15 00 00 00 01 00 02 91 02
			15 00 00 00 01 00 02 92 F8
			15 00 00 00 01 00 02 93 03
			15 00 00 00 01 00 02 94 27
			15 00 00 00 01 00 02 95 03
			15 00 00 00 01 00 02 96 44
			15 00 00 00 01 00 02 97 03
			15 00 00 00 01 00 02 98 67
			15 00 00 00 01 00 02 99 03
			15 00 00 00 01 00 02 9A 7D
			15 00 00 00 01 00 02 9B 03
			15 00 00 00 01 00 02 9C 97
			15 00 00 00 01 00 02 9D 03
			15 00 00 00 01 00 02 9E 9E
			15 00 00 00 01 00 02 9F 03
			15 00 00 00 01 00 02 A0 A6
			15 00 00 00 01 00 02 A2 03
			15 00 00 00 01 00 02 A3 AD
			15 00 00 00 01 00 02 A4 03
			15 00 00 00 01 00 02 A5 B3
			15 00 00 00 01 00 02 A6 03
			15 00 00 00 01 00 02 A7 B8
			15 00 00 00 01 00 02 A9 03
			15 00 00 00 01 00 02 AA BC
			15 00 00 00 01 00 02 AB 03
			15 00 00 00 01 00 02 AC BE
			15 00 00 00 01 00 02 AD 03
			15 00 00 00 01 00 02 AE FF
			15 00 00 00 01 00 02 AF 02
			15 00 00 00 01 00 02 B0 58
			15 00 00 00 01 00 02 B1 02
			15 00 00 00 01 00 02 B2 59
			15 00 00 00 01 00 02 B3 02
			15 00 00 00 01 00 02 B4 5B
			15 00 00 00 01 00 02 B5 02
			15 00 00 00 01 00 02 B6 5D
			15 00 00 00 01 00 02 B7 02
			15 00 00 00 01 00 02 B8 5F
			15 00 00 00 01 00 02 B9 02
			15 00 00 00 01 00 02 BA 61
			15 00 00 00 01 00 02 BB 02
			15 00 00 00 01 00 02 BC 63
			15 00 00 00 01 00 02 BD 02
			15 00 00 00 01 00 02 BE 64
			15 00 00 00 01 00 02 BF 02
			15 00 00 00 01 00 02 C0 66
			15 00 00 00 01 00 02 C1 02
			15 00 00 00 01 00 02 C2 6E
			15 00 00 00 01 00 02 C3 02
			15 00 00 00 01 00 02 C4 76
			15 00 00 00 01 00 02 C5 02
			15 00 00 00 01 00 02 C6 85
			15 00 00 00 01 00 02 C7 02
			15 00 00 00 01 00 02 C8 94
			15 00 00 00 01 00 02 C9 02
			15 00 00 00 01 00 02 CA B2
			15 00 00 00 01 00 02 CB 02
			15 00 00 00 01 00 02 CC D3
			15 00 00 00 01 00 02 CD 02
			15 00 00 00 01 00 02 CE D4
			15 00 00 00 01 00 02 CF 02
			15 00 00 00 01 00 02 D0 F8
			15 00 00 00 01 00 02 D1 03
			15 00 00 00 01 00 02 D2 27
			15 00 00 00 01 00 02 D3 03
			15 00 00 00 01 00 02 D4 44
			15 00 00 00 01 00 02 D5 03
			15 00 00 00 01 00 02 D6 67
			15 00 00 00 01 00 02 D7 03
			15 00 00 00 01 00 02 D8 7D
			15 00 00 00 01 00 02 D9 03
			15 00 00 00 01 00 02 DA 97
			15 00 00 00 01 00 02 DB 03
			15 00 00 00 01 00 02 DC 9E
			15 00 00 00 01 00 02 DD 03
			15 00 00 00 01 00 02 DE A6
			15 00 00 00 01 00 02 DF 03
			15 00 00 00 01 00 02 E0 AD
			15 00 00 00 01 00 02 E1 03
			15 00 00 00 01 00 02 E2 B3
			15 00 00 00 01 00 02 E3 03
			15 00 00 00 01 00 02 E4 B8
			15 00 00 00 01 00 02 E5 03
			15 00 00 00 01 00 02 E6 BC
			15 00 00 00 01 00 02 E7 03
			15 00 00 00 01 00 02 E8 BE
			15 00 00 00 01 00 02 E9 03
			15 00 00 00 01 00 02 EA FF
			15 00 00 00 01 00 02 FB 01
			15 01 00 00 01 00 02 FF 10
			];
		qcom,mdss-dsi-dispparam-papermode-state = "dsi_hs_mode";
		qcom,mdss-dsi-dispparam-papermode1-command = [
			15 01 00 00 78 00 02 FF 20
			15 00 00 00 01 00 02 FB 01

			15 00 00 00 01 00 02 75 00
			15 00 00 00 01 00 02 76 C8
			15 00 00 00 01 00 02 77 00
			15 00 00 00 01 00 02 78 D2
			15 00 00 00 01 00 02 79 00
			15 00 00 00 01 00 02 7A E5
			15 00 00 00 01 00 02 7B 00
			15 00 00 00 01 00 02 7C F6
			15 00 00 00 01 00 02 7D 01
			15 00 00 00 01 00 02 7E 06
			15 00 00 00 01 00 02 7F 01
			15 00 00 00 01 00 02 80 15
			15 00 00 00 01 00 02 81 01
			15 00 00 00 01 00 02 82 22
			15 00 00 00 01 00 02 83 01
			15 00 00 00 01 00 02 84 2F
			15 00 00 00 01 00 02 85 01
			15 00 00 00 01 00 02 86 3C
			15 00 00 00 01 00 02 87 01
			15 00 00 00 01 00 02 88 66
			15 00 00 00 01 00 02 89 01
			15 00 00 00 01 00 02 8A 89
			15 00 00 00 01 00 02 8B 01
			15 00 00 00 01 00 02 8C C2
			15 00 00 00 01 00 02 8D 01
			15 00 00 00 01 00 02 8E EE
			15 00 00 00 01 00 02 8F 02
			15 00 00 00 01 00 02 90 34
			15 00 00 00 01 00 02 91 02
			15 00 00 00 01 00 02 92 6D
			15 00 00 00 01 00 02 93 02
			15 00 00 00 01 00 02 94 6F
			15 00 00 00 01 00 02 95 02
			15 00 00 00 01 00 02 96 A6
			15 00 00 00 01 00 02 97 02
			15 00 00 00 01 00 02 98 E1
			15 00 00 00 01 00 02 99 03
			15 00 00 00 01 00 02 9A 04
			15 00 00 00 01 00 02 9B 03
			15 00 00 00 01 00 02 9C 33
			15 00 00 00 01 00 02 9D 03
			15 00 00 00 01 00 02 9E 4F
			15 00 00 00 01 00 02 9F 03
			15 00 00 00 01 00 02 A0 72
			15 00 00 00 01 00 02 A2 03
			15 00 00 00 01 00 02 A3 7C
			15 00 00 00 01 00 02 A4 03
			15 00 00 00 01 00 02 A5 88
			15 00 00 00 01 00 02 A6 03
			15 00 00 00 01 00 02 A7 95
			15 00 00 00 01 00 02 A9 03
			15 00 00 00 01 00 02 AA A3
			15 00 00 00 01 00 02 AB 03
			15 00 00 00 01 00 02 AC B4
			15 00 00 00 01 00 02 AD 03
			15 00 00 00 01 00 02 AE C3
			15 00 00 00 01 00 02 AF 03
			15 00 00 00 01 00 02 B0 CD
			15 00 00 00 01 00 02 B1 03
			15 00 00 00 01 00 02 B2 FF

			15 00 00 00 01 00 02 B3 00
			15 00 00 00 01 00 02 B4 C8
			15 00 00 00 01 00 02 B5 00
			15 00 00 00 01 00 02 B6 D2
			15 00 00 00 01 00 02 B7 00
			15 00 00 00 01 00 02 B8 E5
			15 00 00 00 01 00 02 B9 00
			15 00 00 00 01 00 02 BA F6
			15 00 00 00 01 00 02 BB 01
			15 00 00 00 01 00 02 BC 06
			15 00 00 00 01 00 02 BD 01
			15 00 00 00 01 00 02 BE 15
			15 00 00 00 01 00 02 BF 01
			15 00 00 00 01 00 02 C0 22
			15 00 00 00 01 00 02 C1 01
			15 00 00 00 01 00 02 C2 2F
			15 00 00 00 01 00 02 C3 01
			15 00 00 00 01 00 02 C4 3C
			15 00 00 00 01 00 02 C5 01
			15 00 00 00 01 00 02 C6 66
			15 00 00 00 01 00 02 C7 01
			15 00 00 00 01 00 02 C8 89
			15 00 00 00 01 00 02 C9 01
			15 00 00 00 01 00 02 CA C2
			15 00 00 00 01 00 02 CB 01
			15 00 00 00 01 00 02 CC EE
			15 00 00 00 01 00 02 CD 02
			15 00 00 00 01 00 02 CE 34
			15 00 00 00 01 00 02 CF 02
			15 00 00 00 01 00 02 D0 6D
			15 00 00 00 01 00 02 D1 02
			15 00 00 00 01 00 02 D2 6F
			15 00 00 00 01 00 02 D3 02
			15 00 00 00 01 00 02 D4 A6
			15 00 00 00 01 00 02 D5 02
			15 00 00 00 01 00 02 D6 E1
			15 00 00 00 01 00 02 D7 03
			15 00 00 00 01 00 02 D8 04
			15 00 00 00 01 00 02 D9 03
			15 00 00 00 01 00 02 DA 33
			15 00 00 00 01 00 02 DB 03
			15 00 00 00 01 00 02 DC 4F
			15 00 00 00 01 00 02 DD 03
			15 00 00 00 01 00 02 DE 72
			15 00 00 00 01 00 02 DF 03
			15 00 00 00 01 00 02 E0 7C
			15 00 00 00 01 00 02 E1 03
			15 00 00 00 01 00 02 E2 88
			15 00 00 00 01 00 02 E3 03
			15 00 00 00 01 00 02 E4 95
			15 00 00 00 01 00 02 E5 03
			15 00 00 00 01 00 02 E6 A3
			15 00 00 00 01 00 02 E7 03
			15 00 00 00 01 00 02 E8 B4
			15 00 00 00 01 00 02 E9 03
			15 00 00 00 01 00 02 EA C3
			15 00 00 00 01 00 02 EB 03
			15 00 00 00 01 00 02 EC CD
			15 00 00 00 01 00 02 ED 03
			15 00 00 00 01 00 02 EE FF

			15 00 00 00 01 00 02 EF 00
			15 00 00 00 01 00 02 F0 C8
			15 00 00 00 01 00 02 F1 00
			15 00 00 00 01 00 02 F2 D3
			15 00 00 00 01 00 02 F3 00
			15 00 00 00 01 00 02 F4 E6
			15 00 00 00 01 00 02 F5 00
			15 00 00 00 01 00 02 F6 F8
			15 00 00 00 01 00 02 F7 01
			15 00 00 00 01 00 02 F8 09
			15 00 00 00 01 00 02 F9 01
			15 00 00 00 01 00 02 FA 18
			15 00 00 00 01 00 02 FF 21
			15 00 00 00 01 00 02 FB 01
			15 00 00 00 01 00 02 00 01
			15 00 00 00 01 00 02 01 26
			15 00 00 00 01 00 02 02 01
			15 00 00 00 01 00 02 03 33
			15 00 00 00 01 00 02 04 01
			15 00 00 00 01 00 02 05 3F
			15 00 00 00 01 00 02 06 01
			15 00 00 00 01 00 02 07 6B
			15 00 00 00 01 00 02 08 01
			15 00 00 00 01 00 02 09 8E
			15 00 00 00 01 00 02 0A 01
			15 00 00 00 01 00 02 0B C7
			15 00 00 00 01 00 02 0C 01
			15 00 00 00 01 00 02 0D F2
			15 00 00 00 01 00 02 0E 02
			15 00 00 00 01 00 02 0F 37
			15 00 00 00 01 00 02 10 02
			15 00 00 00 01 00 02 11 70
			15 00 00 00 01 00 02 12 02
			15 00 00 00 01 00 02 13 72
			15 00 00 00 01 00 02 14 02
			15 00 00 00 01 00 02 15 A8
			15 00 00 00 01 00 02 16 02
			15 00 00 00 01 00 02 17 E3
			15 00 00 00 01 00 02 18 03
			15 00 00 00 01 00 02 19 05
			15 00 00 00 01 00 02 1A 03
			15 00 00 00 01 00 02 1B 34
			15 00 00 00 01 00 02 1C 03
			15 00 00 00 01 00 02 1D 50
			15 00 00 00 01 00 02 1E 03
			15 00 00 00 01 00 02 1F 73
			15 00 00 00 01 00 02 20 03
			15 00 00 00 01 00 02 21 7D
			15 00 00 00 01 00 02 22 03
			15 00 00 00 01 00 02 23 89
			15 00 00 00 01 00 02 24 03
			15 00 00 00 01 00 02 25 96
			15 00 00 00 01 00 02 26 03
			15 00 00 00 01 00 02 27 A5
			15 00 00 00 01 00 02 28 03
			15 00 00 00 01 00 02 29 B5
			15 00 00 00 01 00 02 2A 03
			15 00 00 00 01 00 02 2B C3
			15 00 00 00 01 00 02 2D 03
			15 00 00 00 01 00 02 2F CC
			15 00 00 00 01 00 02 30 03
			15 00 00 00 01 00 02 31 FF
			15 00 00 00 01 00 02 32 00
			15 00 00 00 01 00 02 33 C8
			15 00 00 00 01 00 02 34 00
			15 00 00 00 01 00 02 35 D3
			15 00 00 00 01 00 02 36 00
			15 00 00 00 01 00 02 37 E6
			15 00 00 00 01 00 02 38 00
			15 00 00 00 01 00 02 39 F8
			15 00 00 00 01 00 02 3A 01
			15 00 00 00 01 00 02 3B 09
			15 00 00 00 01 00 02 3D 01
			15 00 00 00 01 00 02 3F 18
			15 00 00 00 01 00 02 40 01
			15 00 00 00 01 00 02 41 26
			15 00 00 00 01 00 02 42 01
			15 00 00 00 01 00 02 43 33
			15 00 00 00 01 00 02 44 01
			15 00 00 00 01 00 02 45 3F
			15 00 00 00 01 00 02 46 01
			15 00 00 00 01 00 02 47 6B
			15 00 00 00 01 00 02 48 01
			15 00 00 00 01 00 02 49 8E
			15 00 00 00 01 00 02 4A 01
			15 00 00 00 01 00 02 4B C7
			15 00 00 00 01 00 02 4C 01
			15 00 00 00 01 00 02 4D F2
			15 00 00 00 01 00 02 4E 02
			15 00 00 00 01 00 02 4F 37
			15 00 00 00 01 00 02 50 02
			15 00 00 00 01 00 02 51 70
			15 00 00 00 01 00 02 52 02
			15 00 00 00 01 00 02 53 72
			15 00 00 00 01 00 02 54 02
			15 00 00 00 01 00 02 55 A8
			15 00 00 00 01 00 02 56 02
			15 00 00 00 01 00 02 58 E3
			15 00 00 00 01 00 02 59 03
			15 00 00 00 01 00 02 5A 05
			15 00 00 00 01 00 02 5B 03
			15 00 00 00 01 00 02 5C 34
			15 00 00 00 01 00 02 5D 03
			15 00 00 00 01 00 02 5E 50
			15 00 00 00 01 00 02 5F 03
			15 00 00 00 01 00 02 60 73
			15 00 00 00 01 00 02 61 03
			15 00 00 00 01 00 02 62 7D
			15 00 00 00 01 00 02 63 03
			15 00 00 00 01 00 02 64 89
			15 00 00 00 01 00 02 65 03
			15 00 00 00 01 00 02 66 96
			15 00 00 00 01 00 02 67 03
			15 00 00 00 01 00 02 68 A5
			15 00 00 00 01 00 02 69 03
			15 00 00 00 01 00 02 6A B5
			15 00 00 00 01 00 02 6B 03
			15 00 00 00 01 00 02 6C C3
			15 00 00 00 01 00 02 6D 03
			15 00 00 00 01 00 02 6E CC
			15 00 00 00 01 00 02 6F 03
			15 00 00 00 01 00 02 70 FF
			15 00 00 00 01 00 02 71 01
			15 00 00 00 01 00 02 72 90
			15 00 00 00 01 00 02 73 01
			15 00 00 00 01 00 02 74 93
			15 00 00 00 01 00 02 75 01
			15 00 00 00 01 00 02 76 9A
			15 00 00 00 01 00 02 77 01
			15 00 00 00 01 00 02 78 A1
			15 00 00 00 01 00 02 79 01
			15 00 00 00 01 00 02 7A A7
			15 00 00 00 01 00 02 7B 01
			15 00 00 00 01 00 02 7C AD
			15 00 00 00 01 00 02 7D 01
			15 00 00 00 01 00 02 7E B3
			15 00 00 00 01 00 02 7F 01
			15 00 00 00 01 00 02 80 B9
			15 00 00 00 01 00 02 81 01
			15 00 00 00 01 00 02 82 BF
			15 00 00 00 01 00 02 83 01
			15 00 00 00 01 00 02 84 D4
			15 00 00 00 01 00 02 85 01
			15 00 00 00 01 00 02 86 E7
			15 00 00 00 01 00 02 87 02
			15 00 00 00 01 00 02 88 0A
			15 00 00 00 01 00 02 89 02
			15 00 00 00 01 00 02 8A 27
			15 00 00 00 01 00 02 8B 02
			15 00 00 00 01 00 02 8C 5A
			15 00 00 00 01 00 02 8D 02
			15 00 00 00 01 00 02 8E 8B
			15 00 00 00 01 00 02 8F 02
			15 00 00 00 01 00 02 90 8C
			15 00 00 00 01 00 02 91 02
			15 00 00 00 01 00 02 92 BD
			15 00 00 00 01 00 02 93 02
			15 00 00 00 01 00 02 94 F3
			15 00 00 00 01 00 02 95 03
			15 00 00 00 01 00 02 96 14
			15 00 00 00 01 00 02 97 03
			15 00 00 00 01 00 02 98 41
			15 00 00 00 01 00 02 99 03
			15 00 00 00 01 00 02 9A 5B
			15 00 00 00 01 00 02 9B 03
			15 00 00 00 01 00 02 9C 7C
			15 00 00 00 01 00 02 9D 03
			15 00 00 00 01 00 02 9E 86
			15 00 00 00 01 00 02 9F 03
			15 00 00 00 01 00 02 A0 91
			15 00 00 00 01 00 02 A2 03
			15 00 00 00 01 00 02 A3 9E
			15 00 00 00 01 00 02 A4 03
			15 00 00 00 01 00 02 A5 AB
			15 00 00 00 01 00 02 A6 03
			15 00 00 00 01 00 02 A7 B9
			15 00 00 00 01 00 02 A9 03
			15 00 00 00 01 00 02 AA C5
			15 00 00 00 01 00 02 AB 03
			15 00 00 00 01 00 02 AC CC
			15 00 00 00 01 00 02 AD 03
			15 00 00 00 01 00 02 AE FF

			15 00 00 00 01 00 02 AF 01
			15 00 00 00 01 00 02 B0 90
			15 00 00 00 01 00 02 B1 01
			15 00 00 00 01 00 02 B2 93
			15 00 00 00 01 00 02 B3 01
			15 00 00 00 01 00 02 B4 9A
			15 00 00 00 01 00 02 B5 01
			15 00 00 00 01 00 02 B6 A1
			15 00 00 00 01 00 02 B7 01
			15 00 00 00 01 00 02 B8 A7
			15 00 00 00 01 00 02 B9 01
			15 00 00 00 01 00 02 BA AD
			15 00 00 00 01 00 02 BB 01
			15 00 00 00 01 00 02 BC B3
			15 00 00 00 01 00 02 BD 01
			15 00 00 00 01 00 02 BE B9
			15 00 00 00 01 00 02 BF 01
			15 00 00 00 01 00 02 C0 BF
			15 00 00 00 01 00 02 C1 01
			15 00 00 00 01 00 02 C2 D4
			15 00 00 00 01 00 02 C3 01
			15 00 00 00 01 00 02 C4 E7
			15 00 00 00 01 00 02 C5 02
			15 00 00 00 01 00 02 C6 0A
			15 00 00 00 01 00 02 C7 02
			15 00 00 00 01 00 02 C8 27
			15 00 00 00 01 00 02 C9 02
			15 00 00 00 01 00 02 CA 5A
			15 00 00 00 01 00 02 CB 02
			15 00 00 00 01 00 02 CC 8B
			15 00 00 00 01 00 02 CD 02
			15 00 00 00 01 00 02 CE 8C
			15 00 00 00 01 00 02 CF 02
			15 00 00 00 01 00 02 D0 BD
			15 00 00 00 01 00 02 D1 02
			15 00 00 00 01 00 02 D2 F3
			15 00 00 00 01 00 02 D3 03
			15 00 00 00 01 00 02 D4 14
			15 00 00 00 01 00 02 D5 03
			15 00 00 00 01 00 02 D6 41
			15 00 00 00 01 00 02 D7 03
			15 00 00 00 01 00 02 D8 5B
			15 00 00 00 01 00 02 D9 03
			15 00 00 00 01 00 02 DA 7C
			15 00 00 00 01 00 02 DB 03
			15 00 00 00 01 00 02 DC 86
			15 00 00 00 01 00 02 DD 03
			15 00 00 00 01 00 02 DE 91
			15 00 00 00 01 00 02 DF 03
			15 00 00 00 01 00 02 E0 9E
			15 00 00 00 01 00 02 E1 03
			15 00 00 00 01 00 02 E2 AB
			15 00 00 00 01 00 02 E3 03
			15 00 00 00 01 00 02 E4 B9
			15 00 00 00 01 00 02 E5 03
			15 00 00 00 01 00 02 E6 C5
			15 00 00 00 01 00 02 E7 03
			15 00 00 00 01 00 02 E8 CC
			15 00 00 00 01 00 02 E9 03
			15 00 00 00 01 00 02 EA FF
			15 00 00 00 01 00 02 FB 01
			15 01 00 00 01 00 02 FF 10
			];
		qcom,mdss-dsi-dispparam-papermode1-state = "dsi_hs_mode";
		qcom,mdss-dsi-dispparam-papermode2-command = [
			15 01 00 00 78 00 02 FF 20
			15 00 00 00 01 00 02 FB 01

			15 00 00 00 01 00 02 75 00
			15 00 00 00 01 00 02 76 C8
			15 00 00 00 01 00 02 77 00
			15 00 00 00 01 00 02 78 D2
			15 00 00 00 01 00 02 79 00
			15 00 00 00 01 00 02 7A E5
			15 00 00 00 01 00 02 7B 00
			15 00 00 00 01 00 02 7C F6
			15 00 00 00 01 00 02 7D 01
			15 00 00 00 01 00 02 7E 06
			15 00 00 00 01 00 02 7F 01
			15 00 00 00 01 00 02 80 15
			15 00 00 00 01 00 02 81 01
			15 00 00 00 01 00 02 82 22
			15 00 00 00 01 00 02 83 01
			15 00 00 00 01 00 02 84 2F
			15 00 00 00 01 00 02 85 01
			15 00 00 00 01 00 02 86 3C
			15 00 00 00 01 00 02 87 01
			15 00 00 00 01 00 02 88 66
			15 00 00 00 01 00 02 89 01
			15 00 00 00 01 00 02 8A 89
			15 00 00 00 01 00 02 8B 01
			15 00 00 00 01 00 02 8C C2
			15 00 00 00 01 00 02 8D 01
			15 00 00 00 01 00 02 8E EE
			15 00 00 00 01 00 02 8F 02
			15 00 00 00 01 00 02 90 34
			15 00 00 00 01 00 02 91 02
			15 00 00 00 01 00 02 92 6D
			15 00 00 00 01 00 02 93 02
			15 00 00 00 01 00 02 94 6F
			15 00 00 00 01 00 02 95 02
			15 00 00 00 01 00 02 96 A6
			15 00 00 00 01 00 02 97 02
			15 00 00 00 01 00 02 98 E1
			15 00 00 00 01 00 02 99 03
			15 00 00 00 01 00 02 9A 04
			15 00 00 00 01 00 02 9B 03
			15 00 00 00 01 00 02 9C 33
			15 00 00 00 01 00 02 9D 03
			15 00 00 00 01 00 02 9E 4F
			15 00 00 00 01 00 02 9F 03
			15 00 00 00 01 00 02 A0 72
			15 00 00 00 01 00 02 A2 03
			15 00 00 00 01 00 02 A3 7C
			15 00 00 00 01 00 02 A4 03
			15 00 00 00 01 00 02 A5 88
			15 00 00 00 01 00 02 A6 03
			15 00 00 00 01 00 02 A7 95
			15 00 00 00 01 00 02 A9 03
			15 00 00 00 01 00 02 AA A3
			15 00 00 00 01 00 02 AB 03
			15 00 00 00 01 00 02 AC B4
			15 00 00 00 01 00 02 AD 03
			15 00 00 00 01 00 02 AE C3
			15 00 00 00 01 00 02 AF 03
			15 00 00 00 01 00 02 B0 CD
			15 00 00 00 01 00 02 B1 03
			15 00 00 00 01 00 02 B2 FF

			15 00 00 00 01 00 02 B3 00
			15 00 00 00 01 00 02 B4 C8
			15 00 00 00 01 00 02 B5 00
			15 00 00 00 01 00 02 B6 D2
			15 00 00 00 01 00 02 B7 00
			15 00 00 00 01 00 02 B8 E5
			15 00 00 00 01 00 02 B9 00
			15 00 00 00 01 00 02 BA F6
			15 00 00 00 01 00 02 BB 01
			15 00 00 00 01 00 02 BC 06
			15 00 00 00 01 00 02 BD 01
			15 00 00 00 01 00 02 BE 15
			15 00 00 00 01 00 02 BF 01
			15 00 00 00 01 00 02 C0 22
			15 00 00 00 01 00 02 C1 01
			15 00 00 00 01 00 02 C2 2F
			15 00 00 00 01 00 02 C3 01
			15 00 00 00 01 00 02 C4 3C
			15 00 00 00 01 00 02 C5 01
			15 00 00 00 01 00 02 C6 66
			15 00 00 00 01 00 02 C7 01
			15 00 00 00 01 00 02 C8 89
			15 00 00 00 01 00 02 C9 01
			15 00 00 00 01 00 02 CA C2
			15 00 00 00 01 00 02 CB 01
			15 00 00 00 01 00 02 CC EE
			15 00 00 00 01 00 02 CD 02
			15 00 00 00 01 00 02 CE 34
			15 00 00 00 01 00 02 CF 02
			15 00 00 00 01 00 02 D0 6D
			15 00 00 00 01 00 02 D1 02
			15 00 00 00 01 00 02 D2 6F
			15 00 00 00 01 00 02 D3 02
			15 00 00 00 01 00 02 D4 A6
			15 00 00 00 01 00 02 D5 02
			15 00 00 00 01 00 02 D6 E1
			15 00 00 00 01 00 02 D7 03
			15 00 00 00 01 00 02 D8 04
			15 00 00 00 01 00 02 D9 03
			15 00 00 00 01 00 02 DA 33
			15 00 00 00 01 00 02 DB 03
			15 00 00 00 01 00 02 DC 4F
			15 00 00 00 01 00 02 DD 03
			15 00 00 00 01 00 02 DE 72
			15 00 00 00 01 00 02 DF 03
			15 00 00 00 01 00 02 E0 7C
			15 00 00 00 01 00 02 E1 03
			15 00 00 00 01 00 02 E2 88
			15 00 00 00 01 00 02 E3 03
			15 00 00 00 01 00 02 E4 95
			15 00 00 00 01 00 02 E5 03
			15 00 00 00 01 00 02 E6 A3
			15 00 00 00 01 00 02 E7 03
			15 00 00 00 01 00 02 E8 B4
			15 00 00 00 01 00 02 E9 03
			15 00 00 00 01 00 02 EA C3
			15 00 00 00 01 00 02 EB 03
			15 00 00 00 01 00 02 EC CD
			15 00 00 00 01 00 02 ED 03
			15 00 00 00 01 00 02 EE FF

			15 00 00 00 01 00 02 EF 00
			15 00 00 00 01 00 02 F0 C8
			15 00 00 00 01 00 02 F1 00
			15 00 00 00 01 00 02 F2 D3
			15 00 00 00 01 00 02 F3 00
			15 00 00 00 01 00 02 F4 E6
			15 00 00 00 01 00 02 F5 00
			15 00 00 00 01 00 02 F6 F8
			15 00 00 00 01 00 02 F7 01
			15 00 00 00 01 00 02 F8 09
			15 00 00 00 01 00 02 F9 01
			15 00 00 00 01 00 02 FA 18
			15 00 00 00 01 00 02 FF 21
			15 00 00 00 01 00 02 FB 01
			15 00 00 00 01 00 02 00 01
			15 00 00 00 01 00 02 01 26
			15 00 00 00 01 00 02 02 01
			15 00 00 00 01 00 02 03 33
			15 00 00 00 01 00 02 04 01
			15 00 00 00 01 00 02 05 3F
			15 00 00 00 01 00 02 06 01
			15 00 00 00 01 00 02 07 6B
			15 00 00 00 01 00 02 08 01
			15 00 00 00 01 00 02 09 8E
			15 00 00 00 01 00 02 0A 01
			15 00 00 00 01 00 02 0B C7
			15 00 00 00 01 00 02 0C 01
			15 00 00 00 01 00 02 0D F2
			15 00 00 00 01 00 02 0E 02
			15 00 00 00 01 00 02 0F 37
			15 00 00 00 01 00 02 10 02
			15 00 00 00 01 00 02 11 70
			15 00 00 00 01 00 02 12 02
			15 00 00 00 01 00 02 13 72
			15 00 00 00 01 00 02 14 02
			15 00 00 00 01 00 02 15 A8
			15 00 00 00 01 00 02 16 02
			15 00 00 00 01 00 02 17 E3
			15 00 00 00 01 00 02 18 03
			15 00 00 00 01 00 02 19 05
			15 00 00 00 01 00 02 1A 03
			15 00 00 00 01 00 02 1B 34
			15 00 00 00 01 00 02 1C 03
			15 00 00 00 01 00 02 1D 50
			15 00 00 00 01 00 02 1E 03
			15 00 00 00 01 00 02 1F 73
			15 00 00 00 01 00 02 20 03
			15 00 00 00 01 00 02 21 7D
			15 00 00 00 01 00 02 22 03
			15 00 00 00 01 00 02 23 89
			15 00 00 00 01 00 02 24 03
			15 00 00 00 01 00 02 25 96
			15 00 00 00 01 00 02 26 03
			15 00 00 00 01 00 02 27 A5
			15 00 00 00 01 00 02 28 03
			15 00 00 00 01 00 02 29 B5
			15 00 00 00 01 00 02 2A 03
			15 00 00 00 01 00 02 2B C3
			15 00 00 00 01 00 02 2D 03
			15 00 00 00 01 00 02 2F CC
			15 00 00 00 01 00 02 30 03
			15 00 00 00 01 00 02 31 FF
			15 00 00 00 01 00 02 32 00
			15 00 00 00 01 00 02 33 C8
			15 00 00 00 01 00 02 34 00
			15 00 00 00 01 00 02 35 D3
			15 00 00 00 01 00 02 36 00
			15 00 00 00 01 00 02 37 E6
			15 00 00 00 01 00 02 38 00
			15 00 00 00 01 00 02 39 F8
			15 00 00 00 01 00 02 3A 01
			15 00 00 00 01 00 02 3B 09
			15 00 00 00 01 00 02 3D 01
			15 00 00 00 01 00 02 3F 18
			15 00 00 00 01 00 02 40 01
			15 00 00 00 01 00 02 41 26
			15 00 00 00 01 00 02 42 01
			15 00 00 00 01 00 02 43 33
			15 00 00 00 01 00 02 44 01
			15 00 00 00 01 00 02 45 3F
			15 00 00 00 01 00 02 46 01
			15 00 00 00 01 00 02 47 6B
			15 00 00 00 01 00 02 48 01
			15 00 00 00 01 00 02 49 8E
			15 00 00 00 01 00 02 4A 01
			15 00 00 00 01 00 02 4B C7
			15 00 00 00 01 00 02 4C 01
			15 00 00 00 01 00 02 4D F2
			15 00 00 00 01 00 02 4E 02
			15 00 00 00 01 00 02 4F 37
			15 00 00 00 01 00 02 50 02
			15 00 00 00 01 00 02 51 70
			15 00 00 00 01 00 02 52 02
			15 00 00 00 01 00 02 53 72
			15 00 00 00 01 00 02 54 02
			15 00 00 00 01 00 02 55 A8
			15 00 00 00 01 00 02 56 02
			15 00 00 00 01 00 02 58 E3
			15 00 00 00 01 00 02 59 03
			15 00 00 00 01 00 02 5A 05
			15 00 00 00 01 00 02 5B 03
			15 00 00 00 01 00 02 5C 34
			15 00 00 00 01 00 02 5D 03
			15 00 00 00 01 00 02 5E 50
			15 00 00 00 01 00 02 5F 03
			15 00 00 00 01 00 02 60 73
			15 00 00 00 01 00 02 61 03
			15 00 00 00 01 00 02 62 7D
			15 00 00 00 01 00 02 63 03
			15 00 00 00 01 00 02 64 89
			15 00 00 00 01 00 02 65 03
			15 00 00 00 01 00 02 66 96
			15 00 00 00 01 00 02 67 03
			15 00 00 00 01 00 02 68 A5
			15 00 00 00 01 00 02 69 03
			15 00 00 00 01 00 02 6A B5
			15 00 00 00 01 00 02 6B 03
			15 00 00 00 01 00 02 6C C3
			15 00 00 00 01 00 02 6D 03
			15 00 00 00 01 00 02 6E CC
			15 00 00 00 01 00 02 6F 03
			15 00 00 00 01 00 02 70 FF
			15 00 00 00 01 00 02 71 01
			15 00 00 00 01 00 02 72 C2
			15 00 00 00 01 00 02 73 01
			15 00 00 00 01 00 02 74 C5
			15 00 00 00 01 00 02 75 01
			15 00 00 00 01 00 02 76 CA
			15 00 00 00 01 00 02 77 01
			15 00 00 00 01 00 02 78 CE
			15 00 00 00 01 00 02 79 01
			15 00 00 00 01 00 02 7A D3
			15 00 00 00 01 00 02 7B 01
			15 00 00 00 01 00 02 7C D8
			15 00 00 00 01 00 02 7D 01
			15 00 00 00 01 00 02 7E DC
			15 00 00 00 01 00 02 7F 01
			15 00 00 00 01 00 02 80 E1
			15 00 00 00 01 00 02 81 01
			15 00 00 00 01 00 02 82 E5
			15 00 00 00 01 00 02 83 01
			15 00 00 00 01 00 02 84 F6
			15 00 00 00 01 00 02 85 02
			15 00 00 00 01 00 02 86 06
			15 00 00 00 01 00 02 87 02
			15 00 00 00 01 00 02 88 22
			15 00 00 00 01 00 02 89 02
			15 00 00 00 01 00 02 8A 3B
			15 00 00 00 01 00 02 8B 02
			15 00 00 00 01 00 02 8C 6A
			15 00 00 00 01 00 02 8D 02
			15 00 00 00 01 00 02 8E 97
			15 00 00 00 01 00 02 8F 02
			15 00 00 00 01 00 02 90 98
			15 00 00 00 01 00 02 91 02
			15 00 00 00 01 00 02 92 C7
			15 00 00 00 01 00 02 93 02
			15 00 00 00 01 00 02 94 FB
			15 00 00 00 01 00 02 95 03
			15 00 00 00 01 00 02 96 1A
			15 00 00 00 01 00 02 97 03
			15 00 00 00 01 00 02 98 47
			15 00 00 00 01 00 02 99 03
			15 00 00 00 01 00 02 9A 61
			15 00 00 00 01 00 02 9B 03
			15 00 00 00 01 00 02 9C 81
			15 00 00 00 01 00 02 9D 03
			15 00 00 00 01 00 02 9E 8B
			15 00 00 00 01 00 02 9F 03
			15 00 00 00 01 00 02 A0 96
			15 00 00 00 01 00 02 A2 03
			15 00 00 00 01 00 02 A3 A2
			15 00 00 00 01 00 02 A4 03
			15 00 00 00 01 00 02 A5 AE
			15 00 00 00 01 00 02 A6 03
			15 00 00 00 01 00 02 A7 BB
			15 00 00 00 01 00 02 A9 03
			15 00 00 00 01 00 02 AA C6
			15 00 00 00 01 00 02 AB 03
			15 00 00 00 01 00 02 AC CC
			15 00 00 00 01 00 02 AD 03
			15 00 00 00 01 00 02 AE FF

			15 00 00 00 01 00 02 AF 01
			15 00 00 00 01 00 02 B0 C2
			15 00 00 00 01 00 02 B1 01
			15 00 00 00 01 00 02 B2 C5
			15 00 00 00 01 00 02 B3 01
			15 00 00 00 01 00 02 B4 CA
			15 00 00 00 01 00 02 B5 01
			15 00 00 00 01 00 02 B6 CE
			15 00 00 00 01 00 02 B7 01
			15 00 00 00 01 00 02 B8 D3
			15 00 00 00 01 00 02 B9 01
			15 00 00 00 01 00 02 BA D8
			15 00 00 00 01 00 02 BB 01
			15 00 00 00 01 00 02 BC DC
			15 00 00 00 01 00 02 BD 01
			15 00 00 00 01 00 02 BE E1
			15 00 00 00 01 00 02 BF 01
			15 00 00 00 01 00 02 C0 E5
			15 00 00 00 01 00 02 C1 01
			15 00 00 00 01 00 02 C2 F6
			15 00 00 00 01 00 02 C3 02
			15 00 00 00 01 00 02 C4 06
			15 00 00 00 01 00 02 C5 02
			15 00 00 00 01 00 02 C6 22
			15 00 00 00 01 00 02 C7 02
			15 00 00 00 01 00 02 C8 3B
			15 00 00 00 01 00 02 C9 02
			15 00 00 00 01 00 02 CA 6A
			15 00 00 00 01 00 02 CB 02
			15 00 00 00 01 00 02 CC 97
			15 00 00 00 01 00 02 CD 02
			15 00 00 00 01 00 02 CE 98
			15 00 00 00 01 00 02 CF 02
			15 00 00 00 01 00 02 D0 C7
			15 00 00 00 01 00 02 D1 02
			15 00 00 00 01 00 02 D2 FB
			15 00 00 00 01 00 02 D3 03
			15 00 00 00 01 00 02 D4 1A
			15 00 00 00 01 00 02 D5 03
			15 00 00 00 01 00 02 D6 47
			15 00 00 00 01 00 02 D7 03
			15 00 00 00 01 00 02 D8 61
			15 00 00 00 01 00 02 D9 03
			15 00 00 00 01 00 02 DA 81
			15 00 00 00 01 00 02 DB 03
			15 00 00 00 01 00 02 DC 8B
			15 00 00 00 01 00 02 DD 03
			15 00 00 00 01 00 02 DE 96
			15 00 00 00 01 00 02 DF 03
			15 00 00 00 01 00 02 E0 A2
			15 00 00 00 01 00 02 E1 03
			15 00 00 00 01 00 02 E2 AE
			15 00 00 00 01 00 02 E3 03
			15 00 00 00 01 00 02 E4 BB
			15 00 00 00 01 00 02 E5 03
			15 00 00 00 01 00 02 E6 C6
			15 00 00 00 01 00 02 E7 03
			15 00 00 00 01 00 02 E8 CC
			15 00 00 00 01 00 02 E9 03
			15 00 00 00 01 00 02 EA FF
			15 00 00 00 01 00 02 FB 01
			15 01 00 00 01 00 02 FF 10
			];

		qcom,mdss-dsi-dispparam-papermode2-state = "dsi_hs_mode";
		qcom,mdss-dsi-dispparam-papermode3-command = [
			15 01 00 00 78 00 02 FF 20
			15 00 00 00 01 00 02 FB 01

			15 00 00 00 01 00 02 75 00
			15 00 00 00 01 00 02 76 C8
			15 00 00 00 01 00 02 77 00
			15 00 00 00 01 00 02 78 D2
			15 00 00 00 01 00 02 79 00
			15 00 00 00 01 00 02 7A E5
			15 00 00 00 01 00 02 7B 00
			15 00 00 00 01 00 02 7C F6
			15 00 00 00 01 00 02 7D 01
			15 00 00 00 01 00 02 7E 06
			15 00 00 00 01 00 02 7F 01
			15 00 00 00 01 00 02 80 15
			15 00 00 00 01 00 02 81 01
			15 00 00 00 01 00 02 82 22
			15 00 00 00 01 00 02 83 01
			15 00 00 00 01 00 02 84 2F
			15 00 00 00 01 00 02 85 01
			15 00 00 00 01 00 02 86 3C
			15 00 00 00 01 00 02 87 01
			15 00 00 00 01 00 02 88 66
			15 00 00 00 01 00 02 89 01
			15 00 00 00 01 00 02 8A 89
			15 00 00 00 01 00 02 8B 01
			15 00 00 00 01 00 02 8C C2
			15 00 00 00 01 00 02 8D 01
			15 00 00 00 01 00 02 8E EE
			15 00 00 00 01 00 02 8F 02
			15 00 00 00 01 00 02 90 34
			15 00 00 00 01 00 02 91 02
			15 00 00 00 01 00 02 92 6D
			15 00 00 00 01 00 02 93 02
			15 00 00 00 01 00 02 94 6F
			15 00 00 00 01 00 02 95 02
			15 00 00 00 01 00 02 96 A6
			15 00 00 00 01 00 02 97 02
			15 00 00 00 01 00 02 98 E1
			15 00 00 00 01 00 02 99 03
			15 00 00 00 01 00 02 9A 04
			15 00 00 00 01 00 02 9B 03
			15 00 00 00 01 00 02 9C 33
			15 00 00 00 01 00 02 9D 03
			15 00 00 00 01 00 02 9E 4F
			15 00 00 00 01 00 02 9F 03
			15 00 00 00 01 00 02 A0 72
			15 00 00 00 01 00 02 A2 03
			15 00 00 00 01 00 02 A3 7C
			15 00 00 00 01 00 02 A4 03
			15 00 00 00 01 00 02 A5 88
			15 00 00 00 01 00 02 A6 03
			15 00 00 00 01 00 02 A7 95
			15 00 00 00 01 00 02 A9 03
			15 00 00 00 01 00 02 AA A3
			15 00 00 00 01 00 02 AB 03
			15 00 00 00 01 00 02 AC B4
			15 00 00 00 01 00 02 AD 03
			15 00 00 00 01 00 02 AE C3
			15 00 00 00 01 00 02 AF 03
			15 00 00 00 01 00 02 B0 CD
			15 00 00 00 01 00 02 B1 03
			15 00 00 00 01 00 02 B2 FF

			15 00 00 00 01 00 02 B3 00
			15 00 00 00 01 00 02 B4 C8
			15 00 00 00 01 00 02 B5 00
			15 00 00 00 01 00 02 B6 D2
			15 00 00 00 01 00 02 B7 00
			15 00 00 00 01 00 02 B8 E5
			15 00 00 00 01 00 02 B9 00
			15 00 00 00 01 00 02 BA F6
			15 00 00 00 01 00 02 BB 01
			15 00 00 00 01 00 02 BC 06
			15 00 00 00 01 00 02 BD 01
			15 00 00 00 01 00 02 BE 15
			15 00 00 00 01 00 02 BF 01
			15 00 00 00 01 00 02 C0 22
			15 00 00 00 01 00 02 C1 01
			15 00 00 00 01 00 02 C2 2F
			15 00 00 00 01 00 02 C3 01
			15 00 00 00 01 00 02 C4 3C
			15 00 00 00 01 00 02 C5 01
			15 00 00 00 01 00 02 C6 66
			15 00 00 00 01 00 02 C7 01
			15 00 00 00 01 00 02 C8 89
			15 00 00 00 01 00 02 C9 01
			15 00 00 00 01 00 02 CA C2
			15 00 00 00 01 00 02 CB 01
			15 00 00 00 01 00 02 CC EE
			15 00 00 00 01 00 02 CD 02
			15 00 00 00 01 00 02 CE 34
			15 00 00 00 01 00 02 CF 02
			15 00 00 00 01 00 02 D0 6D
			15 00 00 00 01 00 02 D1 02
			15 00 00 00 01 00 02 D2 6F
			15 00 00 00 01 00 02 D3 02
			15 00 00 00 01 00 02 D4 A6
			15 00 00 00 01 00 02 D5 02
			15 00 00 00 01 00 02 D6 E1
			15 00 00 00 01 00 02 D7 03
			15 00 00 00 01 00 02 D8 04
			15 00 00 00 01 00 02 D9 03
			15 00 00 00 01 00 02 DA 33
			15 00 00 00 01 00 02 DB 03
			15 00 00 00 01 00 02 DC 4F
			15 00 00 00 01 00 02 DD 03
			15 00 00 00 01 00 02 DE 72
			15 00 00 00 01 00 02 DF 03
			15 00 00 00 01 00 02 E0 7C
			15 00 00 00 01 00 02 E1 03
			15 00 00 00 01 00 02 E2 88
			15 00 00 00 01 00 02 E3 03
			15 00 00 00 01 00 02 E4 95
			15 00 00 00 01 00 02 E5 03
			15 00 00 00 01 00 02 E6 A3
			15 00 00 00 01 00 02 E7 03
			15 00 00 00 01 00 02 E8 B4
			15 00 00 00 01 00 02 E9 03
			15 00 00 00 01 00 02 EA C3
			15 00 00 00 01 00 02 EB 03
			15 00 00 00 01 00 02 EC CD
			15 00 00 00 01 00 02 ED 03
			15 00 00 00 01 00 02 EE FF

			15 00 00 00 01 00 02 EF 00
			15 00 00 00 01 00 02 F0 C8
			15 00 00 00 01 00 02 F1 00
			15 00 00 00 01 00 02 F2 D3
			15 00 00 00 01 00 02 F3 00
			15 00 00 00 01 00 02 F4 E6
			15 00 00 00 01 00 02 F5 00
			15 00 00 00 01 00 02 F6 F8
			15 00 00 00 01 00 02 F7 01
			15 00 00 00 01 00 02 F8 09
			15 00 00 00 01 00 02 F9 01
			15 00 00 00 01 00 02 FA 18
			15 00 00 00 01 00 02 FF 21
			15 00 00 00 01 00 02 FB 01
			15 00 00 00 01 00 02 00 01
			15 00 00 00 01 00 02 01 26
			15 00 00 00 01 00 02 02 01
			15 00 00 00 01 00 02 03 33
			15 00 00 00 01 00 02 04 01
			15 00 00 00 01 00 02 05 3F
			15 00 00 00 01 00 02 06 01
			15 00 00 00 01 00 02 07 6B
			15 00 00 00 01 00 02 08 01
			15 00 00 00 01 00 02 09 8E
			15 00 00 00 01 00 02 0A 01
			15 00 00 00 01 00 02 0B C7
			15 00 00 00 01 00 02 0C 01
			15 00 00 00 01 00 02 0D F2
			15 00 00 00 01 00 02 0E 02
			15 00 00 00 01 00 02 0F 37
			15 00 00 00 01 00 02 10 02
			15 00 00 00 01 00 02 11 70
			15 00 00 00 01 00 02 12 02
			15 00 00 00 01 00 02 13 72
			15 00 00 00 01 00 02 14 02
			15 00 00 00 01 00 02 15 A8
			15 00 00 00 01 00 02 16 02
			15 00 00 00 01 00 02 17 E3
			15 00 00 00 01 00 02 18 03
			15 00 00 00 01 00 02 19 05
			15 00 00 00 01 00 02 1A 03
			15 00 00 00 01 00 02 1B 34
			15 00 00 00 01 00 02 1C 03
			15 00 00 00 01 00 02 1D 50
			15 00 00 00 01 00 02 1E 03
			15 00 00 00 01 00 02 1F 73
			15 00 00 00 01 00 02 20 03
			15 00 00 00 01 00 02 21 7D
			15 00 00 00 01 00 02 22 03
			15 00 00 00 01 00 02 23 89
			15 00 00 00 01 00 02 24 03
			15 00 00 00 01 00 02 25 96
			15 00 00 00 01 00 02 26 03
			15 00 00 00 01 00 02 27 A5
			15 00 00 00 01 00 02 28 03
			15 00 00 00 01 00 02 29 B5
			15 00 00 00 01 00 02 2A 03
			15 00 00 00 01 00 02 2B C3
			15 00 00 00 01 00 02 2D 03
			15 00 00 00 01 00 02 2F CC
			15 00 00 00 01 00 02 30 03
			15 00 00 00 01 00 02 31 FF
			15 00 00 00 01 00 02 32 00
			15 00 00 00 01 00 02 33 C8
			15 00 00 00 01 00 02 34 00
			15 00 00 00 01 00 02 35 D3
			15 00 00 00 01 00 02 36 00
			15 00 00 00 01 00 02 37 E6
			15 00 00 00 01 00 02 38 00
			15 00 00 00 01 00 02 39 F8
			15 00 00 00 01 00 02 3A 01
			15 00 00 00 01 00 02 3B 09
			15 00 00 00 01 00 02 3D 01
			15 00 00 00 01 00 02 3F 18
			15 00 00 00 01 00 02 40 01
			15 00 00 00 01 00 02 41 26
			15 00 00 00 01 00 02 42 01
			15 00 00 00 01 00 02 43 33
			15 00 00 00 01 00 02 44 01
			15 00 00 00 01 00 02 45 3F
			15 00 00 00 01 00 02 46 01
			15 00 00 00 01 00 02 47 6B
			15 00 00 00 01 00 02 48 01
			15 00 00 00 01 00 02 49 8E
			15 00 00 00 01 00 02 4A 01
			15 00 00 00 01 00 02 4B C7
			15 00 00 00 01 00 02 4C 01
			15 00 00 00 01 00 02 4D F2
			15 00 00 00 01 00 02 4E 02
			15 00 00 00 01 00 02 4F 37
			15 00 00 00 01 00 02 50 02
			15 00 00 00 01 00 02 51 70
			15 00 00 00 01 00 02 52 02
			15 00 00 00 01 00 02 53 72
			15 00 00 00 01 00 02 54 02
			15 00 00 00 01 00 02 55 A8
			15 00 00 00 01 00 02 56 02
			15 00 00 00 01 00 02 58 E3
			15 00 00 00 01 00 02 59 03
			15 00 00 00 01 00 02 5A 05
			15 00 00 00 01 00 02 5B 03
			15 00 00 00 01 00 02 5C 34
			15 00 00 00 01 00 02 5D 03
			15 00 00 00 01 00 02 5E 50
			15 00 00 00 01 00 02 5F 03
			15 00 00 00 01 00 02 60 73
			15 00 00 00 01 00 02 61 03
			15 00 00 00 01 00 02 62 7D
			15 00 00 00 01 00 02 63 03
			15 00 00 00 01 00 02 64 89
			15 00 00 00 01 00 02 65 03
			15 00 00 00 01 00 02 66 96
			15 00 00 00 01 00 02 67 03
			15 00 00 00 01 00 02 68 A5
			15 00 00 00 01 00 02 69 03
			15 00 00 00 01 00 02 6A B5
			15 00 00 00 01 00 02 6B 03
			15 00 00 00 01 00 02 6C C3
			15 00 00 00 01 00 02 6D 03
			15 00 00 00 01 00 02 6E CC
			15 00 00 00 01 00 02 6F 03
			15 00 00 00 01 00 02 70 FF
			15 00 00 00 01 00 02 71 01
			15 00 00 00 01 00 02 72 E0
			15 00 00 00 01 00 02 73 01
			15 00 00 00 01 00 02 74 E2
			15 00 00 00 01 00 02 75 01
			15 00 00 00 01 00 02 76 E6
			15 00 00 00 01 00 02 77 01
			15 00 00 00 01 00 02 78 EA
			15 00 00 00 01 00 02 79 01
			15 00 00 00 01 00 02 7A EE
			15 00 00 00 01 00 02 7B 01
			15 00 00 00 01 00 02 7C F2
			15 00 00 00 01 00 02 7D 01
			15 00 00 00 01 00 02 7E F6
			15 00 00 00 01 00 02 7F 01
			15 00 00 00 01 00 02 80 FA
			15 00 00 00 01 00 02 81 01
			15 00 00 00 01 00 02 82 FE
			15 00 00 00 01 00 02 83 02
			15 00 00 00 01 00 02 84 0D
			15 00 00 00 01 00 02 85 02
			15 00 00 00 01 00 02 86 1A
			15 00 00 00 01 00 02 87 02
			15 00 00 00 01 00 02 88 33
			15 00 00 00 01 00 02 89 02
			15 00 00 00 01 00 02 8A 4A
			15 00 00 00 01 00 02 8B 02
			15 00 00 00 01 00 02 8C 75
			15 00 00 00 01 00 02 8D 02
			15 00 00 00 01 00 02 8E A0
			15 00 00 00 01 00 02 8F 02
			15 00 00 00 01 00 02 90 A1
			15 00 00 00 01 00 02 91 02
			15 00 00 00 01 00 02 92 CE
			15 00 00 00 01 00 02 93 03
			15 00 00 00 01 00 02 94 00
			15 00 00 00 01 00 02 95 03
			15 00 00 00 01 00 02 96 23
			15 00 00 00 01 00 02 97 03
			15 00 00 00 01 00 02 98 4C
			15 00 00 00 01 00 02 99 03
			15 00 00 00 01 00 02 9A 65
			15 00 00 00 01 00 02 9B 03
			15 00 00 00 01 00 02 9C 85
			15 00 00 00 01 00 02 9D 03
			15 00 00 00 01 00 02 9E 8E
			15 00 00 00 01 00 02 9F 03
			15 00 00 00 01 00 02 A0 99
			15 00 00 00 01 00 02 A2 03
			15 00 00 00 01 00 02 A3 A4
			15 00 00 00 01 00 02 A4 03
			15 00 00 00 01 00 02 A5 B1
			15 00 00 00 01 00 02 A6 03
			15 00 00 00 01 00 02 A7 BD
			15 00 00 00 01 00 02 A9 03
			15 00 00 00 01 00 02 AA C7
			15 00 00 00 01 00 02 AB 03
			15 00 00 00 01 00 02 AC CC
			15 00 00 00 01 00 02 AD 03
			15 00 00 00 01 00 02 AE FF

			15 00 00 00 01 00 02 AF 01
			15 00 00 00 01 00 02 B0 E0
			15 00 00 00 01 00 02 B1 01
			15 00 00 00 01 00 02 B2 E2
			15 00 00 00 01 00 02 B3 01
			15 00 00 00 01 00 02 B4 E6
			15 00 00 00 01 00 02 B5 01
			15 00 00 00 01 00 02 B6 EA
			15 00 00 00 01 00 02 B7 01
			15 00 00 00 01 00 02 B8 EE
			15 00 00 00 01 00 02 B9 01
			15 00 00 00 01 00 02 BA F2
			15 00 00 00 01 00 02 BB 01
			15 00 00 00 01 00 02 BC F6
			15 00 00 00 01 00 02 BD 01
			15 00 00 00 01 00 02 BE FA
			15 00 00 00 01 00 02 BF 01
			15 00 00 00 01 00 02 C0 FE
			15 00 00 00 01 00 02 C1 02
			15 00 00 00 01 00 02 C2 0D
			15 00 00 00 01 00 02 C3 02
			15 00 00 00 01 00 02 C4 1A
			15 00 00 00 01 00 02 C5 02
			15 00 00 00 01 00 02 C6 33
			15 00 00 00 01 00 02 C7 02
			15 00 00 00 01 00 02 C8 4A
			15 00 00 00 01 00 02 C9 02
			15 00 00 00 01 00 02 CA 75
			15 00 00 00 01 00 02 CB 02
			15 00 00 00 01 00 02 CC A0
			15 00 00 00 01 00 02 CD 02
			15 00 00 00 01 00 02 CE A1
			15 00 00 00 01 00 02 CF 02
			15 00 00 00 01 00 02 D0 CE
			15 00 00 00 01 00 02 D1 03
			15 00 00 00 01 00 02 D2 00
			15 00 00 00 01 00 02 D3 03
			15 00 00 00 01 00 02 D4 23
			15 00 00 00 01 00 02 D5 03
			15 00 00 00 01 00 02 D6 4C
			15 00 00 00 01 00 02 D7 03
			15 00 00 00 01 00 02 D8 65
			15 00 00 00 01 00 02 D9 03
			15 00 00 00 01 00 02 DA 85
			15 00 00 00 01 00 02 DB 03
			15 00 00 00 01 00 02 DC 8E
			15 00 00 00 01 00 02 DD 03
			15 00 00 00 01 00 02 DE 99
			15 00 00 00 01 00 02 DF 03
			15 00 00 00 01 00 02 E0 A4
			15 00 00 00 01 00 02 E1 03
			15 00 00 00 01 00 02 E2 B1
			15 00 00 00 01 00 02 E3 03
			15 00 00 00 01 00 02 E4 BD
			15 00 00 00 01 00 02 E5 03
			15 00 00 00 01 00 02 E6 C7
			15 00 00 00 01 00 02 E7 03
			15 00 00 00 01 00 02 E8 CC
			15 00 00 00 01 00 02 E9 03
			15 00 00 00 01 00 02 EA FF
			15 00 00 00 01 00 02 FB 01
			15 01 00 00 01 00 02 FF 10
		];
		qcom,mdss-dsi-dispparam-papermode3-state = "dsi_hs_mode";
		qcom,mdss-dsi-dispparam-papermode4-command = [
			15 01 00 00 78 00 02 FF 20
			15 00 00 00 01 00 02 FB 01

			15 00 00 00 01 00 02 75 00
			15 00 00 00 01 00 02 76 C8
			15 00 00 00 01 00 02 77 00
			15 00 00 00 01 00 02 78 D2
			15 00 00 00 01 00 02 79 00
			15 00 00 00 01 00 02 7A E5
			15 00 00 00 01 00 02 7B 00
			15 00 00 00 01 00 02 7C F6
			15 00 00 00 01 00 02 7D 01
			15 00 00 00 01 00 02 7E 06
			15 00 00 00 01 00 02 7F 01
			15 00 00 00 01 00 02 80 15
			15 00 00 00 01 00 02 81 01
			15 00 00 00 01 00 02 82 22
			15 00 00 00 01 00 02 83 01
			15 00 00 00 01 00 02 84 2F
			15 00 00 00 01 00 02 85 01
			15 00 00 00 01 00 02 86 3C
			15 00 00 00 01 00 02 87 01
			15 00 00 00 01 00 02 88 66
			15 00 00 00 01 00 02 89 01
			15 00 00 00 01 00 02 8A 89
			15 00 00 00 01 00 02 8B 01
			15 00 00 00 01 00 02 8C C2
			15 00 00 00 01 00 02 8D 01
			15 00 00 00 01 00 02 8E EE
			15 00 00 00 01 00 02 8F 02
			15 00 00 00 01 00 02 90 34
			15 00 00 00 01 00 02 91 02
			15 00 00 00 01 00 02 92 6D
			15 00 00 00 01 00 02 93 02
			15 00 00 00 01 00 02 94 6F
			15 00 00 00 01 00 02 95 02
			15 00 00 00 01 00 02 96 A6
			15 00 00 00 01 00 02 97 02
			15 00 00 00 01 00 02 98 E1
			15 00 00 00 01 00 02 99 03
			15 00 00 00 01 00 02 9A 04
			15 00 00 00 01 00 02 9B 03
			15 00 00 00 01 00 02 9C 33
			15 00 00 00 01 00 02 9D 03
			15 00 00 00 01 00 02 9E 4F
			15 00 00 00 01 00 02 9F 03
			15 00 00 00 01 00 02 A0 72
			15 00 00 00 01 00 02 A2 03
			15 00 00 00 01 00 02 A3 7C
			15 00 00 00 01 00 02 A4 03
			15 00 00 00 01 00 02 A5 88
			15 00 00 00 01 00 02 A6 03
			15 00 00 00 01 00 02 A7 95
			15 00 00 00 01 00 02 A9 03
			15 00 00 00 01 00 02 AA A3
			15 00 00 00 01 00 02 AB 03
			15 00 00 00 01 00 02 AC B4
			15 00 00 00 01 00 02 AD 03
			15 00 00 00 01 00 02 AE C3
			15 00 00 00 01 00 02 AF 03
			15 00 00 00 01 00 02 B0 CD
			15 00 00 00 01 00 02 B1 03
			15 00 00 00 01 00 02 B2 FF

			15 00 00 00 01 00 02 B3 00
			15 00 00 00 01 00 02 B4 C8
			15 00 00 00 01 00 02 B5 00
			15 00 00 00 01 00 02 B6 D2
			15 00 00 00 01 00 02 B7 00
			15 00 00 00 01 00 02 B8 E5
			15 00 00 00 01 00 02 B9 00
			15 00 00 00 01 00 02 BA F6
			15 00 00 00 01 00 02 BB 01
			15 00 00 00 01 00 02 BC 06
			15 00 00 00 01 00 02 BD 01
			15 00 00 00 01 00 02 BE 15
			15 00 00 00 01 00 02 BF 01
			15 00 00 00 01 00 02 C0 22
			15 00 00 00 01 00 02 C1 01
			15 00 00 00 01 00 02 C2 2F
			15 00 00 00 01 00 02 C3 01
			15 00 00 00 01 00 02 C4 3C
			15 00 00 00 01 00 02 C5 01
			15 00 00 00 01 00 02 C6 66
			15 00 00 00 01 00 02 C7 01
			15 00 00 00 01 00 02 C8 89
			15 00 00 00 01 00 02 C9 01
			15 00 00 00 01 00 02 CA C2
			15 00 00 00 01 00 02 CB 01
			15 00 00 00 01 00 02 CC EE
			15 00 00 00 01 00 02 CD 02
			15 00 00 00 01 00 02 CE 34
			15 00 00 00 01 00 02 CF 02
			15 00 00 00 01 00 02 D0 6D
			15 00 00 00 01 00 02 D1 02
			15 00 00 00 01 00 02 D2 6F
			15 00 00 00 01 00 02 D3 02
			15 00 00 00 01 00 02 D4 A6
			15 00 00 00 01 00 02 D5 02
			15 00 00 00 01 00 02 D6 E1
			15 00 00 00 01 00 02 D7 03
			15 00 00 00 01 00 02 D8 04
			15 00 00 00 01 00 02 D9 03
			15 00 00 00 01 00 02 DA 33
			15 00 00 00 01 00 02 DB 03
			15 00 00 00 01 00 02 DC 4F
			15 00 00 00 01 00 02 DD 03
			15 00 00 00 01 00 02 DE 72
			15 00 00 00 01 00 02 DF 03
			15 00 00 00 01 00 02 E0 7C
			15 00 00 00 01 00 02 E1 03
			15 00 00 00 01 00 02 E2 88
			15 00 00 00 01 00 02 E3 03
			15 00 00 00 01 00 02 E4 95
			15 00 00 00 01 00 02 E5 03
			15 00 00 00 01 00 02 E6 A3
			15 00 00 00 01 00 02 E7 03
			15 00 00 00 01 00 02 E8 B4
			15 00 00 00 01 00 02 E9 03
			15 00 00 00 01 00 02 EA C3
			15 00 00 00 01 00 02 EB 03
			15 00 00 00 01 00 02 EC CD
			15 00 00 00 01 00 02 ED 03
			15 00 00 00 01 00 02 EE FF

			15 00 00 00 01 00 02 EF 00
			15 00 00 00 01 00 02 F0 C8
			15 00 00 00 01 00 02 F1 00
			15 00 00 00 01 00 02 F2 D3
			15 00 00 00 01 00 02 F3 00
			15 00 00 00 01 00 02 F4 E6
			15 00 00 00 01 00 02 F5 00
			15 00 00 00 01 00 02 F6 F8
			15 00 00 00 01 00 02 F7 01
			15 00 00 00 01 00 02 F8 09
			15 00 00 00 01 00 02 F9 01
			15 00 00 00 01 00 02 FA 18
			15 00 00 00 01 00 02 FF 21
			15 00 00 00 01 00 02 FB 01
			15 00 00 00 01 00 02 00 01
			15 00 00 00 01 00 02 01 26
			15 00 00 00 01 00 02 02 01
			15 00 00 00 01 00 02 03 33
			15 00 00 00 01 00 02 04 01
			15 00 00 00 01 00 02 05 3F
			15 00 00 00 01 00 02 06 01
			15 00 00 00 01 00 02 07 6B
			15 00 00 00 01 00 02 08 01
			15 00 00 00 01 00 02 09 8E
			15 00 00 00 01 00 02 0A 01
			15 00 00 00 01 00 02 0B C7
			15 00 00 00 01 00 02 0C 01
			15 00 00 00 01 00 02 0D F2
			15 00 00 00 01 00 02 0E 02
			15 00 00 00 01 00 02 0F 37
			15 00 00 00 01 00 02 10 02
			15 00 00 00 01 00 02 11 70
			15 00 00 00 01 00 02 12 02
			15 00 00 00 01 00 02 13 72
			15 00 00 00 01 00 02 14 02
			15 00 00 00 01 00 02 15 A8
			15 00 00 00 01 00 02 16 02
			15 00 00 00 01 00 02 17 E3
			15 00 00 00 01 00 02 18 03
			15 00 00 00 01 00 02 19 05
			15 00 00 00 01 00 02 1A 03
			15 00 00 00 01 00 02 1B 34
			15 00 00 00 01 00 02 1C 03
			15 00 00 00 01 00 02 1D 50
			15 00 00 00 01 00 02 1E 03
			15 00 00 00 01 00 02 1F 73
			15 00 00 00 01 00 02 20 03
			15 00 00 00 01 00 02 21 7D
			15 00 00 00 01 00 02 22 03
			15 00 00 00 01 00 02 23 89
			15 00 00 00 01 00 02 24 03
			15 00 00 00 01 00 02 25 96
			15 00 00 00 01 00 02 26 03
			15 00 00 00 01 00 02 27 A5
			15 00 00 00 01 00 02 28 03
			15 00 00 00 01 00 02 29 B5
			15 00 00 00 01 00 02 2A 03
			15 00 00 00 01 00 02 2B C3
			15 00 00 00 01 00 02 2D 03
			15 00 00 00 01 00 02 2F CC
			15 00 00 00 01 00 02 30 03
			15 00 00 00 01 00 02 31 FF
			15 00 00 00 01 00 02 32 00
			15 00 00 00 01 00 02 33 C8
			15 00 00 00 01 00 02 34 00
			15 00 00 00 01 00 02 35 D3
			15 00 00 00 01 00 02 36 00
			15 00 00 00 01 00 02 37 E6
			15 00 00 00 01 00 02 38 00
			15 00 00 00 01 00 02 39 F8
			15 00 00 00 01 00 02 3A 01
			15 00 00 00 01 00 02 3B 09
			15 00 00 00 01 00 02 3D 01
			15 00 00 00 01 00 02 3F 18
			15 00 00 00 01 00 02 40 01
			15 00 00 00 01 00 02 41 26
			15 00 00 00 01 00 02 42 01
			15 00 00 00 01 00 02 43 33
			15 00 00 00 01 00 02 44 01
			15 00 00 00 01 00 02 45 3F
			15 00 00 00 01 00 02 46 01
			15 00 00 00 01 00 02 47 6B
			15 00 00 00 01 00 02 48 01
			15 00 00 00 01 00 02 49 8E
			15 00 00 00 01 00 02 4A 01
			15 00 00 00 01 00 02 4B C7
			15 00 00 00 01 00 02 4C 01
			15 00 00 00 01 00 02 4D F2
			15 00 00 00 01 00 02 4E 02
			15 00 00 00 01 00 02 4F 37
			15 00 00 00 01 00 02 50 02
			15 00 00 00 01 00 02 51 70
			15 00 00 00 01 00 02 52 02
			15 00 00 00 01 00 02 53 72
			15 00 00 00 01 00 02 54 02
			15 00 00 00 01 00 02 55 A8
			15 00 00 00 01 00 02 56 02
			15 00 00 00 01 00 02 58 E3
			15 00 00 00 01 00 02 59 03
			15 00 00 00 01 00 02 5A 05
			15 00 00 00 01 00 02 5B 03
			15 00 00 00 01 00 02 5C 34
			15 00 00 00 01 00 02 5D 03
			15 00 00 00 01 00 02 5E 50
			15 00 00 00 01 00 02 5F 03
			15 00 00 00 01 00 02 60 73
			15 00 00 00 01 00 02 61 03
			15 00 00 00 01 00 02 62 7D
			15 00 00 00 01 00 02 63 03
			15 00 00 00 01 00 02 64 89
			15 00 00 00 01 00 02 65 03
			15 00 00 00 01 00 02 66 96
			15 00 00 00 01 00 02 67 03
			15 00 00 00 01 00 02 68 A5
			15 00 00 00 01 00 02 69 03
			15 00 00 00 01 00 02 6A B5
			15 00 00 00 01 00 02 6B 03
			15 00 00 00 01 00 02 6C C3
			15 00 00 00 01 00 02 6D 03
			15 00 00 00 01 00 02 6E CC
			15 00 00 00 01 00 02 6F 03
			15 00 00 00 01 00 02 70 FF
			15 00 00 00 01 00 02 71 01
			15 00 00 00 01 00 02 72 F4
			15 00 00 00 01 00 02 73 01
			15 00 00 00 01 00 02 74 F6
			15 00 00 00 01 00 02 75 01
			15 00 00 00 01 00 02 76 FA
			15 00 00 00 01 00 02 77 01
			15 00 00 00 01 00 02 78 FE
			15 00 00 00 01 00 02 79 02
			15 00 00 00 01 00 02 7A 01
			15 00 00 00 01 00 02 7B 02
			15 00 00 00 01 00 02 7C 05
			15 00 00 00 01 00 02 7D 02
			15 00 00 00 01 00 02 7E 08
			15 00 00 00 01 00 02 7F 02
			15 00 00 00 01 00 02 80 0C
			15 00 00 00 01 00 02 81 02
			15 00 00 00 01 00 02 82 0F
			15 00 00 00 01 00 02 83 02
			15 00 00 00 01 00 02 84 1C
			15 00 00 00 01 00 02 85 02
			15 00 00 00 01 00 02 86 28
			15 00 00 00 01 00 02 87 02
			15 00 00 00 01 00 02 88 3E
			15 00 00 00 01 00 02 89 02
			15 00 00 00 01 00 02 8A 54
			15 00 00 00 01 00 02 8B 02
			15 00 00 00 01 00 02 8C 7D
			15 00 00 00 01 00 02 8D 02
			15 00 00 00 01 00 02 8E A6
			15 00 00 00 01 00 02 8F 02
			15 00 00 00 01 00 02 90 A8
			15 00 00 00 01 00 02 91 02
			15 00 00 00 01 00 02 92 D3
			15 00 00 00 01 00 02 93 03
			15 00 00 00 01 00 02 94 05
			15 00 00 00 01 00 02 95 03
			15 00 00 00 01 00 02 96 27
			15 00 00 00 01 00 02 97 03
			15 00 00 00 01 00 02 98 4F
			15 00 00 00 01 00 02 99 03
			15 00 00 00 01 00 02 9A 68
			15 00 00 00 01 00 02 9B 03
			15 00 00 00 01 00 02 9C 87
			15 00 00 00 01 00 02 9D 03
			15 00 00 00 01 00 02 9E 91
			15 00 00 00 01 00 02 9F 03
			15 00 00 00 01 00 02 A0 9B
			15 00 00 00 01 00 02 A2 03
			15 00 00 00 01 00 02 A3 A7
			15 00 00 00 01 00 02 A4 03
			15 00 00 00 01 00 02 A5 B2
			15 00 00 00 01 00 02 A6 03
			15 00 00 00 01 00 02 A7 BE
			15 00 00 00 01 00 02 A9 03
			15 00 00 00 01 00 02 AA C7
			15 00 00 00 01 00 02 AB 03
			15 00 00 00 01 00 02 AC CC
			15 00 00 00 01 00 02 AD 03
			15 00 00 00 01 00 02 AE FF

			15 00 00 00 01 00 02 AF 01
			15 00 00 00 01 00 02 B0 F4
			15 00 00 00 01 00 02 B1 01
			15 00 00 00 01 00 02 B2 F6
			15 00 00 00 01 00 02 B3 01
			15 00 00 00 01 00 02 B4 FA
			15 00 00 00 01 00 02 B5 01
			15 00 00 00 01 00 02 B6 FE
			15 00 00 00 01 00 02 B7 02
			15 00 00 00 01 00 02 B8 01
			15 00 00 00 01 00 02 B9 02
			15 00 00 00 01 00 02 BA 05
			15 00 00 00 01 00 02 BB 02
			15 00 00 00 01 00 02 BC 08
			15 00 00 00 01 00 02 BD 02
			15 00 00 00 01 00 02 BE 0C
			15 00 00 00 01 00 02 BF 02
			15 00 00 00 01 00 02 C0 0F
			15 00 00 00 01 00 02 C1 02
			15 00 00 00 01 00 02 C2 1C
			15 00 00 00 01 00 02 C3 02
			15 00 00 00 01 00 02 C4 28
			15 00 00 00 01 00 02 C5 02
			15 00 00 00 01 00 02 C6 3E
			15 00 00 00 01 00 02 C7 02
			15 00 00 00 01 00 02 C8 54
			15 00 00 00 01 00 02 C9 02
			15 00 00 00 01 00 02 CA 7D
			15 00 00 00 01 00 02 CB 02
			15 00 00 00 01 00 02 CC A6
			15 00 00 00 01 00 02 CD 02
			15 00 00 00 01 00 02 CE A8
			15 00 00 00 01 00 02 CF 02
			15 00 00 00 01 00 02 D0 D3
			15 00 00 00 01 00 02 D1 03
			15 00 00 00 01 00 02 D2 05
			15 00 00 00 01 00 02 D3 03
			15 00 00 00 01 00 02 D4 27
			15 00 00 00 01 00 02 D5 03
			15 00 00 00 01 00 02 D6 4F
			15 00 00 00 01 00 02 D7 03
			15 00 00 00 01 00 02 D8 68
			15 00 00 00 01 00 02 D9 03
			15 00 00 00 01 00 02 DA 87
			15 00 00 00 01 00 02 DB 03
			15 00 00 00 01 00 02 DC 91
			15 00 00 00 01 00 02 DD 03
			15 00 00 00 01 00 02 DE 9B
			15 00 00 00 01 00 02 DF 03
			15 00 00 00 01 00 02 E0 A7
			15 00 00 00 01 00 02 E1 03
			15 00 00 00 01 00 02 E2 B2
			15 00 00 00 01 00 02 E3 03
			15 00 00 00 01 00 02 E4 BE
			15 00 00 00 01 00 02 E5 03
			15 00 00 00 01 00 02 E6 C7
			15 00 00 00 01 00 02 E7 03
			15 00 00 00 01 00 02 E8 CC
			15 00 00 00 01 00 02 E9 03
			15 00 00 00 01 00 02 EA FF
			15 00 00 00 01 00 02 FB 01
			15 01 00 00 01 00 02 FF 10
		];
		qcom,mdss-dsi-dispparam-papermode4-state = "dsi_hs_mode";
		qcom,mdss-dsi-dispparam-papermode5-command = [
			15 01 00 00 78 00 02 FF 20
			15 00 00 00 01 00 02 FB 01

			15 00 00 00 01 00 02 75 00
			15 00 00 00 01 00 02 76 C8
			15 00 00 00 01 00 02 77 00
			15 00 00 00 01 00 02 78 D2
			15 00 00 00 01 00 02 79 00
			15 00 00 00 01 00 02 7A E5
			15 00 00 00 01 00 02 7B 00
			15 00 00 00 01 00 02 7C F6
			15 00 00 00 01 00 02 7D 01
			15 00 00 00 01 00 02 7E 06
			15 00 00 00 01 00 02 7F 01
			15 00 00 00 01 00 02 80 15
			15 00 00 00 01 00 02 81 01
			15 00 00 00 01 00 02 82 22
			15 00 00 00 01 00 02 83 01
			15 00 00 00 01 00 02 84 2F
			15 00 00 00 01 00 02 85 01
			15 00 00 00 01 00 02 86 3C
			15 00 00 00 01 00 02 87 01
			15 00 00 00 01 00 02 88 66
			15 00 00 00 01 00 02 89 01
			15 00 00 00 01 00 02 8A 89
			15 00 00 00 01 00 02 8B 01
			15 00 00 00 01 00 02 8C C2
			15 00 00 00 01 00 02 8D 01
			15 00 00 00 01 00 02 8E EE
			15 00 00 00 01 00 02 8F 02
			15 00 00 00 01 00 02 90 34
			15 00 00 00 01 00 02 91 02
			15 00 00 00 01 00 02 92 6D
			15 00 00 00 01 00 02 93 02
			15 00 00 00 01 00 02 94 6F
			15 00 00 00 01 00 02 95 02
			15 00 00 00 01 00 02 96 A6
			15 00 00 00 01 00 02 97 02
			15 00 00 00 01 00 02 98 E1
			15 00 00 00 01 00 02 99 03
			15 00 00 00 01 00 02 9A 04
			15 00 00 00 01 00 02 9B 03
			15 00 00 00 01 00 02 9C 33
			15 00 00 00 01 00 02 9D 03
			15 00 00 00 01 00 02 9E 4F
			15 00 00 00 01 00 02 9F 03
			15 00 00 00 01 00 02 A0 72
			15 00 00 00 01 00 02 A2 03
			15 00 00 00 01 00 02 A3 7C
			15 00 00 00 01 00 02 A4 03
			15 00 00 00 01 00 02 A5 88
			15 00 00 00 01 00 02 A6 03
			15 00 00 00 01 00 02 A7 95
			15 00 00 00 01 00 02 A9 03
			15 00 00 00 01 00 02 AA A3
			15 00 00 00 01 00 02 AB 03
			15 00 00 00 01 00 02 AC B4
			15 00 00 00 01 00 02 AD 03
			15 00 00 00 01 00 02 AE C3
			15 00 00 00 01 00 02 AF 03
			15 00 00 00 01 00 02 B0 CD
			15 00 00 00 01 00 02 B1 03
			15 00 00 00 01 00 02 B2 FF

			15 00 00 00 01 00 02 B3 00
			15 00 00 00 01 00 02 B4 C8
			15 00 00 00 01 00 02 B5 00
			15 00 00 00 01 00 02 B6 D2
			15 00 00 00 01 00 02 B7 00
			15 00 00 00 01 00 02 B8 E5
			15 00 00 00 01 00 02 B9 00
			15 00 00 00 01 00 02 BA F6
			15 00 00 00 01 00 02 BB 01
			15 00 00 00 01 00 02 BC 06
			15 00 00 00 01 00 02 BD 01
			15 00 00 00 01 00 02 BE 15
			15 00 00 00 01 00 02 BF 01
			15 00 00 00 01 00 02 C0 22
			15 00 00 00 01 00 02 C1 01
			15 00 00 00 01 00 02 C2 2F
			15 00 00 00 01 00 02 C3 01
			15 00 00 00 01 00 02 C4 3C
			15 00 00 00 01 00 02 C5 01
			15 00 00 00 01 00 02 C6 66
			15 00 00 00 01 00 02 C7 01
			15 00 00 00 01 00 02 C8 89
			15 00 00 00 01 00 02 C9 01
			15 00 00 00 01 00 02 CA C2
			15 00 00 00 01 00 02 CB 01
			15 00 00 00 01 00 02 CC EE
			15 00 00 00 01 00 02 CD 02
			15 00 00 00 01 00 02 CE 34
			15 00 00 00 01 00 02 CF 02
			15 00 00 00 01 00 02 D0 6D
			15 00 00 00 01 00 02 D1 02
			15 00 00 00 01 00 02 D2 6F
			15 00 00 00 01 00 02 D3 02
			15 00 00 00 01 00 02 D4 A6
			15 00 00 00 01 00 02 D5 02
			15 00 00 00 01 00 02 D6 E1
			15 00 00 00 01 00 02 D7 03
			15 00 00 00 01 00 02 D8 04
			15 00 00 00 01 00 02 D9 03
			15 00 00 00 01 00 02 DA 33
			15 00 00 00 01 00 02 DB 03
			15 00 00 00 01 00 02 DC 4F
			15 00 00 00 01 00 02 DD 03
			15 00 00 00 01 00 02 DE 72
			15 00 00 00 01 00 02 DF 03
			15 00 00 00 01 00 02 E0 7C
			15 00 00 00 01 00 02 E1 03
			15 00 00 00 01 00 02 E2 88
			15 00 00 00 01 00 02 E3 03
			15 00 00 00 01 00 02 E4 95
			15 00 00 00 01 00 02 E5 03
			15 00 00 00 01 00 02 E6 A3
			15 00 00 00 01 00 02 E7 03
			15 00 00 00 01 00 02 E8 B4
			15 00 00 00 01 00 02 E9 03
			15 00 00 00 01 00 02 EA C3
			15 00 00 00 01 00 02 EB 03
			15 00 00 00 01 00 02 EC CD
			15 00 00 00 01 00 02 ED 03
			15 00 00 00 01 00 02 EE FF

			15 00 00 00 01 00 02 EF 00
			15 00 00 00 01 00 02 F0 C8
			15 00 00 00 01 00 02 F1 00
			15 00 00 00 01 00 02 F2 D3
			15 00 00 00 01 00 02 F3 00
			15 00 00 00 01 00 02 F4 E6
			15 00 00 00 01 00 02 F5 00
			15 00 00 00 01 00 02 F6 F8
			15 00 00 00 01 00 02 F7 01
			15 00 00 00 01 00 02 F8 09
			15 00 00 00 01 00 02 F9 01
			15 00 00 00 01 00 02 FA 18
			15 00 00 00 01 00 02 FF 21
			15 00 00 00 01 00 02 FB 01
			15 00 00 00 01 00 02 00 01
			15 00 00 00 01 00 02 01 26
			15 00 00 00 01 00 02 02 01
			15 00 00 00 01 00 02 03 33
			15 00 00 00 01 00 02 04 01
			15 00 00 00 01 00 02 05 3F
			15 00 00 00 01 00 02 06 01
			15 00 00 00 01 00 02 07 6B
			15 00 00 00 01 00 02 08 01
			15 00 00 00 01 00 02 09 8E
			15 00 00 00 01 00 02 0A 01
			15 00 00 00 01 00 02 0B C7
			15 00 00 00 01 00 02 0C 01
			15 00 00 00 01 00 02 0D F2
			15 00 00 00 01 00 02 0E 02
			15 00 00 00 01 00 02 0F 37
			15 00 00 00 01 00 02 10 02
			15 00 00 00 01 00 02 11 70
			15 00 00 00 01 00 02 12 02
			15 00 00 00 01 00 02 13 72
			15 00 00 00 01 00 02 14 02
			15 00 00 00 01 00 02 15 A8
			15 00 00 00 01 00 02 16 02
			15 00 00 00 01 00 02 17 E3
			15 00 00 00 01 00 02 18 03
			15 00 00 00 01 00 02 19 05
			15 00 00 00 01 00 02 1A 03
			15 00 00 00 01 00 02 1B 34
			15 00 00 00 01 00 02 1C 03
			15 00 00 00 01 00 02 1D 50
			15 00 00 00 01 00 02 1E 03
			15 00 00 00 01 00 02 1F 73
			15 00 00 00 01 00 02 20 03
			15 00 00 00 01 00 02 21 7D
			15 00 00 00 01 00 02 22 03
			15 00 00 00 01 00 02 23 89
			15 00 00 00 01 00 02 24 03
			15 00 00 00 01 00 02 25 96
			15 00 00 00 01 00 02 26 03
			15 00 00 00 01 00 02 27 A5
			15 00 00 00 01 00 02 28 03
			15 00 00 00 01 00 02 29 B5
			15 00 00 00 01 00 02 2A 03
			15 00 00 00 01 00 02 2B C3
			15 00 00 00 01 00 02 2D 03
			15 00 00 00 01 00 02 2F CC
			15 00 00 00 01 00 02 30 03
			15 00 00 00 01 00 02 31 FF
			15 00 00 00 01 00 02 32 00
			15 00 00 00 01 00 02 33 C8
			15 00 00 00 01 00 02 34 00
			15 00 00 00 01 00 02 35 D3
			15 00 00 00 01 00 02 36 00
			15 00 00 00 01 00 02 37 E6
			15 00 00 00 01 00 02 38 00
			15 00 00 00 01 00 02 39 F8
			15 00 00 00 01 00 02 3A 01
			15 00 00 00 01 00 02 3B 09
			15 00 00 00 01 00 02 3D 01
			15 00 00 00 01 00 02 3F 18
			15 00 00 00 01 00 02 40 01
			15 00 00 00 01 00 02 41 26
			15 00 00 00 01 00 02 42 01
			15 00 00 00 01 00 02 43 33
			15 00 00 00 01 00 02 44 01
			15 00 00 00 01 00 02 45 3F
			15 00 00 00 01 00 02 46 01
			15 00 00 00 01 00 02 47 6B
			15 00 00 00 01 00 02 48 01
			15 00 00 00 01 00 02 49 8E
			15 00 00 00 01 00 02 4A 01
			15 00 00 00 01 00 02 4B C7
			15 00 00 00 01 00 02 4C 01
			15 00 00 00 01 00 02 4D F2
			15 00 00 00 01 00 02 4E 02
			15 00 00 00 01 00 02 4F 37
			15 00 00 00 01 00 02 50 02
			15 00 00 00 01 00 02 51 70
			15 00 00 00 01 00 02 52 02
			15 00 00 00 01 00 02 53 72
			15 00 00 00 01 00 02 54 02
			15 00 00 00 01 00 02 55 A8
			15 00 00 00 01 00 02 56 02
			15 00 00 00 01 00 02 58 E3
			15 00 00 00 01 00 02 59 03
			15 00 00 00 01 00 02 5A 05
			15 00 00 00 01 00 02 5B 03
			15 00 00 00 01 00 02 5C 34
			15 00 00 00 01 00 02 5D 03
			15 00 00 00 01 00 02 5E 50
			15 00 00 00 01 00 02 5F 03
			15 00 00 00 01 00 02 60 73
			15 00 00 00 01 00 02 61 03
			15 00 00 00 01 00 02 62 7D
			15 00 00 00 01 00 02 63 03
			15 00 00 00 01 00 02 64 89
			15 00 00 00 01 00 02 65 03
			15 00 00 00 01 00 02 66 96
			15 00 00 00 01 00 02 67 03
			15 00 00 00 01 00 02 68 A5
			15 00 00 00 01 00 02 69 03
			15 00 00 00 01 00 02 6A B5
			15 00 00 00 01 00 02 6B 03
			15 00 00 00 01 00 02 6C C3
			15 00 00 00 01 00 02 6D 03
			15 00 00 00 01 00 02 6E CC
			15 00 00 00 01 00 02 6F 03
			15 00 00 00 01 00 02 70 FF
			15 00 00 00 01 00 02 71 02
			15 00 00 00 01 00 02 72 0C
			15 00 00 00 01 00 02 73 02
			15 00 00 00 01 00 02 74 0E
			15 00 00 00 01 00 02 75 02
			15 00 00 00 01 00 02 76 11
			15 00 00 00 01 00 02 77 02
			15 00 00 00 01 00 02 78 14
			15 00 00 00 01 00 02 79 02
			15 00 00 00 01 00 02 7A 17
			15 00 00 00 01 00 02 7B 02
			15 00 00 00 01 00 02 7C 1A
			15 00 00 00 01 00 02 7D 02
			15 00 00 00 01 00 02 7E 1D
			15 00 00 00 01 00 02 7F 02
			15 00 00 00 01 00 02 80 20
			15 00 00 00 01 00 02 81 02
			15 00 00 00 01 00 02 82 22
			15 00 00 00 01 00 02 83 02
			15 00 00 00 01 00 02 84 2E
			15 00 00 00 01 00 02 85 02
			15 00 00 00 01 00 02 86 38
			15 00 00 00 01 00 02 87 02
			15 00 00 00 01 00 02 88 4D
			15 00 00 00 01 00 02 89 02
			15 00 00 00 01 00 02 8A 61
			15 00 00 00 01 00 02 8B 02
			15 00 00 00 01 00 02 8C 88
			15 00 00 00 01 00 02 8D 02
			15 00 00 00 01 00 02 8E AF
			15 00 00 00 01 00 02 8F 02
			15 00 00 00 01 00 02 90 B0
			15 00 00 00 01 00 02 91 02
			15 00 00 00 01 00 02 92 DA
			15 00 00 00 01 00 02 93 03
			15 00 00 00 01 00 02 94 0B
			15 00 00 00 01 00 02 95 03
			15 00 00 00 01 00 02 96 2D
			15 00 00 00 01 00 02 97 03
			15 00 00 00 01 00 02 98 54
			15 00 00 00 01 00 02 99 03
			15 00 00 00 01 00 02 9A 6C
			15 00 00 00 01 00 02 9B 03
			15 00 00 00 01 00 02 9C 8B
			15 00 00 00 01 00 02 9D 03
			15 00 00 00 01 00 02 9E 94
			15 00 00 00 01 00 02 9F 03
			15 00 00 00 01 00 02 A0 9E
			15 00 00 00 01 00 02 A2 03
			15 00 00 00 01 00 02 A3 A9
			15 00 00 00 01 00 02 A4 03
			15 00 00 00 01 00 02 A5 B5
			15 00 00 00 01 00 02 A6 03
			15 00 00 00 01 00 02 A7 BF
			15 00 00 00 01 00 02 A9 03
			15 00 00 00 01 00 02 AA C8
			15 00 00 00 01 00 02 AB 03
			15 00 00 00 01 00 02 AC EE
			15 00 00 00 01 00 02 AD 03
			15 00 00 00 01 00 02 AE FF

			15 00 00 00 01 00 02 AF 02
			15 00 00 00 01 00 02 B0 0C
			15 00 00 00 01 00 02 B1 02
			15 00 00 00 01 00 02 B2 0E
			15 00 00 00 01 00 02 B3 02
			15 00 00 00 01 00 02 B4 11
			15 00 00 00 01 00 02 B5 02
			15 00 00 00 01 00 02 B6 14
			15 00 00 00 01 00 02 B7 02
			15 00 00 00 01 00 02 B8 17
			15 00 00 00 01 00 02 B9 02
			15 00 00 00 01 00 02 BA 1A
			15 00 00 00 01 00 02 BB 02
			15 00 00 00 01 00 02 BC 1D
			15 00 00 00 01 00 02 BD 02
			15 00 00 00 01 00 02 BE 20
			15 00 00 00 01 00 02 BF 02
			15 00 00 00 01 00 02 C0 22
			15 00 00 00 01 00 02 C1 02
			15 00 00 00 01 00 02 C2 2E
			15 00 00 00 01 00 02 C3 02
			15 00 00 00 01 00 02 C4 38
			15 00 00 00 01 00 02 C5 02
			15 00 00 00 01 00 02 C6 4D
			15 00 00 00 01 00 02 C7 02
			15 00 00 00 01 00 02 C8 61
			15 00 00 00 01 00 02 C9 02
			15 00 00 00 01 00 02 CA 88
			15 00 00 00 01 00 02 CB 02
			15 00 00 00 01 00 02 CC AF
			15 00 00 00 01 00 02 CD 02
			15 00 00 00 01 00 02 CE B0
			15 00 00 00 01 00 02 CF 02
			15 00 00 00 01 00 02 D0 DA
			15 00 00 00 01 00 02 D1 03
			15 00 00 00 01 00 02 D2 0B
			15 00 00 00 01 00 02 D3 03
			15 00 00 00 01 00 02 D4 2D
			15 00 00 00 01 00 02 D5 03
			15 00 00 00 01 00 02 D6 54
			15 00 00 00 01 00 02 D7 03
			15 00 00 00 01 00 02 D8 6C
			15 00 00 00 01 00 02 D9 03
			15 00 00 00 01 00 02 DA 8B
			15 00 00 00 01 00 02 DB 03
			15 00 00 00 01 00 02 DC 94
			15 00 00 00 01 00 02 DD 03
			15 00 00 00 01 00 02 DE 9E
			15 00 00 00 01 00 02 DF 03
			15 00 00 00 01 00 02 E0 A9
			15 00 00 00 01 00 02 E1 03
			15 00 00 00 01 00 02 E2 B5
			15 00 00 00 01 00 02 E3 03
			15 00 00 00 01 00 02 E4 BF
			15 00 00 00 01 00 02 E5 03
			15 00 00 00 01 00 02 E6 C8
			15 00 00 00 01 00 02 E7 03
			15 00 00 00 01 00 02 E8 EE
			15 00 00 00 01 00 02 E9 03
			15 00 00 00 01 00 02 EA FF
			15 00 00 00 01 00 02 FB 01
			15 01 00 00 01 00 02 FF 10
		];
		qcom,mdss-dsi-dispparam-papermode5-state = "dsi_hs_mode";
		qcom,mdss-dsi-dispparam-papermode6-command = [
			15 01 00 00 78 00 02 FF 20
			15 00 00 00 01 00 02 FB 01

			15 00 00 00 01 00 02 75 00
			15 00 00 00 01 00 02 76 C8
			15 00 00 00 01 00 02 77 00
			15 00 00 00 01 00 02 78 D2
			15 00 00 00 01 00 02 79 00
			15 00 00 00 01 00 02 7A E5
			15 00 00 00 01 00 02 7B 00
			15 00 00 00 01 00 02 7C F6
			15 00 00 00 01 00 02 7D 01
			15 00 00 00 01 00 02 7E 06
			15 00 00 00 01 00 02 7F 01
			15 00 00 00 01 00 02 80 15
			15 00 00 00 01 00 02 81 01
			15 00 00 00 01 00 02 82 22
			15 00 00 00 01 00 02 83 01
			15 00 00 00 01 00 02 84 2F
			15 00 00 00 01 00 02 85 01
			15 00 00 00 01 00 02 86 3C
			15 00 00 00 01 00 02 87 01
			15 00 00 00 01 00 02 88 66
			15 00 00 00 01 00 02 89 01
			15 00 00 00 01 00 02 8A 89
			15 00 00 00 01 00 02 8B 01
			15 00 00 00 01 00 02 8C C2
			15 00 00 00 01 00 02 8D 01
			15 00 00 00 01 00 02 8E EE
			15 00 00 00 01 00 02 8F 02
			15 00 00 00 01 00 02 90 34
			15 00 00 00 01 00 02 91 02
			15 00 00 00 01 00 02 92 6D
			15 00 00 00 01 00 02 93 02
			15 00 00 00 01 00 02 94 6F
			15 00 00 00 01 00 02 95 02
			15 00 00 00 01 00 02 96 A6
			15 00 00 00 01 00 02 97 02
			15 00 00 00 01 00 02 98 E1
			15 00 00 00 01 00 02 99 03
			15 00 00 00 01 00 02 9A 04
			15 00 00 00 01 00 02 9B 03
			15 00 00 00 01 00 02 9C 33
			15 00 00 00 01 00 02 9D 03
			15 00 00 00 01 00 02 9E 4F
			15 00 00 00 01 00 02 9F 03
			15 00 00 00 01 00 02 A0 72
			15 00 00 00 01 00 02 A2 03
			15 00 00 00 01 00 02 A3 7C
			15 00 00 00 01 00 02 A4 03
			15 00 00 00 01 00 02 A5 88
			15 00 00 00 01 00 02 A6 03
			15 00 00 00 01 00 02 A7 95
			15 00 00 00 01 00 02 A9 03
			15 00 00 00 01 00 02 AA A3
			15 00 00 00 01 00 02 AB 03
			15 00 00 00 01 00 02 AC B4
			15 00 00 00 01 00 02 AD 03
			15 00 00 00 01 00 02 AE C3
			15 00 00 00 01 00 02 AF 03
			15 00 00 00 01 00 02 B0 CD
			15 00 00 00 01 00 02 B1 03
			15 00 00 00 01 00 02 B2 FF

			15 00 00 00 01 00 02 B3 00
			15 00 00 00 01 00 02 B4 C8
			15 00 00 00 01 00 02 B5 00
			15 00 00 00 01 00 02 B6 D2
			15 00 00 00 01 00 02 B7 00
			15 00 00 00 01 00 02 B8 E5
			15 00 00 00 01 00 02 B9 00
			15 00 00 00 01 00 02 BA F6
			15 00 00 00 01 00 02 BB 01
			15 00 00 00 01 00 02 BC 06
			15 00 00 00 01 00 02 BD 01
			15 00 00 00 01 00 02 BE 15
			15 00 00 00 01 00 02 BF 01
			15 00 00 00 01 00 02 C0 22
			15 00 00 00 01 00 02 C1 01
			15 00 00 00 01 00 02 C2 2F
			15 00 00 00 01 00 02 C3 01
			15 00 00 00 01 00 02 C4 3C
			15 00 00 00 01 00 02 C5 01
			15 00 00 00 01 00 02 C6 66
			15 00 00 00 01 00 02 C7 01
			15 00 00 00 01 00 02 C8 89
			15 00 00 00 01 00 02 C9 01
			15 00 00 00 01 00 02 CA C2
			15 00 00 00 01 00 02 CB 01
			15 00 00 00 01 00 02 CC EE
			15 00 00 00 01 00 02 CD 02
			15 00 00 00 01 00 02 CE 34
			15 00 00 00 01 00 02 CF 02
			15 00 00 00 01 00 02 D0 6D
			15 00 00 00 01 00 02 D1 02
			15 00 00 00 01 00 02 D2 6F
			15 00 00 00 01 00 02 D3 02
			15 00 00 00 01 00 02 D4 A6
			15 00 00 00 01 00 02 D5 02
			15 00 00 00 01 00 02 D6 E1
			15 00 00 00 01 00 02 D7 03
			15 00 00 00 01 00 02 D8 04
			15 00 00 00 01 00 02 D9 03
			15 00 00 00 01 00 02 DA 33
			15 00 00 00 01 00 02 DB 03
			15 00 00 00 01 00 02 DC 4F
			15 00 00 00 01 00 02 DD 03
			15 00 00 00 01 00 02 DE 72
			15 00 00 00 01 00 02 DF 03
			15 00 00 00 01 00 02 E0 7C
			15 00 00 00 01 00 02 E1 03
			15 00 00 00 01 00 02 E2 88
			15 00 00 00 01 00 02 E3 03
			15 00 00 00 01 00 02 E4 95
			15 00 00 00 01 00 02 E5 03
			15 00 00 00 01 00 02 E6 A3
			15 00 00 00 01 00 02 E7 03
			15 00 00 00 01 00 02 E8 B4
			15 00 00 00 01 00 02 E9 03
			15 00 00 00 01 00 02 EA C3
			15 00 00 00 01 00 02 EB 03
			15 00 00 00 01 00 02 EC CD
			15 00 00 00 01 00 02 ED 03
			15 00 00 00 01 00 02 EE FF

			15 00 00 00 01 00 02 EF 00
			15 00 00 00 01 00 02 F0 C8
			15 00 00 00 01 00 02 F1 00
			15 00 00 00 01 00 02 F2 D3
			15 00 00 00 01 00 02 F3 00
			15 00 00 00 01 00 02 F4 E6
			15 00 00 00 01 00 02 F5 00
			15 00 00 00 01 00 02 F6 F8
			15 00 00 00 01 00 02 F7 01
			15 00 00 00 01 00 02 F8 09
			15 00 00 00 01 00 02 F9 01
			15 00 00 00 01 00 02 FA 18
			15 00 00 00 01 00 02 FF 21
			15 00 00 00 01 00 02 FB 01
			15 00 00 00 01 00 02 00 01
			15 00 00 00 01 00 02 01 26
			15 00 00 00 01 00 02 02 01
			15 00 00 00 01 00 02 03 33
			15 00 00 00 01 00 02 04 01
			15 00 00 00 01 00 02 05 3F
			15 00 00 00 01 00 02 06 01
			15 00 00 00 01 00 02 07 6B
			15 00 00 00 01 00 02 08 01
			15 00 00 00 01 00 02 09 8E
			15 00 00 00 01 00 02 0A 01
			15 00 00 00 01 00 02 0B C7
			15 00 00 00 01 00 02 0C 01
			15 00 00 00 01 00 02 0D F2
			15 00 00 00 01 00 02 0E 02
			15 00 00 00 01 00 02 0F 37
			15 00 00 00 01 00 02 10 02
			15 00 00 00 01 00 02 11 70
			15 00 00 00 01 00 02 12 02
			15 00 00 00 01 00 02 13 72
			15 00 00 00 01 00 02 14 02
			15 00 00 00 01 00 02 15 A8
			15 00 00 00 01 00 02 16 02
			15 00 00 00 01 00 02 17 E3
			15 00 00 00 01 00 02 18 03
			15 00 00 00 01 00 02 19 05
			15 00 00 00 01 00 02 1A 03
			15 00 00 00 01 00 02 1B 34
			15 00 00 00 01 00 02 1C 03
			15 00 00 00 01 00 02 1D 50
			15 00 00 00 01 00 02 1E 03
			15 00 00 00 01 00 02 1F 73
			15 00 00 00 01 00 02 20 03
			15 00 00 00 01 00 02 21 7D
			15 00 00 00 01 00 02 22 03
			15 00 00 00 01 00 02 23 89
			15 00 00 00 01 00 02 24 03
			15 00 00 00 01 00 02 25 96
			15 00 00 00 01 00 02 26 03
			15 00 00 00 01 00 02 27 A5
			15 00 00 00 01 00 02 28 03
			15 00 00 00 01 00 02 29 B5
			15 00 00 00 01 00 02 2A 03
			15 00 00 00 01 00 02 2B C3
			15 00 00 00 01 00 02 2D 03
			15 00 00 00 01 00 02 2F CC
			15 00 00 00 01 00 02 30 03
			15 00 00 00 01 00 02 31 FF
			15 00 00 00 01 00 02 32 00
			15 00 00 00 01 00 02 33 C8
			15 00 00 00 01 00 02 34 00
			15 00 00 00 01 00 02 35 D3
			15 00 00 00 01 00 02 36 00
			15 00 00 00 01 00 02 37 E6
			15 00 00 00 01 00 02 38 00
			15 00 00 00 01 00 02 39 F8
			15 00 00 00 01 00 02 3A 01
			15 00 00 00 01 00 02 3B 09
			15 00 00 00 01 00 02 3D 01
			15 00 00 00 01 00 02 3F 18
			15 00 00 00 01 00 02 40 01
			15 00 00 00 01 00 02 41 26
			15 00 00 00 01 00 02 42 01
			15 00 00 00 01 00 02 43 33
			15 00 00 00 01 00 02 44 01
			15 00 00 00 01 00 02 45 3F
			15 00 00 00 01 00 02 46 01
			15 00 00 00 01 00 02 47 6B
			15 00 00 00 01 00 02 48 01
			15 00 00 00 01 00 02 49 8E
			15 00 00 00 01 00 02 4A 01
			15 00 00 00 01 00 02 4B C7
			15 00 00 00 01 00 02 4C 01
			15 00 00 00 01 00 02 4D F2
			15 00 00 00 01 00 02 4E 02
			15 00 00 00 01 00 02 4F 37
			15 00 00 00 01 00 02 50 02
			15 00 00 00 01 00 02 51 70
			15 00 00 00 01 00 02 52 02
			15 00 00 00 01 00 02 53 72
			15 00 00 00 01 00 02 54 02
			15 00 00 00 01 00 02 55 A8
			15 00 00 00 01 00 02 56 02
			15 00 00 00 01 00 02 58 E3
			15 00 00 00 01 00 02 59 03
			15 00 00 00 01 00 02 5A 05
			15 00 00 00 01 00 02 5B 03
			15 00 00 00 01 00 02 5C 34
			15 00 00 00 01 00 02 5D 03
			15 00 00 00 01 00 02 5E 50
			15 00 00 00 01 00 02 5F 03
			15 00 00 00 01 00 02 60 73
			15 00 00 00 01 00 02 61 03
			15 00 00 00 01 00 02 62 7D
			15 00 00 00 01 00 02 63 03
			15 00 00 00 01 00 02 64 89
			15 00 00 00 01 00 02 65 03
			15 00 00 00 01 00 02 66 96
			15 00 00 00 01 00 02 67 03
			15 00 00 00 01 00 02 68 A5
			15 00 00 00 01 00 02 69 03
			15 00 00 00 01 00 02 6A B5
			15 00 00 00 01 00 02 6B 03
			15 00 00 00 01 00 02 6C C3
			15 00 00 00 01 00 02 6D 03
			15 00 00 00 01 00 02 6E CC
			15 00 00 00 01 00 02 6F 03
			15 00 00 00 01 00 02 70 FF
			15 00 00 00 01 00 02 71 02
			15 00 00 00 01 00 02 72 26
			15 00 00 00 01 00 02 73 02
			15 00 00 00 01 00 02 74 27
			15 00 00 00 01 00 02 75 02
			15 00 00 00 01 00 02 76 2A
			15 00 00 00 01 00 02 77 02
			15 00 00 00 01 00 02 78 2C
			15 00 00 00 01 00 02 79 02
			15 00 00 00 01 00 02 7A 2F
			15 00 00 00 01 00 02 7B 02
			15 00 00 00 01 00 02 7C 32
			15 00 00 00 01 00 02 7D 02
			15 00 00 00 01 00 02 7E 34
			15 00 00 00 01 00 02 7F 02
			15 00 00 00 01 00 02 80 37
			15 00 00 00 01 00 02 81 02
			15 00 00 00 01 00 02 82 39
			15 00 00 00 01 00 02 83 02
			15 00 00 00 01 00 02 84 43
			15 00 00 00 01 00 02 85 02
			15 00 00 00 01 00 02 86 4C
			15 00 00 00 01 00 02 87 02
			15 00 00 00 01 00 02 88 5F
			15 00 00 00 01 00 02 89 02
			15 00 00 00 01 00 02 8A 71
			15 00 00 00 01 00 02 8B 02
			15 00 00 00 01 00 02 8C 95
			15 00 00 00 01 00 02 8D 02
			15 00 00 00 01 00 02 8E BA
			15 00 00 00 01 00 02 8F 02
			15 00 00 00 01 00 02 90 BB
			15 00 00 00 01 00 02 91 02
			15 00 00 00 01 00 02 92 E3
			15 00 00 00 01 00 02 93 03
			15 00 00 00 01 00 02 94 12
			15 00 00 00 01 00 02 95 03
			15 00 00 00 01 00 02 96 34
			15 00 00 00 01 00 02 97 03
			15 00 00 00 01 00 02 98 5A
			15 00 00 00 01 00 02 99 03
			15 00 00 00 01 00 02 9A 72
			15 00 00 00 01 00 02 9B 03
			15 00 00 00 01 00 02 9C 90
			15 00 00 00 01 00 02 9D 03
			15 00 00 00 01 00 02 9E 99
			15 00 00 00 01 00 02 9F 03
			15 00 00 00 01 00 02 A0 A2
			15 00 00 00 01 00 02 A2 03
			15 00 00 00 01 00 02 A3 AD
			15 00 00 00 01 00 02 A4 03
			15 00 00 00 01 00 02 A5 B7
			15 00 00 00 01 00 02 A6 03
			15 00 00 00 01 00 02 A7 C1
			15 00 00 00 01 00 02 A9 03
			15 00 00 00 01 00 02 AA C9
			15 00 00 00 01 00 02 AB 03
			15 00 00 00 01 00 02 AC F0
			15 00 00 00 01 00 02 AD 03
			15 00 00 00 01 00 02 AE FF

			15 00 00 00 01 00 02 AF 02
			15 00 00 00 01 00 02 B0 26
			15 00 00 00 01 00 02 B1 02
			15 00 00 00 01 00 02 B2 27
			15 00 00 00 01 00 02 B3 02
			15 00 00 00 01 00 02 B4 2A
			15 00 00 00 01 00 02 B5 02
			15 00 00 00 01 00 02 B6 2C
			15 00 00 00 01 00 02 B7 02
			15 00 00 00 01 00 02 B8 2F
			15 00 00 00 01 00 02 B9 02
			15 00 00 00 01 00 02 BA 32
			15 00 00 00 01 00 02 BB 02
			15 00 00 00 01 00 02 BC 34
			15 00 00 00 01 00 02 BD 02
			15 00 00 00 01 00 02 BE 37
			15 00 00 00 01 00 02 BF 02
			15 00 00 00 01 00 02 C0 39
			15 00 00 00 01 00 02 C1 02
			15 00 00 00 01 00 02 C2 43
			15 00 00 00 01 00 02 C3 02
			15 00 00 00 01 00 02 C4 4C
			15 00 00 00 01 00 02 C5 02
			15 00 00 00 01 00 02 C6 5F
			15 00 00 00 01 00 02 C7 02
			15 00 00 00 01 00 02 C8 71
			15 00 00 00 01 00 02 C9 02
			15 00 00 00 01 00 02 CA 95
			15 00 00 00 01 00 02 CB 02
			15 00 00 00 01 00 02 CC BA
			15 00 00 00 01 00 02 CD 02
			15 00 00 00 01 00 02 CE BB
			15 00 00 00 01 00 02 CF 02
			15 00 00 00 01 00 02 D0 E3
			15 00 00 00 01 00 02 D1 03
			15 00 00 00 01 00 02 D2 12
			15 00 00 00 01 00 02 D3 03
			15 00 00 00 01 00 02 D4 34
			15 00 00 00 01 00 02 D5 03
			15 00 00 00 01 00 02 D6 5A
			15 00 00 00 01 00 02 D7 03
			15 00 00 00 01 00 02 D8 72
			15 00 00 00 01 00 02 D9 03
			15 00 00 00 01 00 02 DA 90
			15 00 00 00 01 00 02 DB 03
			15 00 00 00 01 00 02 DC 99
			15 00 00 00 01 00 02 DD 03
			15 00 00 00 01 00 02 DE A2
			15 00 00 00 01 00 02 DF 03
			15 00 00 00 01 00 02 E0 AD
			15 00 00 00 01 00 02 E1 03
			15 00 00 00 01 00 02 E2 B7
			15 00 00 00 01 00 02 E3 03
			15 00 00 00 01 00 02 E4 C1
			15 00 00 00 01 00 02 E5 03
			15 00 00 00 01 00 02 E6 C9
			15 00 00 00 01 00 02 E7 03
			15 00 00 00 01 00 02 E8 F0
			15 00 00 00 01 00 02 E9 03
			15 00 00 00 01 00 02 EA FF
			15 00 00 00 01 00 02 FB 01
			15 01 00 00 01 00 02 FF 10
		];
		qcom,mdss-dsi-dispparam-papermode6-state = "dsi_hs_mode";
		qcom,mdss-dsi-dispparam-papermode7-command = [
			15 01 00 00 78 00 02 FF 20
			15 00 00 00 01 00 02 FB 01

			15 00 00 00 01 00 02 75 00
			15 00 00 00 01 00 02 76 C8
			15 00 00 00 01 00 02 77 00
			15 00 00 00 01 00 02 78 D2
			15 00 00 00 01 00 02 79 00
			15 00 00 00 01 00 02 7A E5
			15 00 00 00 01 00 02 7B 00
			15 00 00 00 01 00 02 7C F6
			15 00 00 00 01 00 02 7D 01
			15 00 00 00 01 00 02 7E 06
			15 00 00 00 01 00 02 7F 01
			15 00 00 00 01 00 02 80 15
			15 00 00 00 01 00 02 81 01
			15 00 00 00 01 00 02 82 22
			15 00 00 00 01 00 02 83 01
			15 00 00 00 01 00 02 84 2F
			15 00 00 00 01 00 02 85 01
			15 00 00 00 01 00 02 86 3C
			15 00 00 00 01 00 02 87 01
			15 00 00 00 01 00 02 88 66
			15 00 00 00 01 00 02 89 01
			15 00 00 00 01 00 02 8A 89
			15 00 00 00 01 00 02 8B 01
			15 00 00 00 01 00 02 8C C2
			15 00 00 00 01 00 02 8D 01
			15 00 00 00 01 00 02 8E EE
			15 00 00 00 01 00 02 8F 02
			15 00 00 00 01 00 02 90 34
			15 00 00 00 01 00 02 91 02
			15 00 00 00 01 00 02 92 6D
			15 00 00 00 01 00 02 93 02
			15 00 00 00 01 00 02 94 6F
			15 00 00 00 01 00 02 95 02
			15 00 00 00 01 00 02 96 A6
			15 00 00 00 01 00 02 97 02
			15 00 00 00 01 00 02 98 E1
			15 00 00 00 01 00 02 99 03
			15 00 00 00 01 00 02 9A 04
			15 00 00 00 01 00 02 9B 03
			15 00 00 00 01 00 02 9C 33
			15 00 00 00 01 00 02 9D 03
			15 00 00 00 01 00 02 9E 4F
			15 00 00 00 01 00 02 9F 03
			15 00 00 00 01 00 02 A0 72
			15 00 00 00 01 00 02 A2 03
			15 00 00 00 01 00 02 A3 7C
			15 00 00 00 01 00 02 A4 03
			15 00 00 00 01 00 02 A5 88
			15 00 00 00 01 00 02 A6 03
			15 00 00 00 01 00 02 A7 95
			15 00 00 00 01 00 02 A9 03
			15 00 00 00 01 00 02 AA A3
			15 00 00 00 01 00 02 AB 03
			15 00 00 00 01 00 02 AC B4
			15 00 00 00 01 00 02 AD 03
			15 00 00 00 01 00 02 AE C3
			15 00 00 00 01 00 02 AF 03
			15 00 00 00 01 00 02 B0 CD
			15 00 00 00 01 00 02 B1 03
			15 00 00 00 01 00 02 B2 FF

			15 00 00 00 01 00 02 B3 00
			15 00 00 00 01 00 02 B4 C8
			15 00 00 00 01 00 02 B5 00
			15 00 00 00 01 00 02 B6 D2
			15 00 00 00 01 00 02 B7 00
			15 00 00 00 01 00 02 B8 E5
			15 00 00 00 01 00 02 B9 00
			15 00 00 00 01 00 02 BA F6
			15 00 00 00 01 00 02 BB 01
			15 00 00 00 01 00 02 BC 06
			15 00 00 00 01 00 02 BD 01
			15 00 00 00 01 00 02 BE 15
			15 00 00 00 01 00 02 BF 01
			15 00 00 00 01 00 02 C0 22
			15 00 00 00 01 00 02 C1 01
			15 00 00 00 01 00 02 C2 2F
			15 00 00 00 01 00 02 C3 01
			15 00 00 00 01 00 02 C4 3C
			15 00 00 00 01 00 02 C5 01
			15 00 00 00 01 00 02 C6 66
			15 00 00 00 01 00 02 C7 01
			15 00 00 00 01 00 02 C8 89
			15 00 00 00 01 00 02 C9 01
			15 00 00 00 01 00 02 CA C2
			15 00 00 00 01 00 02 CB 01
			15 00 00 00 01 00 02 CC EE
			15 00 00 00 01 00 02 CD 02
			15 00 00 00 01 00 02 CE 34
			15 00 00 00 01 00 02 CF 02
			15 00 00 00 01 00 02 D0 6D
			15 00 00 00 01 00 02 D1 02
			15 00 00 00 01 00 02 D2 6F
			15 00 00 00 01 00 02 D3 02
			15 00 00 00 01 00 02 D4 A6
			15 00 00 00 01 00 02 D5 02
			15 00 00 00 01 00 02 D6 E1
			15 00 00 00 01 00 02 D7 03
			15 00 00 00 01 00 02 D8 04
			15 00 00 00 01 00 02 D9 03
			15 00 00 00 01 00 02 DA 33
			15 00 00 00 01 00 02 DB 03
			15 00 00 00 01 00 02 DC 4F
			15 00 00 00 01 00 02 DD 03
			15 00 00 00 01 00 02 DE 72
			15 00 00 00 01 00 02 DF 03
			15 00 00 00 01 00 02 E0 7C
			15 00 00 00 01 00 02 E1 03
			15 00 00 00 01 00 02 E2 88
			15 00 00 00 01 00 02 E3 03
			15 00 00 00 01 00 02 E4 95
			15 00 00 00 01 00 02 E5 03
			15 00 00 00 01 00 02 E6 A3
			15 00 00 00 01 00 02 E7 03
			15 00 00 00 01 00 02 E8 B4
			15 00 00 00 01 00 02 E9 03
			15 00 00 00 01 00 02 EA C3
			15 00 00 00 01 00 02 EB 03
			15 00 00 00 01 00 02 EC CD
			15 00 00 00 01 00 02 ED 03
			15 00 00 00 01 00 02 EE FF

			15 00 00 00 01 00 02 EF 00
			15 00 00 00 01 00 02 F0 C8
			15 00 00 00 01 00 02 F1 00
			15 00 00 00 01 00 02 F2 D3
			15 00 00 00 01 00 02 F3 00
			15 00 00 00 01 00 02 F4 E6
			15 00 00 00 01 00 02 F5 00
			15 00 00 00 01 00 02 F6 F8
			15 00 00 00 01 00 02 F7 01
			15 00 00 00 01 00 02 F8 09
			15 00 00 00 01 00 02 F9 01
			15 00 00 00 01 00 02 FA 18
			15 00 00 00 01 00 02 FF 21
			15 00 00 00 01 00 02 FB 01
			15 00 00 00 01 00 02 00 01
			15 00 00 00 01 00 02 01 26
			15 00 00 00 01 00 02 02 01
			15 00 00 00 01 00 02 03 33
			15 00 00 00 01 00 02 04 01
			15 00 00 00 01 00 02 05 3F
			15 00 00 00 01 00 02 06 01
			15 00 00 00 01 00 02 07 6B
			15 00 00 00 01 00 02 08 01
			15 00 00 00 01 00 02 09 8E
			15 00 00 00 01 00 02 0A 01
			15 00 00 00 01 00 02 0B C7
			15 00 00 00 01 00 02 0C 01
			15 00 00 00 01 00 02 0D F2
			15 00 00 00 01 00 02 0E 02
			15 00 00 00 01 00 02 0F 37
			15 00 00 00 01 00 02 10 02
			15 00 00 00 01 00 02 11 70
			15 00 00 00 01 00 02 12 02
			15 00 00 00 01 00 02 13 72
			15 00 00 00 01 00 02 14 02
			15 00 00 00 01 00 02 15 A8
			15 00 00 00 01 00 02 16 02
			15 00 00 00 01 00 02 17 E3
			15 00 00 00 01 00 02 18 03
			15 00 00 00 01 00 02 19 05
			15 00 00 00 01 00 02 1A 03
			15 00 00 00 01 00 02 1B 34
			15 00 00 00 01 00 02 1C 03
			15 00 00 00 01 00 02 1D 50
			15 00 00 00 01 00 02 1E 03
			15 00 00 00 01 00 02 1F 73
			15 00 00 00 01 00 02 20 03
			15 00 00 00 01 00 02 21 7D
			15 00 00 00 01 00 02 22 03
			15 00 00 00 01 00 02 23 89
			15 00 00 00 01 00 02 24 03
			15 00 00 00 01 00 02 25 96
			15 00 00 00 01 00 02 26 03
			15 00 00 00 01 00 02 27 A5
			15 00 00 00 01 00 02 28 03
			15 00 00 00 01 00 02 29 B5
			15 00 00 00 01 00 02 2A 03
			15 00 00 00 01 00 02 2B C3
			15 00 00 00 01 00 02 2D 03
			15 00 00 00 01 00 02 2F CC
			15 00 00 00 01 00 02 30 03
			15 00 00 00 01 00 02 31 FF
			15 00 00 00 01 00 02 32 00
			15 00 00 00 01 00 02 33 C8
			15 00 00 00 01 00 02 34 00
			15 00 00 00 01 00 02 35 D3
			15 00 00 00 01 00 02 36 00
			15 00 00 00 01 00 02 37 E6
			15 00 00 00 01 00 02 38 00
			15 00 00 00 01 00 02 39 F8
			15 00 00 00 01 00 02 3A 01
			15 00 00 00 01 00 02 3B 09
			15 00 00 00 01 00 02 3D 01
			15 00 00 00 01 00 02 3F 18
			15 00 00 00 01 00 02 40 01
			15 00 00 00 01 00 02 41 26
			15 00 00 00 01 00 02 42 01
			15 00 00 00 01 00 02 43 33
			15 00 00 00 01 00 02 44 01
			15 00 00 00 01 00 02 45 3F
			15 00 00 00 01 00 02 46 01
			15 00 00 00 01 00 02 47 6B
			15 00 00 00 01 00 02 48 01
			15 00 00 00 01 00 02 49 8E
			15 00 00 00 01 00 02 4A 01
			15 00 00 00 01 00 02 4B C7
			15 00 00 00 01 00 02 4C 01
			15 00 00 00 01 00 02 4D F2
			15 00 00 00 01 00 02 4E 02
			15 00 00 00 01 00 02 4F 37
			15 00 00 00 01 00 02 50 02
			15 00 00 00 01 00 02 51 70
			15 00 00 00 01 00 02 52 02
			15 00 00 00 01 00 02 53 72
			15 00 00 00 01 00 02 54 02
			15 00 00 00 01 00 02 55 A8
			15 00 00 00 01 00 02 56 02
			15 00 00 00 01 00 02 58 E3
			15 00 00 00 01 00 02 59 03
			15 00 00 00 01 00 02 5A 05
			15 00 00 00 01 00 02 5B 03
			15 00 00 00 01 00 02 5C 34
			15 00 00 00 01 00 02 5D 03
			15 00 00 00 01 00 02 5E 50
			15 00 00 00 01 00 02 5F 03
			15 00 00 00 01 00 02 60 73
			15 00 00 00 01 00 02 61 03
			15 00 00 00 01 00 02 62 7D
			15 00 00 00 01 00 02 63 03
			15 00 00 00 01 00 02 64 89
			15 00 00 00 01 00 02 65 03
			15 00 00 00 01 00 02 66 96
			15 00 00 00 01 00 02 67 03
			15 00 00 00 01 00 02 68 A5
			15 00 00 00 01 00 02 69 03
			15 00 00 00 01 00 02 6A B5
			15 00 00 00 01 00 02 6B 03
			15 00 00 00 01 00 02 6C C3
			15 00 00 00 01 00 02 6D 03
			15 00 00 00 01 00 02 6E CC
			15 00 00 00 01 00 02 6F 03
			15 00 00 00 01 00 02 70 FF
			15 00 00 00 01 00 02 71 02
			15 00 00 00 01 00 02 72 3F
			15 00 00 00 01 00 02 73 02
			15 00 00 00 01 00 02 74 40
			15 00 00 00 01 00 02 75 02
			15 00 00 00 01 00 02 76 42
			15 00 00 00 01 00 02 77 02
			15 00 00 00 01 00 02 78 45
			15 00 00 00 01 00 02 79 02
			15 00 00 00 01 00 02 7A 47
			15 00 00 00 01 00 02 7B 02
			15 00 00 00 01 00 02 7C 49
			15 00 00 00 01 00 02 7D 02
			15 00 00 00 01 00 02 7E 4B
			15 00 00 00 01 00 02 7F 02
			15 00 00 00 01 00 02 80 4D
			15 00 00 00 01 00 02 81 02
			15 00 00 00 01 00 02 82 4F
			15 00 00 00 01 00 02 83 02
			15 00 00 00 01 00 02 84 58
			15 00 00 00 01 00 02 85 02
			15 00 00 00 01 00 02 86 61
			15 00 00 00 01 00 02 87 02
			15 00 00 00 01 00 02 88 71
			15 00 00 00 01 00 02 89 02
			15 00 00 00 01 00 02 8A 82
			15 00 00 00 01 00 02 8B 02
			15 00 00 00 01 00 02 8C A4
			15 00 00 00 01 00 02 8D 02
			15 00 00 00 01 00 02 8E C6
			15 00 00 00 01 00 02 8F 02
			15 00 00 00 01 00 02 90 C7
			15 00 00 00 01 00 02 91 02
			15 00 00 00 01 00 02 92 ED
			15 00 00 00 01 00 02 93 03
			15 00 00 00 01 00 02 94 1B
			15 00 00 00 01 00 02 95 03
			15 00 00 00 01 00 02 96 3C
			15 00 00 00 01 00 02 97 03
			15 00 00 00 01 00 02 98 61
			15 00 00 00 01 00 02 99 03
			15 00 00 00 01 00 02 9A 78
			15 00 00 00 01 00 02 9B 03
			15 00 00 00 01 00 02 9C 95
			15 00 00 00 01 00 02 9D 03
			15 00 00 00 01 00 02 9E 9D
			15 00 00 00 01 00 02 9F 03
			15 00 00 00 01 00 02 A0 A7
			15 00 00 00 01 00 02 A2 03
			15 00 00 00 01 00 02 A3 B1
			15 00 00 00 01 00 02 A4 03
			15 00 00 00 01 00 02 A5 BA
			15 00 00 00 01 00 02 A6 03
			15 00 00 00 01 00 02 A7 C3
			15 00 00 00 01 00 02 A9 03
			15 00 00 00 01 00 02 AA C9
			15 00 00 00 01 00 02 AB 03
			15 00 00 00 01 00 02 AC EF
			15 00 00 00 01 00 02 AD 03
			15 00 00 00 01 00 02 AE FF

			15 00 00 00 01 00 02 AF 02
			15 00 00 00 01 00 02 B0 3F
			15 00 00 00 01 00 02 B1 02
			15 00 00 00 01 00 02 B2 40
			15 00 00 00 01 00 02 B3 02
			15 00 00 00 01 00 02 B4 42
			15 00 00 00 01 00 02 B5 02
			15 00 00 00 01 00 02 B6 45
			15 00 00 00 01 00 02 B7 02
			15 00 00 00 01 00 02 B8 47
			15 00 00 00 01 00 02 B9 02
			15 00 00 00 01 00 02 BA 49
			15 00 00 00 01 00 02 BB 02
			15 00 00 00 01 00 02 BC 4B
			15 00 00 00 01 00 02 BD 02
			15 00 00 00 01 00 02 BE 4D
			15 00 00 00 01 00 02 BF 02
			15 00 00 00 01 00 02 C0 4F
			15 00 00 00 01 00 02 C1 02
			15 00 00 00 01 00 02 C2 58
			15 00 00 00 01 00 02 C3 02
			15 00 00 00 01 00 02 C4 61
			15 00 00 00 01 00 02 C5 02
			15 00 00 00 01 00 02 C6 71
			15 00 00 00 01 00 02 C7 02
			15 00 00 00 01 00 02 C8 82
			15 00 00 00 01 00 02 C9 02
			15 00 00 00 01 00 02 CA A4
			15 00 00 00 01 00 02 CB 02
			15 00 00 00 01 00 02 CC C6
			15 00 00 00 01 00 02 CD 02
			15 00 00 00 01 00 02 CE C7
			15 00 00 00 01 00 02 CF 02
			15 00 00 00 01 00 02 D0 ED
			15 00 00 00 01 00 02 D1 03
			15 00 00 00 01 00 02 D2 1B
			15 00 00 00 01 00 02 D3 03
			15 00 00 00 01 00 02 D4 3C
			15 00 00 00 01 00 02 D5 03
			15 00 00 00 01 00 02 D6 61
			15 00 00 00 01 00 02 D7 03
			15 00 00 00 01 00 02 D8 78
			15 00 00 00 01 00 02 D9 03
			15 00 00 00 01 00 02 DA 95
			15 00 00 00 01 00 02 DB 03
			15 00 00 00 01 00 02 DC 9D
			15 00 00 00 01 00 02 DD 03
			15 00 00 00 01 00 02 DE A7
			15 00 00 00 01 00 02 DF 03
			15 00 00 00 01 00 02 E0 B1
			15 00 00 00 01 00 02 E1 03
			15 00 00 00 01 00 02 E2 BA
			15 00 00 00 01 00 02 E3 03
			15 00 00 00 01 00 02 E4 C3
			15 00 00 00 01 00 02 E5 03
			15 00 00 00 01 00 02 E6 C9
			15 00 00 00 01 00 02 E7 03
			15 00 00 00 01 00 02 E8 EF
			15 00 00 00 01 00 02 E9 03
			15 00 00 00 01 00 02 EA FF
			15 00 00 00 01 00 02 FB 01
			15 01 00 00 01 00 02 FF 10
		];
		qcom,mdss-dsi-dispparam-papermode7-state = "dsi_hs_mode";
	};
};
