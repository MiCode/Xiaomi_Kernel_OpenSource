/* Copyright (c) 2013, The Linux Foundation. All rights reserved.
 *
 * This program is free software; you can redistribute it and/or modify
 * it under the terms of the GNU General Public License version 2 and
 * only version 2 as published by the Free Software Foundation.
 *
 * This program is distributed in the hope that it will be useful,
 * but WITHOUT ANY WARRANTY; without even the implied warranty of
 * MERCHANTABILITY or FITNESS FOR A PARTICULAR PURPOSE.  See the
 * GNU General Public License for more details.
 */

/dts-v1/;

/include/ "msm8974pro-ab.dtsi"
/include/ "msm8974-cdp.dtsi"

/ {
	model = "Qualcomm MSM 8974Pro CDP";
	compatible = "qcom,msm8974-cdp", "qcom,msm8974", "qcom,cdp";
	qcom,msm-id = <208 1 0x10000>,
		      <209 1 0x10000>,
		      <211 1 0x10000>,
		      <212 1 0x10000>,
		      <214 1 0x10000>,
		      <215 1 0x10000>,
		      <217 1 0x10000>,
		      <218 1 0x10000>,
		      <194 1 0x10000>,	/* 8974Pro-AC IDs */
		      <210 1 0x10000>,
		      <213 1 0x10000>,
		      <216 1 0x10000>;
};
