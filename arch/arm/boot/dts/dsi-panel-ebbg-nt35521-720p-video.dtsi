/* Copyright (c) 2014, The Linux Foundation. All rights reserved.
 * Copyright (C) 2015 XiaoMi, Inc.
 *
 * This program is free software; you can redistribute it and/or modify
 * it under the terms of the GNU General Public License version 2 and
 * only version 2 as published by the Free Software Foundation.
 *
 * This program is distributed in the hope that it will be useful,
 * but WITHOUT ANY WARRANTY; without even the implied warranty of
 * MERCHANTABILITY or FITNESS FOR A PARTICULAR PURPOSE.  See the
 * GNU General Public License for more details.
 */

/*---------------------------------------------------------------------------
 * This file is autogenerated file using gcdb parser. Please do not edit it.
 * Update input XML file to add a new entry or update variable in this file
 * VERSION = "1.0"
 *---------------------------------------------------------------------------*/
&mdss_mdp {
	dsi_ebbg_nt35521_720_vid: qcom,mdss_dsi_ebbg_nt35521_720p_video {
		qcom,mdss-dsi-panel-name = "ebbg nt35521 720p video mode dsi panel";
		qcom,mdss-dsi-panel-controller = <&mdss_dsi0>;
		qcom,mdss-dsi-panel-type = "dsi_video_mode";
		qcom,mdss-dsi-panel-destination = "display_1";
		qcom,mdss-dsi-panel-framerate = <60>;
		qcom,mdss-dsi-virtual-channel-id = <0>;
		qcom,mdss-dsi-stream = <0>;
		qcom,mdss-dsi-panel-width = <720>;
		qcom,mdss-dsi-panel-height = <1280>;
		qcom,mdss-dsi-h-front-porch = <180>;
		qcom,mdss-dsi-h-back-porch = <180>;
		qcom,mdss-dsi-h-pulse-width = <8>;
		qcom,mdss-dsi-h-sync-skew = <0>;
		qcom,mdss-dsi-v-back-porch = <12>;
		qcom,mdss-dsi-v-front-porch = <20>;
		qcom,mdss-dsi-v-pulse-width = <2>;

		qcom,mdss-dsi-h-left-border = <0>;
		qcom,mdss-dsi-h-right-border = <0>;
		qcom,mdss-dsi-v-top-border = <0>;
		qcom,mdss-dsi-v-bottom-border = <0>;
		qcom,mdss-dsi-bpp = <24>;
		qcom,mdss-dsi-underflow-color = <0xff>;
		qcom,mdss-dsi-border-color = <0>;
		qcom,mdss-dsi-pixel-packing = "tight";

		qcom,mdss-dsi-on-command = [
		29 01 00 00 00 00 05 FF AA 55 A5 80
		29 01 00 00 00 00 02 6f 01
		29 01 00 00 00 00 02 f8 38
		29 01 00 00 00 00 02 6f 02
		29 01 00 00 00 00 02 f8 03
		29 01 00 00 00 00 02 6f 0F
		29 01 00 00 00 00 02 FA 13
		29 01 00 00 00 00 02 6f 0A
		29 01 00 00 00 00 02 F8 33
		29 01 00 00 00 00 02 6f 0B
		29 01 00 00 00 00 02 F8 30
		29 01 00 00 00 00 02 6f 11
		29 01 00 00 00 00 02 F3 01
		29 01 00 00 00 00 05 FF AA 55 A5 00

		29 01 00 00 00 00 06 F0 55 AA 52 08 00
		29 01 00 00 00 00 05 FF AA 55 A5 80
		29 01 00 00 00 00 02 B6 08
		29 01 00 00 00 00 05 B8 01 04 10 10
		29 01 00 00 00 00 03 BB 63 63
		29 01 00 00 00 00 03 BC 00 00
		29 01 00 00 00 00 06 BD 02 78 10 18 00
		29 01 00 00 00 00 02 C8 80
		29 01 00 00 00 00 0D D7 30 30 30 3F 00 00 00 00 00 00 00 00
		29 01 00 00 00 00 0E D8 00 00 00 00 00 00 00 00 00 00 3F 30 00
		29 01 00 00 00 00 06 F0 55 AA 52 08 01
		29 01 00 00 00 00 03 B3 3B 3B
		29 01 00 00 00 00 03 B4 12 12
		29 01 00 00 00 00 03 B5 05 05
		29 01 00 00 00 00 03 B9 54 54
		29 01 00 00 00 00 03 BA 36 36
		29 01 00 00 00 00 03 BC 98 00
		29 01 00 00 00 00 03 BD 98 00
		29 01 00 00 00 00 02 C0 0C

		29 01 00 00 00 00 06 F0 55 AA 52 08 02
		29 01 00 00 00 00 02 EE 03
        29 01 00 00 00 00 11 B0 00 00 00 16 00 40 00 5F 00 78 00 9D 00 BF 00 F2
		29 01 00 00 00 00 11 B1 01 1A 01 55 01 83 01 CB 02 07 02 09 02 4A 02 8F
		29 01 00 00 00 00 11 B2 02 BA 02 F9 03 21 03 52 03 6E 03 94 03 AB 03 BD
		29 01 00 00 00 00 05 B3 03 CC 03 CD
		29 01 00 00 00 00 11 B4 00 B9 00 C0 00 CD 00 D9 00 E4 00 F9 01 0C 01 2E
		29 01 00 00 00 00 11 B5 01 49 01 78 01 9D 01 DD 02 13 02 15 02 55 02 99
		29 01 00 00 00 00 11 B6 02 C5 03 00 03 27 03 54 03 70 03 93 03 AB 03 BD
		29 01 00 00 00 00 05 B7 03 CC 03 CD
		29 01 00 00 00 00 11 B8 00 00 00 11 00 33 00 4D 00 65 00 8B 00 AB 00 E0
		29 01 00 00 00 00 11 B9 01 08 01 49 01 78 01 C4 02 03 02 05 02 47 02 8E
		29 01 00 00 00 00 11 BA 02 BB 02 F8 03 20 03 5A 03 77 03 9C 03 AC 03 BD
		29 01 00 00 00 00 05 BB 03 CC 03 CD

		29 01 00 00 00 00 06 F0 55 AA 52 08 03
		29 01 00 00 00 00 03 B0 F5 00
		29 01 00 00 00 00 03 B1 F5 00
		29 01 00 00 00 00 06 B2 03 00 4B 00 00
		29 01 00 00 00 00 06 B6 03 00 4B 00 00
		29 01 00 00 00 00 06 BA 35 00 4B 00 00
		29 01 00 00 00 00 06 BB 35 00 4B 00 00
		29 01 00 00 00 00 05 C0 30 00 00 00
		29 01 00 00 00 00 05 C1 30 00 00 00
		29 01 00 00 00 00 05 C2 12 00 00 00
		29 01 00 00 00 00 05 C3 12 00 00 00
		29 01 00 00 00 00 02 C4 40
		29 01 00 00 00 00 02 C5 40
		29 01 00 00 00 00 02 EF 00

		29 01 00 00 00 00 06 F0 55 AA 52 08 05
		29 01 00 00 00 00 02 C0 09
		29 01 00 00 00 00 02 C4 83
		29 01 00 00 00 00 03 C8 07 30
		29 01 00 00 00 00 03 C9 01 10
		29 01 00 00 00 00 04 CC 00 00 08
		29 01 00 00 00 00 04 CD 00 00 08
		29 01 00 00 00 00 04 CE 00 00 08
		29 01 00 00 00 00 04 CF 00 00 08
		29 01 00 00 00 00 02 D0 14
		29 01 00 00 00 00 05 D1 02 00 00 00
		29 01 00 00 00 00 05 D2 02 00 00 06
		29 01 00 00 00 00 02 ED 03
		29 01 00 00 00 00 06 BD 03 01 01 0F 0F
		29 01 00 00 00 00 03 B3 17 26
		29 01 00 00 00 00 03 B7 17 26
		29 01 00 00 00 00 02 E5 06
		29 01 00 00 00 00 02 E6 06
		29 01 00 00 00 00 02 E7 06
		29 01 00 00 00 00 02 E8 06
		29 01 00 00 00 00 02 EC 06

		29 01 00 00 00 00 06 F0 55 AA 52 08 06
		29 01 00 00 00 00 03 B0 16 14
		29 01 00 00 00 00 03 B1 12 10
		29 01 00 00 00 00 03 B2 00 2E
		29 01 00 00 00 00 03 B3 2E 2E
		29 01 00 00 00 00 03 B4 2E 34
		29 01 00 00 00 00 03 B5 34 34
		29 01 00 00 00 00 03 B6 34 34
		29 01 00 00 00 00 03 B7 34 34
		29 01 00 00 00 00 03 B8 29 2C
		29 01 00 00 00 00 03 B9 34 34
		29 01 00 00 00 00 03 BA 34 34
		29 01 00 00 00 00 03 BB 2C 29
		29 01 00 00 00 00 03 BC 34 34
		29 01 00 00 00 00 03 BD 34 34
		29 01 00 00 00 00 03 BE 34 34
		29 01 00 00 00 00 03 BF 34 2E
		29 01 00 00 00 00 03 C0 2E 2E
		29 01 00 00 00 00 03 C1 2E 01
		29 01 00 00 00 00 03 C2 11 13
		29 01 00 00 00 00 03 C3 15 17
		29 01 00 00 00 00 03 C4 15 17
		29 01 00 00 00 00 03 C5 11 13
		29 01 00 00 00 00 03 C6 2E 01
		29 01 00 00 00 00 03 C7 2E 2E
		29 01 00 00 00 00 03 C8 2E 34
		29 01 00 00 00 00 03 C9 34 34
		29 01 00 00 00 00 03 CA 34 34
		29 01 00 00 00 00 03 CB 34 34
		29 01 00 00 00 00 03 CC 29 2C
		29 01 00 00 00 00 03 CD 34 34
		29 01 00 00 00 00 03 CE 34 34
		29 01 00 00 00 00 03 CF 2C 29
		29 01 00 00 00 00 03 D0 34 34
		29 01 00 00 00 00 03 D1 34 34
		29 01 00 00 00 00 03 D2 34 34
		29 01 00 00 00 00 03 D3 34 2E
		29 01 00 00 00 00 03 D4 2E 2E
		29 01 00 00 00 00 03 D5 00 2E
		29 01 00 00 00 00 03 D6 12 10
		29 01 00 00 00 00 03 D7 16 14
		29 01 00 00 00 00 06 D8 00 00 00 00 00
		29 01 00 00 00 00 06 D9 00 00 00 00 00
		29 01 00 00 00 00 03 E5 34 34
		29 01 00 00 00 00 03 E6 34 34
		29 01 00 00 00 00 02 E7 00

		29 01 00 00 00 00 02 34 00
		15 01 00 00 00 00 02 51 ff
		15 01 00 00 10 00 02 53 2c
		15 01 00 00 10 00 02 55 01
		05 01 00 00 78 00 02 11 00
		05 01 00 00 26 00 02 29 00
		];

		qcom,mdss-dsi-off-command = [05 01 00 00 14 00 02 28 00
					05 01 00 00 78 00 02 10 00];
		qcom,mdss-dsi-on-command-state = "dsi_lp_mode";
		qcom,mdss-dsi-off-command-state = "dsi_hs_mode";
		qcom,mdss-dsi-h-sync-pulse = <1>;
		qcom,mdss-dsi-traffic-mode = "non_burst_sync_pulse";
		qcom,mdss-dsi-bllp-eof-power-mode;
		qcom,mdss-dsi-bllp-power-mode;
		qcom,mdss-dsi-lane-0-state;
		qcom,mdss-dsi-lane-1-state;
		qcom,mdss-dsi-lane-2-state;
		qcom,mdss-dsi-lane-3-state;
		qcom,mdss-dsi-lp11-init;
		qcom,mdss-dsi-panel-timings = [bb 8e 21 00 99 9C 19 90 25 03 04 00];//514M
		qcom,mdss-dsi-t-clk-post = <0x19>;
		qcom,mdss-dsi-t-clk-pre = <0x2f>;
		qcom,mdss-dsi-bl-min-level = <1>;
		qcom,mdss-dsi-bl-max-level = <255>;
		qcom,mdss-dsi-dma-trigger = "trigger_sw";
		qcom,mdss-dsi-mdp-trigger = "none";
		qcom,mdss-dsi-bl-pmic-control-type = "bl_ctrl_sic";
		qcom,mdss-dsi-reset-sequence = <1 5>, <0 5>, <1 120>;
		qcom,mdss-pan-physical-width-dimension = <68>;
		qcom,mdss-pan-physical-height-dimension = <121>;
		qcom,cont-splash-enabled;
		qcom,dispparam-enabled;

	};
};
