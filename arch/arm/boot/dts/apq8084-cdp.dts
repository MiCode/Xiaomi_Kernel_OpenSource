/* Copyright (c) 2013, The Linux Foundation. All rights reserved.
 *
 * This program is free software; you can redistribute it and/or modify
 * it under the terms of the GNU General Public License version 2 and
 * only version 2 as published by the Free Software Foundation.
 *
 * This program is distributed in the hope that it will be useful,
 * but WITHOUT ANY WARRANTY; without even the implied warranty of
 * MERCHANTABILITY or FITNESS FOR A PARTICULAR PURPOSE.  See the
 * GNU General Public License for more details.
 */

/dts-v1/;

/include/ "apq8084.dtsi"
/include/ "apq8084-cdp.dtsi"

/ {
	model = "Qualcomm APQ 8084 CDP";
	compatible = "qcom,apq8084-cdp", "qcom,apq8084", "qcom,cdp";
	qcom,board-id = <1 0>,
			<1 1>,
			<1 2>,
			<1 3>,
			<1 4>,
			<21 0>,
			<21 1>,
			<21 2>,
			<21 3>,
			<21 4>;
};
