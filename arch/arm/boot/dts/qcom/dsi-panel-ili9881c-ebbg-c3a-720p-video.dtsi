/* Copyright (c) 2013, The Linux Foundation. All rights reserved.
 * Copyright (C) 2018 XiaoMi, Inc.
 *
 * This program is free software; you can redistribute it and/or modify
 * it under the terms of the GNU General Public License version 2 and
 * only version 2 as published by the Free Software Foundation.
 *
 * This program is distributed in the hope that it will be useful,
 * but WITHOUT ANY WARRANTY; without even the implied warranty of
 * MERCHANTABILITY or FITNESS FOR A PARTICULAR PURPOSE.  See the
 * GNU General Public License for more details.
 */

/*---------------------------------------------------------------------------
 * This file is autogenerated file using gcdb parser. Please do not edit it.
 * Update input XML file to add a new entry or update variable in this file
 * VERSION = "1.0"
 *---------------------------------------------------------------------------*/
&mdss_mdp {
	dsi_ili9881c_ebbg_720p_video: qcom,mdss_dsi_ili9881c_ebbg_c3a_720p_video {
		qcom,mdss-dsi-panel-name = "ili9881c_HD720p_video_Ebbg_c3a";
		qcom,mdss-dsi-panel-controller = <&mdss_dsi0>;
		qcom,mdss-dsi-panel-type = "dsi_video_mode";
		qcom,mdss-dsi-panel-destination = "display_1";
		qcom,mdss-dsi-panel-framerate = <60>;
		qcom,mdss-dsi-virtual-channel-id = <0>;
		qcom,mdss-dsi-stream = <0>;
		qcom,mdss-dsi-panel-width = <720>;
		qcom,mdss-dsi-panel-height = <1280>;
		qcom,mdss-pan-physical-width-dimension = <62>;
		qcom,mdss-pan-physical-height-dimension = <110>;
		qcom,mdss-dsi-h-front-porch = <116>;
		qcom,mdss-dsi-h-back-porch = <180>;
		qcom,mdss-dsi-h-pulse-width = <8>;
		qcom,mdss-dsi-h-sync-skew = <0>;
		qcom,mdss-dsi-v-back-porch = <18>;
		qcom,mdss-dsi-v-front-porch = <10>;
		qcom,mdss-dsi-v-pulse-width = <4>;
		qcom,mdss-dsi-h-left-border = <0>;
		qcom,mdss-dsi-h-right-border = <0>;
		qcom,mdss-dsi-v-top-border = <0>;
		qcom,mdss-dsi-v-bottom-border = <0>;
		qcom,mdss-dsi-bpp = <24>;
		qcom,mdss-dsi-underflow-color = <0x00>;
		qcom,mdss-dsi-border-color = <0>;
		qcom,mdss-dsi-on-command = [39 01 00 00 00 00 04 FF 98 81 04
				39 01 00 00 00 00 04 FF 98 81 04
				39 01 00 00 00 00 02 E5 00
				39 01 00 00 0A 00 04 FF 98 81 00
				39 01 00 00 96 00 02 11 00
				39 01 00 00 00 00 02 29 00
				39 01 00 00 0A 00 02 35 00
				39 00 00 00 00 00 04 FF 98 81 03
				39 00 00 00 00 00 02 2C 0C
				39 01 00 00 00 00 04 FF 98 81 00];
		qcom,mdss-dsi-off-command = [39 00 00 00 00 00 04 FF 98 81 00
				05 00 00 00 0A 00 02 28 00
				05 01 00 00 96 00 02 10 00];
		qcom,mdss-dsi-on-command-state = "dsi_lp_mode";
		qcom,mdss-dsi-off-command-state = "dsi_lp_mode";
		qcom,mdss-dsi-panel-warm-command = [39 00 00 00 00 00 04 FF 98 81 01
				39 00 00 00 00 00 04 FF 98 81 01
				39 00 00 00 00 00 02 A0 00//AEG+
				39 00 00 00 00 00 02 A1 17
				39 00 00 00 00 00 02 A2 27
				39 00 00 00 00 00 02 A3 14
				39 00 00 00 00 00 02 A4 17
				39 00 00 00 00 00 02 A5 29
				39 00 00 00 00 00 02 A6 1F
				39 00 00 00 00 00 02 A7 20
				39 00 00 00 00 00 02 A8 89
				39 00 00 00 00 00 02 A9 1D
				39 00 00 00 00 00 02 AA 29
				39 00 00 00 00 00 02 AB 74
				39 00 00 00 00 00 02 AC 1B
				39 00 00 00 00 00 02 AD 1A
				39 00 00 00 00 00 02 AE 4F
				39 00 00 00 00 00 02 AF 23
				39 00 00 00 00 00 02 B0 27
				39 00 00 00 00 00 02 B1 4F
				39 00 00 00 00 00 02 B2 5D
				39 00 00 00 00 00 02 B3 32
				39 00 00 00 00 00 02 C0 00//AEG-
				39 00 00 00 00 00 02 C1 17
				39 00 00 00 00 00 02 C2 27
				39 00 00 00 00 00 02 C3 14
				39 00 00 00 00 00 02 C4 17
				39 00 00 00 00 00 02 C5 29
				39 00 00 00 00 00 02 C6 1F
				39 00 00 00 00 00 02 C7 20
				39 00 00 00 00 00 02 C8 89
				39 00 00 00 00 00 02 C9 1D
				39 00 00 00 00 00 02 CA 29
				39 00 00 00 00 00 02 CB 74
				39 00 00 00 00 00 02 CC 1B
				39 00 00 00 00 00 02 CD 1A
				39 00 00 00 00 00 02 CE 4F
				39 00 00 00 00 00 02 CF 23
				39 00 00 00 00 00 02 D0 27
				39 00 00 00 00 00 02 D1 4F
				39 00 00 00 00 00 02 D2 5D
				39 01 00 00 00 00 02 D3 32
				39 00 00 00 00 00 04 FF 98 81 05
				39 00 00 00 00 00 04 FF 98 81 05
				39 00 00 00 00 00 02 85 48//D3G EN
				39 00 00 00 00 00 02 00 00
				39 00 00 00 00 00 02 01 00
				39 00 00 00 00 00 02 02 00
				39 00 00 00 00 00 02 03 13
				39 00 00 00 00 00 02 04 00
				39 00 00 00 00 00 02 05 22
				39 00 00 00 00 00 02 06 00
				39 00 00 00 00 00 02 07 30
				39 00 00 00 00 00 02 08 00
				39 00 00 00 00 00 02 09 42
				39 00 00 00 00 00 02 0A 00
				39 00 00 00 00 00 02 0B 53
				39 00 00 00 00 00 02 0C 00
				39 00 00 00 00 00 02 0D 65
				39 00 00 00 00 00 02 0E 00
				39 00 00 00 00 00 02 0F 76
				39 00 00 00 00 00 02 10 00
				39 00 00 00 00 00 02 11 85
				39 00 00 00 00 00 02 12 00
				39 00 00 00 00 00 02 13 95
				39 00 00 00 00 00 02 14 00
				39 00 00 00 00 00 02 15 A5
				39 00 00 00 00 00 02 16 00
				39 00 00 00 00 00 02 17 B7
				39 00 00 00 00 00 02 18 00
				39 00 00 00 00 00 02 19 C6
				39 00 00 00 00 00 02 1A 00
				39 00 00 00 00 00 02 1B D6
				39 00 00 00 00 00 02 1C 00
				39 00 00 00 00 00 02 1D E6
				39 00 00 00 00 00 02 1E 00
				39 00 00 00 00 00 02 1F F6
				39 00 00 00 00 00 02 20 01
				39 00 00 00 00 00 02 21 05
				39 00 00 00 00 00 02 22 01
				39 00 00 00 00 00 02 23 16
				39 00 00 00 00 00 02 24 01
				39 00 00 00 00 00 02 25 24
				39 00 00 00 00 00 02 26 01
				39 00 00 00 00 00 02 27 32
				39 00 00 00 00 00 02 28 01
				39 00 00 00 00 00 02 29 41
				39 00 00 00 00 00 02 2A 01
				39 00 00 00 00 00 02 2B 51
				39 00 00 00 00 00 02 2C 01
				39 00 00 00 00 00 02 2D 62
				39 00 00 00 00 00 02 2E 01
				39 00 00 00 00 00 02 2F 72
				39 00 00 00 00 00 02 30 01
				39 00 00 00 00 00 02 31 82
				39 00 00 00 00 00 02 32 01
				39 00 00 00 00 00 02 33 94
				39 00 00 00 00 00 02 34 01
				39 00 00 00 00 00 02 35 A4
				39 00 00 00 00 00 02 36 01
				39 00 00 00 00 00 02 37 C3
				39 00 00 00 00 00 02 38 01
				39 00 00 00 00 00 02 39 E2
				39 00 00 00 00 00 02 3A 02
				39 00 00 00 00 00 02 3B 02
				39 00 00 00 00 00 02 3C 02
				39 00 00 00 00 00 02 3D 1D
				39 00 00 00 00 00 02 3E 02
				39 00 00 00 00 00 02 3F 3F
				39 00 00 00 00 00 02 40 02
				39 00 00 00 00 00 02 41 5C
				39 00 00 00 00 00 02 42 02
				39 00 00 00 00 00 02 43 7B
				39 00 00 00 00 00 02 44 02
				39 00 00 00 00 00 02 45 9C
				39 00 00 00 00 00 02 46 02
				39 00 00 00 00 00 02 47 BE
				39 00 00 00 00 00 02 48 02
				39 00 00 00 00 00 02 49 DA
				39 00 00 00 00 00 02 4A 02
				39 00 00 00 00 00 02 4B FA
				39 00 00 00 00 00 02 4C 03
				39 00 00 00 00 00 02 4D 1C
				39 00 00 00 00 00 02 4E 03
				39 00 00 00 00 00 02 4F 3C
				39 00 00 00 00 00 02 50 03
				39 00 00 00 00 00 02 51 5B
				39 00 00 00 00 00 02 52 03
				39 00 00 00 00 00 02 53 7B
				39 00 00 00 00 00 02 54 03
				39 00 00 00 00 00 02 55 A0
				39 00 00 00 00 00 02 56 03
				39 00 00 00 00 00 02 57 BC
				39 00 00 00 00 00 02 58 03
				39 00 00 00 00 00 02 59 DB
				39 00 00 00 00 00 02 5A 00
				39 01 00 00 00 00 02 5B 01
				39 00 00 00 00 00 04 FF 98 81 06
				39 00 00 00 00 00 04 FF 98 81 06
				39 00 00 00 00 00 02 00 00
				39 00 00 00 00 00 02 01 00
				39 00 00 00 00 00 02 02 00
				39 00 00 00 00 00 02 03 0D
				39 00 00 00 00 00 02 04 00
				39 00 00 00 00 00 02 05 1C
				39 00 00 00 00 00 02 06 00
				39 00 00 00 00 00 02 07 29
				39 00 00 00 00 00 02 08 00
				39 00 00 00 00 00 02 09 36
				39 00 00 00 00 00 02 0A 00
				39 00 00 00 00 00 02 0B 45
				39 00 00 00 00 00 02 0C 00
				39 00 00 00 00 00 02 0D 54
				39 00 00 00 00 00 02 0E 00
				39 00 00 00 00 00 02 0F 62
				39 00 00 00 00 00 02 10 00
				39 00 00 00 00 00 02 11 70
				39 00 00 00 00 00 02 12 00
				39 00 00 00 00 00 02 13 7D
				39 00 00 00 00 00 02 14 00
				39 00 00 00 00 00 02 15 8A
				39 00 00 00 00 00 02 16 00
				39 00 00 00 00 00 02 17 98
				39 00 00 00 00 00 02 18 00
				39 00 00 00 00 00 02 19 A7
				39 00 00 00 00 00 02 1A 00
				39 00 00 00 00 00 02 1B B5
				39 00 00 00 00 00 02 1C 00
				39 00 00 00 00 00 02 1D C2
				39 00 00 00 00 00 02 1E 00
				39 00 00 00 00 00 02 1F D0
				39 00 00 00 00 00 02 20 00
				39 00 00 00 00 00 02 21 DF
				39 00 00 00 00 00 02 22 00
				39 00 00 00 00 00 02 23 EE
				39 00 00 00 00 00 02 24 00
				39 00 00 00 00 00 02 25 FD
				39 00 00 00 00 00 02 26 01
				39 00 00 00 00 00 02 27 0B
				39 00 00 00 00 00 02 28 01
				39 00 00 00 00 00 02 29 18
				39 00 00 00 00 00 02 2A 01
				39 00 00 00 00 00 02 2B 24
				39 00 00 00 00 00 02 2C 01
				39 00 00 00 00 00 02 2D 31
				39 00 00 00 00 00 02 2E 01
				39 00 00 00 00 00 02 2F 3C
				39 00 00 00 00 00 02 30 01
				39 00 00 00 00 00 02 31 4A
				39 00 00 00 00 00 02 32 01
				39 00 00 00 00 00 02 33 59
				39 00 00 00 00 00 02 34 01
				39 00 00 00 00 00 02 35 67
				39 00 00 00 00 00 02 36 01
				39 00 00 00 00 00 02 37 83
				39 00 00 00 00 00 02 38 01
				39 00 00 00 00 00 02 39 9E
				39 00 00 00 00 00 02 3A 01
				39 00 00 00 00 00 02 3B B9
				39 00 00 00 00 00 02 3C 01
				39 00 00 00 00 00 02 3D D4
				39 00 00 00 00 00 02 3E 01
				39 00 00 00 00 00 02 3F EE
				39 00 00 00 00 00 02 40 02
				39 00 00 00 00 00 02 41 0A
				39 00 00 00 00 00 02 42 02
				39 00 00 00 00 00 02 43 26
				39 00 00 00 00 00 02 44 02
				39 00 00 00 00 00 02 45 43
				39 00 00 00 00 00 02 46 02
				39 00 00 00 00 00 02 47 5C
				39 00 00 00 00 00 02 48 02
				39 00 00 00 00 00 02 49 77
				39 00 00 00 00 00 02 4A 02
				39 00 00 00 00 00 02 4B 92
				39 00 00 00 00 00 02 4C 02
				39 00 00 00 00 00 02 4D AF
				39 00 00 00 00 00 02 4E 02
				39 00 00 00 00 00 02 4F CA
				39 00 00 00 00 00 02 50 02
				39 00 00 00 00 00 02 51 E4
				39 00 00 00 00 00 02 52 02
				39 00 00 00 00 00 02 53 FF
				39 00 00 00 00 00 02 54 03
				39 00 00 00 00 00 02 55 21
				39 00 00 00 00 00 02 56 03
				39 00 00 00 00 00 02 57 39
				39 00 00 00 00 00 02 58 03
				39 00 00 00 00 00 02 59 55
				39 00 00 00 00 00 02 5A 03
				39 01 00 00 00 00 02 5B 70
				39 00 00 00 00 00 04 FF 98 81 07
				39 00 00 00 00 00 04 FF 98 81 07
				39 00 00 00 00 00 02 00 00
				39 00 00 00 00 00 02 01 00
				39 00 00 00 00 00 02 02 00
				39 00 00 00 00 00 02 03 0A
				39 00 00 00 00 00 02 04 00
				39 00 00 00 00 00 02 05 13
				39 00 00 00 00 00 02 06 00
				39 00 00 00 00 00 02 07 25
				39 00 00 00 00 00 02 08 00
				39 00 00 00 00 00 02 09 30
				39 00 00 00 00 00 02 0A 00
				39 00 00 00 00 00 02 0B 3B
				39 00 00 00 00 00 02 0C 00
				39 00 00 00 00 00 02 0D 43
				39 00 00 00 00 00 02 0E 00
				39 00 00 00 00 00 02 0F 51
				39 00 00 00 00 00 02 10 00
				39 00 00 00 00 00 02 11 5F
				39 00 00 00 00 00 02 12 00
				39 00 00 00 00 00 02 13 6D
				39 00 00 00 00 00 02 14 00
				39 00 00 00 00 00 02 15 7B
				39 00 00 00 00 00 02 16 00
				39 00 00 00 00 00 02 17 87
				39 00 00 00 00 00 02 18 00
				39 00 00 00 00 00 02 19 94
				39 00 00 00 00 00 02 1A 00
				39 00 00 00 00 00 02 1B A2
				39 00 00 00 00 00 02 1C 00
				39 00 00 00 00 00 02 1D B0
				39 00 00 00 00 00 02 1E 00
				39 00 00 00 00 00 02 1F BC
				39 00 00 00 00 00 02 20 00
				39 00 00 00 00 00 02 21 C9
				39 00 00 00 00 00 02 22 00
				39 00 00 00 00 00 02 23 D6
				39 00 00 00 00 00 02 24 00
				39 00 00 00 00 00 02 25 E4
				39 00 00 00 00 00 02 26 00
				39 00 00 00 00 00 02 27 F2
				39 00 00 00 00 00 02 28 00
				39 00 00 00 00 00 02 29 FF
				39 00 00 00 00 00 02 2A 01
				39 00 00 00 00 00 02 2B 0B
				39 00 00 00 00 00 02 2C 01
				39 00 00 00 00 00 02 2D 18
				39 00 00 00 00 00 02 2E 01
				39 00 00 00 00 00 02 2F 23
				39 00 00 00 00 00 02 30 01
				39 00 00 00 00 00 02 31 2F
				39 00 00 00 00 00 02 32 01
				39 00 00 00 00 00 02 33 39
				39 00 00 00 00 00 02 34 01
				39 00 00 00 00 00 02 35 46
				39 00 00 00 00 00 02 36 01
				39 00 00 00 00 00 02 37 60
				39 00 00 00 00 00 02 38 01
				39 00 00 00 00 00 02 39 79
				39 00 00 00 00 00 02 3A 01
				39 00 00 00 00 00 02 3B 93
				39 00 00 00 00 00 02 3C 01
				39 00 00 00 00 00 02 3D AD
				39 00 00 00 00 00 02 3E 01
				39 00 00 00 00 00 02 3F C5
				39 00 00 00 00 00 02 40 01
				39 00 00 00 00 00 02 41 DD
				39 00 00 00 00 00 02 42 01
				39 00 00 00 00 00 02 43 F6
				39 00 00 00 00 00 02 44 02
				39 00 00 00 00 00 02 45 0F
				39 00 00 00 00 00 02 46 02
				39 00 00 00 00 00 02 47 29
				39 00 00 00 00 00 02 48 02
				39 00 00 00 00 00 02 49 43
				39 00 00 00 00 00 02 4A 02
				39 00 00 00 00 00 02 4B 5A
				39 00 00 00 00 00 02 4C 02
				39 00 00 00 00 00 02 4D 73
				39 00 00 00 00 00 02 4E 02
				39 00 00 00 00 00 02 4F 8C
				39 00 00 00 00 00 02 50 02
				39 00 00 00 00 00 02 51 A6
				39 00 00 00 00 00 02 52 02
				39 00 00 00 00 00 02 53 C0
				39 00 00 00 00 00 02 54 02
				39 00 00 00 00 00 02 55 DB
				39 00 00 00 00 00 02 56 02
				39 00 00 00 00 00 02 57 EF
				39 00 00 00 00 00 02 58 03
				39 00 00 00 00 00 02 59 0B
				39 00 00 00 00 00 02 5A 03
				39 00 00 00 00 00 02 5B 25
				39 00 00 00 00 00 04 FF 98 81 00
				39 01 00 00 00 00 04 FF 98 81 00];
		qcom,mdss-dsi-panel-cool-command = [
				39 00 00 00 00 00 04 FF 98 81 01
				39 00 00 00 00 00 04 FF 98 81 01
				39 00 00 00 00 00 02 A0 00
				39 00 00 00 00 00 02 A1 19
				39 00 00 00 00 00 02 A2 29
				39 00 00 00 00 00 02 A3 14
				39 00 00 00 00 00 02 A4 18
				39 00 00 00 00 00 02 A5 2A
				39 00 00 00 00 00 02 A6 20
				39 00 00 00 00 00 02 A7 20
				39 00 00 00 00 00 02 A8 91
				39 00 00 00 00 00 02 A9 1C
				39 00 00 00 00 00 02 AA 28
				39 00 00 00 00 00 02 AB 7E
				39 00 00 00 00 00 02 AC 1C
				39 00 00 00 00 00 02 AD 1C
				39 00 00 00 00 00 02 AE 51
				39 00 00 00 00 00 02 AF 26
				39 00 00 00 00 00 02 B0 2B
				39 00 00 00 00 00 02 B1 57
				39 00 00 00 00 00 02 B2 66
				39 00 00 00 00 00 02 B3 32
				39 00 00 00 00 00 02 C0 00
				39 00 00 00 00 00 02 C1 19
				39 00 00 00 00 00 02 C2 29
				39 00 00 00 00 00 02 C3 14
				39 00 00 00 00 00 02 C4 18
				39 00 00 00 00 00 02 C5 2A
				39 00 00 00 00 00 02 C6 20
				39 00 00 00 00 00 02 C7 20
				39 00 00 00 00 00 02 C8 91
				39 00 00 00 00 00 02 C9 1C
				39 00 00 00 00 00 02 CA 28
				39 00 00 00 00 00 02 CB 7E
				39 00 00 00 00 00 02 CC 1C
				39 00 00 00 00 00 02 CD 1C
				39 00 00 00 00 00 02 CE 51
				39 00 00 00 00 00 02 CF 26
				39 00 00 00 00 00 02 D0 2B
				39 00 00 00 00 00 02 D1 57
				39 00 00 00 00 00 02 D2 66
				39 01 00 00 00 00 02 D3 32
				39 00 00 00 00 00 04 FF 98 81 05
				39 00 00 00 00 00 04 FF 98 81 05
				39 00 00 00 00 00 02 85 48
				39 00 00 00 00 00 02 00 00
				39 00 00 00 00 00 02 01 00
				39 00 00 00 00 00 02 02 00
				39 00 00 00 00 00 02 03 17
				39 00 00 00 00 00 02 04 00
				39 00 00 00 00 00 02 05 27
				39 00 00 00 00 00 02 06 00
				39 00 00 00 00 00 02 07 35
				39 00 00 00 00 00 02 08 00
				39 00 00 00 00 00 02 09 44
				39 00 00 00 00 00 02 0A 00
				39 00 00 00 00 00 02 0B 53
				39 00 00 00 00 00 02 0C 00
				39 00 00 00 00 00 02 0D 65
				39 00 00 00 00 00 02 0E 00
				39 00 00 00 00 00 02 0F 76
				39 00 00 00 00 00 02 10 00
				39 00 00 00 00 00 02 11 81
				39 00 00 00 00 00 02 12 00
				39 00 00 00 00 00 02 13 91
				39 00 00 00 00 00 02 14 00
				39 00 00 00 00 00 02 15 A5
				39 00 00 00 00 00 02 16 00
				39 00 00 00 00 00 02 17 B5
				39 00 00 00 00 00 02 18 00
				39 00 00 00 00 00 02 19 C4
				39 00 00 00 00 00 02 1A 00
				39 00 00 00 00 00 02 1B D6
				39 00 00 00 00 00 02 1C 00
				39 00 00 00 00 00 02 1D E9
				39 00 00 00 00 00 02 1E 00
				39 00 00 00 00 00 02 1F FA
				39 00 00 00 00 00 02 20 01
				39 00 00 00 00 00 02 21 08
				39 00 00 00 00 00 02 22 01
				39 00 00 00 00 00 02 23 17
				39 00 00 00 00 00 02 24 01
				39 00 00 00 00 00 02 25 25
				39 00 00 00 00 00 02 26 01
				39 00 00 00 00 00 02 27 34
				39 00 00 00 00 00 02 28 01
				39 00 00 00 00 00 02 29 42
				39 00 00 00 00 00 02 2A 01
				39 00 00 00 00 00 02 2B 54
				39 00 00 00 00 00 02 2C 01
				39 00 00 00 00 00 02 2D 64
				39 00 00 00 00 00 02 2E 01
				39 00 00 00 00 00 02 2F 74
				39 00 00 00 00 00 02 30 01
				39 00 00 00 00 00 02 31 83
				39 00 00 00 00 00 02 32 01
				39 00 00 00 00 00 02 33 92
				39 00 00 00 00 00 02 34 01
				39 00 00 00 00 00 02 35 A2
				39 00 00 00 00 00 02 36 01
				39 00 00 00 00 00 02 37 C2
				39 00 00 00 00 00 02 38 01
				39 00 00 00 00 00 02 39 E1
				39 00 00 00 00 00 02 3A 02
				39 00 00 00 00 00 02 3B 00
				39 00 00 00 00 00 02 3C 02
				39 00 00 00 00 00 02 3D 1F
				39 00 00 00 00 00 02 3E 02
				39 00 00 00 00 00 02 3F 41
				39 00 00 00 00 00 02 40 02
				39 00 00 00 00 00 02 41 5F
				39 00 00 00 00 00 02 42 02
				39 00 00 00 00 00 02 43 7E
				39 00 00 00 00 00 02 44 02
				39 00 00 00 00 00 02 45 9F
				39 00 00 00 00 00 02 46 02
				39 00 00 00 00 00 02 47 C1
				39 00 00 00 00 00 02 48 02
				39 00 00 00 00 00 02 49 DD
				39 00 00 00 00 00 02 4A 02
				39 00 00 00 00 00 02 4B FB
				39 00 00 00 00 00 02 4C 03
				39 00 00 00 00 00 02 4D 20
				39 00 00 00 00 00 02 4E 03
				39 00 00 00 00 00 02 4F 3B
				39 00 00 00 00 00 02 50 03
				39 00 00 00 00 00 02 51 5B
				39 00 00 00 00 00 02 52 03
				39 00 00 00 00 00 02 53 7C
				39 00 00 00 00 00 02 54 03
				39 00 00 00 00 00 02 55 A0
				39 00 00 00 00 00 02 56 03
				39 00 00 00 00 00 02 57 C3
				39 00 00 00 00 00 02 58 03
				39 00 00 00 00 00 02 59 E3
				39 00 00 00 00 00 02 5A 00
				39 01 00 00 00 00 02 5B 00
				39 00 00 00 00 00 04 FF 98 81 06
				39 00 00 00 00 00 04 FF 98 81 06
				39 00 00 00 00 00 02 00 00
				39 00 00 00 00 00 02 01 00
				39 00 00 00 00 00 02 02 00
				39 00 00 00 00 00 02 03 12
				39 00 00 00 00 00 02 04 00
				39 00 00 00 00 00 02 05 21
				39 00 00 00 00 00 02 06 00
				39 00 00 00 00 00 02 07 2F
				39 00 00 00 00 00 02 08 00
				39 00 00 00 00 00 02 09 3D
				39 00 00 00 00 00 02 0A 00
				39 00 00 00 00 00 02 0B 4B
				39 00 00 00 00 00 02 0C 00
				39 00 00 00 00 00 02 0D 5A
				39 00 00 00 00 00 02 0E 00
				39 00 00 00 00 00 02 0F 69
				39 00 00 00 00 00 02 10 00
				39 00 00 00 00 00 02 11 77
				39 00 00 00 00 00 02 12 00
				39 00 00 00 00 00 02 13 85
				39 00 00 00 00 00 02 14 00
				39 00 00 00 00 00 02 15 94
				39 00 00 00 00 00 02 16 00
				39 00 00 00 00 00 02 17 A4
				39 00 00 00 00 00 02 18 00
				39 00 00 00 00 00 02 19 B3
				39 00 00 00 00 00 02 1A 00
				39 00 00 00 00 00 02 1B C3
				39 00 00 00 00 00 02 1C 00
				39 00 00 00 00 00 02 1D D1
				39 00 00 00 00 00 02 1E 00
				39 00 00 00 00 00 02 1F E1
				39 00 00 00 00 00 02 20 00
				39 00 00 00 00 00 02 21 EF
				39 00 00 00 00 00 02 22 00
				39 00 00 00 00 00 02 23 FF
				39 00 00 00 00 00 02 24 01
				39 00 00 00 00 00 02 25 11
				39 00 00 00 00 00 02 26 01
				39 00 00 00 00 00 02 27 1F
				39 00 00 00 00 00 02 28 01
				39 00 00 00 00 00 02 29 2B
				39 00 00 00 00 00 02 2A 01
				39 00 00 00 00 00 02 2B 39
				39 00 00 00 00 00 02 2C 01
				39 00 00 00 00 00 02 2D 47
				39 00 00 00 00 00 02 2E 01
				39 00 00 00 00 00 02 2F 56
				39 00 00 00 00 00 02 30 01
				39 00 00 00 00 00 02 31 66
				39 00 00 00 00 00 02 32 01
				39 00 00 00 00 00 02 33 75
				39 00 00 00 00 00 02 34 01
				39 00 00 00 00 00 02 35 85
				39 00 00 00 00 00 02 36 01
				39 00 00 00 00 00 02 37 A1
				39 00 00 00 00 00 02 38 01
				39 00 00 00 00 00 02 39 BE
				39 00 00 00 00 00 02 3A 01
				39 00 00 00 00 00 02 3B DB
				39 00 00 00 00 00 02 3C 01
				39 00 00 00 00 00 02 3D F6
				39 00 00 00 00 00 02 3E 02
				39 00 00 00 00 00 02 3F 14
				39 00 00 00 00 00 02 40 02
				39 00 00 00 00 00 02 41 33
				39 00 00 00 00 00 02 42 02
				39 00 00 00 00 00 02 43 4F
				39 00 00 00 00 00 02 44 02
				39 00 00 00 00 00 02 45 6C
				39 00 00 00 00 00 02 46 02
				39 00 00 00 00 00 02 47 8A
				39 00 00 00 00 00 02 48 02
				39 00 00 00 00 00 02 49 A9
				39 00 00 00 00 00 02 4A 02
				39 00 00 00 00 00 02 4B C5
				39 00 00 00 00 00 02 4C 02
				39 00 00 00 00 00 02 4D E3
				39 00 00 00 00 00 02 4E 03
				39 00 00 00 00 00 02 4F 00
				39 00 00 00 00 00 02 50 03
				39 00 00 00 00 00 02 51 21
				39 00 00 00 00 00 02 52 03
				39 00 00 00 00 00 02 53 3F
				39 00 00 00 00 00 02 54 03
				39 00 00 00 00 00 02 55 61
				39 00 00 00 00 00 02 56 03
				39 00 00 00 00 00 02 57 7C
				39 00 00 00 00 00 02 58 03
				39 00 00 00 00 00 02 59 9B
				39 00 00 00 00 00 02 5A 03
				39 01 00 00 00 00 02 5B B6
				39 00 00 00 00 00 04 FF 98 81 07
				39 00 00 00 00 00 04 FF 98 81 07
				39 00 00 00 00 00 02 00 00
				39 00 00 00 00 00 02 01 00
				39 00 00 00 00 00 02 02 00
				39 00 00 00 00 00 02 03 09
				39 00 00 00 00 00 02 04 00
				39 00 00 00 00 00 02 05 16
				39 00 00 00 00 00 02 06 00
				39 00 00 00 00 00 02 07 26
				39 00 00 00 00 00 02 08 00
				39 00 00 00 00 00 02 09 36
				39 00 00 00 00 00 02 0A 00
				39 00 00 00 00 00 02 0B 43
				39 00 00 00 00 00 02 0C 00
				39 00 00 00 00 00 02 0D 4F
				39 00 00 00 00 00 02 0E 00
				39 00 00 00 00 00 02 0F 5E
				39 00 00 00 00 00 02 10 00
				39 00 00 00 00 00 02 11 6D
				39 00 00 00 00 00 02 12 00
				39 00 00 00 00 00 02 13 7D
				39 00 00 00 00 00 02 14 00
				39 00 00 00 00 00 02 15 8D
				39 00 00 00 00 00 02 16 00
				39 00 00 00 00 00 02 17 9E
				39 00 00 00 00 00 02 18 00
				39 00 00 00 00 00 02 19 AD
				39 00 00 00 00 00 02 1A 00
				39 00 00 00 00 00 02 1B BE
				39 00 00 00 00 00 02 1C 00
				39 00 00 00 00 00 02 1D CC
				39 00 00 00 00 00 02 1E 00
				39 00 00 00 00 00 02 1F DC
				39 00 00 00 00 00 02 20 00
				39 00 00 00 00 00 02 21 EC
				39 00 00 00 00 00 02 22 00
				39 00 00 00 00 00 02 23 FC
				39 00 00 00 00 00 02 24 01
				39 00 00 00 00 00 02 25 0C
				39 00 00 00 00 00 02 26 01
				39 00 00 00 00 00 02 27 1A
				39 00 00 00 00 00 02 28 01
				39 00 00 00 00 00 02 29 27
				39 00 00 00 00 00 02 2A 01
				39 00 00 00 00 00 02 2B 35
				39 00 00 00 00 00 02 2C 01
				39 00 00 00 00 00 02 2D 42
				39 00 00 00 00 00 02 2E 01
				39 00 00 00 00 00 02 2F 51
				39 00 00 00 00 00 02 30 01
				39 00 00 00 00 00 02 31 60
				39 00 00 00 00 00 02 32 01
				39 00 00 00 00 00 02 33 6F
				39 00 00 00 00 00 02 34 01
				39 00 00 00 00 00 02 35 7E
				39 00 00 00 00 00 02 36 01
				39 00 00 00 00 00 02 37 9C
				39 00 00 00 00 00 02 38 01
				39 00 00 00 00 00 02 39 B9
				39 00 00 00 00 00 02 3A 01
				39 00 00 00 00 00 02 3B D5
				39 00 00 00 00 00 02 3C 01
				39 00 00 00 00 00 02 3D F1
				39 00 00 00 00 00 02 3E 02
				39 00 00 00 00 00 02 3F 0E
				39 00 00 00 00 00 02 40 02
				39 00 00 00 00 00 02 41 2C
				39 00 00 00 00 00 02 42 02
				39 00 00 00 00 00 02 43 49
				39 00 00 00 00 00 02 44 02
				39 00 00 00 00 00 02 45 65
				39 00 00 00 00 00 02 46 02
				39 00 00 00 00 00 02 47 82
				39 00 00 00 00 00 02 48 02
				39 00 00 00 00 00 02 49 A0
				39 00 00 00 00 00 02 4A 02
				39 00 00 00 00 00 02 4B BE
				39 00 00 00 00 00 02 4C 02
				39 00 00 00 00 00 02 4D DA
				39 00 00 00 00 00 02 4E 02
				39 00 00 00 00 00 02 4F F6
				39 00 00 00 00 00 02 50 03
				39 00 00 00 00 00 02 51 17
				39 00 00 00 00 00 02 52 03
				39 00 00 00 00 00 02 53 37
				39 00 00 00 00 00 02 54 03
				39 00 00 00 00 00 02 55 56
				39 00 00 00 00 00 02 56 03
				39 00 00 00 00 00 02 57 72
				39 00 00 00 00 00 02 58 03
				39 00 00 00 00 00 02 59 8F
				39 00 00 00 00 00 02 5A 03
				39 00 00 00 00 00 02 5B AB
				39 00 00 00 00 00 04 FF 98 81 00
				39 01 00 00 00 00 04 FF 98 81 00 ];
		qcom,mdss-dsi-panel-nature-command =  [39 00 00 00 00 00 04 FF 98 81 04
				39 00 00 00 00 00 04 FF 98 81 04
				39 00 00 00 00 00 02 E5 02
				39 00 00 00 0A 00 04 FF 98 81 00
				39 00 00 00 0A 00 02 11 00
				39 00 00 00 00 00 04 FF 98 81 03
				39 00 00 00 00 00 02 2C 0C
				39 01 00 00 00 00 04 FF 98 81 00];
		qcom,mdss-dsi-panel-gamma-command-state = "dsi_hs_mode";

		qcom,mdss-dsi-init-last;

		qcom,mdss-dsi-panel-ce-std-command = [39 01 00 00 00 00 04 FF 98 81 02
				39 01 00 00 00 00 04 FF 98 81 02
				39 01 00 00 00 00 02 10 06
				39 01 00 00 00 00 04 FF 98 81 00
				39 01 00 00 00 00 04 FF 98 81 00];
		qcom,mdss-dsi-panel-ce-vivid-command = [39 00 00 00 00 00 04 FF 98 81 02
				39 00 00 00 00 00 04 FF 98 81 02
				39 00 00 00 00 00 02 10 16
				39 00 00 00 00 00 02 68 02
				39 00 00 00 00 00 02 69 03
				39 00 00 00 00 00 02 6A 03
				39 00 00 00 00 00 02 6B 03
				39 00 00 00 00 00 02 6C 00
				39 00 00 00 00 00 02 6D 04
				39 00 00 00 00 00 02 6E 04
				39 00 00 00 00 00 02 6F 05
				39 00 00 00 00 00 02 70 05
				39 00 00 00 00 00 02 71 05
				39 00 00 00 00 00 02 72 03
				39 00 00 00 00 00 02 73 01
				39 00 00 00 00 00 02 74 01
				39 00 00 00 00 00 02 75 02
				39 00 00 00 00 00 02 76 04
				39 00 00 00 00 00 02 77 02
				39 00 00 00 00 00 02 78 02
				39 00 00 00 00 00 02 79 02
				39 00 00 00 00 00 02 7A 02
				39 00 00 00 00 00 02 7B 02
				39 00 00 00 00 00 02 7C 02
				39 00 00 00 00 00 02 7D 02
				39 00 00 00 00 00 02 7E 02
				39 00 00 00 00 00 02 7F 02
				39 00 00 00 00 00 04 FF 98 81 00
				39 01 00 00 00 00 04 FF 98 81 00];
		qcom,mdss-dsi-panel-ce-command-state = "dsi_hs_mode";

		qcom,mdss-dsi-h-sync-pulse = <1>;
		qcom,mdss-dsi-traffic-mode = "burst_mode";
		qcom,mdss-dsi-bllp-eof-power-mode;
		qcom,mdss-dsi-bllp-power-mode;
		qcom,mdss-dsi-lane-0-state;
		qcom,mdss-dsi-lane-1-state;
		qcom,mdss-dsi-lane-2-state;
		qcom,mdss-dsi-lane-3-state;

		qcom,mdss-dsi-panel-timings = [8B 1E 14 00 44 48 18 22 19 03 04 00];
		qcom,mdss-dsi-t-clk-post = <0x04>;
		qcom,mdss-dsi-t-clk-pre = <0x1c>;
		qcom,mdss-dsi-bl-min-level = <4>;
		qcom,mdss-dsi-bl-max-level = <255>;
		qcom,mdss-dsi-bl-pmic-pwm-frequency = <100>;
		qcom,mdss-dsi-bl-pmic-bank-select = <0>;
		qcom,mdss-dsi-dma-trigger = "trigger_sw";
		qcom,mdss-dsi-mdp-trigger = "none";
		qcom,mdss-dsi-bl-pmic-control-type = "bl_ctrl_pwm";
		qcom,mdss-dsi-pwm-gpio = <&pm8937_mpps 4 0>;

		qcom,esd-check-enabled;
		qcom,mdss-dsi-panel-status-command = [06 01 00 01 05 00 02 0A 08];
		qcom,mdss-dsi-panel-status-command-state = "dsi_hs_mode";
		qcom,mdss-dsi-panel-status-check-mode = "reg_read";
		qcom,mdss-dsi-panel-status-valid-params = <1>;
		qcom,mdss-dsi-panel-status-value = <0x9c>;
		qcom,mdss-dsi-panel-status-read-length = <1>;

		qcom,mdss-dsi-lp11-init;
		qcom,mdss-dsi-init-delay-us = <50000>;
		qcom,mdss-dsi-reset-sequence = <1 5>, <0 10>, <1 80>;

	};
};
