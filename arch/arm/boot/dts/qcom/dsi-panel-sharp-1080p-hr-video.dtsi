/* Copyright (c) 2014-2015, The Linux Foundation. All rights reserved.
 *
 * This program is free software; you can redistribute it and/or modify
 * it under the terms of the GNU General Public License version 2 and
 * only version 2 as published by the Free Software Foundation.
 *
 * This program is distributed in the hope that it will be useful,
 * but WITHOUT ANY WARRANTY; without even the implied warranty of
 * MERCHANTABILITY or FITNESS FOR A PARTICULAR PURPOSE.  See the
 * GNU General Public License for more details.
 */

&mdss_mdp {
	dsi_sharp_1080_hr_vid: qcom,mdss_dsi_sharp_1080p_hr_video {
		qcom,mdss-dsi-panel-name = "Sharp 1080p hr video mode dsi panel";
		qcom,mdss-dsi-panel-type = "dsi_video_mode";
		qcom,mdss-dsi-panel-framerate = <60>;
		qcom,mdss-dsi-virtual-channel-id = <0>;
		qcom,mdss-dsi-stream = <0>;
		qcom,mdss-dsi-panel-width = <1080>;
		qcom,mdss-dsi-panel-height = <1920>;
		qcom,mdss-dsi-h-front-porch = <157>;
		qcom,mdss-dsi-h-back-porch = <44>;
		qcom,mdss-dsi-h-pulse-width = <16>;
		qcom,mdss-dsi-h-sync-skew = <0>;
		qcom,mdss-dsi-v-back-porch = <6>;
		qcom,mdss-dsi-v-front-porch = <14>;
		qcom,mdss-dsi-v-pulse-width = <2>;
		qcom,mdss-dsi-h-left-border = <0>;
		qcom,mdss-dsi-h-right-border = <0>;
		qcom,mdss-dsi-v-top-border = <0>;
		qcom,mdss-dsi-v-bottom-border = <0>;
		qcom,mdss-dsi-bpp = <24>;
		qcom,mdss-dsi-underflow-color = <0xff>;
		qcom,mdss-dsi-border-color = <0>;
		qcom,mdss-dsi-on-command = [15 01 00 00 00 00 02 ff 00
			15 01 00 00 00 00 02 36 00
			15 01 00 00 00 00 02 b0 18
			05 01 00 00 00 00 02 d3 08
			05 01 00 00 00 00 02 d4 0d
			05 01 00 00 00 00 02 d5 0a
			05 01 00 00 00 00 02 d6 0a
			05 01 00 00 00 00 02 d9 61
			05 01 00 00 00 00 02 fb 01
			05 01 00 00 00 00 02 ff 01
			05 01 00 00 00 00 02 fb 01
			05 01 00 00 00 00 02 04 0c
			05 01 00 00 00 00 02 05 3a
			05 01 00 00 00 00 02 06 55
			05 01 00 00 00 00 02 07 d5
			05 01 00 00 00 00 02 0a 0f
			05 01 00 00 00 00 02 0c a6
			05 01 00 00 00 00 02 0d 9d
			05 01 00 00 00 00 02 0e 9d
			05 01 00 00 00 00 02 0f 70
			05 01 00 00 00 00 02 10 63
			05 01 00 00 00 00 02 11 50
			05 01 00 00 00 00 02 12 6e
			05 01 00 00 00 00 02 16 15
			05 01 00 00 00 00 02 17 15
			05 01 00 00 00 00 02 5b ca
			05 01 00 00 00 00 02 60 d5
			05 01 00 00 00 00 02 61 f7
			05 01 00 00 00 00 02 6c ab
			05 01 00 00 00 00 02 6d 44
			05 01 00 00 00 00 02 75 00
			05 01 00 00 00 00 02 76 44
			05 01 00 00 00 00 02 77 00
			05 01 00 00 00 00 02 78 4e
			05 01 00 00 00 00 02 79 00
			05 01 00 00 00 00 02 7a 5c
			05 01 00 00 00 00 02 7b 00
			05 01 00 00 00 00 02 7c 69
			05 01 00 00 00 00 02 7d 00
			05 01 00 00 00 00 02 7e 77
			05 01 00 00 00 00 02 7f 00
			05 01 00 00 00 00 02 80 84
			05 01 00 00 00 00 02 81 00
			05 01 00 00 00 00 02 82 90
			05 01 00 00 00 00 02 83 00
			05 01 00 00 00 00 02 84 9b
			05 01 00 00 00 00 02 85 00
			05 01 00 00 00 00 02 86 a5
			05 01 00 00 00 00 02 87 00
			05 01 00 00 00 00 02 88 c9
			05 01 00 00 00 00 02 89 00
			05 01 00 00 00 00 02 8a e7
			05 01 00 00 00 00 02 8b 01
			05 01 00 00 00 00 02 8c 18
			05 01 00 00 00 00 02 8d 01
			05 01 00 00 00 00 02 8e 3e
			05 01 00 00 00 00 02 8f 01
			05 01 00 00 00 00 02 90 7b
			05 01 00 00 00 00 02 91 01
			05 01 00 00 00 00 02 92 aa
			05 01 00 00 00 00 02 93 01
			05 01 00 00 00 00 02 94 ab
			05 01 00 00 00 00 02 95 01
			05 01 00 00 00 00 02 96 d7
			05 01 00 00 00 00 02 97 02
			05 01 00 00 00 00 02 98 05
			05 01 00 00 00 00 02 99 02
			05 01 00 00 00 00 02 9a 1f
			05 01 00 00 00 00 02 9b 02
			05 01 00 00 00 00 02 9c 42
			05 01 00 00 00 00 02 9d 02
			05 01 00 00 00 00 02 9e 60
			05 01 00 00 00 00 02 9f 02
			05 01 00 00 00 00 02 a0 8c
			05 01 00 00 00 00 02 a2 02
			05 01 00 00 00 00 02 a3 9b
			05 01 00 00 00 00 02 a4 02
			05 01 00 00 00 00 02 a5 af
			05 01 00 00 00 00 02 a6 02
			05 01 00 00 00 00 02 a7 c6
			05 01 00 00 00 00 02 a9 02
			05 01 00 00 00 00 02 aa e9
			05 01 00 00 00 00 02 ab 03
			05 01 00 00 00 00 02 ac 10
			05 01 00 00 00 00 02 ad 03
			05 01 00 00 00 00 02 ae 5c
			05 01 00 00 00 00 02 af 03
			05 01 00 00 00 00 02 b0 9b
			05 01 00 00 00 00 02 b1 03
			05 01 00 00 00 00 02 b2 9b
			05 01 00 00 00 00 02 b3 00
			05 01 00 00 00 00 02 b4 43
			05 01 00 00 00 00 02 b5 00
			05 01 00 00 00 00 02 b6 4f
			05 01 00 00 00 00 02 b7 00
			05 01 00 00 00 00 02 b8 5f
			05 01 00 00 00 00 02 b9 00
			05 01 00 00 00 00 02 ba 6e
			05 01 00 00 00 00 02 bb 00
			05 01 00 00 00 00 02 bc 7c
			05 01 00 00 00 00 02 bd 00
			05 01 00 00 00 00 02 be 89
			05 01 00 00 00 00 02 bf 00
			05 01 00 00 00 00 02 c0 95
			05 01 00 00 00 00 02 c1 00
			05 01 00 00 00 00 02 c2 a0
			05 01 00 00 00 00 02 c3 00
			05 01 00 00 00 00 02 c4 aa
			05 01 00 00 00 00 02 c5 00
			05 01 00 00 00 00 02 c6 ce
			05 01 00 00 00 00 02 c7 00
			05 01 00 00 00 00 02 c8 ec
			05 01 00 00 00 00 02 c9 01
			05 01 00 00 00 00 02 ca 1b
			05 01 00 00 00 00 02 cb 01
			05 01 00 00 00 00 02 cc 3f
			05 01 00 00 00 00 02 cd 01
			05 01 00 00 00 00 02 ce 7b
			05 01 00 00 00 00 02 cf 01
			05 01 00 00 00 00 02 d0 aa
			05 01 00 00 00 00 02 d1 01
			05 01 00 00 00 00 02 d2 ab
			05 01 00 00 00 00 02 d3 01
			05 01 00 00 00 00 02 d4 d7
			05 01 00 00 00 00 02 d5 02
			05 01 00 00 00 00 02 d6 00
			05 01 00 00 00 00 02 d7 02
			05 01 00 00 00 00 02 d8 1a
			05 01 00 00 00 00 02 d9 02
			05 01 00 00 00 00 02 da 39
			05 01 00 00 00 00 02 db 02
			05 01 00 00 00 00 02 dc 51
			05 01 00 00 00 00 02 dd 02
			05 01 00 00 00 00 02 de 75
			05 01 00 00 00 00 02 df 02
			05 01 00 00 00 00 02 e0 84
			05 01 00 00 00 00 02 e1 02
			05 01 00 00 00 00 02 e2 98
			05 01 00 00 00 00 02 e3 02
			05 01 00 00 00 00 02 e4 ab
			05 01 00 00 00 00 02 e5 02
			05 01 00 00 00 00 02 e6 c9
			05 01 00 00 00 00 02 e7 02
			05 01 00 00 00 00 02 e8 f5
			05 01 00 00 00 00 02 e9 03
			05 01 00 00 00 00 02 ea 41
			05 01 00 00 00 00 02 eb 03
			05 01 00 00 00 00 02 ec 7f
			05 01 00 00 00 00 02 ed 03
			05 01 00 00 00 00 02 ee 80
			05 01 00 00 00 00 02 ef 00
			05 01 00 00 00 00 02 f0 44
			05 01 00 00 00 00 02 f1 00
			05 01 00 00 00 00 02 f2 4e
			05 01 00 00 00 00 02 f3 00
			05 01 00 00 00 00 02 f4 5c
			05 01 00 00 00 00 02 f5 00
			05 01 00 00 00 00 02 f6 69
			05 01 00 00 00 00 02 f7 00
			05 01 00 00 00 00 02 f8 77
			05 01 00 00 00 00 02 f9 00
			05 01 00 00 00 00 02 fa 84
			05 01 00 00 00 00 02 ff 02
			05 01 00 00 00 00 02 00 00
			05 01 00 00 00 00 02 01 90
			05 01 00 00 00 00 02 02 00
			05 01 00 00 00 00 02 03 9b
			05 01 00 00 00 00 02 04 00
			05 01 00 00 00 00 02 05 a5
			05 01 00 00 00 00 02 06 00
			05 01 00 00 00 00 02 07 c9
			05 01 00 00 00 00 02 08 00
			05 01 00 00 00 00 02 09 e7
			05 01 00 00 00 00 02 0a 01
			05 01 00 00 00 00 02 0b 18
			05 01 00 00 00 00 02 0c 01
			05 01 00 00 00 00 02 0d 3e
			05 01 00 00 00 00 02 0e 01
			05 01 00 00 00 00 02 0f 7b
			05 01 00 00 00 00 02 10 01
			05 01 00 00 00 00 02 11 aa
			05 01 00 00 00 00 02 12 01
			05 01 00 00 00 00 02 13 ab
			05 01 00 00 00 00 02 14 01
			05 01 00 00 00 00 02 15 d7
			05 01 00 00 00 00 02 16 02
			05 01 00 00 00 00 02 17 05
			05 01 00 00 00 00 02 18 02
			05 01 00 00 00 00 02 19 1f
			05 01 00 00 00 00 02 1a 02
			05 01 00 00 00 00 02 1b 42
			05 01 00 00 00 00 02 1c 02
			05 01 00 00 00 00 02 1d 60
			05 01 00 00 00 00 02 1e 02
			05 01 00 00 00 00 02 1f 8c
			05 01 00 00 00 00 02 20 02
			05 01 00 00 00 00 02 21 9b
			05 01 00 00 00 00 02 22 02
			05 01 00 00 00 00 02 23 af
			05 01 00 00 00 00 02 24 02
			05 01 00 00 00 00 02 25 c6
			05 01 00 00 00 00 02 26 02
			05 01 00 00 00 00 02 27 e9
			05 01 00 00 00 00 02 28 03
			05 01 00 00 00 00 02 29 10
			05 01 00 00 00 00 02 2a 03
			05 01 00 00 00 00 02 2b 5c
			05 01 00 00 00 00 02 2d 03
			05 01 00 00 00 00 02 2f 9b
			05 01 00 00 00 00 02 30 03
			05 01 00 00 00 00 02 31 9b
			05 01 00 00 00 00 02 32 00
			05 01 00 00 00 00 02 33 43
			05 01 00 00 00 00 02 34 00
			05 01 00 00 00 00 02 35 4f
			05 01 00 00 00 00 02 36 00
			05 01 00 00 00 00 02 37 5f
			05 01 00 00 00 00 02 38 00
			05 01 00 00 00 00 02 39 6e
			05 01 00 00 00 00 02 3a 00
			05 01 00 00 00 00 02 3b 7c
			05 01 00 00 00 00 02 3d 00
			05 01 00 00 00 00 02 3f 89
			05 01 00 00 00 00 02 40 00
			05 01 00 00 00 00 02 41 95
			05 01 00 00 00 00 02 42 00
			05 01 00 00 00 00 02 43 a0
			05 01 00 00 00 00 02 44 00
			05 01 00 00 00 00 02 45 aa
			05 01 00 00 00 00 02 46 00
			05 01 00 00 00 00 02 47 ce
			05 01 00 00 00 00 02 48 00
			05 01 00 00 00 00 02 49 ec
			05 01 00 00 00 00 02 4a 01
			05 01 00 00 00 00 02 4b 1b
			05 01 00 00 00 00 02 4c 01
			05 01 00 00 00 00 02 4d 3f
			05 01 00 00 00 00 02 4e 01
			05 01 00 00 00 00 02 4f 7b
			05 01 00 00 00 00 02 50 01
			05 01 00 00 00 00 02 51 aa
			05 01 00 00 00 00 02 52 01
			05 01 00 00 00 00 02 53 ab
			05 01 00 00 00 00 02 54 01
			05 01 00 00 00 00 02 55 d7
			05 01 00 00 00 00 02 56 02
			05 01 00 00 00 00 02 58 00
			05 01 00 00 00 00 02 59 02
			05 01 00 00 00 00 02 5a 1a
			05 01 00 00 00 00 02 5b 02
			05 01 00 00 00 00 02 5c 39
			05 01 00 00 00 00 02 5d 02
			05 01 00 00 00 00 02 5e 51
			05 01 00 00 00 00 02 5f 02
			05 01 00 00 00 00 02 60 75
			05 01 00 00 00 00 02 61 02
			05 01 00 00 00 00 02 62 84
			05 01 00 00 00 00 02 63 02
			05 01 00 00 00 00 02 64 98
			05 01 00 00 00 00 02 65 02
			05 01 00 00 00 00 02 66 ab
			05 01 00 00 00 00 02 67 02
			05 01 00 00 00 00 02 68 c9
			05 01 00 00 00 00 02 69 02
			05 01 00 00 00 00 02 6a f5
			05 01 00 00 00 00 02 6b 03
			05 01 00 00 00 00 02 6c 41
			05 01 00 00 00 00 02 6d 03
			05 01 00 00 00 00 02 6e 7f
			05 01 00 00 00 00 02 6f 03
			05 01 00 00 00 00 02 70 80
			05 01 00 00 00 00 02 71 00
			05 01 00 00 00 00 02 72 44
			05 01 00 00 00 00 02 73 00
			05 01 00 00 00 00 02 74 4e
			05 01 00 00 00 00 02 75 00
			05 01 00 00 00 00 02 76 5c
			05 01 00 00 00 00 02 77 00
			05 01 00 00 00 00 02 78 69
			05 01 00 00 00 00 02 79 00
			05 01 00 00 00 00 02 7a 77
			05 01 00 00 00 00 02 7b 00
			05 01 00 00 00 00 02 7c 84
			05 01 00 00 00 00 02 7d 00
			05 01 00 00 00 00 02 7e 90
			05 01 00 00 00 00 02 7f 00
			05 01 00 00 00 00 02 80 9b
			05 01 00 00 00 00 02 81 00
			05 01 00 00 00 00 02 82 a5
			05 01 00 00 00 00 02 83 00
			05 01 00 00 00 00 02 84 c9
			05 01 00 00 00 00 02 85 00
			05 01 00 00 00 00 02 86 e7
			05 01 00 00 00 00 02 87 01
			05 01 00 00 00 00 02 88 18
			05 01 00 00 00 00 02 89 01
			05 01 00 00 00 00 02 8a 3e
			05 01 00 00 00 00 02 8b 01
			05 01 00 00 00 00 02 8c 7b
			05 01 00 00 00 00 02 8d 01
			05 01 00 00 00 00 02 8e aa
			05 01 00 00 00 00 02 8f 01
			05 01 00 00 00 00 02 90 ab
			05 01 00 00 00 00 02 91 01
			05 01 00 00 00 00 02 92 d7
			05 01 00 00 00 00 02 93 02
			05 01 00 00 00 00 02 94 05
			05 01 00 00 00 00 02 95 02
			05 01 00 00 00 00 02 96 1f
			05 01 00 00 00 00 02 97 02
			05 01 00 00 00 00 02 98 42
			05 01 00 00 00 00 02 99 02
			05 01 00 00 00 00 02 9a 60
			05 01 00 00 00 00 02 9b 02
			05 01 00 00 00 00 02 9c 8c
			05 01 00 00 00 00 02 9d 02
			05 01 00 00 00 00 02 9e 9b
			05 01 00 00 00 00 02 9f 02
			05 01 00 00 00 00 02 a0 af
			05 01 00 00 00 00 02 a2 02
			05 01 00 00 00 00 02 a3 c6
			05 01 00 00 00 00 02 a4 02
			05 01 00 00 00 00 02 a5 e9
			05 01 00 00 00 00 02 a6 03
			05 01 00 00 00 00 02 a7 10
			05 01 00 00 00 00 02 a9 03
			05 01 00 00 00 00 02 aa 5c
			05 01 00 00 00 00 02 ab 03
			05 01 00 00 00 00 02 ac 9b
			05 01 00 00 00 00 02 ad 03
			05 01 00 00 00 00 02 ae 9b
			05 01 00 00 00 00 02 af 00
			05 01 00 00 00 00 02 b0 43
			05 01 00 00 00 00 02 b1 00
			05 01 00 00 00 00 02 b2 4f
			05 01 00 00 00 00 02 b3 00
			05 01 00 00 00 00 02 b4 5f
			05 01 00 00 00 00 02 b5 00
			05 01 00 00 00 00 02 b6 6e
			05 01 00 00 00 00 02 b7 00
			05 01 00 00 00 00 02 b8 7c
			05 01 00 00 00 00 02 b9 00
			05 01 00 00 00 00 02 ba 89
			05 01 00 00 00 00 02 bb 00
			05 01 00 00 00 00 02 bc 95
			05 01 00 00 00 00 02 bd 00
			05 01 00 00 00 00 02 be a0
			05 01 00 00 00 00 02 bf 00
			05 01 00 00 00 00 02 c0 aa
			05 01 00 00 00 00 02 c1 00
			05 01 00 00 00 00 02 c2 ce
			05 01 00 00 00 00 02 c3 00
			05 01 00 00 00 00 02 c4 ec
			05 01 00 00 00 00 02 c5 01
			05 01 00 00 00 00 02 c6 1b
			05 01 00 00 00 00 02 c7 01
			05 01 00 00 00 00 02 c8 3f
			05 01 00 00 00 00 02 c9 01
			05 01 00 00 00 00 02 ca 7b
			05 01 00 00 00 00 02 cb 01
			05 01 00 00 00 00 02 cc aa
			05 01 00 00 00 00 02 cd 01
			05 01 00 00 00 00 02 ce ab
			05 01 00 00 00 00 02 cf 01
			05 01 00 00 00 00 02 d0 d7
			05 01 00 00 00 00 02 d1 02
			05 01 00 00 00 00 02 d2 00
			05 01 00 00 00 00 02 d3 02
			05 01 00 00 00 00 02 d4 1a
			05 01 00 00 00 00 02 d5 02
			05 01 00 00 00 00 02 d6 39
			05 01 00 00 00 00 02 d7 02
			05 01 00 00 00 00 02 d8 51
			05 01 00 00 00 00 02 d9 02
			05 01 00 00 00 00 02 da 75
			05 01 00 00 00 00 02 db 02
			05 01 00 00 00 00 02 dc 84
			05 01 00 00 00 00 02 dd 02
			05 01 00 00 00 00 02 de 98
			05 01 00 00 00 00 02 df 02
			05 01 00 00 00 00 02 e0 ab
			05 01 00 00 00 00 02 e1 02
			05 01 00 00 00 00 02 e2 c9
			05 01 00 00 00 00 02 e3 02
			05 01 00 00 00 00 02 e4 f5
			05 01 00 00 00 00 02 e5 03
			05 01 00 00 00 00 02 e6 41
			05 01 00 00 00 00 02 e7 03
			05 01 00 00 00 00 02 e8 7f
			05 01 00 00 00 00 02 e9 03
			05 01 00 00 00 00 02 ea 80
			05 01 00 00 00 00 02 fb 01
			05 01 00 00 00 00 02 ff 05
			05 01 00 00 00 00 02 fb 01
			05 01 00 00 00 00 02 00 0c
			05 01 00 00 00 00 02 01 08
			05 01 00 00 00 00 02 02 0e
			05 01 00 00 00 00 02 03 0e
			05 01 00 00 00 00 02 04 38
			05 01 00 00 00 00 02 05 1a
			05 01 00 00 00 00 02 06 16
			05 01 00 00 00 00 02 07 1b
			05 01 00 00 00 00 02 08 17
			05 01 00 00 00 00 02 09 1c
			05 01 00 00 00 00 02 0a 18
			05 01 00 00 00 00 02 0b 1d
			05 01 00 00 00 00 02 0c 19
			05 01 00 00 00 00 02 0d 38
			05 01 00 00 00 00 02 0e 0a
			05 01 00 00 00 00 02 0f 06
			05 01 00 00 00 00 02 10 0e
			05 01 00 00 00 00 02 11 0e
			05 01 00 00 00 00 02 12 38
			05 01 00 00 00 00 02 14 0a
			05 01 00 00 00 00 02 15 06
			05 01 00 00 00 00 02 16 0e
			05 01 00 00 00 00 02 17 0e
			05 01 00 00 00 00 02 18 38
			05 01 00 00 00 00 02 19 1a
			05 01 00 00 00 00 02 1a 16
			05 01 00 00 00 00 02 1b 1b
			05 01 00 00 00 00 02 1c 17
			05 01 00 00 00 00 02 1d 1c
			05 01 00 00 00 00 02 1e 18
			05 01 00 00 00 00 02 1f 1d
			05 01 00 00 00 00 02 20 19
			05 01 00 00 00 00 02 21 38
			05 01 00 00 00 00 02 22 0c
			05 01 00 00 00 00 02 23 08
			05 01 00 00 00 00 02 24 0e
			05 01 00 00 00 00 02 25 0e
			05 01 00 00 00 00 02 26 38
			05 01 00 00 00 00 02 28 0e
			05 01 00 00 00 00 02 29 0e
			05 01 00 00 00 00 02 2a 06
			05 01 00 00 00 00 02 2b 0a
			05 01 00 00 00 00 02 2d 38
			05 01 00 00 00 00 02 2f 19
			05 01 00 00 00 00 02 30 1d
			05 01 00 00 00 00 02 31 18
			05 01 00 00 00 00 02 32 1c
			05 01 00 00 00 00 02 33 17
			05 01 00 00 00 00 02 34 1b
			05 01 00 00 00 00 02 35 16
			05 01 00 00 00 00 02 36 1a
			05 01 00 00 00 00 02 37 38
			05 01 00 00 00 00 02 38 0e
			05 01 00 00 00 00 02 39 0e
			05 01 00 00 00 00 02 3a 08
			05 01 00 00 00 00 02 3b 0c
			05 01 00 00 00 00 02 3d 38
			05 01 00 00 00 00 02 40 0e
			05 01 00 00 00 00 02 41 0e
			05 01 00 00 00 00 02 42 08
			05 01 00 00 00 00 02 43 0c
			05 01 00 00 00 00 02 44 38
			05 01 00 00 00 00 02 45 19
			05 01 00 00 00 00 02 46 1d
			05 01 00 00 00 00 02 47 18
			05 01 00 00 00 00 02 48 1c
			05 01 00 00 00 00 02 49 17
			05 01 00 00 00 00 02 4a 1b
			05 01 00 00 00 00 02 4b 16
			05 01 00 00 00 00 02 4c 1a
			05 01 00 00 00 00 02 4d 38
			05 01 00 00 00 00 02 4e 0e
			05 01 00 00 00 00 02 4f 0e
			05 01 00 00 00 00 02 50 06
			05 01 00 00 00 00 02 51 0a
			05 01 00 00 00 00 02 52 38
			05 01 00 00 00 00 02 5b 01
			05 01 00 00 00 00 02 5c 10
			05 01 00 00 00 00 02 5e 27
			05 01 00 00 00 00 02 5f 27
			05 01 00 00 00 00 02 60 27
			05 01 00 00 00 00 02 61 27
			05 01 00 00 00 00 02 62 28
			05 01 00 00 00 00 02 63 01
			05 01 00 00 00 00 02 64 32
			05 01 00 00 00 00 02 65 30
			05 01 00 00 00 00 02 66 44
			05 01 00 00 00 00 02 67 11
			05 01 00 00 00 00 02 68 01
			05 01 00 00 00 00 02 69 18
			05 01 00 00 00 00 02 6a 06
			05 01 00 00 00 00 02 6b 22
			05 01 00 00 00 00 02 6c 08
			05 01 00 00 00 00 02 6d 08
			05 01 00 00 00 00 02 78 00
			05 01 00 00 00 00 02 7e 0f
			05 01 00 00 00 00 02 7f 0f
			05 01 00 00 00 00 02 80 0f
			05 01 00 00 00 00 02 8f c0
			05 01 00 00 00 00 02 90 7a
			05 01 00 00 00 00 02 91 0f
			05 01 00 00 00 00 02 92 07
			05 01 00 00 00 00 02 96 11
			05 01 00 00 00 00 02 97 14
			05 01 00 00 00 00 02 98 00
			05 01 00 00 00 00 02 99 00
			05 01 00 00 00 00 02 9a 00
			05 01 00 00 00 00 02 9b 64
			05 01 00 00 00 00 02 9c 15
			05 01 00 00 00 00 02 aa 70
			05 01 00 00 00 00 02 ab da
			05 01 00 00 00 00 02 ae f4
			05 01 00 00 00 00 02 af 40
			05 01 00 00 00 00 02 b0 7f
			05 01 00 00 00 00 02 b1 16
			05 01 00 00 00 00 02 b5 3a
			05 01 00 00 00 00 02 bc 85
			05 01 00 00 00 00 02 bd f4
			05 01 00 00 00 00 02 be 33
			05 01 00 00 00 00 02 bf 13
			05 01 00 00 00 00 02 c0 77
			05 01 00 00 00 00 02 c1 77
			05 01 00 00 00 00 02 c2 77
			05 01 00 00 00 00 02 c3 77
			05 01 00 00 00 00 02 c4 77
			05 01 00 00 00 00 02 c5 77
			05 01 00 00 00 00 02 c6 77
			05 01 00 00 00 00 02 c7 77
			05 01 00 00 00 00 02 c8 aa
			05 01 00 00 00 00 02 c9 2a
			05 01 00 00 00 00 02 ca 00
			05 01 00 00 00 00 02 cb aa
			05 01 00 00 00 00 02 cc 12
			05 01 00 00 00 00 02 cf 88
			05 01 00 00 00 00 02 d0 a0
			05 01 00 00 00 00 02 d1 00
			05 01 00 00 00 00 02 d3 00
			05 01 00 00 00 00 02 d6 08
			05 01 00 00 00 00 02 d7 00
			05 01 00 00 00 00 02 d8 00
			05 01 00 00 00 00 02 ef 70
			05 01 00 00 00 00 02 ff ee
			05 01 00 00 00 00 02 40 00
			05 01 00 00 00 00 02 41 00
			05 01 00 00 00 00 02 42 00
			05 01 00 00 00 00 02 1e 66
			05 01 00 00 00 00 02 3a 60
			05 01 00 00 00 00 02 39 26
			05 01 00 00 00 00 02 fb 01
			05 01 00 00 00 00 02 ff 00
			05 01 00 00 00 00 02 20 00
			05 01 00 00 32 00 02 29 00
			05 01 00 00 78 00 02 11 00
			23 01 00 00 0a 00 02 b0 00
			23 01 00 00 0a 00 02 b2 00
			23 01 00 00 0a 00 02 b3 0c
			23 01 00 00 0a 00 02 b4 02
			29 01 00 00 00 00 06 c0 40 02 7f c8 08
			29 01 00 00 00 00 10 c1 00 a8 00 00 00 00 00 9d 08 27 00 00 00 00 00
			29 01 00 00 00 00 06 c2 00 00 09 00 00
			23 01 00 00 0a 00 02 c3 04
			29 01 00 00 00 00 04 c4 4d 83 00
			29 01 00 00 00 00 0b c6 12 00 08 71 00 00 00 80 00 04
			23 01 00 00 0a 00 02 c7 22
			29 01 00 00 00 00 05 c8 4c 0c 0c 0c
			29 01 00 00 00 00 0e c9 00 40 00 16 32 2e 3a 43 3e 3c 45 79 3f
			29 01 00 00 00 00 0e ca 00 46 1a 23 21 1c 25 31 2d 49 5f 7f 3f
			29 01 00 00 00 00 0e cb 00 4c 20 3a 42 40 47 4b 42 3e 46 7e 3f
			29 01 00 00 00 00 0e cc 00 41 19 21 1d 14 18 1f 1d 25 3f 73 3f
			29 01 00 00 00 00 0e cd 23 79 5a 5f 57 4c 51 51 45 3f 4b 7f 3f
			29 01 00 00 00 00 0e ce 00 40 14 20 1a 0e 0e 13 08 00 05 46 1c
			29 01 00 00 00 00 04 d0 6a 64 01
			29 01 00 00 00 00 03 d1 77 d4
			23 01 00 00 0a 00 02 d3 33
			29 01 00 00 00 00 03 d5 0f 0f
			29 01 00 00 00 00 07 d8 34 64 23 25 62 32
			29 01 00 00 00 00 0c de 10 7b 11 0a 00 00 00 00 00 00 00
			29 01 00 00 00 00 09 fd 04 55 53 00 70 ff 10 73
			23 01 00 00 0a 00 02 e2 00
			05 01 00 00 78 00 02 11 00
			05 01 00 00 32 00 02 29 00];
		qcom,mdss-dsi-off-command = [
			05 01 00 00 32 00 02 ff 05
			05 01 00 00 32 00 02 d6 00
			05 01 00 00 32 00 02 ff 00
			05 01 00 00 32 00 02 28 00
			05 01 00 00 32 00 02 b0 00
			05 01 00 00 32 00 02 10 00
			05 01 00 00 32 00 02 28 00
				 05 01 00 00 78 00 02 10 00];
		qcom,mdss-dsi-on-command-state = "dsi_lp_mode";
		qcom,mdss-dsi-off-command-state = "dsi_hs_mode";
		qcom,mdss-dsi-h-sync-pulse = <0>;
		qcom,mdss-dsi-traffic-mode = "non_burst_sync_event";
		qcom,mdss-dsi-bllp-eof-power-mode;
		qcom,mdss-dsi-bllp-power-mode;
		qcom,mdss-dsi-lane-0-state;
		qcom,mdss-dsi-lane-1-state;
		qcom,mdss-dsi-lane-2-state;
		qcom,mdss-dsi-lane-3-state;
		qcom,mdss-dsi-panel-timings = [e9 38 26 00 6a 6c 2c 3c 21 03 04 00];
		qcom,mdss-dsi-t-clk-post = <0x02>;
		qcom,mdss-dsi-t-clk-pre = <0x2f>;
		qcom,mdss-dsi-bl-min-level = <1>;
		qcom,mdss-dsi-bl-max-level = <4095>;
		qcom,mdss-dsi-dma-trigger = "trigger_sw";
		qcom,mdss-dsi-mdp-trigger = "none";
		qcom,mdss-dsi-bl-pmic-control-type = "bl_ctrl_bdic";
		qcom,mdss-dsi-reset-sequence = <1 20>, <0 200>, <1 20>;
	};
};
