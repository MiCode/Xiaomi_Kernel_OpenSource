/*
 * Copyright (c) 2016, The Linux Foundation. All rights reserved.
 *
 * This program is free software; you can redistribute it and/or modify
 * it under the terms of the GNU General Public License version 2 and
 * only version 2 as published by the Free Software Foundation.
 *
 * This program is distributed in the hope that it will be useful,
 * but WITHOUT ANY WARRANTY; without even the implied warranty of
 * MERCHANTABILITY or FITNESS FOR A PARTICULAR PURPOSE.  See the
 * GNU General Public License for more details.
 */

/dts-v1/;

#include "msm8940.dtsi"
#include "msm8940-pmi8940-cdp.dtsi"

/ {
	model = "Qualcomm Technologies, Inc. MSM8940-PMI8940 RCM";
	compatible = "qcom,msm8940-cdp", "qcom,msm8940", "qcom,cdp";
	qcom,board-id= <21 0>;
	qcom,pmic-id = <0x10019 0x020040 0x0 0x0>;
};
