/* Copyright (c) 2013, The Linux Foundation. All rights reserved.
 * Copyright (C) 2016 XiaoMi, Inc.
 *
 * This program is free software; you can redistribute it and/or modify
 * it under the terms of the GNU General Public License version 2 and
 * only version 2 as published by the Free Software Foundation.
 *
 * This program is distributed in the hope that it will be useful,
 * but WITHOUT ANY WARRANTY; without even the implied warranty of
 * MERCHANTABILITY or FITNESS FOR A PARTICULAR PURPOSE.  See the
 * GNU General Public License for more details.
 */

/*---------------------------------------------------------------------------
 * This file is autogenerated file using gcdb parser. Please do not edit it.
 * Update input XML file to add a new entry or update variable in this file
 * VERSION = "1.0"
 *---------------------------------------------------------------------------*/
&mdss_mdp {
	dsi_boent35521_720p_vid: qcom,mdss_dsi_boent35521_720p_video {
		qcom,mdss-dsi-panel-name = "boe nt35521 720p video mode dsi panel";
		qcom,mdss-dsi-panel-controller = <&mdss_dsi0>;
		qcom,mdss-dsi-panel-type = "dsi_video_mode";
		qcom,mdss-dsi-panel-destination = "display_1";
		qcom,cont-splash-enabled;
		qcom,mdss-dsi-panel-framerate = <60>;
		qcom,mdss-dsi-virtual-channel-id = <0>;
		qcom,mdss-dsi-stream = <0>;
		qcom,mdss-dsi-panel-width = <720>;
		qcom,mdss-dsi-panel-height = <1280>;
		qcom,mdss-dsi-h-front-porch = <72>;
		qcom,mdss-dsi-h-back-porch = <72>;
		qcom,mdss-dsi-h-pulse-width = <24>;
		qcom,mdss-dsi-h-sync-skew = <0>;
		qcom,mdss-dsi-v-back-porch = <16>;
		qcom,mdss-dsi-v-front-porch = <16>;
		qcom,mdss-dsi-v-pulse-width = <4>;
		qcom,mdss-dsi-h-left-border = <0>;
		qcom,mdss-dsi-h-right-border = <0>;
		qcom,mdss-dsi-v-top-border = <0>;
		qcom,mdss-dsi-v-bottom-border = <10>;
		qcom,mdss-dsi-bpp = <24>;
		qcom,mdss-dsi-underflow-color = <0xff>;
		qcom,mdss-dsi-border-color = <0>;
		qcom,mdss-dsi-pixel-packing = "tight";
		qcom,mdss-dsi-on-command = [
				29 01 00 00 00 00 05 FF AA 55 A5 80
				29 01 00 00 00 00 03 6F 11 00
				29 01 00 00 00 00 03 F7 20 00
				29 01 00 00 00 00 02 6F 06
				29 01 00 00 00 00 02 F7 A0
				29 01 00 00 00 00 02 6F 19
				29 01 00 00 00 00 02 F7 12
				29 01 00 00 00 00 02 6F 02
				29 01 00 00 00 00 02 F7 47
				29 01 00 00 00 00 02 6F 17
				29 01 00 00 00 00 02 F4 70
				29 01 00 00 00 00 02 6F 01
				29 01 00 00 00 00 02 F9 46
				29 01 00 00 00 00 06 F0 55 AA 52 08 00
				29 01 00 00 00 00 06 BD 01 A0 10 10 01
				29 01 00 00 00 00 05 B8 01 02 02 02
				29 01 00 00 00 00 03 BB 11 11
				29 01 00 00 00 00 03 BC 00 00
				23 01 00 00 00 00 02 B6 03
				23 01 00 00 00 00 02 C8 80
				29 01 00 00 00 00 03 D9 01 01
				23 01 00 00 00 00 02 D4 C7
				29 01 00 00 00 00 06 F0 55 AA 52 08 01
				29 01 00 00 00 00 03 B0 09 09
				29 01 00 00 00 00 03 B1 09 09
				29 01 00 00 00 00 03 BC 80 00
				29 01 00 00 00 00 03 BD 80 00
				23 01 00 00 00 00 02 CA 00
				23 01 00 00 00 00 02 C0 0C
				29 01 00 00 00 00 03 B5 04 04
				29 01 00 00 00 00 03 B6 05 05
				29 01 00 00 00 00 03 B8 05 05
				29 01 00 00 00 00 03 B3 19 19
				29 01 00 00 00 00 03 B4 19 19
				29 01 00 00 00 00 03 B9 26 26
				29 01 00 00 00 00 03 BA 25 25
				29 01 00 00 00 00 06 F0 55 AA 52 08 02
				23 01 00 00 00 00 02 EE 00
				29 01 00 00 00 00 11 B0 00 01 00 03 00 0A 00 21 00 34 00 49 00 5E 00 7B
				29 01 00 00 00 00 11 B1 00 AE 00 FF 01 42 01 AA 01 FD 02 00 02 47 02 99
				29 01 00 00 00 00 11 B2 02 CF 03 13 03 45 03 82 03 9A 03 B3 03 CA 03 E5
				29 01 00 00 00 00 05 B3 03 F8 03 FF
				29 01 00 00 00 00 11 B4 00 02 00 09 00 20 00 2F 00 3B 00 53 00 65 00 80
				29 01 00 00 00 00 11 B5 00 B4 01 03 01 45 01 A9 01 FC 01 FE 02 46 02 9A
				29 01 00 00 00 00 11 B6 02 CF 03 17 03 4A 03 8C 03 A2 03 B9 03 D0 03 E7
				29 01 00 00 00 00 05 B7 03 F7 03 FF
				29 01 00 00 00 00 11 B8 00 35 00 38 00 44 00 4C 00 57 00 67 00 75 00 99
				29 01 00 00 00 00 11 B9 00 C7 01 11 01 4D 01 AE 01 FF 02 01 02 48 02 9A
				29 01 00 00 00 00 11 BA 02 D0 03 1A 03 54 03 A9 03 B7 03 CA 03 D9 03 EC
				29 01 00 00 00 00 05 BB 03 F5 03 FF
				29 01 00 00 00 00 11 BC 00 01 00 03 00 0A 00 21 00 34 00 49 00 5E 00 7B
				29 01 00 00 00 00 11 BD 00 AE 00 FF 01 42 01 AA 01 FD 02 00 02 47 02 99
				29 01 00 00 00 00 11 BE 02 CF 03 13 03 45 03 82 03 9A 03 B3 03 CA 03 E5
				29 01 00 00 00 00 05 BF 03 F8 03 FF
				29 01 00 00 00 00 11 C0 00 02 00 09 00 20 00 2F 00 3B 00 53 00 65 00 80
				29 01 00 00 00 00 11 C1 00 B4 01 03 01 45 01 A9 01 FC 01 FE 02 46 02 9A
				29 01 00 00 00 00 11 C2 02 CF 03 17 03 4A 03 8C 03 A2 03 B9 03 D0 03 E7
				29 01 00 00 00 00 05 C3 03 F7 03 FF
				29 01 00 00 00 00 11 C4 00 35 00 38 00 44 00 4C 00 57 00 67 00 75 00 99
				29 01 00 00 00 00 11 C5 00 C7 01 11 01 4D 01 AE 01 FF 02 01 02 48 02 9A
				29 01 00 00 00 00 11 C6 02 D0 03 1A 03 54 03 A9 03 B7 03 CA 03 D9 03 EC
				29 01 00 00 00 00 05 C7 03 F5 03 FF
				29 01 00 00 00 00 05 EF 0D 07 16 1A

				29 01 00 00 00 00 06 F0 55 AA 52 08 06
				29 01 00 00 00 00 03 B0 10 12
				29 01 00 00 00 00 03 B1 14 16
				29 01 00 00 00 00 03 B2 00 02
				29 01 00 00 00 00 03 B3 31 31
				29 01 00 00 00 00 03 B4 31 34
				29 01 00 00 00 00 03 B5 34 34
				29 01 00 00 00 00 03 B6 34 31
				29 01 00 00 00 00 03 B7 31 31
				29 01 00 00 00 00 03 B8 31 31
				29 01 00 00 00 00 03 B9 2D 2E
				29 01 00 00 00 00 03 BA 2E 2D
				29 01 00 00 00 00 03 BB 31 31
				29 01 00 00 00 00 03 BC 31 31
				29 01 00 00 00 00 03 BD 31 34
				29 01 00 00 00 00 03 BE 34 34
				29 01 00 00 00 00 03 BF 34 31
				29 01 00 00 00 00 03 C0 31 31
				29 01 00 00 00 00 03 C1 03 01
				29 01 00 00 00 00 03 C2 17 15
				29 01 00 00 00 00 03 C3 13 11
				29 01 00 00 00 00 03 E5 31 31
				29 01 00 00 00 00 03 C4 17 15
				29 01 00 00 00 00 03 C5 13 11
				29 01 00 00 00 00 03 C6 03 01
				29 01 00 00 00 00 03 C7 31 31
				29 01 00 00 00 00 03 C8 31 34
				29 01 00 00 00 00 03 C9 34 34
				29 01 00 00 00 00 03 CA 34 31
				29 01 00 00 00 00 03 CB 31 31
				29 01 00 00 00 00 03 CC 31 31
				29 01 00 00 00 00 03 CD 2E 2D
				29 01 00 00 00 00 03 CE 2D 2E
				29 01 00 00 00 00 03 CF 31 31
				29 01 00 00 00 00 03 D0 31 31
				29 01 00 00 00 00 03 D1 31 34
				29 01 00 00 00 00 03 D2 34 34
				29 01 00 00 00 00 03 D3 34 31
				29 01 00 00 00 00 03 D4 31 31
				29 01 00 00 00 00 03 D5 00 02
				29 01 00 00 00 00 03 D6 10 12
				29 01 00 00 00 00 03 D7 14 16
				29 01 00 00 00 00 03 E6 32 32
				29 01 00 00 00 00 06 D8 00 00 00 00 00
				29 01 00 00 00 00 06 D9 00 00 00 00 00
				23 01 00 00 00 00 02 E7 00
				29 01 00 00 00 00 06 F0 55 AA 52 08 05
				23 01 00 00 00 00 02 ED 30
				29 01 00 00 00 00 03 B0 17 06
				23 01 00 00 00 00 02 B8 00
				23 01 00 00 00 00 02 C0 0D
				23 01 00 00 00 00 02 C1 0B
				23 01 00 00 00 00 02 C2 23
				23 01 00 00 00 00 02 C3 40
				23 01 00 00 00 00 02 C4 84
				23 01 00 00 00 00 02 C5 82
				23 01 00 00 00 00 02 C6 82
				23 01 00 00 00 00 02 C7 80
				29 01 00 00 00 00 03 C8 0B 30
				29 01 00 00 00 00 03 C9 05 10
				29 01 00 00 00 00 03 CA 01 10
				29 01 00 00 00 00 03 CB 01 10
				29 01 00 00 00 00 06 D1 03 05 05 07 00
				29 01 00 00 00 00 06 D2 03 05 09 03 00
				29 01 00 00 00 00 06 D3 00 00 6A 07 10
				29 01 00 00 00 00 06 D4 30 00 6A 07 10
				29 01 00 00 00 00 06 F0 55 AA 52 08 03
				29 01 00 00 00 00 03 B0 00 00
				29 01 00 00 00 00 03 B1 00 00
				29 01 00 00 00 00 06 B2 05 00 0A 00 00
				29 01 00 00 00 00 06 B3 05 00 0A 00 00
				29 01 00 00 00 00 06 B4 05 00 0A 00 00
				29 01 00 00 00 00 06 B5 05 00 0A 00 00
				29 01 00 00 00 00 06 B6 02 00 0A 00 00
				29 01 00 00 00 00 06 B7 02 00 0A 00 00
				29 01 00 00 00 00 06 B8 02 00 0A 00 00
				29 01 00 00 00 00 06 B9 02 00 0A 00 00
				29 01 00 00 00 00 06 BA 53 00 00 00 00
				29 01 00 00 00 00 06 BB 53 00 00 00 00
				29 01 00 00 00 00 06 BC 53 00 00 00 00
				29 01 00 00 00 00 06 BD 53 00 00 00 00
				23 01 00 00 00 00 02 C4 60
				23 01 00 00 00 00 02 C5 40
				23 01 00 00 00 00 02 C6 64
				23 01 00 00 00 00 02 C7 44
				23 01 00 00 00 00 02 6F 11
				23 01 00 00 00 00 02 F3 01
				15 01 00 00 00 00 02 51 ff
				15 01 00 00 10 00 02 53 2c
				15 01 00 00 10 00 02 55 01
				05 01 00 00 78 00 02 11 00
				05 01 00 00 14 00 02 29 00

				];
		qcom,mdss-dsi-off-command = [05 01 00 00 00 00 02 28 00
				05 01 00 00 00 00 02 10 00];
		ceon-command = [
				29 00 00 00 00 00 06 F0 55 AA 52 08 00
				29 00 00 00 00 00 11 CC 40 36 87 00 00 00 00 00 00 00 00 00 40 08 A5 05
				29 00 00 00 00 00 11 D1 00 02 0A 0E 12 16 18 18 18 18 16 14 12 0E 08 00
				29 00 00 00 00 00 0D D7 28 30 27 23 23 00 00 00 00 00 00 00
				29 00 00 00 00 00 0E D8 00 00 00 00 00 00 00 00 00 00 23 25 00
				15 01 00 00 10 00 02 55 81
				];
		ceoff-command = [
				15 01 00 00 10 00 02 55 01
				];

		warm-command = [
				29 01 00 00 00 00 06 F0 55 AA 52 08 02
				23 01 00 00 00 00 02 EE 03
				29 01 00 00 00 00 11 B0 00 00 00 08 00 2C 00 45 00 56 00 78 00 93 00 BF
				29 01 00 00 00 00 11 B1 00 F2 01 48 01 88 01 F0 02 41 02 43 02 90 02 E8
				29 01 00 00 00 00 11 B2 03 21 03 62 03 8E 03 B0 03 D6 03 F8 03 FA 03 FD
				29 01 00 00 00 00 05 B3 03 FE 03 FF
				29 01 00 00 00 00 11 B4 00 00 00 04 00 1C 00 35 00 49 00 67 00 7E 00 B8
				29 01 00 00 00 00 11 B5 00 F0 01 41 01 82 01 EA 02 3C 02 3E 02 8D 02 E5
				29 01 00 00 00 00 11 B6 03 1D 03 60 03 8C 03 B2 03 C4 03 D9 03 E8 03 F1
				29 01 00 00 00 00 05 B7 03 FE 03 FF
				29 01 00 00 00 00 11 B8 00 88 00 89 00 94 00 9A 00 A8 00 BD 00 D5 01 03
				29 01 00 00 00 00 11 B9 01 2B 01 6B 01 A2 02 00 02 4B 02 4D 02 98 02 F1
				29 01 00 00 00 00 11 BA 03 2B 03 74 03 A8 03 DF 03 E2 03 E4 03 E9 03 F8
				29 01 00 00 00 00 05 BB 03 FE 03 FF
				];
		default-command = [
				29 01 00 00 00 00 06 F0 55 AA 52 08 02
				23 01 00 00 00 00 02 EE 03
				29 01 00 00 00 00 11 B0 00 23 00 33 00 40 00 47 00 58 00 7A 00 93 00 D0
				29 01 00 00 00 00 11 B1 01 00 01 4F 01 8C 01 F3 02 44 02 46 02 92 02 EA
				29 01 00 00 00 00 11 B2 03 21 03 62 03 8C 03 B0 03 CA 03 DF 03 EB 03 F6
				29 01 00 00 00 00 05 B3 03 FE 03 FF
				29 01 00 00 00 00 11 B4 00 00 00 04 00 22 00 3B 00 4C 00 6B 00 80 00 B6
				29 01 00 00 00 00 11 B5 00 EC 01 3D 01 7F 01 E8 02 3C 02 3E 02 8D 02 E5
				29 01 00 00 00 00 11 B6 03 1D 03 60 03 8C 03 B2 03 C4 03 D9 03 E8 03 F1
				29 01 00 00 00 00 05 B7 03 FE 03 FF
				29 01 00 00 00 00 11 B8 00 00 00 04 00 19 00 2F 00 3D 00 58 00 6F 00 9B
				29 01 00 00 00 00 11 B9 00 D0 01 27 01 6D 01 DA 02 33 02 35 02 86 02 E1
				29 01 00 00 00 00 11 BA 03 1C 03 65 03 9A 03 CF 03 F6 03 F8 03 FA 03 FD
				29 01 00 00 00 00 05 BB 03 FE 03 FF
				];

		cold-command = [
				29 01 00 00 00 00 06 F0 55 AA 52 08 02
				23 01 00 00 00 00 02 EE 03
				29 01 00 00 00 00 06 F0 55 AA 52 08 02
				23 01 00 00 00 00 02 EE 03
				29 01 00 00 00 00 11 B0 00 64 00 66 00 69 00 6F 00 7D 00 88 00 8F 00 9B
				29 01 00 00 00 00 11 B1 01 39 01 77 01 AD 02 08 02 53 02 55 02 9D 02 F3
				29 01 00 00 00 00 11 B2 03 2A 03 6C 03 96 03 B7 03 E2 03 E4 03 E9 03 F8
				29 01 00 00 00 00 05 B3 03 FE 03 FF
				29 00 00 00 00 00 11 B4 00 61 00 68 00 6A 00 6F 00 76 00 79 00 7F 00 B6
				29 01 00 00 00 00 11 B5 00 EC 01 3D 01 7F 01 E8 02 3C 02 3E 02 8D 02 E5
				29 01 00 00 00 00 11 B6 03 1D 03 60 03 8C 03 B2 03 C4 03 D9 03 E8 03 F1
				29 01 00 00 00 00 05 B7 03 FE 03 FF
				29 01 00 00 00 00 11 B8 00 00 00 04 00 19 00 2F 00 3D 00 58 00 6F 00 9B
				29 01 00 00 00 00 11 B9 00 D0 01 27 01 6D 01 DA 02 33 02 35 02 86 02 E1
				29 01 00 00 00 00 11 BA 03 1C 03 65 03 9A 03 CF 03 F6 03 F8 03 FA 03 FD
				29 01 00 00 00 00 05 BB 03 FE 03 FF
				];
		qcom,mdss-dsi-on-command-state = "dsi_lp_mode";
		qcom,mdss-dsi-off-command-state = "dsi_lp_mode";
		qcom,mdss-extra-command-state = "dsi_lp_mode";


		qcom,mdss-dsi-panel-status-command = [06 01 00 01 05 00 02 0A 08];
		qcom,mdss-dsi-panel-status-command-state = "dsi_lp_mode";
		qcom,mdss-dsi-panel-status-check-mode = "reg_read";
		qcom,mdss-dsi-panel-status-value = <0x9c>;
		qcom,esd-check-enabled;
		qcom,mdss-dsi-h-sync-pulse = <1>;
		qcom,mdss-dsi-traffic-mode = "burst_mode";
		qcom,mdss-dsi-bllp-eof-power-mode;
		qcom,mdss-dsi-bllp-power-mode;
		qcom,mdss-dsi-lane-0-state;
		qcom,mdss-dsi-lane-1-state;
		qcom,mdss-dsi-lane-2-state;
		qcom,mdss-dsi-lane-3-state;
		qcom,mdss-dsi-panel-timings = [7b 1a 10 00 3e 40 16 1e 15 03 04 00];
		qcom,mdss-dsi-t-clk-post = <0x20>;
		qcom,mdss-dsi-t-clk-pre = <0x2D>;
		qcom,mdss-dsi-bl-min-level = <1>;
		qcom,mdss-dsi-bl-max-level = <64>;
		qcom,mdss-dsi-dma-trigger = "trigger_sw";
		qcom,mdss-dsi-mdp-trigger = "none";
		qcom,mdss-dsi-bl-pmic-control-type = "bl_ctrl_gpio";
		qcom,mdss-dsi-pulse-gpio = <&msm_gpio 98 0>;
		qcom,mdss-dsi-reset-sequence = <1 20>, <0 20>, <1 120>;
		qcom,mdss-pan-physical-width-dimension = <68>;
		qcom,mdss-pan-physical-height-dimension = <121>;

	};
};

