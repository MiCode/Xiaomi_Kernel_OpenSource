/* Copyright (c) 2014, The Linux Foundation. All rights reserved.
 * Copyright (C) 2018 XiaoMi, Inc.
 *
 * This program is free software; you can redistribute it and/or modify
 * it under the terms of the GNU General Public License version 2 and
 * only version 2 as published by the Free Software Foundation.
 *
 * This program is distributed in the hope that it will be useful,
 * but WITHOUT ANY WARRANTY; without even the implied warranty of
 * MERCHANTABILITY or FITNESS FOR A PARTICULAR PURPOSE.  See the
 * GNU General Public License for more details.
 */

/*---------------------------------------------------------------------------
 * This file is autogenerated file using gcdb parser. Please do not edit it.
 * Update input XML file to add a new entry or update variable in this file
 * VERSION = "1.0"
 *---------------------------------------------------------------------------*/
&mdss_mdp {
	dsi_hx8394f_boe_720_vid: qcom,mdss_dsi_hx8394f_boe_720p_video {
		qcom,mdss-dsi-panel-name = "hx8394F_HD720p_video_BOE_c3a";
		qcom,mdss-dsi-panel-controller = <&mdss_dsi0>;
		qcom,mdss-dsi-panel-type = "dsi_video_mode";
		qcom,mdss-dsi-panel-destination = "display_1";
		qcom,mdss-dsi-panel-framerate = <60>;
		qcom,mdss-dsi-virtual-channel-id = <0>;
		qcom,mdss-dsi-stream = <0>;
		qcom,mdss-dsi-panel-width = <720>;
		qcom,mdss-dsi-panel-height = <1280>;
		qcom,mdss-dsi-h-front-porch = <160>;
		qcom,mdss-dsi-h-back-porch = <160>;
		qcom,mdss-dsi-h-pulse-width = <24>;
		qcom,mdss-dsi-h-sync-skew = <0>;
		qcom,mdss-dsi-v-back-porch = <12>;
		qcom,mdss-dsi-v-front-porch = <15>;
		qcom,mdss-dsi-v-pulse-width = <4>;
		qcom,mdss-dsi-h-left-border = <0>;
		qcom,mdss-dsi-h-right-border = <0>;
		qcom,mdss-dsi-v-top-border = <0>;
		qcom,mdss-dsi-v-bottom-border = <0>;
		qcom,mdss-dsi-bpp = <24>;
		qcom,mdss-dsi-color-order = "rgb_swap_rgb";
		qcom,mdss-dsi-underflow-color = <0x00>;
		qcom,mdss-dsi-border-color = <0>;
		qcom,mdss-dsi-on-command = [39 01 00 00 00 00 04 B9 FF 83 94
				05 01 00 00 78 00 02 11 00
				05 01 00 00 14 00 02 29 00];
		qcom,mdss-dsi-off-command = [05 01 00 00 32 00 02 28 00
				05 01 00 00 78 00 02 10 00];
		qcom,mdss-dsi-on-command-state = "dsi_lp_mode";
		qcom,mdss-dsi-off-command-state = "dsi_hs_mode";
		qcom,mdss-dsi-panel-warm-command = [39 01 00 00 01 00 3B E0 07 08 09 0D 10 14 16 13 24 36 48 4A 58 6F 76 80 97 A5 A8 B5 C6 62 63 68 6F 72 78 7F 7F 00 02 08 0D 0C 0E 0F 10 24 36 48 4A 58 6F 78 82 99 A4 A0 B1 C0 5E 5E 64 6B 6C 73 7F 7F
				39 01 00 00 01 00 02 BD 00
				39 01 00 00 01 00 2C C1 01 00 0C 18 24 30 3A 43 4A 52 59 5F 66 6D 74 7B 83 8A 91 99 A0 A7 AE B5 BC C3 CA D1 D9 E0 E7 EF F7 FF 15 B3 59 B8 1E 00 AC 63 C0
				39 01 00 00 01 00 02 BD 01
				39 01 00 00 01 00 2B C1 00 0B 16 21 2C 36 3E 46 4D 54 5A 60 66 6C 73 79 7F 86 8D 93 9B A0 A6 AD B3 B9 BF C6 CD D3 DA E0 E6 06 9D 40 21 E3 3C 6E 62 C0
				39 01 00 00 01 00 02 BD 02
				39 01 00 00 01 00 2B C1 00 0A 14 1E 28 32 3B 43 4A 51 57 5D 62 69 6F 75 7B 82 88 8F 95 9C A2 A7 AE B4 BA C0 C6 CD D2 D9 DE 16 BE 95 DB CD E3 01 8C C0
				39 01 00 00 01 00 02 BD 00];
		qcom,mdss-dsi-panel-cool-command = [39 01 00 00 01 00 3B E0 07 08 09 0D 10 14 16 13 24 36 48 4A 58 6F 76 80 97 A5 A8 B5 C6 62 63 68 6F 72 78 7F 7F 00 02 08 0D 0C 0E 11 10 24 36 48 4A 58 6F 78 82 99 A4 A0 B1 C0 5E 5E 64 6B 6C 73 7F 7F
				39 01 00 00 01 00 02 BD 00
				39 01 00 00 01 00 2C C1 01 00 0A 14 1E 28 32 3C 43 4B 52 59 5F 66 6D 74 7B 82 8A 92 9A A0 A8 AF B7 BD C7 CE D5 DD E6 EE F7 FF 16 E3 11 59 A4 8D C3 84 C0
				39 01 00 00 01 00 02 BD 01
				39 01 00 00 01 00 2B C1 00 0A 13 1D 27 31 3B 43 4A 51 57 5E 64 6B 72 79 80 87 8F 97 9E A4 AB B3 BA C1 C9 D0 D7 DF E6 EE F6 0F F0 1D AA B4 7C 01 C8 00
				39 01 00 00 01 00 02 BD 02
				39 01 00 00 01 00 2B C1 00 0A 13 1D 27 32 3C 44 4C 53 5A 60 68 6F 76 7D 85 8C 94 9C A3 AA B2 B9 C0 C8 D0 D8 DF E7 EE F6 FE 0E 56 27 1B 7E B5 F8 8B 00
				39 01 00 00 01 00 02 BD 00];
		qcom,mdss-dsi-panel-nature-command = [39 01 00 00 01 00 3B E0 07 08 09 0D 10 14 16 13 24 36 48 4A 58 6F 76 80 97 A5 A8 B5 C6 62 63 68 6F 72 78 7F 7F 00 02 08 0D 0C 0E 0F 10 24 36 48 4A 58 6F 78 82 99 A4 A0 B1 C0 5E 5E 64 6B 6C 73 7F 7F
				39 01 00 00 01 00 02 BD 00
				39 01 00 00 01 00 2C C1 01 00 0A 14 1E 28 32 3B 43 4A 52 58 5F 65 6D 74 7B 82 8A 92 99 A1 A8 AE B6 BE C5 CD D6 DC E5 ED F6 FF 15 8F C9 C5 97 4F 3C CB C0
				39 01 00 00 01 00 02 BD 01
				39 01 00 00 01 00 2B C1 00 09 13 1D 26 30 39 41 48 4F 55 5C 62 68 6F 76 7D 84 8B 92 9A A0 A7 AE B5 BC C3 CB D2 D9 E0 E7 EF 24 85 5C 39 07 79 44 1A 80
				39 01 00 00 01 00 02 BD 02
				39 01 00 00 01 00 2B C1 00 09 12 1B 24 2E 38 41 48 4F 56 5C 62 69 70 77 7E 85 8C 93 9B A2 A8 AF B6 BD C4 CC D3 DA E1 E8 F0 15 7C 62 A9 1B 8B 4C 2E 00
				39 01 00 00 01 00 02 BD 00];
		qcom,mdss-dsi-panel-gamma-command-state = "dsi_lp_mode";
		qcom,mdss-dsi-panel-ce-std-command = [39 01 00 00 0A 00 03 E4 00 00];
		qcom,mdss-dsi-panel-ce-vivid-command = [39 01 00 00 14 00 02 E4 00
				39 01 00 00 14 00 20 E5 00 00 0B 08 01 00 00 00 00 00 00 05 1D 19 1F 05 ED 09 20 00 00 04 0B 02 01 08 08 07 02 04 02
				39 01 00 00 14 00 16 E6 00 08 00 05 05 10 10 10 20 20 20 10 10 10 10 10 03 A0 01 0F 11
				39 01 00 00 14 00 03 E4 00 41];
		qcom,mdss-dsi-panel-ce-command-state = "dsi_lp_mode";

		qcom,mdss-dsi-panel-eye-command01 = [39 01 00 00 00 00 3B E0 07 08 09 0D 10 14 16 13 24 36 48 4A 58 6F 76 80 97 A5 A8 B5 C6 62 63 68 6F 72 78 7F 7F 00 02 08 0D 0C 0E 0F 10 24 36 48 4A 58 6F 78 82 99 A4 A0 B1 C0 5E 5E 64 6B 6C 73 7F 7F
				39 01 00 00 00 00 02 BD 00
				39 01 00 00 00 00 2C C1 01 00 0A 14 1E 28 32 3B 43 4A 52 58 5F 65 6D 74 7B 82 8A 92 99 A1 A8 AE B6 BE C5 CD D6 DC E5 ED F6 FF 15 8F C9 C5 97 4F 3C CB C0
				39 01 00 00 00 00 02 BD 01
				39 01 00 00 00 00 2B C1 00 09 13 1D 26 30 39 41 48 4F 55 5C 62 68 6F 76 7D 84 8B 92 9A A0 A7 AE B5 BC C3 CB D2 D9 E0 E7 EF 24 85 5C 39 07 79 44 1A 80
				39 01 00 00 00 00 02 BD 02
				39 01 00 00 00 00 2B C1 00 08 11 19 22 2C 35 3D 44 4B 51 57 5D 64 6A 71 77 7E 85 8C 93 99 9F A6 AC B3 BA C1 C8 CF D6 DC E3 37 5E 9A 48 50 6E C9 01 80
				39 01 00 00 00 00 02 BD 00];
		qcom,mdss-dsi-panel-eye-command02 = [39 01 00 00 00 00 3B E0 07 08 09 0D 10 14 16 13 24 36 48 4A 58 6F 76 80 97 A5 A8 B5 C6 62 63 68 6F 72 78 7F 7F 00 02 08 0D 0C 0E 0F 10 24 36 48 4A 58 6F 78 82 99 A4 A0 B1 C0 5E 5E 64 6B 6C 73 7F 7F
				39 01 00 00 00 00 02 BD 00
				39 01 00 00 00 00 2C C1 01 00 0A 14 1E 28 32 3B 43 4A 52 58 5F 65 6D 74 7B 82 8A 92 99 A1 A8 AE B6 BE C5 CD D6 DC E5 ED F6 FF 15 8F C9 C5 97 4F 3C CB C0
				39 01 00 00 00 00 02 BD 01
				39 01 00 00 00 00 2B C1 00 09 13 1D 26 30 39 41 48 4F 55 5C 62 68 6F 76 7D 84 8B 92 9A A0 A7 AE B5 BC C3 CB D2 D9 E0 E7 EF 24 85 5C 39 07 79 44 1A 80
				39 01 00 00 00 00 02 BD 02
				39 01 00 00 00 00 2B C1 00 08 10 18 20 2A 33 3A 40 47 4D 53 58 5E 65 6B 71 77 7E 84 8B 91 97 9E A3 A9 B0 B7 BD C4 CB D1 D7 16 81 D4 B0 77 E8 FD E0 C0
				39 01 00 00 00 00 02 BD 00];
		qcom,mdss-dsi-panel-eye-command03 = [39 01 00 00 00 00 3B E0 07 08 09 0D 10 14 16 13 24 36 48 4A 58 6F 76 80 97 A5 A8 B5 C6 62 63 68 6F 72 78 7F 7F 00 02 08 0D 0C 0E 0F 10 24 36 48 4A 58 6F 78 82 99 A4 A0 B1 C0 5E 5E 64 6B 6C 73 7F 7F
				39 01 00 00 00 00 02 BD 00
				39 01 00 00 00 00 2C C1 01 00 0A 14 1E 28 32 3B 43 4A 52 58 5F 65 6D 74 7B 82 8A 92 99 A1 A8 AE B6 BE C5 CD D6 DC E5 ED F6 FF 15 8F C9 C5 97 4F 3C CB C0
				39 01 00 00 00 00 02 BD 01
				39 01 00 00 00 00 2B C1 00 09 13 1D 26 30 39 41 48 4F 55 5C 62 68 6F 76 7D 84 8B 92 9A A0 A7 AE B5 BC C3 CB D2 D9 E0 E7 EF 24 85 5C 39 07 79 44 1A 80
				39 01 00 00 00 00 02 BD 02
				39 01 00 00 00 00 2B C1 00 07 0F 17 1E 27 30 37 3D 43 49 4E 53 59 5F 65 6B 71 77 7D 84 8A 8F 95 9B A1 A7 AD B3 BA C0 C6 CC 38 F5 B7 FE 6F 8B 4B C4 80
				39 01 00 00 00 00 02 BD 00];
		qcom,mdss-dsi-panel-eye-command04 = [39 01 00 00 00 00 3B E0 07 08 09 0D 10 14 16 13 24 36 48 4A 58 6F 76 80 97 A5 A8 B5 C6 62 63 68 6F 72 78 7F 7F 00 02 08 0D 0C 0E 0F 10 24 36 48 4A 58 6F 78 82 99 A4 A0 B1 C0 5E 5E 64 6B 6C 73 7F 7F
				39 01 00 00 00 00 02 BD 00
				39 01 00 00 00 00 2C C1 01 00 0A 14 1E 28 32 3B 43 4A 52 58 5F 65 6D 74 7B 82 8A 92 99 A1 A8 AE B6 BE C5 CD D6 DC E5 ED F6 FF 15 8F C9 C5 97 4F 3C CB C0
				39 01 00 00 00 00 02 BD 01
				39 01 00 00 00 00 2B C1 00 09 13 1D 26 30 39 41 48 4F 55 5C 62 68 6F 76 7D 84 8B 92 9A A0 A7 AE B5 BC C3 CB D2 D9 E0 E7 EF 24 85 5C 39 07 79 44 1A 80
				39 01 00 00 00 00 02 BD 02
				39 01 00 00 00 00 2B C1 00 07 0E 15 1D 25 2D 34 39 3F 44 4A 4E 54 5A 5F 64 6A 70 76 7C 81 87 8C 92 97 9D A3 A9 AF B4 BA C0 1B 14 EC E2 F9 B3 1A 0D 40
				39 01 00 00 00 00 02 BD 00];
		qcom,mdss-dsi-panel-eye-command05 = [39 01 00 00 00 00 3B E0 07 08 09 0D 10 14 16 13 24 36 48 4A 58 6F 76 80 97 A5 A8 B5 C6 62 63 68 6F 72 78 7F 7F 00 02 08 0D 0C 0E 0F 10 24 36 48 4A 58 6F 78 82 99 A4 A0 B1 C0 5E 5E 64 6B 6C 73 7F 7F
				39 01 00 00 00 00 02 BD 00
				39 01 00 00 00 00 2C C1 01 00 0A 14 1E 28 32 3B 43 4A 52 58 5F 65 6D 74 7B 82 8A 92 99 A1 A8 AE B6 BE C5 CD D6 DC E5 ED F6 FF 15 8F C9 C5 97 4F 3C CB C0
				39 01 00 00 00 00 02 BD 01
				39 01 00 00 00 00 2B C1 00 09 13 1D 26 30 39 41 48 4F 55 5C 62 68 6F 76 7D 84 8B 92 9A A0 A7 AE B5 BC C3 CB D2 D9 E0 E7 EF 24 85 5C 39 07 79 44 1A 80
				39 01 00 00 00 00 02 BD 02
				39 01 00 00 00 00 2B C1 00 06 0D 14 1B 23 2A 31 36 3B 40 45 4A 4F 54 59 5F 64 6A 6F 75 7A 7F 84 89 8E 94 99 9F A4 AA AF B5 3E 5C BF 6F 21 52 A7 35 00
				39 01 00 00 00 00 02 BD 00];
		qcom,mdss-dsi-panel-eye-command06 = [39 01 00 00 00 00 3B E0 07 08 09 0D 10 14 16 13 24 36 48 4A 58 6F 76 80 97 A5 A8 B5 C6 62 63 68 6F 72 78 7F 7F 00 02 08 0D 0C 0E 0F 10 24 36 48 4A 58 6F 78 82 99 A4 A0 B1 C0 5E 5E 64 6B 6C 73 7F 7F
				39 01 00 00 00 00 02 BD 00
				39 01 00 00 00 00 2C C1 01 00 0A 14 1E 28 32 3B 43 4A 52 58 5F 65 6D 74 7B 82 8A 92 99 A1 A8 AE B6 BE C5 CD D6 DC E5 ED F6 FF 15 8F C9 C5 97 4F 3C CB C0
				39 01 00 00 00 00 02 BD 01
				39 01 00 00 00 00 2B C1 00 09 13 1D 26 30 39 41 48 4F 55 5C 62 68 6F 76 7D 84 8B 92 9A A0 A7 AE B5 BC C3 CB D2 D9 E0 E7 EF 24 85 5C 39 07 79 44 1A 80
				39 01 00 00 00 00 02 BD 02
				39 01 00 00 00 00 2B C1 00 06 0C 13 19 21 28 2E 33 38 3D 41 46 4B 50 54 59 5E 63 69 6E 73 77 7D 81 86 8C 91 96 9B A0 A5 AA 2D D5 63 03 BC 9C 90 19 C0
				39 01 00 00 00 00 02 BD 00];
		qcom,mdss-dsi-panel-eye-command07 = [39 01 00 00 00 00 3B E0 07 08 09 0D 10 14 16 13 24 36 48 4A 58 6F 76 80 97 A5 A8 B5 C6 62 63 68 6F 72 78 7F 7F 00 02 08 0D 0C 0E 0F 10 24 36 48 4A 58 6F 78 82 99 A4 A0 B1 C0 5E 5E 64 6B 6C 73 7F 7F
				39 01 00 00 00 00 02 BD 00
				39 01 00 00 00 00 2C C1 01 00 0A 14 1E 28 32 3B 43 4A 52 58 5F 65 6D 74 7B 82 8A 92 99 A1 A8 AE B6 BE C5 CD D6 DC E5 ED F6 FF 15 8F C9 C5 97 4F 3C CB C0
				39 01 00 00 00 00 02 BD 01
				39 01 00 00 00 00 2B C1 00 09 13 1D 26 30 39 41 48 4F 55 5C 62 68 6F 76 7D 84 8B 92 9A A0 A7 AE B5 BC C3 CB D2 D9 E0 E7 EF 24 85 5C 39 07 79 44 1A 80
				39 01 00 00 00 00 02 BD 02
				39 01 00 00 00 00 2B C1 00 06 0C 12 18 1F 25 2B 30 34 39 3D 41 46 4A 4F 53 58 5D 62 67 6B 70 74 79 7D 82 87 8C 91 96 9A 9F 00 08 31 4D E4 63 2E 42 80
				39 01 00 00 00 00 02 BD 00];
		qcom,mdss-dsi-panel-eye-command08 = [39 01 00 00 00 00 3B E0 07 08 09 0D 10 14 16 13 24 36 48 4A 58 6F 76 80 97 A5 A8 B5 C6 62 63 68 6F 72 78 7F 7F 00 02 08 0D 0C 0E 0F 10 24 36 48 4A 58 6F 78 82 99 A4 A0 B1 C0 5E 5E 64 6B 6C 73 7F 7F
				39 01 00 00 00 00 02 BD 00
				39 01 00 00 00 00 2C C1 01 00 0A 14 1E 28 32 3B 43 4A 52 58 5F 65 6D 74 7B 82 8A 92 99 A1 A8 AE B6 BE C5 CD D6 DC E5 ED F6 FF 15 8F C9 C5 97 4F 3C CB C0
				39 01 00 00 00 00 02 BD 01
				39 01 00 00 00 00 2B C1 00 09 13 1D 26 30 39 41 48 4F 55 5C 62 68 6F 76 7D 84 8B 92 9A A0 A7 AE B5 BC C3 CB D2 D9 E0 E7 EF 24 85 5C 39 07 79 44 1A 80
				39 01 00 00 00 00 02 BD 02
				39 01 00 00 00 00 2B C1 00 05 0B 10 16 1C 22 27 2C 30 34 38 3C 40 45 49 4D 51 56 5A 5F 63 67 6B 6F 74 78 7D 81 86 8A 8E 93 22 6F 7F 70 76 57 CC 8A 40
				39 01 00 00 00 00 02 BD 00];
		qcom,mdss-dsi-panel-eye-command-num = <8>;
		qcom,mdss-dsi-h-sync-pulse = <1>;
		qcom,mdss-dsi-traffic-mode = "burst_mode";
		qcom,mdss-dsi-lane-map = "lane_map_0123";
		qcom,mdss-dsi-bllp-eof-power-mode;
		qcom,mdss-dsi-bllp-power-mode;
		qcom,mdss-dsi-lane-0-state;
		qcom,mdss-dsi-lane-1-state;
		qcom,mdss-dsi-lane-2-state;
		qcom,mdss-dsi-lane-3-state;
		qcom,mdss-dsi-panel-timings = [8C 20 14 00 46 48 1A 22 18 03 04 00];
		qcom,mdss-dsi-t-clk-post = <0x04>;
		qcom,mdss-dsi-t-clk-pre = <0x1C>;
		qcom,mdss-dsi-bl-min-level = <4>;
		qcom,mdss-dsi-bl-max-level = <255>;
		qcom,mdss-dsi-bl-pmic-pwm-frequency = <100>;
		qcom,mdss-dsi-bl-pmic-bank-select = <0>;
		qcom,mdss-dsi-dma-trigger = "trigger_sw";
		qcom,mdss-dsi-mdp-trigger = "none";
		qcom,mdss-dsi-bl-pmic-control-type = "bl_ctrl_pwm";
		qcom,mdss-dsi-reset-sequence = <1 50>, <0 20>, <1 5>;
		qcom,mdss-pan-physical-width-dimension = <62>;
		qcom,mdss-pan-physical-height-dimension = <110>;
		qcom,mdss-dsi-lp11-init;
		qcom,mdss-dsi-init-delay-us = <50000>;
		qcom,mdss-dsi-tx-eot-append;
	};
};
