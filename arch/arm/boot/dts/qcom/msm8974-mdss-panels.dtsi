/* Copyright (c) 2013-2014, The Linux Foundation. All rights reserved.
 *
 * This program is free software; you can redistribute it and/or modify
 * it under the terms of the GNU General Public License version 2 and
 * only version 2 as published by the Free Software Foundation.
 *
 * This program is distributed in the hope that it will be useful,
 * but WITHOUT ANY WARRANTY; without even the implied warranty of
 * MERCHANTABILITY or FITNESS FOR A PARTICULAR PURPOSE.  See the
 * GNU General Public License for more details.
 */

#include "dsi-panel-orise-720p-video.dtsi"
#include "dsi-panel-toshiba-720p-video.dtsi"
#include "dsi-panel-sharp-qhd-video.dtsi"
#include "dsi-panel-generic-720p-cmd.dtsi"
#include "dsi-panel-jdi-1080p-video.dtsi"
#include "dsi-panel-sim-video.dtsi"
#include "dsi-panel-sim-dualmipi0-video.dtsi"
#include "dsi-panel-sim-dualmipi1-video.dtsi"
#include "dsi-panel-sim-cmd.dtsi"
#include "dsi-panel-sim-dualmipi0-cmd.dtsi"
#include "dsi-panel-sim-dualmipi1-cmd.dtsi"
