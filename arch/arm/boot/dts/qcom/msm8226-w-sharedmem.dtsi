/* Copyright (c) 2014, The Linux Foundation. All rights reserved.
 *
 * This program is free software; you can redistribute it and/or modify
 * it under the terms of the GNU General Public License version 2 and
 * only version 2 as published by the Free Software Foundation.
 *
 * This program is distributed in the hope that it will be useful,
 * but WITHOUT ANY WARRANTY; without even the implied warranty of
 * MERCHANTABILITY or FITNESS FOR A PARTICULAR PURPOSE.  See the
 * GNU General Public License for more details.
 */

/ {

	qcom,rmtfs_sharedmem@07f00000 {
		compatible = "qcom,sharedmem-uio";
		reg = <0x07f00000 0x00100000>;
		reg-names = "rmtfs";
		qcom,client-id = <0x00000001>;
	};

	qcom,dsp_sharedmem@03260000 {
		compatible = "qcom,sharedmem-uio";
		reg = <0x03260000 0x00020000>;
		reg-names = "rfsa_dsp";
		qcom,client-id = <0x011013ec>;
	};

	qcom,mdm_sharedmem@03260000 {
		compatible = "qcom,sharedmem-uio";
		reg = <0x03260000 0x00020000>;
		reg-names = "rfsa_mdm";
		qcom,client-id = <0x011013ed>;
	};
};
