/* Copyright (c) 2016, The Linux Foundation. All rights reserved.
 *
 * This program is free software; you can redistribute it and/or modify
 * it under the terms of the GNU General Public License version 2 and
 * only version 2 as published by the Free Software Foundation.
 *
 * This program is distributed in the hope that it will be useful,
 * but WITHOUT ANY WARRANTY; without even the implied warranty of
 * MERCHANTABILITY or FITNESS FOR A PARTICULAR PURPOSE.  See the
 * GNU General Public License for more details.
 */


/dts-v1/;

#include "msmfalcon.dtsi"
#include "msmfalcon-cdp.dtsi"
#include "msm-pm3falcon.dtsi"

/ {
	model = "Qualcomm Technologies, Inc. MSM FALCON PMFALCON + PM3FALCON RCM";
	compatible = "qcom,msmfalcon-cdp", "qcom,msmfalcon", "qcom,cdp";
	qcom,board-id = <21 0>;
	qcom,pmic-id = <0x0001001b 0x0001011a 0x0 0x0>;
};
