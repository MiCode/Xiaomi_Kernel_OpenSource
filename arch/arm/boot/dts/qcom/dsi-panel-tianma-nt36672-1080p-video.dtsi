/* Copyright (c) 2017, The Linux Foundation. All rights reserved.
 * Copyright (C) 2019 XiaoMi, Inc.
 *
 * This program is free software; you can redistribute it and/or modify
 * it under the terms of the GNU General Public License version 2 and
 * only version 2 as published by the Free Software Foundation.
 *
 * This program is distributed in the hope that it will be useful,
 * but WITHOUT ANY WARRANTY; without even the implied warranty of
 * MERCHANTABILITY or FITNESS FOR A PARTICULAR PURPOSE.  See the
 * GNU General Public License for more details.
 */

&mdss_mdp {
	dsi_nt36672_tianma_fhd_video: qcom,mdss_dsi_nt36672_tianma_fhd_video {
		qcom,mdss-dsi-panel-name = "tianma nt36672 fhd video mode dsi panel";
		qcom,mdss-dsi-panel-controller = <&mdss_dsi0>;
		qcom,mdss-dsi-panel-type = "dsi_video_mode";
		qcom,mdss-dsi-panel-framerate = <60>;
		qcom,mdss-dsi-virtual-channel-id = <0>;
		qcom,mdss-dsi-stream = <0>;
		qcom,mdss-dsi-panel-width = <1080>;
		qcom,mdss-dsi-panel-height = <2160>;
		qcom,mdss-pan-physical-width-dimension = <68>;
		qcom,mdss-pan-physical-height-dimension = <136>;
		qcom,mdss-dsi-h-front-porch = <96>;
		qcom,mdss-dsi-h-back-porch = <56>;
		qcom,mdss-dsi-h-pulse-width = <4>;
		qcom,mdss-dsi-h-sync-skew = <0>;
		qcom,mdss-dsi-v-back-porch = <33>;
		qcom,mdss-dsi-v-front-porch = <4>;
		qcom,mdss-dsi-v-pulse-width = <2>;
		qcom,mdss-dsi-h-left-border = <0>;
		qcom,mdss-dsi-h-right-border = <0>;
		qcom,mdss-dsi-v-top-border = <0>;
		qcom,mdss-dsi-v-bottom-border = <0>;
		qcom,mdss-dsi-bpp = <24>;
		qcom,mdss-dsi-underflow-color = <0xff>;
		qcom,mdss-dsi-border-color = <0>;
		qcom,mdss-dsi-h-sync-pulse = <0>;
		qcom,mdss-dsi-traffic-mode = "burst_mode";
		qcom,mdss-dsi-bllp-eof-power-mode;
		qcom,mdss-dsi-bllp-power-mode;
		qcom,mdss-dsi-lane-0-state;
		qcom,mdss-dsi-lane-1-state;
		qcom,mdss-dsi-lane-2-state;
		qcom,mdss-dsi-lane-3-state;
		qcom,mdss-dsi-panel-timings = [e6 38 26 00 68 6e 2a
				3c 44 03 04 00];
		qcom,mdss-dsi-t-clk-post = <0x0d>;
		qcom,mdss-dsi-t-clk-pre = <0x32>;
		qcom,mdss-dsi-bl-min-level = <1>;
		qcom,mdss-dsi-bl-max-level = <4095>;
		qcom,mdss-dsi-dma-trigger = "trigger_sw";
		qcom,mdss-dsi-mdp-trigger = "none";
		qcom,mdss-dsi-on-command = [
				15 01 00 00 00 00 02 ff 20
				15 01 00 00 00 00 02 fb 01
				15 01 00 00 00 00 02 30 10
				15 01 00 00 00 00 02 31 50
				15 01 00 00 00 00 02 32 2f
				15 01 00 00 00 00 02 ff 10
				05 01 00 00 46 00 02 11 00
				15 01 00 00 00 00 02 51 ff
				39 01 00 00 00 00 03 68 03 04
				15 01 00 00 00 00 02 53 2c
				15 01 00 00 00 00 02 55 00
				05 01 00 00 05 00 02 29 00
		];
		qcom,mdss-dsi-off-command = [
				05 01 00 00 14 00 02 28 00
				05 01 00 00 78 00 02 10 00
		];
		qcom,mdss-dsi-ce-on-command = [
		];
		qcom,mdss-dsi-ce-off-command = [
		];
		qcom,mdss-dsi-srgb-on-command = [
		];
		qcom,mdss-dsi-srgb-off-command = [
		];
		qcom,mdss-dsi-cabc-on-command = [
				15 01 00 00 00 00 02 FF 23
				15 00 00 00 00 00 02 07 20
				15 00 00 00 00 00 02 08 05
				15 00 00 00 00 00 02 09 00
				15 00 00 00 00 00 02 10 95
				15 00 00 00 00 00 02 30 FF
				15 00 00 00 00 00 02 31 FF
				15 00 00 00 00 00 02 32 FF
				15 00 00 00 00 00 02 33 FF
				15 00 00 00 00 00 02 34 FF
				15 00 00 00 00 00 02 35 FF
				15 00 00 00 00 00 02 36 FF
				15 00 00 00 00 00 02 37 FF
				15 00 00 00 00 00 02 38 FF
				15 00 00 00 00 00 02 39 FF
				15 00 00 00 00 00 02 3A FF
				15 00 00 00 00 00 02 3B F9
				15 00 00 00 00 00 02 3D D9
				15 00 00 00 00 00 02 3F B9
				15 00 00 00 00 00 02 40 AB
				15 00 00 00 00 00 02 41 98
				15 01 00 00 00 00 02 FF 10
				15 01 00 00 00 00 02 55 01
		];
		qcom,mdss-dsi-cabc-off-command = [
				15 01 00 00 00 00 02 FF 10
				15 01 00 00 00 00 02 55 00
		];
		qcom,mdss-dsi-gamma0-command = [
				15 00 00 00 00 00 02 FF 20
				15 00 00 00 00 00 02 FB 01

				39 00 00 00 00 00 11 B0 00 2B 00 3F 00 61 00 7E 00 97 00 AD 00 C1 00 D3
				39 00 00 00 00 00 11 B1 00 E3 01 18 01 40 01 7B 01 A9 01 EF 02 26 02 28
				39 00 00 00 00 00 11 B2 02 5E 02 9C 02 C4 02 F6 03 14 03 44 03 50 03 5D
				39 00 00 00 00 00 0D B3 03 6E 03 80 03 99 03 BA 03 D5 03 D8

				39 00 00 00 00 00 11 B4 00 00 00 20 00 49 00 6A 00 85 00 9E 00 B3 00 C6
				39 00 00 00 00 00 11 B5 00 D7 01 0F 01 38 01 76 01 A6 01 ED 02 25 02 26
				39 00 00 00 00 00 11 B6 02 5D 02 9B 02 C4 02 F6 03 15 03 45 03 51 03 5F
				39 00 00 00 00 00 0D B7 03 6F 03 81 03 97 03 B5 03 D3 03 D8

				39 00 00 00 00 00 11 B8 00 3A 00 4E 00 70 00 8D 00 A5 00 BB 00 CE 00 DF
				39 00 00 00 00 00 11 B9 00 EE 01 21 01 47 01 82 01 AF 01 F3 02 2A 02 2B
				39 00 00 00 00 00 11 BA 02 61 02 9F 02 C8 02 FA 03 1E 03 52 03 63 03 7A
				39 01 00 00 00 00 0D BB 03 9E 03 B8 03 BA 03 CA 03 D6 03 D8

				15 00 00 00 00 00 02 FF 21
				15 00 00 00 00 00 02 FB 01

				39 00 00 00 00 00 11 B0 00 2B 00 3F 00 61 00 7E 00 97 00 AD 00 C1 00 D3
				39 00 00 00 00 00 11 B1 00 E3 01 18 01 40 01 7B 01 A9 01 EF 02 26 02 28
				39 00 00 00 00 00 11 B2 02 5E 02 9C 02 C4 02 F6 03 14 03 44 03 50 03 5D
				39 00 00 00 00 00 0D B3 03 6E 03 80 03 99 03 BA 03 D5 03 D8

				39 00 00 00 00 00 11 B4 00 00 00 20 00 49 00 6A 00 85 00 9E 00 B3 00 C6
				39 00 00 00 00 00 11 B5 00 D7 01 0F 01 38 01 76 01 A6 01 ED 02 25 02 26
				39 00 00 00 00 00 11 B6 02 5D 02 9B 02 C4 02 F6 03 15 03 45 03 51 03 5F
				39 00 00 00 00 00 0D B7 03 6F 03 81 03 97 03 B5 03 D3 03 D8

				39 00 00 00 00 00 11 B8 00 3A 00 4E 00 70 00 8D 00 A5 00 BB 00 CE 00 DF
				39 00 00 00 00 00 11 B9 00 EE 01 21 01 47 01 82 01 AF 01 F3 02 2A 02 2B
				39 00 00 00 00 00 11 BA 02 61 02 9F 02 C8 02 FA 03 1E 03 52 03 63 03 7A
				39 00 00 00 00 00 0D BB 03 9E 03 B8 03 BA 03 CA 03 D6 03 D8

				15 01 00 00 00 00 02 FF 10
		];
		qcom,mdss-dsi-gamma1-command = [
				15 00 00 00 00 00 02 FF 20
				15 00 00 00 00 00 02 FB 01

				39 00 00 00 00 00 11 B0 00 BC 00 C6 00 D7 00 E7 00 F6 01 02 01 0F 01 1B
				39 00 00 00 00 00 11 B1 01 26 01 4C 01 69 01 9B 01 C2 02 00 02 34 02 36
				39 00 00 00 00 00 11 B2 02 6A 02 AA 02 CE 02 FF 03 20 03 4B 03 58 03 66
				39 00 00 00 00 00 0D B3 03 75 03 87 03 9E 03 B7 03 D1 03 D7

				39 00 00 00 00 00 11 B4 00 00 00 22 00 4E 00 70 00 8C 00 A5 00 BA 00 CD
				39 00 00 00 00 00 11 B5 00 DE 01 15 01 3F 01 7D 01 AC 01 F2 02 2A 02 2C
				39 00 00 00 00 00 11 B6 02 62 02 9F 02 C7 02 FA 03 19 03 46 03 53 03 61
				39 00 00 00 00 00 0D B7 03 71 03 83 03 9A 03 B5 03 D5 03 D7

				39 00 00 00 00 00 11 B8 01 04 01 0A 01 17 01 21 01 2B 01 35 01 3F 01 47
				39 00 00 00 00 00 11 B9 01 4F 01 6D 01 87 01 B1 01 D4 02 0D 02 3E 02 40
				39 00 00 00 00 00 11 BA 02 73 02 AE 02 D5 03 08 03 26 03 57 03 5D 03 6A
				39 01 00 00 00 00 0D BB 03 79 03 8C 03 A0 03 C1 03 C3 03 D7

				15 00 00 00 00 00 02 FF 21
				15 00 00 00 00 00 02 FB 01

				39 00 00 00 00 00 11 B0 00 BC 00 C6 00 D7 00 E7 00 F6 01 02 01 0F 01 1B
				39 00 00 00 00 00 11 B1 01 26 01 4C 01 69 01 9B 01 C2 02 00 02 34 02 36
				39 00 00 00 00 00 11 B2 02 6A 02 AA 02 CE 02 FF 03 20 03 4B 03 58 03 66
				39 00 00 00 00 00 0D B3 03 75 03 87 03 9E 03 B7 03 D1 03 D7

				39 00 00 00 00 00 11 B4 00 00 00 22 00 4E 00 70 00 8C 00 A5 00 BA 00 CD
				39 00 00 00 00 00 11 B5 00 DE 01 15 01 3F 01 7D 01 AC 01 F2 02 2A 02 2C
				39 00 00 00 00 00 11 B6 02 62 02 9F 02 C7 02 FA 03 19 03 46 03 53 03 61
				39 00 00 00 00 00 0D B7 03 71 03 83 03 9A 03 B5 03 D5 03 D7

				39 00 00 00 00 00 11 B8 01 04 01 0A 01 17 01 21 01 2B 01 35 01 3F 01 47
				39 00 00 00 00 00 11 B9 01 4F 01 6D 01 87 01 B1 01 D4 02 0D 02 3E 02 40
				39 00 00 00 00 00 11 BA 02 73 02 AE 02 D5 03 08 03 26 03 57 03 5D 03 6A
				39 00 00 00 00 00 0D BB 03 79 03 8C 03 A0 03 C1 03 C3 03 D7

				15 01 00 00 00 00 02 FF 10

		];
		qcom,mdss-dsi-gamma2-command = [
				15 00 00 00 00 00 02 FF 20
				15 00 00 00 00 00 02 FB 01

				39 00 00 00 00 00 11 B0 00 36 00 51 00 6F 00 8E 00 A5 00 BA 00 CE 00 DF
				39 00 00 00 00 00 11 B1 00 EF 01 22 01 48 01 84 01 B1 01 F4 02 2C 02 2E
				39 00 00 00 00 00 11 B2 02 64 02 A2 02 C8 02 FC 03 1D 03 48 03 55 03 63
				39 00 00 00 00 00 0D B3 03 73 03 86 03 9E 03 B7 03 CF 03 D7

				39 00 00 00 00 00 11 B4 00 00 00 1E 00 4D 00 6F 00 8C 00 A5 00 BA 00 CD
				39 00 00 00 00 00 11 B5 00 DE 01 15 01 3F 01 7D 01 AC 01 F2 02 2A 02 2C
				39 00 00 00 00 00 11 B6 02 62 02 9F 02 C6 02 FA 03 1C 03 45 03 53 03 61
				39 00 00 00 00 00 0D B7 03 71 03 84 03 9D 03 BA 03 D6 03 D7

				39 00 00 00 00 00 11 B8 00 B5 00 C0 00 D3 00 E4 00 F5 01 02 01 0F 01 1B
				39 00 00 00 00 00 11 B9 01 26 01 4C 01 6C 01 9E 01 C5 02 03 02 37 02 39
				39 00 00 00 00 00 11 BA 02 6D 02 A9 02 CF 03 05 03 28 03 53 03 5A 03 68
				39 01 00 00 00 00 0D BB 03 79 03 8C 03 A0 03 C1 03 C3 03 D7

				15 00 00 00 00 00 02 FF 21
				15 00 00 00 00 00 02 FB 01

				39 00 00 00 00 00 11 B0 00 36 00 51 00 6F 00 8E 00 A5 00 BA 00 CE 00 DF
				39 00 00 00 00 00 11 B1 00 EF 01 22 01 48 01 84 01 B1 01 F4 02 2C 02 2E
				39 00 00 00 00 00 11 B2 02 64 02 A2 02 C8 02 FC 03 1D 03 48 03 55 03 63
				39 00 00 00 00 00 0D B3 03 73 03 86 03 9E 03 B7 03 CF 03 D7

				39 00 00 00 00 00 11 B4 00 00 00 1E 00 4D 00 6F 00 8C 00 A5 00 BA 00 CD
				39 00 00 00 00 00 11 B5 00 DE 01 15 01 3F 01 7D 01 AC 01 F2 02 2A 02 2C
				39 00 00 00 00 00 11 B6 02 62 02 9F 02 C6 02 FB 03 1C 03 45 03 53 03 61
				39 00 00 00 00 00 0D B7 03 71 03 84 03 9D 03 BA 03 D6 03 D7

				39 00 00 00 00 00 11 B8 01 B5 00 C0 00 D3 01 E4 01 F5 01 02 01 0F 01 1B
				39 00 00 00 00 00 11 B9 01 26 01 4C 01 6C 01 9E 01 C5 02 03 02 37 02 39
				39 00 00 00 00 00 11 BA 02 6D 02 A9 02 CF 03 05 03 28 03 53 03 5A 03 68
				39 00 00 00 00 00 0D BB 03 77 03 8B 03 A5 03 C6 03 CA 03 D7

				15 01 00 00 00 00 02 FF 10
		];
		qcom,mdss-dsi-gamma3-command = [
				15 00 00 00 00 00 02 FF 20
				15 00 00 00 00 00 02 FB 01
				39 00 00 00 00 00 11 B0 00 4F 00 61 00 7E 00 97 00 AE 00 C4 00 D6 00 E8
				39 00 00 00 00 00 11 B1 00 F3 01 27 01 4B 01 86 01 B6 01 F7 02 2D 02 2F
				39 00 00 00 00 00 11 B2 02 64 02 A1 02 C9 02 FC 03 1D 03 48 03 55 03 63
				39 00 00 00 00 00 0D B3 03 72 03 85 03 9C 03 BB 03 D5 03 D7
				39 00 00 00 00 00 11 B4 00 66 00 75 00 90 00 A8 00 BD 00 CF 00 E0 00 EF
				39 00 00 00 00 00 11 B5 00 FE 01 2C 01 51 01 89 01 B5 01 F9 02 2E 02 30
				39 00 00 00 00 00 11 B6 02 65 02 A0 02 C9 02 FC 03 1C 03 47 03 55 03 62
				39 00 00 00 00 00 0D B7 03 72 03 84 03 9A 03 B5 03 D5 03 D7
				39 00 00 00 00 00 11 B8 00 00 00 20 00 57 00 7A 00 97 00 B3 00 C7 00 D9
				39 00 00 00 00 00 11 B9 00 EA 01 20 01 47 01 86 01 B6 01 F9 02 2F 02 30
				39 00 00 00 00 00 11 BA 02 65 02 A1 02 C9 02 FC 03 1E 03 4F 03 56 03 64
				39 01 00 00 00 00 0D BB 03 73 03 86 03 9C 03 B7 03 BF 03 D7
				15 00 00 00 00 00 02 FF 21
				15 00 00 00 00 00 02 FB 01
				39 00 00 00 00 00 11 B0 00  4F 00 61 00 7E 00 97 00 AE 00 C4 00 D6 00 E8
				39 00 00 00 00 00 11 B1 00 F3 01 27 01 4B 01 86 01 B6 01 F7 02 2D 02 2F
				39 00 00 00 00 00 11 B2 02 64 02 A1 02 C9 02 FC 03 1D 03 48 03 55 03 63
				39 00 00 00 00 00 0D B3 03 72 03 85 03 9C 03 BB 03 D5 03 D7
				39 00 00 00 00 00 11 B4 00 66 00 75 00 90 00 A8 00 BD 00 CF 00 E0 00 EF
				39 00 00 00 00 00 11 B5 00 FE 01 2C 01 51 01 89 01 B5 01 F9 02 2E 02 30
				39 00 00 00 00 00 11 B6 02 65 02 A0 02 C9 02 FC 03 1C 03 47 03 55 03 62
				39 00 00 00 00 00 0D B7 03 72 03 84 03 9A 03 B5 03 D5 03 D7
				39 00 00 00 00 00 11 B8 00 00 00 20 00 57 00 7A 00 97 00 B3 00 C7 00 D9
				39 00 00 00 00 00 11 B9 00 EA 01 20 01 47 01 86 01 B6 01 F9 02 2F 02 30
				39 00 00 00 00 00 11 BA 02 65 02 A1 02 C9 02 FC 03 1E 03 4F 03 56 03 64
				39 00 00 00 00 00 0D BB 03 73 03 86 03 9C 03 B7 03 BF 03 D7
				15 01 00 00 00 00 02 FF 10
		];
		qcom,mdss-dsi-gamma4-command = [
				15 00 00 00 00 00 02 FF 20
				15 00 00 00 00 00 02 FB 01
				39 00 00 00 00 00 11 B0 00 42 00 54 00 72 00 90 00 A5 00 BD 00 D0 00 DD
				39 00 00 00 00 00 11 B1 00 F0 01 1F 01 46 01 82 01 B0 01 F5 02 2C 02 2E
				39 00 00 00 00 00 11 B2 02 64 02 A0 02 C8 02 FC 03 1D 03 48 03 55 03 63
				39 00 00 00 00 00 0D B3 03 73 03 85 03 9D 03 B8 03 D6 03 D7
				39 00 00 00 00 00 11 B4 00 D6 00 DE 00 ED 00 FA 01 07 01 12 01 1D 01 28
				39 00 00 00 00 00 11 B5 01 31 01 54 01 71 01 A0 01 C6 02 03 02 36 02 37
				39 00 00 00 00 00 11 B6 02 6B 02 A6 02 CD 03 00 03 22 03 4B 03 58 03 66
				39 00 00 00 00 00 0D B7 03 75 03 88 03 9E 03 B9 03 D5 03 D7
				39 00 00 00 00 00 11 B8 00 00 00 1B 00 51 00 7C 00 9A 00 B5 00 C8 00 DA
				39 00 00 00 00 00 11 B9 00 EB 01 1E 01 46 01 85 01 B3 01 F9 02 2F 02 30
				39 00 00 00 00 00 11 BA 02 66 02 A1 02 C8 02 FD 03 1E 03 4B 03 56 03 65
				39 01 00 00 00 00 0D BB 03 74 03 87 03 9E 03 BD 03 C1 03 D7
				15 00 00 00 00 00 02 FF 21
				15 00 00 00 00 00 02 FB 01
				39 00 00 00 00 00 11 B0 00 42 00 54 00 72 00 90 00 A5 00 BD 00 D0 00 DD
				39 00 00 00 00 00 11 B1 00 F0 01 1F 01 46 01 82 01 B0 01 F5 02 2C 02 2E
				39 00 00 00 00 00 11 B2 02 64 02 A0 02 C8 02 FC 03 1D 03 48 03 55 03 63
				39 00 00 00 00 00 0D B3 03 73 03 85 03 9D 03 B8 03 D6 03 D7
				39 00 00 00 00 00 11 B4 00 D6 00 DE 00 ED 00 FA 01 07 01 12 01 1D 01 28
				39 00 00 00 00 00 11 B5 01 31 01 54 01 71 01 A0 01 C6 02 03 02 36 02 37
				39 00 00 00 00 00 11 B6 02 6B 02 A6 02 CD 03 00 03 22 03 4B 03 58 03 66
				39 00 00 00 00 00 0D B7 03 75 03 88 03 9E 03 B9 03 D5 03 D7
				39 00 00 00 00 00 11 B8 00 00 00 1B 00 51 00 7C 00 9A 00 B5 00 C8 00 DA
				39 00 00 00 00 00 11 B9 00 EB 01 1E 01 46 01 85 01 B3 01 F9 02 2F 02 30
				39 00 00 00 00 00 11 BA 02 66 02 A1 02 C8 02 FD 03 1E 03 4B 03 56 03 65
				39 00 00 00 00 00 0D BB 03 74 03 87 03 9E 03 BD 03 C1 03 D7
				15 01 00 00 00 00 02 FF 10
		];
		qcom,mdss-dsi-gamma5-command = [
				15 00 00 00 00 00 02 FF 20
				15 00 00 00 00 00 02 FB 01
				39 00 00 00 00 00 11 B0 00 00 00 1B 00 48 00 69 00 85 00 A0 00 B4 00 C9
				39 00 00 00 00 00 11 B1 00 D9 01 0D 01 3D 01 7A 01 AA 01 F0 02 29 02 2A
				39 00 00 00 00 00 11 B2 02 60 02 9F 02 C6 02 F7 03 16 03 47 03 54 03 62
				39 00 00 00 00 00 0D B3 03 71 03 84 03 9B 03 BA 03 D4 03 D7
				39 00 00 00 00 00 11 B4 00 A3 00 AF 00 C3 00 D5 00 E5 00 F3 01 01 01 0D
				39 00 00 00 00 00 11 B5 01 19 01 42 01 61 01 95 01 BD 01 FD 02 32 02 33
				39 00 00 00 00 00 11 B6 02 68 02 A8 02 CB 02 FF 03 1F 03 49 03 56 03 63
				39 00 00 00 00 00 0D B7 03 73 03 85 03 9B 03 B6 03 D6 03 D7
				39 00 00 00 00 00 11 B8 00 E7 00 EE 00 FC 01 09 01 15 01 22 01 2B 01 36
				39 00 00 00 00 00 11 B9 01 3E 01 5C 01 7B 01 A7 01 CD 02 08 02 3B 02 3C
				39 00 00 00 00 00 11 BA 02 70 02 AC 02 D1 03 06 03 29 03 58 03 63 03 6C
				39 01 00 00 00 00 0D BB 03 7D 03 90 03 A2 03 BB 03 BD 03 D7
				15 00 00 00 00 00 02 FF 21
				15 00 00 00 00 00 02 FB 01
				39 00 00 00 00 00 11 B0 00 00 00 1B 00 48 00 69 00 85 00 A0 00 B4 00 C9
				39 00 00 00 00 00 11 B1 00 D9 01 0D 01 3D 01 7A 01 AA 01 F0 02 29 02 2A
				39 00 00 00 00 00 11 B2 02 60 02 9F 02 C6 02 F7 03 16 03 47 03 54 03 62
				39 00 00 00 00 00 0D B3 03 71 03 84 03 9B 03 BA 03 D4 03 D7
				39 00 00 00 00 00 11 B4 00 A3 00 AF 00 C3 00 D5 00 E5 00 F3 01 01 01 0D
				39 00 00 00 00 00 11 B5 01 19 01 42 01 61 01 95 01 BD 01 FD 02 32 02 33
				39 00 00 00 00 00 11 B6 02 68 02 A8 02 CB 02 FF 03 1F 03 49 03 56 03 63
				39 00 00 00 00 00 0D B7 03 73 03 85 03 9B 03 B6 03 D6 03 D7
				39 00 00 00 00 00 11 B8 00 E7 00 EE 00 FC 01 09 01 15 01 22 01 2B 01 36
				39 00 00 00 00 00 11 B9 01 3E 01 5C 01 7B 01 A7 01 CD 02 08 02 3B 02 3C
				39 00 00 00 00 00 11 BA 02 70 02 AC 02 D1 03 06 03 29 03 58 03 63 03 6C
				39 00 00 00 00 00 0D BB 03 7D 03 90 03 A2 03 BB 03 BD 03 D7
				15 01 00 00 00 00 02 FF 10
		];
		qcom,mdss-dsi-gamma6-command = [
				15 00 00 00 00 00 02 FF 20
				15 00 00 00 00 00 02 FB 01
				39 00 00 00 00 00 11 B0 00 00 00 1B 00 48 00 69 00 85 00 A0 00 B4 00 C9
				39 00 00 00 00 00 11 B1 00 D9 01 0D 01 3D 01 7A 01 AA 01 F0 02 29 02 2A
				39 00 00 00 00 00 11 B2 02 60 02 9F 02 C6 02 F7 03 16 03 47 03 54 03 62
				39 00 00 00 00 00 0D B3 03 71 03 84 03 9B 03 BA 03 D4 03 D7
				39 00 00 00 00 00 11 B4 00 A3 00 AF 00 C3 00 D5 00 E5 00 F3 01 01 01 0D
				39 00 00 00 00 00 11 B5 01 19 01 42 01 61 01 95 01 BD 01 FD 02 32 02 33
				39 00 00 00 00 00 11 B6 02 68 02 A8 02 CB 02 FF 03 1F 03 49 03 56 03 63
				39 00 00 00 00 00 0D B7 03 73 03 85 03 9B 03 B6 03 D6 03 D7
				39 00 00 00 00 00 11 B8 00 E7 00 EE 00 FC 01 09 01 15 01 22 01 2B 01 36
				39 00 00 00 00 00 11 B9 01 3E 01 5C 01 7B 01 A7 01 CD 02 08 02 3B 02 3C
				39 00 00 00 00 00 11 BA 02 70 02 AC 02 D1 03 06 03 29 03 58 03 63 03 6C
				39 01 00 00 00 00 0D BB 03 7D 03 90 03 A2 03 BB 03 BD 03 D7
				15 00 00 00 00 00 02 FF 21
				15 00 00 00 00 00 02 FB 01
				39 00 00 00 00 00 11 B0 00 00 00 1B 00 48 00 69 00 85 00 A0 00 B4 00 C9
				39 00 00 00 00 00 11 B1 00 D9 01 0D 01 3D 01 7A 01 AA 01 F0 02 29 02 2A
				39 00 00 00 00 00 11 B2 02 60 02 9F 02 C6 02 F7 03 16 03 47 03 54 03 62
				39 00 00 00 00 00 0D B3 03 71 03 84 03 9B 03 BA 03 D4 03 D7
				39 00 00 00 00 00 11 B4 00 A3 00 AF 00 C3 00 D5 00 E5 00 F3 01 01 01 0D
				39 00 00 00 00 00 11 B5 01 19 01 42 01 61 01 95 01 BD 01 FD 02 32 02 33
				39 00 00 00 00 00 11 B6 02 68 02 A8 02 CB 02 FF 03 1F 03 49 03 56 03 63
				39 00 00 00 00 00 0D B7 03 73 03 85 03 9B 03 B6 03 D6 03 D7
				39 00 00 00 00 00 11 B8 00 E7 00 EE 00 FC 01 09 01 15 01 22 01 2B 01 36
				39 00 00 00 00 00 11 B9 01 3E 01 5C 01 7B 01 A7 01 CD 02 08 02 3B 02 3C
				39 00 00 00 00 00 11 BA 02 70 02 AC 02 D1 03 06 03 29 03 58 03 63 03 6C
				39 00 00 00 00 00 0D BB 03 7D 03 90 03 A2 03 BB 03 BD 03 D7
				15 01 00 00 00 00 02 FF 10
		];
		qcom,mdss-dsi-gamma7-command = [
				15 00 00 00 00 00 02 FF 20
				15 00 00 00 00 00 02 FB 01
				39 00 00 00 00 00 11 B0 00 B2 00 BF 00 D1 00 E2 00 EF 00 FD 01 09 01 15
				39 00 00 00 00 00 11 B1 01 20 01 45 01 66 01 98 01 BF 01 FE 02 33 02 35
				39 00 00 00 00 00 11 B2 02 69 02 A6 02 CD 02 FF 03 20 03 4B 03 57 03 65
				39 00 00 00 00 00 0D B3 03 75 03 88 03 A0 03 B9 03 D5 03 D7
				39 00 00 00 00 00 11 B4 00 00 00 1B 00 49 00 6D 00 8C 00 A5 00 BB 00 CE
				39 00 00 00 00 00 11 B5 00 DF 01 16 01 3F 01 7D 01 AC 01 F1 02 29 02 2B
				39 00 00 00 00 00 11 B6 02 61 02 9F 02 C6 02 F9 03 18 03 46 03 53 03 61
				39 00 00 00 00 00 0D B7 03 71 03 84 03 9C 03 B9 03 D5 03 D7
				39 00 00 00 00 00 11 B8 00 09 00 2B 00 5F 00 85 00 A1 00 B9 00 CE 00 E0
				39 00 00 00 00 00 11 B9 00 F1 01 25 01 4C 01 88 01 B5 01 F8 02 2F 02 31
				39 00 00 00 00 00 11 BA 02 66 02 A4 02 CA 02 FF 03 22 03 54 03 57 03 66
				39 01 00 00 00 00 0D BB 03 77 03 8A 03 A0 03 B7 03 C3 03 D7
				15 00 00 00 00 00 02 FF 21
				15 00 00 00 00 00 02 FB 01
				39 00 00 00 00 00 11 B0 00 B2 00 BF 00 D1 00 E2 00 EF 00 FD 01 09 01 15
				39 00 00 00 00 00 11 B1 01 20 01 45 01 66 01 98 01 BF 01 FE 02 33 02 35
				39 00 00 00 00 00 11 B2 02 69 02 A6 02 CD 02 FF 03 20 03 4B 03 57 03 65
				39 00 00 00 00 00 0D B3 03 75 03 88 03 A0 03 B9 03 D5 03 D7
				39 00 00 00 00 00 11 B4 00 00 00 1B 00 49 00 6D 00 8C 00 A5 00 BB 00 CE
				39 00 00 00 00 00 11 B5 00 DF 01 16 01 3F 01 7D 01 AC 01 F1 02 29 02 2B
				39 00 00 00 00 00 11 B6 02 61 02 9F 02 C6 02 F9 03 18 03 46 03 53 03 61
				39 00 00 00 00 00 0D B7 03 71 03 84 03 9C 03 B9 03 D5 03 D7
				39 00 00 00 00 00 11 B8 00 09 00 2B 00 5F 00 85 00 A1 00 B9 00 CE 00 E0
				39 00 00 00 00 00 11 B9 00 F1 01 25 01 4C 01 88 01 B5 01 F8 02 2F 02 31
				39 00 00 00 00 00 11 BA 02 66 02 A4 02 CA 02 FF 03 22 03 54 03 57 03 66
				39 00 00 00 00 00 0D BB 03 77 03 8A 03 A0 03 B7 03 C3 03 D7
				15 01 00 00 00 00 02 FF 10
		];
		qcom,mdss-dsi-gamma8-command = [
				15 00 00 00 00 00 02 FF 20
				15 00 00 00 00 00 02 FB 01
				39 00 00 00 00 00 11 B0 01 35 01 3A 01 42 01 4B 01 52 01 59 01 61 01 67
				39 00 00 00 00 00 11 B1 01 6E 01 85 01 9A 01 BF 01 DE 02 13 02 42 02 43
				39 00 00 00 00 00 11 B2 02 74 02 B0 02 D6 03 0A 03 27 03 52 03 5D 03 6B
				39 00 00 00 00 00 0D B3 03 7A 03 8C 03 A2 03 BF 03 D5 03 D7
				39 00 00 00 00 00 11 B4 00 00 00 1E 00 4A 00 6C 00 89 00 A2 00 B7 00 CB
				39 00 00 00 00 00 11 B5 00 DC 01 14 01 3E 01 7C 01 AB 01 F1 02 29 02 2B
				39 00 00 00 00 00 11 B6 02 61 02 9F 02 C6 02 F8 03 1A 03 46 03 53 03 61
				39 00 00 00 00 00 0D B7 03 70 03 83 03 9B 03 B6 03 D6 03 D7
				39 00 00 00 00 00 11 B8 00 16 00 3C 00 69 00 86 00 A3 00 BB 00 D1 00 E2
				39 00 00 00 00 00 11 B9 00 F2 01 26 01 4D 01 88 01 B5 01 F9 02 2F 02 31
				39 00 00 00 00 00 11 BA 02 66 02 A4 02 CA 02 FF 03 23 03 52 03 57 03 66
				39 01 00 00 00 00 0D BB 03 79 03 8C 03 A0 03 BB 03 BF 03 D7
				15 00 00 00 00 00 02 FF 21
				15 00 00 00 00 00 02 FB 01
				39 00 00 00 00 00 11 B0 01 35 01 3A 01 42 01 4B 01 52 01 59 01 61 01 67
				39 00 00 00 00 00 11 B1 01 6E 01 85 01 9A 01 BF 01 DE 02 13 02 42 02 43
				39 00 00 00 00 00 11 B2 02 74 02 B0 02 D6 03 0A 03 27 03 52 03 5D 03 6B
				39 00 00 00 00 00 0D B3 03 7A 03 8C 03 A2 03 BF 03 D5 03 D7
				39 00 00 00 00 00 11 B4 00 00 00 1E 00 4A 00 6C 00 89 00 A2 00 B7 00 CB
				39 00 00 00 00 00 11 B5 00 DC 01 14 01 3E 01 7C 01 AB 01 F1 02 29 02 2B
				39 00 00 00 00 00 11 B6 02 61 02 9F 02 C6 02 F8 03 1A 03 46 03 53 03 61
				39 00 00 00 00 00 0D B7 03 70 03 83 03 9B 03 B6 03 D6 03 D7
				39 00 00 00 00 00 11 B8 00 16 00 3C 00 69 00 86 00 A3 00 BB 00 D1 00 E2
				39 00 00 00 00 00 11 B9 00 F2 01 26 01 4D 01 88 01 B5 01 F9 02 2F 02 31
				39 00 00 00 00 00 11 BA 02 66 02 A4 02 CA 02 FF 03 23 03 52 03 57 03 66
				39 00 00 00 00 00 0D BB 03 79 03 8C 03 A0 03 BB 03 BF 03 D7
				15 01 00 00 00 00 02 FF 10
		];
		qcom,mdss-dsi-gamma9-command = [
				15 00 00 00 00 00 02 FF 20
				15 00 00 00 00 00 02 FB 01
				39 00 00 00 00 00 11 B0 00 00 00 17 00 3F 00 67 00 87 00 A0 00 B4 00 C8
				39 00 00 00 00 00 11 B1 00 DB 01 13 01 3C 01 7C 01 AB 01 F1 02 29 02 2B
				39 00 00 00 00 00 11 B2 02 60 02 9D 02 C4 02 F6 03 1B 03 47 03 54 03 62
				39 00 00 00 00 00 0D B3 03 71 03 82 03 98 03 B1 03 D1 03 D7
				39 00 00 00 00 00 11 B4 00 91 00 9D 00 B3 00 C6 00 D7 00 E7 00 F6 01 03
				39 00 00 00 00 00 11 B5 01 0F 01 39 01 5B 01 90 01 BA 01 FA 02 30 02 32
				39 00 00 00 00 00 11 B6 02 67 02 A4 02 CA 02 FE 03 1E 03 48 03 56 03 63
				39 00 00 00 00 00 0D B7 03 72 03 84 03 98 03 B1 03 D3 03 D7
				39 00 00 00 00 00 11 B8 01 4A 01 4D 01 55 01 5C 01 63 01 6A 01 70 01 77
				39 00 00 00 00 00 11 B9 01 7D 01 93 01 A7 01 C9 01 E7 02 1A 02 48 02 4A
				39 00 00 00 00 00 11 BA 02 7A 02 B4 02 DB 03 0E 03 32 03 5D 03 62 03 6F
				39 01 00 00 00 00 0D BB 03 7D 03 8C 03 A2 03 BD 03 C3 03 D7
				15 00 00 00 00 00 02 FF 21
				15 00 00 00 00 00 02 FB 01
				39 00 00 00 00 00 11 B0 00 00 00 17 00 3F 00 67 00 87 00 A0 00 B4 00 C8
				39 00 00 00 00 00 11 B1 00 DB 01 13 01 3C 01 7C 01 AB 01 F1 02 29 02 2B
				39 00 00 00 00 00 11 B2 02 60 02 9D 02 C4 02 F6 03 1B 03 47 03 54 03 62
				39 00 00 00 00 00 0D B3 03 71 03 82 03 98 03 B1 03 D1 03 D7
				39 00 00 00 00 00 11 B4 00 91 00 9D 00 B3 00 C6 00 D7 00 E7 00 F6 01 03
				39 00 00 00 00 00 11 B5 01 0F 01 39 01 5B 01 90 01 BA 01 FA 02 30 02 32
				39 00 00 00 00 00 11 B6 02 67 02 A4 02 CA 02 FE 03 1E 03 48 03 56 03 63
				39 00 00 00 00 00 0D B7 03 72 03 84 03 98 03 B1 03 D3 03 D7
				39 00 00 00 00 00 11 B8 01 4A 01 4D 01 55 01 5C 01 63 01 6A 01 70 01 77
				39 00 00 00 00 00 11 B9 01 7D 01 93 01 A7 01 C9 01 E7 02 1A 02 48 02 4A
				39 00 00 00 00 00 11 BA 02 7A 02 B4 02 DB 03 0E 03 32 03 5D 03 62 03 6F
				39 00 00 00 00 00 0D BB 03 7D 03 8C 03 A2 03 BD 03 C3 03 D7
				15 01 00 00 00 00 02 FF 10
		];
		qcom,mdss-dsi-gamma10-command = [
				15 00 00 00 00 00 02 FF 20
				15 00 00 00 00 00 02 FB 01
				39 00 00 00 00 00 11 B0 00 00 00 20 00 4B 00 6A 00 87 00 A0 00 B7 00 C8
				39 00 00 00 00 00 11 B1 00 D9 01 11 01 3D 01 7D 01 AC 01 F2 02 29 02 2B
				39 00 00 00 00 00 11 B2 02 62 02 9F 02 C6 02 FB 03 1C 03 47 03 54 03 62
				39 00 00 00 00 00 0D B3 03 72 03 84 03 9A 03 B7 03 CF 03 D7
				39 00 00 00 00 00 11 B4 00 00 00 22 00 4E 00 71 00 8D 00 A5 00 BA 00 CE
				39 00 00 00 00 00 11 B5 00 DF 01 16 01 3F 01 81 01 AC 01 F4 02 2A 02 2B
				39 00 00 00 00 00 11 B6 02 62 02 9D 02 C5 02 FA 03 1C 03 45 03 53 03 61
				39 00 00 00 00 00 0D B7 03 70 03 83 03 99 03 B4 03 D6 03 D7
				39 00 00 00 00 00 11 B8 00 ED 00 F4 01 03 01 0E 01 1A 01 25 01 30 01 38
				39 00 00 00 00 00 11 B9 01 41 01 61 01 7D 01 AD 01 CF 02 0A 02 3B 02 3C
				39 00 00 00 00 00 11 BA 02 70 02 AA 02 D1 03 05 03 28 03 55 03 5C 03 69
				39 01 00 00 00 00 0D BB 03 79 03 8A 03 A0 03 BF 03 C1 03 D7

				15 00 00 00 00 00 02 FF 21
				15 00 00 00 00 00 02 FB 01
				39 00 00 00 00 00 11 B0 00 00 00 20 00 4B 00 6A 00 87 00 A0 00 B7 00 C8
				39 00 00 00 00 00 11 B1 00 D9 01 11 01 3D 01 7D 01 AC 01 F2 02 29 02 2B
				39 00 00 00 00 00 11 B2 02 62 02 9F 02 C6 02 FB 03 1C 03 47 03 54 03 62
				39 00 00 00 00 00 0D B3 03 72 03 84 03 9A 03 B7 03 CF 03 D7
				39 00 00 00 00 00 11 B4 00 00 00 22 00 4E 00 71 00 8D 00 A5 00 BA 00 CE
				39 00 00 00 00 00 11 B5 00 DF 01 16 01 3F 01 81 01 AC 01 F4 02 2A 02 2B
				39 00 00 00 00 00 11 B6 02 62 02 9D 02 C5 02 FA 03 1C 03 45 03 53 03 61
				39 00 00 00 00 00 0D B7 03 70 03 83 03 99 03 B4 03 D6 03 D7
				39 00 00 00 00 00 11 B8 00 ED 00 F4 01 03 01 0E 01 1A 01 25 01 30 01 38
				39 00 00 00 00 00 11 B9 01 41 01 61 01 7D 01 AD 01 CF 02 0A 02 3B 02 3C
				39 00 00 00 00 00 11 BA 02 70 02 AA 02 D1 03 05 03 28 03 55 03 5C 03 69
				39 00 00 00 00 00 0D BB 03 79 03 8A 03 A0 03 BF 03 C1 03 D7
				15 01 00 00 00 00 02 FF 10
		];
		qcom,mdss-dsi-gamma11-command = [
				15 00 00 00 00 00 02 FF 20
				15 00 00 00 00 00 02 FB 01
				39 00 00 00 00 00 11 B0 00 00 00 23 00 51 00 6C 00 8B 00 9D 00 B5 00 C9
				39 00 00 00 00 00 11 B1 00 D8 01 0F 01 3C 01 7A 01 AA 01 F1 02 28 02 2A
				39 00 00 00 00 00 11 B2 02 60 02 9E 02 C5 02 F4 03 12 03 46 03 53 03 61
				39 00 00 00 00 00 0D B3 03 71 03 84 03 9A 03 B7 03 D5 03 D7
				39 00 00 00 00 00 11 B4 00 F5 00 FC 01 08 01 14 01 1E 01 29 01 32 01 3B
				39 00 00 00 00 00 11 B5 01 44 01 63 01 7D 01 A9 01 CC 02 06 02 39 02 3B
				39 00 00 00 00 00 11 B6 02 6E 02 AB 02 D0 03 02 03 23 03 4D 03 59 03 67
				39 00 00 00 00 00 0D B7 03 76 03 88 03 9E 03 B9 03 D5 03 D7
				39 00 00 00 00 00 11 B8 00 E7 00 EF 00 FD 01 09 01 16 01 20 01 2B 01 35
				39 00 00 00 00 00 11 B9 01 3D 01 5E 01 7A 01 A8 01 CD 02 08 02 3A 02 3C
				39 00 00 00 00 00 11 BA 02 6F 02 AB 02 D1 03 03 03 28 03 57 03 5C 03 6F
				39 01 00 00 00 00 0D BB 03 80 03 99 03 A3 03 BC 03 C2 03 D7
				15 00 00 00 00 00 02 FF 21
				15 00 00 00 00 00 02 FB 01
				39 00 00 00 00 00 11 B0 00 00 00 23 00 51 00 6C 00 8B 00 9D 00 B5 00 C9
				39 00 00 00 00 00 11 B1 00 D8 01 0F 01 3C 01 7A 01 AA 01 F1 02 28 02 2A
				39 00 00 00 00 00 11 B2 02 60 02 9E 02 C5 02 F4 03 12 03 46 03 53 03 61
				39 00 00 00 00 00 0D B3 03 71 03 84 03 9A 03 B7 03 D5 03 D7
				39 00 00 00 00 00 11 B4 00 F5 00 FC 01 08 01 14 01 1E 01 29 01 32 01 3B
				39 00 00 00 00 00 11 B5 01 44 01 63 01 7D 01 A9 01 CC 02 06 02 39 02 3B
				39 00 00 00 00 00 11 B6 02 6E 02 AB 02 D0 03 02 03 23 03 4D 03 59 03 67
				39 00 00 00 00 00 0D B7 03 76 03 88 03 9E 03 B9 03 D5 03 D7
				39 00 00 00 00 00 11 B8 00 E7 00 EF 00 FD 01 09 01 16 01 20 01 2B 01 35
				39 00 00 00 00 00 11 B9 01 3D 01 5E 01 7A 01 A8 01 CD 02 08 02 3A 02 3C
				39 00 00 00 00 00 11 BA 02 6F 02 AB 02 D1 03 03 03 28 03 57 03 5C 03 6F
				39 00 00 00 00 00 0D BB 03 80 03 99 03 A3 03 BC 03 C2 03 D7
				15 01 00 00 00 00 02 FF 10
		];
		qcom,mdss-dsi-gamma12-command = [
				15 00 00 00 00 00 02 FF 20
				15 00 00 00 00 00 02 FB 01
				39 00 00 00 00 00 11 B0 00 00 00 23 00 51 00 6C 00 8B 00 9D 00 B5 00 C9
				39 00 00 00 00 00 11 B1 00 D8 01 0F 01 3C 01 7A 01 AA 01 F1 02 28 02 2A
				39 00 00 00 00 00 11 B2 02 60 02 9E 02 C5 02 F4 03 12 03 46 03 53 03 61
				39 00 00 00 00 00 0D B3 03 71 03 84 03 9A 03 B7 03 D5 03 D7
				39 00 00 00 00 00 11 B4 00 F5 00 FC 01 08 01 14 01 1E 01 29 01 32 01 3B
				39 00 00 00 00 00 11 B5 01 44 01 63 01 7D 01 A9 01 CC 02 06 02 39 02 3B
				39 00 00 00 00 00 11 B6 02 6E 02 AB 02 D0 03 02 03 23 03 4D 03 59 03 67
				39 00 00 00 00 00 0D B7 03 76 03 88 03 9E 03 B9 03 D5 03 D7
				39 00 00 00 00 00 11 B8 00 E7 00 EF 00 FD 01 09 01 16 01 20 01 2B 01 35
				39 00 00 00 00 00 11 B9 01 3D 01 5E 01 7A 01 A8 01 CD 02 08 02 3A 02 3C
				39 00 00 00 00 00 11 BA 02 6F 02 AB 02 D1 03 03 03 28 03 57 03 5C 03 6F
				39 01 00 00 00 00 0D BB 03 80 03 99 03 A3 03 BC 03 C2 03 D7
				15 00 00 00 00 00 02 FF 21
				15 00 00 00 00 00 02 FB 01
				39 00 00 00 00 00 11 B0 00 00 00 23 00 51 00 6C 00 8B 00 9D 00 B5 00 C9
				39 00 00 00 00 00 11 B1 00 D8 01 0F 01 3C 01 7A 01 AA 01 F1 02 28 02 2A
				39 00 00 00 00 00 11 B2 02 60 02 9E 02 C5 02 F4 03 12 03 46 03 53 03 61
				39 00 00 00 00 00 0D B3 03 71 03 84 03 9A 03 B7 03 D5 03 D7
				39 00 00 00 00 00 11 B4 00 F5 00 FC 01 08 01 14 01 1E 01 29 01 32 01 3B
				39 00 00 00 00 00 11 B5 01 44 01 63 01 7D 01 A9 01 CC 02 06 02 39 02 3B
				39 00 00 00 00 00 11 B6 02 6E 02 AB 02 D0 03 02 03 23 03 4D 03 59 03 67
				39 00 00 00 00 00 0D B7 03 76 03 88 03 9E 03 B9 03 D5 03 D7
				39 00 00 00 00 00 11 B8 00 E7 00 EF 00 FD 01 09 01 16 01 20 01 2B 01 35
				39 00 00 00 00 00 11 B9 01 3D 01 5E 01 7A 01 A8 01 CD 02 08 02 3A 02 3C
				39 00 00 00 00 00 11 BA 02 6F 02 AB 02 D1 03 03 03 28 03 57 03 5C 03 6F
				39 00 00 00 00 00 0D BB 03 80 03 99 03 A3 03 BC 03 C2 03 D7
				15 01 00 00 00 00 02 FF 10
		];
		qcom,mdss-dsi-gamma13-command = [
				15 00 00 00 00 00 02 FF 20
				15 00 00 00 00 00 02 FB 01
				39 00 00 00 00 00 11 B0 00 00 00 18 00 3F 00 6A 00 86 00 9F 00 BA 00 CD
				39 00 00 00 00 00 11 B1 00 DE 01 15 01 3E 01 7D 01 AB 01 F1 02 2A 02 2C
				39 00 00 00 00 00 11 B2 02 62 02 9F 02 C7 02 FA 03 1B 03 46 03 53 03 61
				39 00 00 00 00 00 0D B3 03 71 03 83 03 9B 03 B4 03 D6 03 D7
				39 00 00 00 00 00 11 B4 00 00 00 25 00 52 00 72 00 8E 00 A6 00 BA 00 CD
				39 00 00 00 00 00 11 B5 00 DE 01 15 01 3F 01 7D 01 AC 01 F1 02 2A 02 2B
				39 00 00 00 00 00 11 B6 02 61 02 9F 02 C7 02 F8 03 1A 03 45 03 53 03 61
				39 00 00 00 00 00 0D B7 03 70 03 82 03 9A 03 B7 03 D5 03 D7
				39 00 00 00 00 00 11 B8 01 09 01 11 01 1C 01 25 01 2F 01 39 01 41 01 4A
				39 00 00 00 00 00 11 B9 01 52 01 6F 01 89 01 B3 01 D5 02 0D 02 3F 02 40
				39 00 00 00 00 00 11 BA 02 72 02 AF 02 D6 03 07 03 2A 03 57 03 5C 03 69
				39 01 00 00 00 00 0D BB 03 7A 03 8B 03 A2 03 BD 03 C1 03 D7
				15 00 00 00 00 00 02 FF 21
				15 00 00 00 00 00 02 FB 01
				39 00 00 00 00 00 11 B0 00 00 00 18 00 3F 00 6A 00 86 00 9F 00 BA 00 CD
				39 00 00 00 00 00 11 B1 00 DE 01 15 01 3E 01 7D 01 AB 01 F1 02 2A 02 2C
				39 00 00 00 00 00 11 B2 02 62 02 9F 02 C7 02 FA 03 1B 03 46 03 53 03 61
				39 00 00 00 00 00 0D B3 03 71 03 83 03 9B 03 B4 03 D6 03 D7
				39 00 00 00 00 00 11 B4 00 00 00 25 00 52 00 72 00 8E 00 A6 00 BA 00 CD
				39 00 00 00 00 00 11 B5 00 DE 01 15 01 3F 01 7D 01 AC 01 F1 02 2A 02 2B
				39 00 00 00 00 00 11 B6 02 61 02 9F 02 C7 02 F8 03 1A 03 45 03 53 03 61
				39 00 00 00 00 00 0D B7 03 70 03 82 03 9A 03 B7 03 D5 03 D7
				39 00 00 00 00 00 11 B8 01 09 01 11 01 1C 01 25 01 2F 01 39 01 41 01 4A
				39 00 00 00 00 00 11 B9 01 52 01 6F 01 89 01 B3 01 D5 02 0D 02 3F 02 40
				39 00 00 00 00 00 11 BA 02 72 02 AF 02 D6 03 07 03 2A 03 57 03 5C 03 69
				39 00 00 00 00 00 0D BB 03 7A 03 8B 03 A2 03 BD 03 C1 03 D7
				15 01 00 00 00 00 02 FF 10
		];
		qcom,mdss-dsi-gamma14-command = [
				15 00 00 00 00 00 02 FF 20
				15 00 00 00 00 00 02 FB 01
				39 00 00 00 00 00 11 B0 00 00 00 20 00 4B 00 6A 00 87 00 A0 00 B7 00 C8
				39 00 00 00 00 00 11 B1 00 D9 01 11 01 3D 01 7D 01 AC 01 F2 02 29 02 2B
				39 00 00 00 00 00 11 B2 02 62 02 9F 02 C6 02 FB 03 1C 03 47 03 54 03 62
				39 00 00 00 00 00 0D B3 03 72 03 84 03 9A 03 B7 03 CF 03 D7
				39 00 00 00 00 00 11 B4 00 00 00 22 00 4E 00 71 00 8D 00 A5 00 BA 00 CE
				39 00 00 00 00 00 11 B5 00 DF 01 16 01 3F 01 81 01 AC 01 F4 02 2A 02 2B
				39 00 00 00 00 00 11 B6 02 62 02 9D 02 C5 02 FA 03 1C 03 45 03 53 03 61
				39 00 00 00 00 00 0D B7 03 70 03 83 03 99 03 B4 03 D6 03 D7
				39 00 00 00 00 00 11 B8 00 ED 00 F4 01 03 01 0E 01 1A 01 25 01 30 01 38
				39 00 00 00 00 00 11 B9 01 41 01 61 01 7D 01 AD 01 CF 02 0A 02 3B 02 3C
				39 00 00 00 00 00 11 BA 02 70 02 AA 02 D1 03 05 03 28 03 55 03 5C 03 69
				39 01 00 00 00 00 0D BB 03 79 03 8A 03 A0 03 BF 03 C1 03 D7

				15 00 00 00 00 00 02 FF 21
				15 00 00 00 00 00 02 FB 01
				39 00 00 00 00 00 11 B0 00 00 00 20 00 4B 00 6A 00 87 00 A0 00 B7 00 C8
				39 00 00 00 00 00 11 B1 00 D9 01 11 01 3D 01 7D 01 AC 01 F2 02 29 02 2B
				39 00 00 00 00 00 11 B2 02 62 02 9F 02 C6 02 FB 03 1C 03 47 03 54 03 62
				39 00 00 00 00 00 0D B3 03 72 03 84 03 9A 03 B7 03 CF 03 D7
				39 00 00 00 00 00 11 B4 00 00 00 22 00 4E 00 71 00 8D 00 A5 00 BA 00 CE
				39 00 00 00 00 00 11 B5 00 DF 01 16 01 3F 01 81 01 AC 01 F4 02 2A 02 2B
				39 00 00 00 00 00 11 B6 02 62 02 9D 02 C5 02 FA 03 1C 03 45 03 53 03 61
				39 00 00 00 00 00 0D B7 03 70 03 83 03 99 03 B4 03 D6 03 D7
				39 00 00 00 00 00 11 B8 00 ED 00 F4 01 03 01 0E 01 1A 01 25 01 30 01 38
				39 00 00 00 00 00 11 B9 01 41 01 61 01 7D 01 AD 01 CF 02 0A 02 3B 02 3C
				39 00 00 00 00 00 11 BA 02 70 02 AA 02 D1 03 05 03 28 03 55 03 5C 03 69
				39 00 00 00 00 00 0D BB 03 79 03 8A 03 A0 03 BF 03 C1 03 D7
				15 01 00 00 00 00 02 FF 10
		];
		qcom,mdss-dsi-gamma15-command = [
				15 00 00 00 00 00 02 FF 20
				15 00 00 00 00 00 02 FB 01
				39 00 00 00 00 00 11 B0 00 4F 00 61 00 7E 00 97 00 AE 00 C4 00 D6 00 E8
				39 00 00 00 00 00 11 B1 00 F3 01 27 01 4B 01 86 01 B6 01 F7 02 2D 02 2F
				39 00 00 00 00 00 11 B2 02 64 02 A1 02 C9 02 FC 03 1D 03 48 03 55 03 63
				39 00 00 00 00 00 0D B3 03 72 03 85 03 9C 03 BB 03 D5 03 D7
				39 00 00 00 00 00 11 B4 00 66 00 75 00 90 00 A8 00 BD 00 CF 00 E0 00 EF
				39 00 00 00 00 00 11 B5 00 FE 01 2C 01 51 01 89 01 B5 01 F9 02 2E 02 30
				39 00 00 00 00 00 11 B6 02 65 02 A0 02 C9 02 FC 03 1C 03 47 03 55 03 62
				39 00 00 00 00 00 0D B7 03 72 03 84 03 9A 03 B5 03 D5 03 D7
				39 00 00 00 00 00 11 B8 00 00 00 20 00 57 00 7A 00 97 00 B3 00 C7 00 D9
				39 00 00 00 00 00 11 B9 00 EA 01 20 01 47 01 86 01 B6 01 F9 02 2F 02 30
				39 00 00 00 00 00 11 BA 02 65 02 A1 02 C9 02 FC 03 1E 03 4F 03 56 03 64
				39 01 00 00 00 00 0D BB 03 73 03 86 03 9C 03 B7 03 BF 03 D7
				15 00 00 00 00 00 02 FF 21
				15 00 00 00 00 00 02 FB 01
				39 00 00 00 00 00 11 B0 00  4F 00 61 00 7E 00 97 00 AE 00 C4 00 D6 00 E8
				39 00 00 00 00 00 11 B1 00 F3 01 27 01 4B 01 86 01 B6 01 F7 02 2D 02 2F
				39 00 00 00 00 00 11 B2 02 64 02 A1 02 C9 02 FC 03 1D 03 48 03 55 03 63
				39 00 00 00 00 00 0D B3 03 72 03 85 03 9C 03 BB 03 D5 03 D7
				39 00 00 00 00 00 11 B4 00 66 00 75 00 90 00 A8 00 BD 00 CF 00 E0 00 EF
				39 00 00 00 00 00 11 B5 00 FE 01 2C 01 51 01 89 01 B5 01 F9 02 2E 02 30
				39 00 00 00 00 00 11 B6 02 65 02 A0 02 C9 02 FC 03 1C 03 47 03 55 03 62
				39 00 00 00 00 00 0D B7 03 72 03 84 03 9A 03 B5 03 D5 03 D7
				39 00 00 00 00 00 11 B8 00 00 00 20 00 57 00 7A 00 97 00 B3 00 C7 00 D9
				39 00 00 00 00 00 11 B9 00 EA 01 20 01 47 01 86 01 B6 01 F9 02 2F 02 30
				39 00 00 00 00 00 11 BA 02 65 02 A1 02 C9 02 FC 03 1E 03 4F 03 56 03 64
				39 00 00 00 00 00 0D BB 03 73 03 86 03 9C 03 B7 03 BF 03 D7
				15 01 00 00 00 00 02 FF 10
		];
		qcom,mdss-dsi-gamma16-command = [
				15 00 00 00 00 00 02 FF 20
				15 00 00 00 00 00 02 FB 01
				39 00 00 00 00 00 11 B0 00 00 00 23 00 51 00 6C 00 8B 00 9D 00 B5 00 C9
				39 00 00 00 00 00 11 B1 00 D8 01 0F 01 3C 01 7A 01 AA 01 F1 02 28 02 2A
				39 00 00 00 00 00 11 B2 02 60 02 9E 02 C5 02 F4 03 12 03 46 03 53 03 61
				39 00 00 00 00 00 0D B3 03 71 03 84 03 9A 03 B7 03 D5 03 D7
				39 00 00 00 00 00 11 B4 00 F5 00 FC 01 08 01 14 01 1E 01 29 01 32 01 3B
				39 00 00 00 00 00 11 B5 01 44 01 63 01 7D 01 A9 01 CC 02 06 02 39 02 3B
				39 00 00 00 00 00 11 B6 02 6E 02 AB 02 D0 03 02 03 23 03 4D 03 59 03 67
				39 00 00 00 00 00 0D B7 03 76 03 88 03 9E 03 B9 03 D5 03 D7
				39 00 00 00 00 00 11 B8 00 E7 00 EF 00 FD 01 09 01 16 01 20 01 2B 01 35
				39 00 00 00 00 00 11 B9 01 3D 01 5E 01 7A 01 A8 01 CD 02 08 02 3A 02 3C
				39 00 00 00 00 00 11 BA 02 6F 02 AB 02 D1 03 03 03 28 03 57 03 5C 03 6F
				39 01 00 00 00 00 0D BB 03 80 03 99 03 A3 03 BC 03 C2 03 D7
				15 00 00 00 00 00 02 FF 21
				15 00 00 00 00 00 02 FB 01
				39 00 00 00 00 00 11 B0 00 00 00 23 00 51 00 6C 00 8B 00 9D 00 B5 00 C9
				39 00 00 00 00 00 11 B1 00 D8 01 0F 01 3C 01 7A 01 AA 01 F1 02 28 02 2A
				39 00 00 00 00 00 11 B2 02 60 02 9E 02 C5 02 F4 03 12 03 46 03 53 03 61
				39 00 00 00 00 00 0D B3 03 71 03 84 03 9A 03 B7 03 D5 03 D7
				39 00 00 00 00 00 11 B4 00 F5 00 FC 01 08 01 14 01 1E 01 29 01 32 01 3B
				39 00 00 00 00 00 11 B5 01 44 01 63 01 7D 01 A9 01 CC 02 06 02 39 02 3B
				39 00 00 00 00 00 11 B6 02 6E 02 AB 02 D0 03 02 03 23 03 4D 03 59 03 67
				39 00 00 00 00 00 0D B7 03 76 03 88 03 9E 03 B9 03 D5 03 D7
				39 00 00 00 00 00 11 B8 00 E7 00 EF 00 FD 01 09 01 16 01 20 01 2B 01 35
				39 00 00 00 00 00 11 B9 01 3D 01 5E 01 7A 01 A8 01 CD 02 08 02 3A 02 3C
				39 00 00 00 00 00 11 BA 02 6F 02 AB 02 D1 03 03 03 28 03 57 03 5C 03 6F
				39 00 00 00 00 00 0D BB 03 80 03 99 03 A3 03 BC 03 C2 03 D7
				15 01 00 00 00 00 02 FF 10
		];
		qcom,mdss-dsi-gamma17-command = [
				15 00 00 00 00 00 02 FF 20
				15 00 00 00 00 00 02 FB 01
				39 00 00 00 00 00 11 B0 01 34 01 3A 01 41 01 4A 01 50 01 59 01 5F 01 66
				39 00 00 00 00 00 11 B1 01 6C 01 85 01 9A 01 BF 01 DF 02 13 02 41 02 43
				39 00 00 00 00 00 11 B2 02 75 02 AF 02 D6 03 09 03 27 03 51 03 5E 03 6C
				39 00 00 00 00 00 0D B3 03 7B 03 8D 03 A3 03 BC 03 D2 03 D7
				39 00 00 00 00 00 11 B4 00 00 00 1D 00 4C 00 6E 00 8C 00 A4 00 BA 00 CD
				39 00 00 00 00 00 11 B5 00 DF 01 15 01 3F 01 7D 01 AB 01 F5 02 2A 02 2B
				39 00 00 00 00 00 11 B6 02 62 02 9D 02 C5 02 F8 03 1B 03 44 03 52 03 61
				39 00 00 00 00 00 0D B7 03 70 03 83 03 9A 03 B5 03 D5 03 D7
				39 00 00 00 00 00 11 B8 01 09 01 0F 01 1A 01 25 01 2F 01 38 01 42 01 4B
				39 00 00 00 00 00 11 B9 01 52 01 6F 01 88 01 B2 01 D5 02 0E 02 3E 02 40
				39 00 00 00 00 00 11 BA 02 73 02 AD 02 D4 03 08 03 29 03 56 03 5E 03 6C
				39 01 00 00 00 00 0D BB 03 7B 03 8D 03 A1 03 C2 03 C4 03 D7
				15 00 00 00 00 00 02 FF 21
				15 00 00 00 00 00 02 FB 01
				39 00 00 00 00 00 11 B0 01 34 01 3A 01 41 01 4A 01 50 01 59 01 5F 01 66
				39 00 00 00 00 00 11 B1 01 6C 01 85 01 9A 01 BF 01 DF 02 13 02 41 02 43
				39 00 00 00 00 00 11 B2 02 75 02 AF 02 D6 03 09 03 27 03 51 03 5E 03 6C
				39 00 00 00 00 00 0D B3 03 7B 03 8D 03 A3 03 BC 03 D2 03 D7
				39 00 00 00 00 00 11 B4 00 00 00 1D 00 4C 00 6E 00 8C 00 A4 00 BA 00 CD
				39 00 00 00 00 00 11 B5 00 DF 01 15 01 3F 01 7D 01 AB 01 F5 02 2A 02 2B
				39 00 00 00 00 00 11 B6 02 62 02 9D 02 C5 02 F8 03 1B 03 44 03 52 03 61
				39 00 00 00 00 00 0D B7 03 70 03 83 03 9A 03 B5 03 D5 03 D7
				39 00 00 00 00 00 11 B8 01 09 01 0F 01 1A 01 25 01 2F 01 38 01 42 01 4B
				39 00 00 00 00 00 11 B9 01 52 01 6F 01 88 01 B2 01 D5 02 0E 02 3E 02 40
				39 00 00 00 00 00 11 BA 02 73 02 AD 02 D4 03 08 03 29 03 56 03 5E 03 6C
				39 00 00 00 00 00 0D BB 03 7B 03 8D 03 A1 03 C2 03 C4 03 D7
				15 01 00 00 00 00 02 FF 10
		];
		qcom,mdss-dsi-gamma18-command = [
				15 00 00 00 00 00 02 FF 20
				15 00 00 00 00 00 02 FB 01
				39 00 00 00 00 00 11 B0 01 00 01 08 01 12 01 1C 01 27 01 30 01 39 01 42
				39 00 00 00 00 00 11 B1 01 4B 01 67 01 83 01 AC 01 CF 02 08 02 3B 02 3C
				39 00 00 00 00 00 11 B2 02 6F 02 AB 02 D1 03 03 03 23 03 4D 03 59 03 67
				39 00 00 00 00 00 0D B3 03 77 03 88 03 9F 03 B8 03 D4 03 D7
				39 00 00 00 00 00 11 B4 00 00 00 1D 00 4B 00 6E 00 8A 00 A3 00 B9 00 CC
				39 00 00 00 00 00 11 B5 00 DD 01 15 01 3E 01 7C 01 AB 01 F1 02 2B 02 2C
				39 00 00 00 00 00 11 B6 02 61 02 9E 02 C6 02 FA 03 19 03 44 03 52 03 60
				39 00 00 00 00 00 0D B7 03 6F 03 82 03 99 03 B6 03 D6 03 D7
				39 00 00 00 00 00 11 B8 00 BD 00 CA 00 DB 00 EA 00 F9 01 07 01 13 01 1E
				39 00 00 00 00 00 11 B9 01 29 01 4F 01 6D 01 9E 01 C6 02 03 02 38 02 39
				39 00 00 00 00 00 11 BA 02 6C 02 A9 02 D0 03 04 03 26 03 53 03 59 03 66
				39 01 00 00 00 00 0D BB 03 76 03 88 03 A0 03 BD 03 BE 03 D7
				15 00 00 00 00 00 02 FF 21
				15 00 00 00 00 00 02 FB 01
				39 00 00 00 00 00 11 B0 01 00 01 08 01 12 01 1C 01 27 01 30 01 39 01 42
				39 00 00 00 00 00 11 B1 01 4B 01 67 01 83 01 AC 01 CF 02 08 02 3B 02 3C
				39 00 00 00 00 00 11 B2 02 6F 02 AB 02 D1 03 03 03 23 03 4D 03 59 03 67
				39 00 00 00 00 00 0D B3 03 77 03 88 03 9F 03 B8 03 D4 03 D7
				39 00 00 00 00 00 11 B4 00 00 00 1D 00 4B 00 6E 00 8A 00 A3 00 B9 00 CC
				39 00 00 00 00 00 11 B5 00 DD 01 15 01 3E 01 7C 01 AB 01 F1 02 2B 02 2C
				39 00 00 00 00 00 11 B6 02 61 02 9E 02 C6 02 FA 03 19 03 44 03 52 03 60
				39 00 00 00 00 00 0D B7 03 6F 03 82 03 99 03 B6 03 D6 03 D7
				39 00 00 00 00 00 11 B8 00 BD 00 CA 00 DB 00 EA 00 F9 01 07 01 13 01 1E
				39 00 00 00 00 00 11 B9 01 29 01 4F 01 6D 01 9E 01 C6 02 03 02 38 02 39
				39 00 00 00 00 00 11 BA 02 6C 02 A9 02 D0 03 04 03 26 03 53 03 59 03 66
				39 00 00 00 00 00 0D BB 03 76 03 88 03 A0 03 BD 03 BE 03 D7
				15 01 00 00 00 00 02 FF 10
		];
		qcom,mdss-dsi-gamma19-command = [
				15 00 00 00 00 00 02 FF 20
				15 00 00 00 00 00 02 FB 01
				39 00 00 00 00 00 11 B0 00 FB 01 00 01 0D 01 18 01 22 01 2C 01 35 01 3E
				39 00 00 00 00 00 11 B1 01 46 01 64 01 7E 01 AE 01 CD 02 08 02 39 02 3B
				39 00 00 00 00 00 11 B2 02 6D 02 A9 02 D0 03 03 03 23 03 4D 03 5A 03 68
				39 00 00 00 00 00 0D B3 03 77 03 88 03 9F 03 BE 03 CA 03 D7
				39 00 00 00 00 00 11 B4 00 4D 00 60 00 7E 00 98 00 AF 00 C3 00 D5 00 E5
				39 00 00 00 00 00 11 B5 00 F4 01 25 01 4B 01 87 01 B2 01 F8 02 2D 02 2E
				39 00 00 00 00 00 11 B6 02 65 02 9F 02 C7 02 FC 03 1C 03 46 03 54 03 61
				39 00 00 00 00 00 0D B7 03 71 03 83 03 9A 03 B5 03 D5 03 D7
				39 00 00 00 00 00 11 B8 00 00 00 27 00 58 00 7C 00 97 00 AF 00 C4 00 D8
				39 00 00 00 00 00 11 B9 00 E8 01 1E 01 46 01 86 01 B2 01 F7 02 2D 02 2F
				39 00 00 00 00 00 11 BA 02 65 02 A1 02 C9 02 FD 03 1F 03 4E 03 56 03 64
				39 01 00 00 00 00 0D BB 03 73 03 86 03 98 03 B7 03 D5 03 D7
				15 00 00 00 00 00 02 FF 21
				15 00 00 00 00 00 02 FB 01
				39 00 00 00 00 00 11 B0 00 FB 01 00 01 0D 01 18 01 22 01 2C 01 35 01 3E
				39 00 00 00 00 00 11 B1 01 46 01 64 01 7E 01 AE 01 CD 02 08 02 39 02 3B
				39 00 00 00 00 00 11 B2 02 6D 02 A9 02 D0 03 03 03 23 03 4D 03 5A 03 68
				39 00 00 00 00 00 0D B3 03 77 03 88 03 9F 03 BE 03 CA 03 D7
				39 00 00 00 00 00 11 B4 00 4D 00 60 00 7E 00 98 00 AF 00 C3 00 D5 00 E5
				39 00 00 00 00 00 11 B5 00 F4 01 25 01 4B 01 87 01 B2 01 F8 02 2D 02 2E
				39 00 00 00 00 00 11 B6 02 65 02 9F 02 C7 02 FC 03 1C 03 46 03 54 03 61
				39 00 00 00 00 00 0D B7 03 71 03 83 03 9A 03 B5 03 D5 03 D7
				39 00 00 00 00 00 11 B8 00 00 00 27 00 58 00 7C 00 97 00 AF 00 C4 00 D8
				39 00 00 00 00 00 11 B9 00 E8 01 1E 01 46 01 86 01 B2 01 F7 02 2D 02 2F
				39 00 00 00 00 00 11 BA 02 65 02 A1 02 C9 02 FD 03 1F 03 4E 03 56 03 64
				39 00 00 00 00 00 0D BB 03 73 03 86 03 98 03 B7 03 D5 03 D7
				15 01 00 00 00 00 02 FF 10
		];
		qcom,mdss-dsi-gamma20-command = [
				15 00 00 00 00 00 02 FF 20
				15 00 00 00 00 00 02 FB 01
				39 00 00 00 00 00 11 B0 00 A3 00 AE 00 C2 00 D1 00 E2 00 EF 00 FC 01 0E
				39 00 00 00 00 00 11 B1 01 15 01 3E 01 5D 01 93 01 BC 01 FC 02 30 02 33
				39 00 00 00 00 00 11 B2 02 66 02 A4 02 CC 02 FD 03 1E 03 49 03 57 03 64
				39 00 00 00 00 00 0D B3 03 74 03 86 03 9C 03 B7 03 C5 03 D7
				39 00 00 00 00 00 11 B4 00 A3 00 AE 00 C2 00 D4 00 E4 00 F2 01 00 01 0B
				39 00 00 00 00 00 11 B5 01 17 01 41 01 60 01 96 01 BD 01 FD 02 32 02 33
				39 00 00 00 00 00 11 B6 02 67 02 A2 02 CB 02 FC 03 1D 03 49 03 56 03 63
				39 00 00 00 00 00 0D B7 03 73 03 84 03 9B 03 B6 03 D6 03 D7
				39 00 00 00 00 00 11 B8 00 00 00 1B 00 5B 00 81 00 9E 00 B8 00 CC 00 DE
				39 00 00 00 00 00 11 B9 00 ED 01 21 01 46 01 86 01 B2 01 F6 02 2D 02 2E
				39 00 00 00 00 00 11 BA 02 63 02 A0 02 C9 02 FB 03 1C 03 4D 03 56 03 64
				39 01 00 00 00 00 0D BB 03 73 03 84 03 96 03 AD 03 D5 03 D7
				15 00 00 00 00 00 02 FF 21
				15 00 00 00 00 00 02 FB 01
				39 00 00 00 00 00 11 B0 00 A3 00 AE 00 C2 00 D1 00 E2 00 EF 00 FC 01 0E
				39 00 00 00 00 00 11 B1 01 15 01 3E 01 5D 01 93 01 BC 01 FC 02 30 02 33
				39 00 00 00 00 00 11 B2 02 66 02 A4 02 CC 02 FD 03 1E 03 49 03 57 03 64
				39 00 00 00 00 00 0D B3 03 74 03 86 03 9C 03 B7 03 C5 03 D7
				39 00 00 00 00 00 11 B4 00 A3 00 AE 00 C2 00 D4 00 E4 00 F2 01 00 01 0B
				39 00 00 00 00 00 11 B5 01 17 01 41 01 60 01 96 01 BD 01 FD 02 32 02 33
				39 00 00 00 00 00 11 B6 02 67 02 A2 02 CB 02 FC 03 1D 03 49 03 56 03 63
				39 00 00 00 00 00 0D B7 03 73 03 84 03 9B 03 B6 03 D6 03 D7
				39 00 00 00 00 00 11 B8 00 00 00 1B 00 5B 00 81 00 9E 00 B8 00 CC 00 DE
				39 00 00 00 00 00 11 B9 00 ED 01 21 01 46 01 86 01 B2 01 F6 02 2D 02 2E
				39 00 00 00 00 00 11 BA 02 63 02 A0 02 C9 02 FB 03 1C 03 4D 03 56 03 64
				39 00 00 00 00 00 0D BB 03 73 03 84 03 96 03 AD 03 D5 03 D7
				15 01 00 00 00 00 02 FF 10
		];
		qcom,mdss-dsi-gamma21-command = [
				15 00 00 00 00 00 02 FF 20
				15 00 00 00 00 00 02 FB 01
				39 00 00 00 00 00 11 B0 01 7E 01 83 01 87 01 8C 01 90 01 95 01 99 01 9E
				39 00 00 00 00 00 11 B1 01 A3 01 B4 01 C6 01 E0 01 F8 02 26 02 51 02 53
				39 00 00 00 00 00 11 B2 02 83 02 BB 02 E1 03 0F 03 31 03 59 03 65 03 72
				39 00 00 00 00 00 0D B3 03 81 03 92 03 A8 03 C3 03 C9 03 D7
				39 00 00 00 00 00 11 B4 00 00 00 13 00 45 00 6E 00 8E 00 A8 00 BE 00 D0
				39 00 00 00 00 00 11 B5 00 E1 01 16 01 40 01 80 01 AD 01 F5 02 2A 02 2B
				39 00 00 00 00 00 11 B6 02 61 02 9E 02 C6 02 F8 03 19 03 45 03 53 03 61
				39 00 00 00 00 00 0D B7 03 71 03 83 03 9B 03 B6 03 D6 03 D7
				39 00 00 00 00 00 11 B8 01 07 01 0F 01 19 01 23 01 2E 01 36 01 3F 01 49
				39 00 00 00 00 00 11 B9 01 50 01 6D 01 88 01 B1 01 D4 02 0E 02 3D 02 3F
				39 00 00 00 00 00 11 BA 02 72 02 AC 02 D4 03 07 03 28 03 57 03 5D 03 6A
				39 01 00 00 00 00 0D BB 03 79 03 8C 03 A2 03 BD 03 D3 03 D7
				15 00 00 00 00 00 02 FF 21
				15 00 00 00 00 00 02 FB 01
				39 00 00 00 00 00 11 B0 01 7E 01 83 01 87 01 8C 01 90 01 95 01 99 01 9E
				39 00 00 00 00 00 11 B1 01 A3 01 B4 01 C6 01 E0 01 F8 02 26 02 51 02 53
				39 00 00 00 00 00 11 B2 02 83 02 BB 02 E1 03 0F 03 31 03 59 03 65 03 72
				39 00 00 00 00 00 0D B3 03 81 03 92 03 A8 03 C3 03 C9 03 D7
				39 00 00 00 00 00 11 B4 00 00 00 13 00 45 00 6E 00 8E 00 A8 00 BE 00 D0
				39 00 00 00 00 00 11 B5 00 E1 01 16 01 40 01 80 01 AD 01 F5 02 2A 02 2B
				39 00 00 00 00 00 11 B6 02 61 02 9E 02 C6 02 F8 03 19 03 45 03 53 03 61
				39 00 00 00 00 00 0D B7 03 71 03 83 03 9B 03 B6 03 D6 03 D7
				39 00 00 00 00 00 11 B8 01 07 01 0F 01 19 01 23 01 2E 01 36 01 3F 01 49
				39 00 00 00 00 00 11 B9 01 50 01 6D 01 88 01 B1 01 D4 02 0E 02 3D 02 3F
				39 00 00 00 00 00 11 BA 02 72 02 AC 02 D4 03 07 03 28 03 57 03 5D 03 6A
				39 00 00 00 00 00 0D BB 03 79 03 8C 03 A2 03 BD 03 D3 03 D7
				15 01 00 00 00 00 02 FF 10
		];
		qcom,mdss-dsi-gamma22-command = [
				15 00 00 00 00 00 02 FF 20
				15 00 00 00 00 00 02 FB 01
				39 00 00 00 00 00 11 B0 01 5D 01 62 01 68 01 6D 01 73 01 79 01 7E 01 84
				39 00 00 00 00 00 11 B1 01 89 01 9C 01 AE 01 CF 01 EB 02 1C 02 4A 02 4B
				39 00 00 00 00 00 11 B2 02 7B 02 B5 02 DD 03 0F 03 2F 03 54 03 60 03 6D
				39 00 00 00 00 00 0D B3 03 7C 03 8C 03 A2 03 BD 03 CB 03 D7
				39 00 00 00 00 00 11 B4 00 00 00 1D 00 4B 00 6E 00 8B 00 A4 00 BA 00 CD
				39 00 00 00 00 00 11 B5 00 DF 01 17 01 40 01 7D 01 AB 01 F1 02 2A 02 2B
				39 00 00 00 00 00 11 B6 02 5E 02 9D 02 C6 02 F8 03 19 03 45 03 52 03 60
				39 00 00 00 00 00 0D B7 03 6F 03 81 03 97 03 B2 03 D6 03 D7
				39 00 00 00 00 00 11 B8 00 C0 00 CD 00 DB 00 ED 00 FC 01 09 01 17 01 23
				39 00 00 00 00 00 11 B9 01 2C 01 51 01 6F 01 9F 01 C6 02 03 02 38 02 39
				39 00 00 00 00 00 11 BA 02 6A 02 A8 02 D0 03 04 03 27 03 56 03 63 03 68
				39 01 00 00 00 00 0D BB 03 81 03 8A 03 A6 03 C5 03 C9 03 D7
				15 00 00 00 00 00 02 FF 21
				15 00 00 00 00 00 02 FB 01
				39 00 00 00 00 00 11 B0 01 5D 01 62 01 68 01 6D 01 73 01 79 01 7E 01 84
				39 00 00 00 00 00 11 B1 01 89 01 9C 01 AE 01 CF 01 EB 02 1C 02 4A 02 4B
				39 00 00 00 00 00 11 B2 02 7B 02 B5 02 DD 03 0F 03 2F 03 54 03 60 03 6D
				39 00 00 00 00 00 0D B3 03 7C 03 8C 03 A2 03 BD 03 CB 03 D7
				39 00 00 00 00 00 11 B4 00 00 00 1D 00 4B 00 6E 00 8B 00 A4 00 BA 00 CD
				39 00 00 00 00 00 11 B5 00 DF 01 17 01 40 01 7D 01 AB 01 F1 02 2A 02 2B
				39 00 00 00 00 00 11 B6 02 5E 02 9D 02 C6 02 F8 03 19 03 45 03 52 03 60
				39 00 00 00 00 00 0D B7 03 6F 03 81 03 97 03 B2 03 D6 03 D7
				39 00 00 00 00 00 11 B8 00 C0 00 CD 00 DB 00 ED 00 FC 01 09 01 17 01 23
				39 00 00 00 00 00 11 B9 01 2C 01 51 01 6F 01 9F 01 C6 02 03 02 38 02 39
				39 00 00 00 00 00 11 BA 02 6A 02 A8 02 D0 03 04 03 27 03 56 03 63 03 68
				39 00 00 00 00 00 0D BB 03 81 03 8A 03 A6 03 C5 03 C9 03 D7
				15 01 00 00 00 00 02 FF 10
		];
		qcom,mdss-dsi-gamma23-command = [
				15 00 00 00 00 00 02 FF 20
				15 00 00 00 00 00 02 FB 01
				39 00 00 00 00 00 11 B0 01 55 01 59 01 5F 01 66 01 6C 01 72 01 78 01 7D
				39 00 00 00 00 00 11 B1 01 83 01 97 01 AA 01 CA 01 E7 02 1A 02 48 02 49
				39 00 00 00 00 00 11 B2 02 7A 02 B3 02 D9 03 08 03 29 03 53 03 60 03 6E
				39 00 00 00 00 00 0D B3 03 7E 03 93 03 B0 03 B7 03 D1 03 D7
				39 00 00 00 00 00 11 B4 00 44 00 56 00 76 00 92 00 AA 00 BF 00 D2 00 E3
				39 00 00 00 00 00 11 B5 00 F2 01 24 01 4A 01 84 01 B0 01 F4 02 2C 02 2D
				39 00 00 00 00 00 11 B6 02 63 02 A3 02 C7 02 FB 03 1C 03 46 03 53 03 61
				39 00 00 00 00 00 0D B7 03 72 03 87 03 9E 03 C0 03 D6 03 D7
				39 00 00 00 00 00 11 B8 00 00 00 1E 00 54 00 6D 00 8E 00 AB 00 BF 00 D5
				39 00 00 00 00 00 11 B9 00 E7 01 1E 01 47 01 84 01 B1 01 F7 02 2E 02 30
				39 00 00 00 00 00 11 BA 02 65 02 A5 02 C9 02 FE 03 1F 03 51 03 58 03 65
				39 01 00 00 00 00 0D BB 03 7A 03 8C 03 AB 03 CC 03 CD 03 D7
				15 00 00 00 00 00 02 FF 21
				15 00 00 00 00 00 02 FB 01
				39 00 00 00 00 00 11 B0 01 55 01 59 01 5F 01 66 01 6C 01 72 01 78 01 7D
				39 00 00 00 00 00 11 B1 01 83 01 97 01 AA 01 CA 01 E7 02 1A 02 48 02 49
				39 00 00 00 00 00 11 B2 02 7A 02 B3 02 D9 03 08 03 29 03 53 03 60 03 6E
				39 00 00 00 00 00 0D B3 03 7E 03 93 03 B0 03 B7 03 D1 03 D7
				39 00 00 00 00 00 11 B4 00 44 00 56 00 76 00 92 00 AA 00 BF 00 D2 00 E3
				39 00 00 00 00 00 11 B5 00 F2 01 24 01 4A 01 84 01 B0 01 F4 02 2C 02 2D
				39 00 00 00 00 00 11 B6 02 63 02 A3 02 C7 02 FB 03 1C 03 46 03 53 03 61
				39 00 00 00 00 00 0D B7 03 72 03 87 03 9E 03 C0 03 D6 03 D7
				39 00 00 00 00 00 11 B8 00 00 00 1E 00 54 00 6D 00 8E 00 AB 00 BF 00 D5
				39 00 00 00 00 00 11 B9 00 E7 01 1E 01 47 01 84 01 B1 01 F7 02 2E 02 30
				39 00 00 00 00 00 11 BA 02 65 02 A5 02 C9 02 FE 03 1F 03 51 03 58 03 65
				39 00 00 00 00 00 0D BB 03 7A 03 8C 03 AB 03 CC 03 CD 03 D7
				15 01 00 00 00 00 02 FF 10
		];
		qcom,mdss-dsi-gamma24-command = [
				15 00 00 00 00 00 02 FF 20
				15 00 00 00 00 00 02 FB 01
				39 00 00 00 00 00 11 B0 01 55 01 59 01 5F 01 66 01 6C 01 72 01 78 01 7D
				39 00 00 00 00 00 11 B1 01 83 01 97 01 AA 01 CA 01 E7 02 1A 02 48 02 49
				39 00 00 00 00 00 11 B2 02 7A 02 B3 02 D9 03 08 03 29 03 53 03 60 03 6E
				39 00 00 00 00 00 0D B3 03 7E 03 93 03 B0 03 B7 03 D1 03 D7
				39 00 00 00 00 00 11 B4 00 44 00 56 00 76 00 92 00 AA 00 BF 00 D2 00 E3
				39 00 00 00 00 00 11 B5 00 F2 01 24 01 4A 01 84 01 B0 01 F4 02 2C 02 2D
				39 00 00 00 00 00 11 B6 02 63 02 A3 02 C7 02 FB 03 1C 03 46 03 53 03 61
				39 00 00 00 00 00 0D B7 03 72 03 87 03 9E 03 C0 03 D6 03 D7
				39 00 00 00 00 00 11 B8 00 00 00 1E 00 54 00 6D 00 8E 00 AB 00 BF 00 D5
				39 00 00 00 00 00 11 B9 00 E7 01 1E 01 47 01 84 01 B1 01 F7 02 2E 02 30
				39 00 00 00 00 00 11 BA 02 65 02 A5 02 C9 02 FE 03 1F 03 51 03 58 03 65
				39 01 00 00 00 00 0D BB 03 7A 03 8C 03 AB 03 CC 03 CD 03 D7
				15 00 00 00 00 00 02 FF 21
				15 00 00 00 00 00 02 FB 01
				39 00 00 00 00 00 11 B0 01 55 01 59 01 5F 01 66 01 6C 01 72 01 78 01 7D
				39 00 00 00 00 00 11 B1 01 83 01 97 01 AA 01 CA 01 E7 02 1A 02 48 02 49
				39 00 00 00 00 00 11 B2 02 7A 02 B3 02 D9 03 08 03 29 03 53 03 60 03 6E
				39 00 00 00 00 00 0D B3 03 7E 03 93 03 B0 03 B7 03 D1 03 D7
				39 00 00 00 00 00 11 B4 00 44 00 56 00 76 00 92 00 AA 00 BF 00 D2 00 E3
				39 00 00 00 00 00 11 B5 00 F2 01 24 01 4A 01 84 01 B0 01 F4 02 2C 02 2D
				39 00 00 00 00 00 11 B6 02 63 02 A3 02 C7 02 FB 03 1C 03 46 03 53 03 61
				39 00 00 00 00 00 0D B7 03 72 03 87 03 9E 03 C0 03 D6 03 D7
				39 00 00 00 00 00 11 B8 00 00 00 1E 00 54 00 6D 00 8E 00 AB 00 BF 00 D5
				39 00 00 00 00 00 11 B9 00 E7 01 1E 01 47 01 84 01 B1 01 F7 02 2E 02 30
				39 00 00 00 00 00 11 BA 02 65 02 A5 02 C9 02 FE 03 1F 03 51 03 58 03 65
				39 00 00 00 00 00 0D BB 03 7A 03 8C 03 AB 03 CC 03 CD 03 D7
				15 01 00 00 00 00 02 FF 10
		];


		qcom,mdss-dsi-on-command-state = "dsi_lp_mode";
		qcom,mdss-dsi-off-command-state = "dsi_hs_mode";
		qcom,mdss-dsi-ce-on-command-state = "dsi_hs_mode";
		qcom,mdss-dsi-ce-off-command-state = "dsi_hs_mode";
		qcom,mdss-dsi-srgb-on-command-state = "dsi_hs_mode";
		qcom,mdss-dsi-srgb-off-command-state = "dsi_hs_mode";
		qcom,mdss-dsi-cabc-on-command-state = "dsi_hs_mode";
		qcom,mdss-dsi-cabc-off-command-state = "dsi_hs_mode";
		qcom,mdss-dsi-gamma-command-state = "dsi_hs_mode";
		qcom,mdss-dsi-bl-pmic-control-type = "bl_ctrl_wled";
		qcom,mdss-dsi-reset-sequence = <1 1>, <0 5>, <1 15>;
		qcom,mdss-dsi-tx-eot-append;
		qcom,mdss-dsi-post-init-delay = <1>;

		qcom,esd-check-enabled;
		qcom,mdss-dsi-panel-status-command = [06 01 00 01 05 00 01 0A];
		qcom,mdss-dsi-panel-status-command-state = "dsi_hs_mode";
		qcom,mdss-dsi-panel-status-check-mode = "reg_read";
		qcom,mdss-dsi-panel-status-read-length = <1>;
		qcom,mdss-dsi-panel-status-value = <0x9c>;
		qcom,mdss-dsi-panel-max-error-count = <3>;
	};
};
