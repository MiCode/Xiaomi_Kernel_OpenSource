/*
 * Copyright (c) 2014-2015, The Linux Foundation. All rights reserved.
 *
 * This program is free software; you can redistribute it and/or modify
 * it under the terms of the GNU General Public License version 2 and
 * only version 2 as published by the Free Software Foundation.
 *
 * This program is distributed in the hope that it will be useful,
 * but WITHOUT ANY WARRANTY; without even the implied warranty of
 * MERCHANTABILITY or FITNESS FOR A PARTICULAR PURPOSE.  See the
 * GNU General Public License for more details.
 */

/dts-v1/;

/memreserve/ 0x86000000 0x00000200;

#include "msmterbium.dtsi"

/ {
	model = "Qualcomm Technologies, Inc. MSM Terbium Simulator";
	compatible = "qcom,msmterbium-sim", "qcom,msmterbium", "qcom,sim";
	qcom,board-id= <16 0>;
};

&blsp1_uart2 {
	status = "ok";
	pinctrl-names = "default";
	pinctrl-0 = <&uart_console_sleep>;
};

&usb_otg {
	qcom,hsusb-otg-otg-control = <1>;
};
