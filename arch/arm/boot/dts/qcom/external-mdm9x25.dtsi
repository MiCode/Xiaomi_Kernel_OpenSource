/* Copyright (c) 2013-2015, The Linux Foundation. All rights reserved.
 *
 * This program is free software; you can redistribute it and/or modify
 * it under the terms of the GNU General Public License version 2 and
 * only version 2 as published by the Free Software Foundation.
 *
 * This program is distributed in the hope that it will be useful,
 * but WITHOUT ANY WARRANTY; without even the implied warranty of
 * MERCHANTABILITY or FITNESS FOR A PARTICULAR PURPOSE.  See the
 * GNU General Public License for more details.
 */

&soc {
	mdm0: qcom,mdm0 {
                compatible = "qcom,ext-mdm9x25";
		reg = <0xfe805000 0x1000>;
		cell-index = <0>;
		#address-cells = <0>;
                interrupt-parent = <&mdm0>;
                interrupts = <0 1 2 3>;
                #interrupt-cells = <1>;
                interrupt-map-mask = <0xffffffff>;
                interrupt-names =
			"err_fatal_irq",
			"status_irq",
			"plbrdy_irq",
			"mdm2ap_vddmin_irq";
		/* modem attributes */
                qcom,ramdump-delay-ms = <2000>;
                qcom,ramdump-timeout-ms = <120000>;
                qcom,vddmin-modes  = "normal";
                qcom,vddmin-drive-strength = <8>;
		qcom,sfr-query;
		qcom,support-shutdown;
		qcom,sysmon-id = <20>;
		qcom,ssctl-instance-id = <0x10>;
		qcom,pil-force-shutdown;
		status = "disabled";
	};

	mdm1: qcom,mdm1 {
                compatible = "qcom,ext-mdm9x35";
		reg = <0xfe805000 0x1000>;
		cell-index = <0>;
		#address-cells = <0>;
                interrupt-parent = <&mdm1>;
                interrupts = <0 1 2 3>;
                #interrupt-cells = <1>;
                interrupt-map-mask = <0xffffffff>;
                interrupt-names =
			"err_fatal_irq",
			"status_irq",
			"plbrdy_irq",
			"mdm2ap_vddmin_irq";
		/* modem attributes */
                qcom,ramdump-delay-ms = <2000>;
                qcom,ramdump-timeout-ms = <120000>;
                qcom,vddmin-modes  = "normal";
                qcom,vddmin-drive-strength = <8>;
		qcom,sfr-query;
		qcom,support-shutdown;
		qcom,sysmon-id = <20>;
		qcom,ssctl-instance-id = <0x10>;
		qcom,pil-force-shutdown;
		status = "disabled";
	};
};

