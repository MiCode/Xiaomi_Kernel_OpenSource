/* Copyright (c) 2013, The Linux Foundation. All rights reserved.
 * Copyright (C) 2016 XiaoMi, Inc.
 *
 * This program is free software; you can redistribute it and/or modify
 * it under the terms of the GNU General Public License version 2 and
 * only version 2 as published by the Free Software Foundation.
 *
 * This program is distributed in the hope that it will be useful,
 * but WITHOUT ANY WARRANTY; without even the implied warranty of
 * MERCHANTABILITY or FITNESS FOR A PARTICULAR PURPOSE.  See the
 * GNU General Public License for more details.
 */

/*---------------------------------------------------------------------------
 * This file is autogenerated file using gcdb parser. Please do not edit it.
 * Update input XML file to add a new entry or update variable in this file
 * VERSION = "1.0"
 *---------------------------------------------------------------------------*/
&mdss_mdp {
	dsi_nt35521s_720_video: qcom,mdss_dsi_nt35521s_720p_video {
		qcom,mdss-dsi-panel-name = "nt35521s_HD720p_video_BOE";
		qcom,mdss-dsi-panel-controller = <&mdss_dsi0>;
		qcom,mdss-dsi-panel-type = "dsi_video_mode";
		qcom,mdss-dsi-panel-destination = "display_1";
		qcom,mdss-dsi-panel-framerate = <60>;
		qcom,mdss-dsi-virtual-channel-id = <0>;
		qcom,mdss-dsi-stream = <0>;
		qcom,mdss-dsi-panel-width = <720>;
		qcom,mdss-dsi-panel-height = <1280>;
		qcom,mdss-pan-physical-width-dimension = <58>;
		qcom,mdss-pan-physical-height-dimension = <103>;
		qcom,mdss-dsi-h-front-porch = <160>;
		qcom,mdss-dsi-h-back-porch = <160>;
		qcom,mdss-dsi-h-pulse-width = <20>;
		qcom,mdss-dsi-h-sync-skew = <0>;
		qcom,mdss-dsi-v-back-porch = <16>;
		qcom,mdss-dsi-v-front-porch = <16>;
		qcom,mdss-dsi-v-pulse-width = <2>;
		qcom,mdss-dsi-h-left-border = <0>;
		qcom,mdss-dsi-h-right-border = <0>;
		qcom,mdss-dsi-v-top-border = <0>;
		qcom,mdss-dsi-v-bottom-border = <20>;
		qcom,mdss-dsi-bpp = <24>;
		qcom,mdss-dsi-underflow-color = <0xff>;
		qcom,mdss-dsi-border-color = <0>;
		qcom,mdss-dsi-on-command = [
				29 01 00 00 00 00 05 FF AA 55 25 01
				29 01 00 00 00 00 02 6F 21
				29 01 00 00 00 00 02 F7 01
				29 01 00 00 00 00 02 6F 21
				29 01 00 00 00 00 02 F7 00
				29 01 00 00 00 00 05 FF AA 55 25 00
				29 01 00 00 00 00 02 35 00
				05 01 00 00 78 00 02 11 00
				05 01 00 00 00 00 02 29 00];
		qcom,mdss-dsi-off-command = [05 01 00 00 00 00 02 28 00
				05 01 00 00 78 00 02 10 00];
		qcom,mdss-dsi-on-command-state = "dsi_lp_mode";
		qcom,mdss-dsi-off-command-state = "dsi_hs_mode";
		qcom,mdss-dsi-panel-warm-command = [29 00 00 00 00 00 06 F0 55 AA 52 08 02
				29 01 00 00 00 00 02 EE 03
				29 00 00 00 00 00 11 B0 00 01 00 07 00 13 00 37 00 3C 00 62 00 94 00 BF
				29 01 00 00 00 00 11 B1 00 E2 01 32 01 62 01 B7 01 FD 01 FE 02 39 02 76
				29 00 00 00 00 00 11 B2 02 9C 02 CE 02 F0 03 1E 03 3B 03 65 03 82 03 A9
				29 01 00 00 00 00 05 B3 03 F9 03 FF
				29 00 00 00 00 00 11 B4 00 DA 00 DF 00 E9 00 F0 00 FA 01 09 01 16 01 32
				29 01 00 00 00 00 11 B5 01 4C 01 75 01 9D 01 DE 02 15 02 17 02 4B 02 84
				29 00 00 00 00 00 11 B6 02 A9 02 DC 02 FF 03 2E 03 4E 03 77 03 92 03 B7
				29 01 00 00 00 00 05 B7 03 E0 03 FF
				29 00 00 00 00 00 11 B8 00 F5 00 F7 00 FD 01 08 01 0C 01 1E 01 28 01 3E
				29 01 00 00 00 00 11 B9 01 57 01 80 01 A5 01 E2 02 19 02 1A 02 4E 02 87
				29 00 00 00 00 00 11 BA 02 AD 02 E2 03 0A 03 4C 03 9F 03 B2 03 C3 03 CF
				29 01 00 00 00 00 05 BB 03 DD 03 FF];
		qcom,mdss-dsi-panel-cool-command = [29 00 00 00 00 00 06 F0 55 AA 52 08 02
				29 01 00 00 00 00 02 EE 03
				29 00 00 00 00 00 11 B0 00 01 00 04 00 0C 00 22 00 44 00 69 00 87 00 C0
				29 01 00 00 00 00 11 B1 00 F9 01 3B 01 75 01 CA 02 0D 02 0E 02 48 02 87
				29 00 00 00 00 00 11 B2 02 AF 02 E5 03 0A 03 3B 03 56 03 7F 03 9B 03 C4
				29 01 00 00 00 00 05 B3 03 FA 03 FF
				29 00 00 00 00 00 11 B4 00 7A 00 83 00 94 00 A3 00 AF 00 C7 00 DF 01 05
				29 01 00 00 00 00 11 B5 01 23 01 5C 01 8A 01 D6 02 14 02 16 02 4F 02 8C
				29 00 00 00 00 00 11 B6 02 B4 02 EA 03 10 03 41 03 61 03 87 03 A7 03 C9
				29 01 00 00 00 00 05 B7 03 EA 03 FF
				29 00 00 00 00 00 11 B8 00 02 00 0C 00 2C 00 3D 00 59 00 7C 00 91 00 C5
				29 01 00 00 00 00 11 B9 00 F5 01 37 01 6D 01 C2 02 07 02 09 02 45 02 84
				29 00 00 00 00 00 11 BA 02 AE 02 E7 03 12 03 58 03 C9 03 D1 03 D9 03 DC
				29 01 00 00 00 00 05 BB 03 DE 03 FF];
		qcom,mdss-dsi-panel-nature-command = [29 00 00 00 00 00 06 F0 55 AA 52 08 02
				29 01 00 00 00 00 02 EE 03
				29 00 00 00 00 00 11 B0 00 00 00 03 00 1B 00 1C 00 50 00 76 00 96 00 CA
				29 01 00 00 00 00 11 B1 00 F6 01 3B 01 72 01 CA 02 0D 02 0E 02 49 02 87
				29 00 00 00 00 00 11 B2 02 AF 02 E3 03 09 03 37 03 59 03 86 03 A5 03 CF
				29 01 00 00 00 00 05 B3 03 FA 03 FF
				29 00 00 00 00 00 11 B4 00 B3 00 B8 00 C3 00 D1 00 DC 00 ED 00 FF 01 20
				29 01 00 00 00 00 11 B5 01 3D 01 6F 01 9A 01 E0 02 1B 02 1D 02 53 02 90
				29 00 00 00 00 00 11 B6 02 B8 02 EF 03 14 03 45 03 66 03 8E 03 AB 03 CA
				29 01 00 00 00 00 05 B7 03 ED 03 FF
				29 00 00 00 00 00 11 B8 00 A1 00 A3 00 B0 00 BC 00 C8 00 DA 00 F0 01 12
				29 01 00 00 00 00 11 B9 01 2E 01 63 01 8F 01 DA 02 17 02 18 02 50 02 8E
				29 00 00 00 00 00 11 BA 02 B7 02 F1 03 1E 03 6D 03 88 03 A3 03 B7 03 C0
				29 01 00 00 00 00 05 BB 03 DD 03 FF];
		qcom,mdss-dsi-panel-ce-std-command = [29 00 00 00 00 00 06 F0 55 AA 52 08 00
				29 01 00 00 00 00 02 55 00];
	 	qcom,mdss-dsi-panel-ce-vivid-command = [29 00 00 00 00 00 06 F0 55 AA 52 08 00
				29 00 00 00 00 00 02 55 90
				29 01 00 00 00 00 07 CC 41 36 87 00 00 00
				29 00 00 00 00 00 0D D7 00 00 00 00 00 00 04 08 0C 10 08 04
				29 01 00 00 00 00 0D D8 04 08 10 0C 08 04 00 00 00 00 00 00
				29 00 00 00 00 00 11 D1 00 00 00 00 00 00 00 00 00 00 00 00 00 00 00 00
				29 01 00 00 00 00 11 D2 00 00 00 00 00 00 00 00 00 00 00 00 00 00 00 00];
		qcom,mdss-dsi-panel-gamma-command-state = "dsi_lp_mode";
		qcom,mdss-dsi-panel-ce-command-state = "dsi_lp_mode";
		qcom,mdss-dsi-h-sync-pulse = <1>;
		qcom,mdss-dsi-traffic-mode = "non_burst_sync_event";
		qcom,mdss-dsi-bllp-eof-power-mode;
		qcom,mdss-dsi-bllp-power-mode;
		qcom,mdss-dsi-lane-0-state;
		qcom,mdss-dsi-lane-1-state;
		qcom,mdss-dsi-lane-2-state;
		qcom,mdss-dsi-panel-timings = [B4 2A 1C 00 54 58 20 2E 20 03 04 00];
		qcom,mdss-dsi-t-clk-post = <0x03>;
		qcom,mdss-dsi-t-clk-pre = <0x23>;
		qcom,mdss-dsi-bl-min-level = <10>;
		qcom,mdss-dsi-bl-max-level = <255>;
		qcom,mdss-dsi-bl-pmic-pwm-frequency = <100>;
		qcom,mdss-dsi-bl-pmic-bank-select = <0>;
		qcom,mdss-dsi-dma-trigger = "trigger_sw";
		qcom,mdss-dsi-mdp-trigger = "none";
		qcom,mdss-dsi-lp11-init;
		qcom,mdss-dsi-init-delay-us = <50000>;
		qcom,mdss-dsi-bl-pmic-control-type = "bl_ctrl_pwm";
		qcom,mdss-dsi-reset-sequence = <1 5>, <0 10>, <1 30>;
	};
};
