/* Copyright (c) 2015, The Linux Foundation. All rights reserved.
 *
 * This program is free software; you can redistribute it and/or modify
 * it under the terms of the GNU General Public License version 2 and
 * only version 2 as published by the Free Software Foundation.
 *
 * This program is distributed in the hope that it will be useful,
 * but WITHOUT ANY WARRANTY; without even the implied warranty of
 * MERCHANTABILITY or FITNESS FOR A PARTICULAR PURPOSE.  See the
 * GNU General Public License for more details.
 */

&mdss_mdp {
	dsi_truly_720_vid: qcom,mdss_dsi_truly_720p_video {
		qcom,mdss-dsi-panel-name = "truly 720p video mode dsi panel";
		qcom,mdss-dsi-panel-type = "dsi_video_mode";
		qcom,mdss-dsi-panel-framerate = <60>;
		qcom,mdss-dsi-virtual-channel-id = <0>;
		qcom,mdss-dsi-stream = <0>;
		qcom,mdss-dsi-panel-width = <720>;
		qcom,mdss-dsi-panel-height = <1280>;
		qcom,mdss-dsi-h-front-porch = <100>;
		qcom,mdss-dsi-h-back-porch = <100>;
		qcom,mdss-dsi-h-pulse-width = <6>;
		qcom,mdss-dsi-h-sync-skew = <0>;
		qcom,mdss-dsi-v-back-porch = <32>;
		qcom,mdss-dsi-v-front-porch = <32>;
		qcom,mdss-dsi-v-pulse-width = <2>;
		qcom,mdss-dsi-h-left-border = <0>;
		qcom,mdss-dsi-h-right-border = <0>;
		qcom,mdss-dsi-v-top-border = <0>;
		qcom,mdss-dsi-v-bottom-border = <0>;
		qcom,mdss-dsi-bpp = <24>;
		qcom,mdss-dsi-underflow-color = <0xff>;
		qcom,mdss-dsi-border-color = <0>;
		qcom,mdss-dsi-h-sync-pulse = <0>;
		qcom,mdss-dsi-traffic-mode = "burst_mode";
		qcom,mdss-dsi-bllp-eof-power-mode;
		qcom,mdss-dsi-bllp-power-mode;
		qcom,mdss-dsi-lane-0-state;
		qcom,mdss-dsi-lane-1-state;
		qcom,mdss-dsi-lane-2-state;
		qcom,mdss-dsi-lane-3-state;
		qcom,mdss-dsi-panel-timings = [87 2c 12 00 40 44 16 1e 17 03
			04 00];
		qcom,mdss-dsi-t-clk-post = <0x04>;
		qcom,mdss-dsi-t-clk-pre = <0x1b>;
		qcom,mdss-dsi-bl-min-level = <1>;
		qcom,mdss-dsi-bl-max-level = <4095>;
		qcom,mdss-dsi-dma-trigger = "trigger_sw";
		qcom,mdss-dsi-mdp-trigger = "none";
		qcom,mdss-dsi-on-command = [29 01 00 00 00 00 06 f0 55 aa 52
				08 00
			29 01 00 00 00 00 03 b1 78 21
			23 01 00 00 00 00 02 b6 0f
			29 01 00 00 00 00 03 bc 00 00
			29 01 00 00 00 00 06 bd 02 b0 1e 1e 00
			29 01 00 00 00 00 0b e7 f2 e6 d8 cc bf b2 a5 99 99 95
			29 01 00 00 00 00 0b e8 f2 e6 d8 cc bf b2 a5 99 99 95
			29 01 00 00 00 00 06 f0 55 aa 52 08 01
			29 01 00 00 00 00 03 bc a0 00
			29 01 00 00 00 00 03 bd a0 00
			23 01 00 00 00 00 02 ca 01
			23 01 00 00 00 00 02 c0 0c
			23 01 00 00 00 00 02 be 4e
			29 01 00 00 00 00 03 b3 38 38
			29 01 00 00 00 00 03 b4 11 11
			29 01 00 00 00 00 03 b6 05 05
			29 01 00 00 00 00 03 b9 45 45
			29 01 00 00 00 00 03 ba 25 25
			29 01 00 00 00 00 03 c4 11 11
			23 01 00 00 00 00 02 c6 66
			29 01 00 00 00 00 06 f0 55 aa 52 08 02
			23 01 00 00 00 00 02 ee 00
			29 01 00 00 00 00 11 b0 00 37 00 48 00 69 00 8a 00 ab 00
				cb 00 eb 01 1c
			29 01 00 00 00 00 11 b1 01 41 01 7c 01 aa 01 f3 02 2d 02
				2e 02 63 02 9d
			29 01 00 00 00 00 11 b2 02 c3 02 f6 03 19 03 54 03 85 03
				b2 03 c1 03 d1
			29 01 00 00 00 00 05 b3 03 e0 03 e8
			29 01 00 00 00 00 11 bc 00 37 00 48 00 69 00 8a 00 ab 00
				cb 00 eb 01 1c
			29 01 00 00 00 00 11 bd 01 41 01 7c 01 aa 01 f3 02 2d 02
				2e 02 63 02 9d
			29 01 00 00 00 00 11 be 02 c3 02 f6 03 19 03 54 03 85 03
				b2 03 c1 03 d1
			29 01 00 00 00 00 05 bf 03 e0 03 e8
			29 01 00 00 00 00 11 b4 00 d1 00 d7 00 e4 00 f1 00 fe 01
				12 01 26 01 48
			29 01 00 00 00 00 11 b5 01 64 01 95 01 bd 02 01 02 36 02
				38 02 6c 02 a7
			29 01 00 00 00 00 11 b6 02 ce 03 04 03 2b 03 5b 03 89 03
				b2 03 c1 03 d1
			29 01 00 00 00 00 05 b7 03 e0 03 e8
			29 01 00 00 00 00 11 c0 00 d1 00 d7 00 e4 00 f1 00 fe 01
				12 01 26 01 48
			29 01 00 00 00 00 11 c1 01 64 01 95 01 bd 02 01 02 36 02
				38 02 6c 02 a7
			29 01 00 00 00 00 11 c2 02 ce 03 04 03 2b 03 5b 03 89 03
				b2 03 c1 03 d1
			29 01 00 00 00 00 05 c3 03 e0 03 e8
			29 01 00 00 00 00 11 b8 00 37 00 45 00 61 00 7d 00 9a 00
				bb 00 dc 01 0b
			29 01 00 00 00 00 11 b9 01 31 01 6e 01 9e 01 ea 02 24 02
				25 02 58 02 90
			29 01 00 00 00 00 11 ba 02 b4 02 e4 03 04 03 44 03 7f 03
				b2 03 c1 03 d1
			29 01 00 00 00 00 05 bb 03 e0 03 e8
			29 01 00 00 00 00 11 c4 00 37 00 45 00 61 00 7d 00 9a 00
				bb 00 dc 01 0b
			29 01 00 00 00 00 11 c5 01 31 01 6e 01 9e 01 ea 02 24 02
				25 02 58 02 90
			29 01 00 00 00 00 11 c6 02 b4 02 e4 03 04 03 44 03 7f 03
				b2 03 c1 03 d1
			29 01 00 00 00 00 05 c7 03 e0 03 e8
			29 01 00 00 00 00 06 f0 55 aa 52 08 06
			29 01 00 00 00 00 03 b0 29 2a
			29 01 00 00 00 00 03 b1 10 12
			29 01 00 00 00 00 03 b2 14 16
			29 01 00 00 00 00 03 b3 18 1a
			29 01 00 00 00 00 03 b4 02 04
			29 01 00 00 00 00 03 b5 34 34
			29 01 00 00 00 00 03 b6 34 2e
			29 01 00 00 00 00 03 b7 2e 2e
			29 01 00 00 00 00 03 b8 34 00
			29 01 00 00 00 00 03 b9 34 34
			29 01 00 00 00 00 03 ba 34 34
			29 01 00 00 00 00 03 bb 01 34
			29 01 00 00 00 00 03 bc 2e 2e
			29 01 00 00 00 00 03 bd 2e 34
			29 01 00 00 00 00 03 be 34 34
			29 01 00 00 00 00 03 bf 05 03
			29 01 00 00 00 00 03 c0 1b 19
			29 01 00 00 00 00 03 c1 17 15
			29 01 00 00 00 00 03 c2 13 11
			29 01 00 00 00 00 03 c3 2a 29
			29 01 00 00 00 00 03 e5 2e 2e
			29 01 00 00 00 00 03 c4 29 2a
			29 01 00 00 00 00 03 c5 1b 19
			29 01 00 00 00 00 03 c6 17 15
			29 01 00 00 00 00 03 c7 13 11
			29 01 00 00 00 00 03 c8 01 05
			29 01 00 00 00 00 03 c9 34 34
			29 01 00 00 00 00 03 ca 34 2e
			29 01 00 00 00 00 03 cb 2e 2e
			29 01 00 00 00 00 03 cc 34 03
			29 01 00 00 00 00 03 cd 34 34
			29 01 00 00 00 00 03 ce 34 34
			29 01 00 00 00 00 03 cf 02 34
			29 01 00 00 00 00 03 d0 2e 2e
			29 01 00 00 00 00 03 d1 2e 34
			29 01 00 00 00 00 03 d2 34 34
			29 01 00 00 00 00 03 d3 04 00
			29 01 00 00 00 00 03 d4 10 12
			29 01 00 00 00 00 03 d5 14 16
			29 01 00 00 00 00 03 d6 18 1a
			29 01 00 00 00 00 03 d7 2a 29
			29 01 00 00 00 00 03 e6 2e 2e
			29 01 00 00 00 00 06 d8 00 00 00 54 00
			29 01 00 00 00 00 06 d9 00 15 00 00 00
			23 01 00 00 00 00 02 e7 00
			29 01 00 00 00 00 06 f0 55 aa 52 08 03
			29 01 00 00 00 00 03 b1 00 00
			29 01 00 00 00 00 03 b0 00 00
			29 01 00 00 00 00 06 b2 05 00 00 00 00
			29 01 00 00 00 00 06 b3 05 00 00 00 00
			29 01 00 00 00 00 06 b4 05 00 00 00 00
			29 01 00 00 00 00 06 b5 05 00 17 00 00
			29 01 00 00 00 00 06 b6 12 00 19 00 00
			29 01 00 00 00 00 06 b7 12 00 19 00 00
			29 01 00 00 00 00 06 b8 12 00 19 00 00
			29 01 00 00 00 00 06 b9 12 00 19 00 00
			29 01 00 00 00 00 06 ba 57 00 00 00 00
			29 01 00 00 00 00 06 bb 57 00 00 00 00
			29 01 00 00 00 00 06 bc 75 00 1a 00 00
			29 01 00 00 00 00 06 bd 53 00 1a 00 00
			29 01 00 00 00 00 05 c0 00 34 00 00
			29 01 00 00 00 00 05 c1 00 34 00 00
			29 01 00 00 00 00 05 c2 00 34 00 00
			29 01 00 00 00 00 05 c3 00 34 00 00
			23 01 00 00 00 00 02 c4 20
			23 01 00 00 00 00 02 c5 00
			23 01 00 00 00 00 02 c6 00
			23 01 00 00 00 00 02 c7 00
			29 01 00 00 00 00 06 f0 55 aa 52 08 05
			23 01 00 00 00 00 02 ed 30
			29 01 00 00 00 00 03 b0 17 06
			23 01 00 00 00 00 02 b8 08
			29 01 00 00 00 00 06 bd 03 07 00 03 00
			29 01 00 00 00 00 03 b1 17 06
			23 01 00 00 00 00 02 b9 00
			29 01 00 00 00 00 03 b2 00 00
			23 01 00 00 00 00 02 ba 00
			29 01 00 00 00 00 03 b3 17 06
			23 01 00 00 00 00 02 bb 0a
			29 01 00 00 00 00 03 b4 17 06
			29 01 00 00 00 00 03 b5 17 06
			29 01 00 00 00 00 03 b6 14 03
			29 01 00 00 00 00 03 b7 00 00
			23 01 00 00 00 00 02 bc 02
			23 01 00 00 00 00 02 e5 06
			23 01 00 00 00 00 02 e6 06
			23 01 00 00 00 00 02 e7 00
			23 01 00 00 00 00 02 e8 06
			23 01 00 00 00 00 02 e9 06
			23 01 00 00 00 00 02 ea 06
			23 01 00 00 00 00 02 eb 00
			23 01 00 00 00 00 02 ec 00
			23 01 00 00 00 00 02 c0 07
			23 01 00 00 00 00 02 c1 80
			23 01 00 00 00 00 02 c2 a4
			23 01 00 00 00 00 02 c3 05
			23 01 00 00 00 00 02 c4 00
			23 01 00 00 00 00 02 c5 02
			23 01 00 00 00 00 02 c6 22
			23 01 00 00 00 00 02 c7 03
			29 01 00 00 00 00 03 c8 05 30
			29 01 00 00 00 00 03 c9 01 31
			29 01 00 00 00 00 03 ca 03 21
			29 01 00 00 00 00 03 cb 01 20
			29 01 00 00 00 00 06 d1 00 05 09 07 10
			29 01 00 00 00 00 06 d2 10 05 0e 03 10
			29 01 00 00 00 00 06 d3 20 00 48 07 10
			29 01 00 00 00 00 06 d4 30 00 43 07 10
			23 01 00 00 00 00 02 d0 00
			29 01 00 00 00 00 04 cc 00 00 3e
			29 01 00 00 00 00 04 cd 00 00 3e
			29 01 00 00 00 00 04 ce 00 00 02
			29 01 00 00 00 00 04 cf 00 00 02
			23 01 00 00 00 00 02 6f 11
			23 01 00 00 00 00 02 f3 01
			15 01 00 00 00 00 02 51 ff
			15 01 00 00 00 00 02 53 2c
			15 01 00 00 00 00 02 55 03
			15 01 00 00 c8 00 02 35 00
			05 01 00 00 78 00 02 11 00
			05 01 00 00 0a 00 02 29 00];
		qcom,mdss-dsi-off-command = [05 01 00 00 14 00 02 28 00
				 05 01 00 00 78 00 02 10 00];
		qcom,mdss-dsi-on-command-state = "dsi_lp_mode";
		qcom,mdss-dsi-off-command-state = "dsi_lp_mode";
		qcom,mdss-dsi-bl-pmic-control-type = "bl_ctrl_wled";
		qcom,mdss-dsi-reset-sequence = <1 10>, <0 10>, <1 10>;
		qcom,mdss-dsi-tx-eot-append;
		qcom,mdss-dsi-lp11-init;
		qcom,mdss-dsi-post-init-delay = <1>;
	};
};
