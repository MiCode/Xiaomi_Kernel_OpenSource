/* Copyright (c) 2015-2016, The Linux Foundation. All rights reserved.
 * Copyright (C) 2018 XiaoMi, Inc.
 *
 * This program is free software; you can redistribute it and/or modify
 * it under the terms of the GNU General Public License version 2 and
 * only version 2 as published by the Free Software Foundation.
 *
 * This program is distributed in the hope that it will be useful,
 * but WITHOUT ANY WARRANTY; without even the implied warranty of
 * MERCHANTABILITY or FITNESS FOR A PARTICULAR PURPOSE.  See the
 * GNU General Public License for more details.
 */

qcom,2508175_huaqin_bn41hdesay_4100mah_averaged_masterslave_jun27th2016 {
	qcom,max-voltage-uv = <4400000>;
	qcom,nom-batt-capacity-mah = <4100>;
	qcom,batt-id-kohm = <82>;
	qcom,battery-beta = <3435>;
	qcom,battery-type = "qrd_msm8953_desay_4100mah";
	qcom,fastchg-current-ma = <2000>;
	qcom,fg-cc-cv-threshold-mv = <4390>;
	qcom,chg-rslow-comp-c1 = <2760396>;
	qcom,chg-rslow-comp-c2 = <3348384>;
	qcom,chg-rs-to-rslow = <870409>;
	qcom,chg-rslow-comp-thr = <0x99>;
	qcom,checksum = <0xFA46>;
	qcom,gui-version = "PMI8950GUI - 2.0.0.16";
	qcom,fg-profile-data = [
		DE 83 BE 7C
		15 81 58 77
		62 83 13 74
		3F 89 50 94
		1D 82 DE 99
		AC BC 0C C9
		56 10 10 88
		A4 7E 60 82
		D2 7C 48 83
		30 72 2E 75
		75 6D 4E 82
		80 99 A9 BC
		5C C9 5E 0C
		C9 0F 82 5A
		14 70 DA FC
		20 2F 05 46
		07 41 00 00
		FF 4C 56 3B
		AF 41 00 00
		00 00 00 00
		00 00 00 00
		4D 70 1A 6A
		C9 74 9E 89
		9F 77 D2 70
		A3 58 9F 81
		91 74 A5 68
		7D 66 B5 9B
		2F 05 63 F3
		64 A0 71 0C
		28 00 FF 36
		F0 11 30 03
		00 00 00 0C
	];
};
