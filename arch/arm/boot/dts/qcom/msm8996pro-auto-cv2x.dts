/* Copyright (c) 2017, The Linux Foundation. All rights reserved.
 *
 * This program is free software; you can redistribute it and/or modify
 * it under the terms of the GNU General Public License version 2 and
 * only version 2 as published by the Free Software Foundation.
 *
 * This program is distributed in the hope that it will be useful,
 * but WITHOUT ANY WARRANTY; without even the implied warranty of
 * MERCHANTABILITY or FITNESS FOR A PARTICULAR PURPOSE.  See the
 * GNU General Public License for more details.
 */

/dts-v1/;

#include <dt-bindings/gpio/gpio.h>
#include "msm8996pro.dtsi"
#include "msm8996-pm8994.dtsi"
#include "msm8996pro-auto.dtsi"
#include "msm8996-cv2x.dtsi"

/ {
	model = "Qualcomm Technologies, Inc. MSM 8996pro AUTO CV2X";
	compatible = "qcom,msm8996-adp", "qcom,msm8996", "qcom,adp";
	qcom,msm-id = <315 0x10001>;
	qcom,board-id = <0x1e 0>;
};
