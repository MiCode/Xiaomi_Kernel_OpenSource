/* Copyright (c) 2019, The Linux Foundation. All rights reserved.
 *
 * This program is free software; you can redistribute it and/or modify
 * it under the terms of the GNU General Public License version 2 and
 * only version 2 as published by the Free Software Foundation.
 *
 * This program is distributed in the hope that it will be useful,
 * but WITHOUT ANY WARRANTY; without even the implied warranty of
 * MERCHANTABILITY or FITNESS FOR A PARTICULAR PURPOSE.  See the
 * GNU General Public License for more details.
 */

/dts-v1/;
/plugin/;

#include "apq8096pro-v1.1-auto-adp-lite.dtsi"

/ {
	model = "Qualcomm Technologies, Inc. APQ 8096pro V1.1 AUTO ADP LITE";
	compatible = "qcom,apq8096-adp", "qcom,msm8996", "qcom,adp";
	qcom,msm-id = <316 0x10001>;
	qcom,board-id = <0x03010019 0>;
};
