
qcom,2760942_huaqin_d2cos_3080mah_averaged_masterslave_jan16th2017 {
	/* #2760942_Huaqin_D2cos_3080mAh_averaged_MasterSlave_Jan16th2017*/
	qcom,max-voltage-uv = <4380000>;
	qcom,nom-batt-capacity-mah = <3080>;
	qcom,batt-id-kohm = <50>;
	qcom,battery-beta = <3380>;
	qcom,battery-type = "battey_qrd_coslight_3080mah";
	qcom,chg-rslow-comp-c1 = <3969816>;
	qcom,chg-rslow-comp-c2 = <7140145>;
	qcom,chg-rs-to-rslow = <997019>;
	qcom,chg-rslow-comp-thr = <0xB8>;
	qcom,checksum = <0x5DAD>;
	qcom,gui-version = "PMI8950GUI - 2.0.0.16";
	qcom,fg-profile-data = [
		 E2 83 DF 7C
		 10 81 12 77
		 65 83 51 74
		 74 89 94 94
		 33 82 B0 99
		 A5 BC 1D C9
		 55 10 02 88
		 9A 7D 74 81
		 8D 77 4E 83
		 CD 70 15 61
		 CD 7E 4F 82
		 9D 99 DF BC
		 B5 C9 59 0C
		 24 0C 15 59
		 14 70 B2 FD
		 A4 3F 23 3D
		 6E 33 00 00
		 35 46 01 38
		 FE 12 00 00
		 00 00 00 00
		 00 00 00 00
		 97 6B B4 6A
		 EF 60 0B 81
		 92 6E 72 60
		 3E 59 C0 79
		 5B 6D 56 5B
		 18 7F 64 9A
		 18 E9 61 55
		 5F A0 71 0C
		 28 00 FF 36
		 F0 11 30 03
		 00 00 00 0C
	];
};
