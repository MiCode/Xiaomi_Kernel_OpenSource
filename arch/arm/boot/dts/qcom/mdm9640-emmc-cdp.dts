/* Copyright (c) 2014-2015, The Linux Foundation. All rights reserved.
 *
 * This program is free software; you can redistribute it and/or modify
 * it under the terms of the GNU General Public License version 2 and
 * only version 2 as published by the Free Software Foundation.
 *
 * This program is distributed in the hope that it will be useful,
 * but WITHOUT ANY WARRANTY; without even the implied warranty of
 * MERCHANTABILITY or FITNESS FOR A PARTICULAR PURPOSE.  See the
 * GNU General Public License for more details.
 */

/dts-v1/;

#include "mdm9640-cdp.dtsi"

/ {
	model = "Qualcomm Technologies, Inc. MSM 9640 CDP";
	compatible = "qcom,mdm9640-cdp", "qcom,mdm9640", "qcom,cdp";
	qcom,board-id = <1 0x00030000>;

        qcom,rmtfs_sharedmem@00000000 {
            compatible = "qcom,sharedmem-uio";
            reg = <0x00000000 0x00100000>;
            reg-names = "rmtfs";
            qcom,client-id = <0x00000001>;
        };
};

&usb3 {
	qcom,skip-charger-detection;
};
