
qcom,3049735_wingtech_s88567aa1scud_3300mah_default {
	qcom,max-voltage-uv = <4400000>;
	qcom,nom-batt-capacity-mah = <3300>;
	qcom,batt-id-kohm = <1000>;
	qcom,battery-beta = <3380>;
	qcom,battery-type = "Generic_Battery";
	qcom,chg-rslow-comp-c1 = <3506249>;
	qcom,chg-rslow-comp-c2 = <4896078>;
	qcom,chg-rs-to-rslow = <1106835>;
	qcom,chg-rslow-comp-thr = <0xA3>;
	qcom,checksum = <0x574F>;
	qcom,gui-version = "PMI8950GUI - 2.0.0.16";
	qcom,fg-profile-data = [
			 DB 83 95 7C
			 E9 80 EF 76
			 60 83 E8 6E
			 F3 88 2C 94
			 3D 82 78 99
			 7B BC F9 C8
			 55 0E 79 83
			 12 6C DB 78
			 EF 6C 40 83
			 56 78 5E 84
			 4E 7B 7D 82
			 80 93 1A B5
			 80 C0 70 0F
			 BB 0C 10 5A
			 14 70 77 FD
			 40 3C AE 45
			 CA 41 00 00
			 49 4C 63 39
			 07 41 00 00
			 00 00 00 00
			 00 00 00 00
			 85 70 D6 6A
			 E6 60 85 89
			 43 76 09 6B
			 63 55 2D 7A
			 FD 6F FE 63
			 68 56 DE A2
			 24 48 68 02
			 66 A0 71 0C
			 28 00 FF 36
			 F0 11 30 03
			 00 00 00 0C
	];
};
