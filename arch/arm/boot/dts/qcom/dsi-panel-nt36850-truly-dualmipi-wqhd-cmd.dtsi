/* Copyright (c) 2017, The Linux Foundation. All rights reserved.
 *
 * This program is free software; you can redistribute it and/or modify
 * it under the terms of the GNU General Public License version 2 and
 * only version 2 as published by the Free Software Foundation.
 *
 * This program is distributed in the hope that it will be useful,
 * but WITHOUT ANY WARRANTY; without even the implied warranty of
 * MERCHANTABILITY or FITNESS FOR A PARTICULAR PURPOSE.  See the
 * GNU General Public License for more details.
 */

&mdss_mdp {
	dsi_dual_nt36850_truly_cmd: qcom,mdss_dsi_nt36850_truly_wqhd_cmd{
		qcom,mdss-dsi-panel-name =
			"Dual nt36850 cmd mode dsi truly panel without DSC";
		qcom,mdss-dsi-panel-type = "dsi_cmd_mode";
		qcom,mdss-dsi-panel-framerate = <60>;
		qcom,mdss-dsi-virtual-channel-id = <0>;
		qcom,mdss-dsi-stream = <0>;
		qcom,mdss-dsi-panel-width = <720>;
		qcom,mdss-dsi-panel-height = <2560>;
		qcom,mdss-dsi-h-front-porch = <120>;
		qcom,mdss-dsi-h-back-porch = <140>;
		qcom,mdss-dsi-h-pulse-width = <20>;
		qcom,mdss-dsi-h-sync-skew = <0>;
		qcom,mdss-dsi-v-back-porch = <20>;
		qcom,mdss-dsi-v-front-porch = <8>;
		qcom,mdss-dsi-v-pulse-width = <4>;
		qcom,mdss-dsi-h-left-border = <0>;
		qcom,mdss-dsi-h-right-border = <0>;
		qcom,mdss-dsi-v-top-border = <0>;
		qcom,mdss-dsi-v-bottom-border = <0>;
		qcom,mdss-dsi-bpp = <24>;
		qcom,mdss-dsi-color-order = "rgb_swap_rgb";
		qcom,mdss-dsi-underflow-color = <0xff>;
		qcom,mdss-dsi-border-color = <0>;
		qcom,mdss-dsi-on-command = [
				15 01 00 00 00 00 02 ff 24
				15 01 00 00 00 00 02 fb 01
				15 01 00 00 00 00 02 00 19
				15 01 00 00 00 00 02 01 03
				15 01 00 00 00 00 02 02 04
				15 01 00 00 00 00 02 03 1b
				15 01 00 00 00 00 02 04 1d
				15 01 00 00 00 00 02 05 01
				15 01 00 00 00 00 02 06 0c
				15 01 00 00 00 00 02 07 0f
				15 01 00 00 00 00 02 08 1f
				15 01 00 00 00 00 02 09 00
				15 01 00 00 00 00 02 0a 00
				15 01 00 00 00 00 02 0b 13
				15 01 00 00 00 00 02 0c 16
				15 01 00 00 00 00 02 0d 14
				15 01 00 00 00 00 02 0e 15
				15 01 00 00 00 00 02 0f 00
				15 01 00 00 00 00 02 10 19
				15 01 00 00 00 00 02 11 03
				15 01 00 00 00 00 02 12 04
				15 01 00 00 00 00 02 13 1b
				15 01 00 00 00 00 02 14 1d
				15 01 00 00 00 00 02 15 01
				15 01 00 00 00 00 02 16 0c
				15 01 00 00 00 00 02 17 0f
				15 01 00 00 00 00 02 18 1f
				15 01 00 00 00 00 02 19 00
				15 01 00 00 00 00 02 1a 00
				15 01 00 00 00 00 02 1b 13
				15 01 00 00 00 00 02 1c 16
				15 01 00 00 00 00 02 1d 14
				15 01 00 00 00 00 02 1e 15
				15 01 00 00 00 00 02 1f 00
				15 01 00 00 00 00 02 21 01
				15 01 00 00 00 00 02 22 10
				15 01 00 00 00 00 02 23 28
				15 01 00 00 00 00 02 24 28
				15 01 00 00 00 00 02 25 5d
				15 01 00 00 00 00 02 26 28
				15 01 00 00 00 00 02 27 28
				15 01 00 00 00 00 02 29 d8
				15 01 00 00 00 00 02 2a 15
				15 01 00 00 00 00 02 2b 00
				15 01 00 00 00 00 02 2d 00
				15 01 00 00 00 00 02 2f 02
				15 01 00 00 00 00 02 30 02
				15 01 00 00 00 00 02 31 00
				15 01 00 00 00 00 02 32 23
				15 01 00 00 00 00 02 33 01
				15 01 00 00 00 00 02 34 03
				15 01 00 00 00 00 02 35 49
				15 01 00 00 00 00 02 36 00
				15 01 00 00 00 00 02 37 1d
				15 01 00 00 00 00 02 38 08
				15 01 00 00 00 00 02 39 03
				15 01 00 00 00 00 02 3a 49
				15 01 00 00 00 00 02 42 01
				15 01 00 00 00 00 02 43 8c
				15 01 00 00 00 00 02 44 a3
				15 01 00 00 00 00 02 48 8c
				15 01 00 00 00 00 02 49 a3
				15 01 00 00 00 00 02 5b 00
				15 01 00 00 00 00 02 5f 4d
				15 01 00 00 00 00 02 63 00
				15 01 00 00 00 00 02 67 04
				15 01 00 00 00 00 02 6e 10
				15 01 00 00 00 00 02 72 02
				15 01 00 00 00 00 02 73 00
				15 01 00 00 00 00 02 74 04
				15 01 00 00 00 00 02 75 1b
				15 01 00 00 00 00 02 76 05
				15 01 00 00 00 00 02 77 01
				15 01 00 00 00 00 02 78 00
				15 01 00 00 00 00 02 79 00
				15 01 00 00 00 00 02 7a 00
				15 01 00 00 00 00 02 7b 91
				15 01 00 00 00 00 02 7c da
				15 01 00 00 00 00 02 7d 10
				15 01 00 00 00 00 02 7e 04
				15 01 00 00 00 00 02 7f 1b
				15 01 00 00 00 00 02 80 00
				15 01 00 00 00 00 02 81 05
				15 01 00 00 00 00 02 82 01
				15 01 00 00 00 00 02 83 00
				15 01 00 00 00 00 02 84 05
				15 01 00 00 00 00 02 85 05
				15 01 00 00 00 00 02 86 1b
				15 01 00 00 00 00 02 87 1b
				15 01 00 00 00 00 02 88 1b
				15 01 00 00 00 00 02 89 1b
				15 01 00 00 00 00 02 8a 00
				15 01 00 00 00 00 02 8b f0
				15 01 00 00 00 00 02 8c 00
				15 01 00 00 00 00 02 8f 63
				15 01 00 00 00 00 02 90 51
				15 01 00 00 00 00 02 91 40
				15 01 00 00 00 00 02 92 51
				15 01 00 00 00 00 02 93 08
				15 01 00 00 00 00 02 94 08
				15 01 00 00 00 00 02 95 51
				15 01 00 00 00 00 02 96 51
				15 01 00 00 00 00 02 97 00
				15 01 00 00 00 00 02 98 00
				15 01 00 00 00 00 02 99 33
				15 01 00 00 00 00 02 9b ff
				15 01 00 00 00 00 02 9c 01
				15 01 00 00 00 00 02 9d 30
				15 01 00 00 00 00 02 a5 10
				15 01 00 00 00 00 02 a6 01
				15 01 00 00 00 00 02 a9 21
				15 01 00 00 00 00 02 b3 2a
				15 01 00 00 00 00 02 b4 da
				15 01 00 00 00 00 02 ba 83
				15 01 00 00 00 00 02 c4 24
				15 01 00 00 00 00 02 c5 aa
				15 01 00 00 00 00 02 c6 09
				15 01 00 00 00 00 02 c7 00
				15 01 00 00 00 00 02 c9 c0
				15 01 00 00 00 00 02 ca 04
				15 01 00 00 00 00 02 d5 3f
				15 01 00 00 00 00 02 d6 10
				15 01 00 00 00 00 02 d7 3f
				15 01 00 00 00 00 02 d8 10
				15 01 00 00 00 00 02 d9 ee
				15 01 00 00 00 00 02 da 49
				15 01 00 00 00 00 02 db 94
				15 01 00 00 00 00 02 e9 33
				15 01 00 00 00 00 02 eb 28
				15 01 00 00 00 00 02 ec 00
				15 01 00 00 00 00 02 ee 00
				15 01 00 00 00 00 02 ef 06
				15 01 00 00 00 00 02 f0 01
				15 01 00 00 00 00 02 f1 01
				15 01 00 00 00 00 02 f2 0d
				15 01 00 00 00 00 02 f3 48
				15 01 00 00 00 00 02 f6 00
				15 01 00 00 00 00 02 f7 00
				15 01 00 00 00 00 02 f8 00
				15 01 00 00 00 00 02 f9 00
				15 01 00 00 00 00 02 ff 26
				15 01 00 00 00 00 02 fb 01
				15 01 00 00 00 00 02 00 ab
				15 01 00 00 00 00 02 01 00
				15 01 00 00 00 00 02 02 80
				15 01 00 00 00 00 02 03 08
				15 01 00 00 00 00 02 04 01
				15 01 00 00 00 00 02 05 32
				15 01 00 00 00 00 02 06 4c
				15 01 00 00 00 00 02 07 26
				15 01 00 00 00 00 02 08 09
				15 01 00 00 00 00 02 09 02
				15 01 00 00 00 00 02 0a 32
				15 01 00 00 00 00 02 0b 55
				15 01 00 00 00 00 02 0c 14
				15 01 00 00 00 00 02 0d 28
				15 01 00 00 00 00 02 0e 00
				15 01 00 00 00 00 02 0f 00
				15 01 00 00 00 00 02 10 00
				15 01 00 00 00 00 02 11 22
				15 01 00 00 00 00 02 12 0a
				15 01 00 00 00 00 02 13 20
				15 01 00 00 00 00 02 14 06
				15 01 00 00 00 00 02 15 00
				15 01 00 00 00 00 02 16 40
				15 01 00 00 00 00 02 19 43
				15 01 00 00 00 00 02 1a 03
				15 01 00 00 00 00 02 1b 25
				15 01 00 00 00 00 02 1c 11
				15 01 00 00 00 00 02 1d 00
				15 01 00 00 00 00 02 1e 80
				15 01 00 00 00 00 02 1f 00
				15 01 00 00 00 00 02 20 00
				15 01 00 00 00 00 02 21 03
				15 01 00 00 00 00 02 22 22
				15 01 00 00 00 00 02 23 25
				15 01 00 00 00 00 02 24 00
				15 01 00 00 00 00 02 25 a7
				15 01 00 00 00 00 02 26 00
				15 01 00 00 00 00 02 27 a5
				15 01 00 00 00 00 02 28 06
				15 01 00 00 00 00 02 29 85
				15 01 00 00 00 00 02 2a 3f
				15 01 00 00 00 00 02 2b 97
				15 01 00 00 00 00 02 2f 25
				15 01 00 00 00 00 02 30 26
				15 01 00 00 00 00 02 31 41
				15 01 00 00 00 00 02 32 04
				15 01 00 00 00 00 02 33 04
				15 01 00 00 00 00 02 34 2b
				15 01 00 00 00 00 02 35 00
				15 01 00 00 00 00 02 36 00
				15 01 00 00 00 00 02 37 c8
				15 01 00 00 00 00 02 38 26
				15 01 00 00 00 00 02 39 25
				15 01 00 00 00 00 02 3a 26
				15 01 00 00 00 00 02 3f eb
				15 01 00 00 00 00 02 41 21
				15 01 00 00 00 00 02 42 03
				15 01 00 00 00 00 02 43 00
				15 01 00 00 00 00 02 44 11
				15 01 00 00 00 00 02 45 00
				15 01 00 00 00 00 02 46 00
				15 01 00 00 00 00 02 47 00
				15 01 00 00 00 00 02 48 00
				15 01 00 00 00 00 02 49 03
				15 01 00 00 00 00 02 4a 00
				15 01 00 00 00 00 02 4b 00
				15 01 00 00 00 00 02 4c 01
				15 01 00 00 00 00 02 4d 4e
				15 01 00 00 00 00 02 4e 01
				15 01 00 00 00 00 02 4f 4c
				15 01 00 00 00 00 02 50 0d
				15 01 00 00 00 00 02 51 0e
				15 01 00 00 00 00 02 52 23
				15 01 00 00 00 00 02 53 97
				15 01 00 00 00 00 02 54 4b
				15 01 00 00 00 00 02 55 4c
				15 01 00 00 00 00 02 56 20
				15 01 00 00 00 00 02 58 04
				15 01 00 00 00 00 02 59 04
				15 01 00 00 00 00 02 5a 09
				15 01 00 00 00 00 02 5b 00
				15 01 00 00 00 00 02 5c 00
				15 01 00 00 00 00 02 5d c8
				15 01 00 00 00 00 02 5e 4c
				15 01 00 00 00 00 02 5f 4b
				15 01 00 00 00 00 02 60 00
				15 01 00 00 00 00 02 80 2b
				15 01 00 00 00 00 02 81 43
				15 01 00 00 00 00 02 82 03
				15 01 00 00 00 00 02 83 25
				15 01 00 00 00 00 02 84 11
				15 01 00 00 00 00 02 85 00
				15 01 00 00 00 00 02 86 80
				15 01 00 00 00 00 02 87 00
				15 01 00 00 00 00 02 88 00
				15 01 00 00 00 00 02 89 03
				15 01 00 00 00 00 02 8a 22
				15 01 00 00 00 00 02 8b 25
				15 01 00 00 00 00 02 8c 00
				15 01 00 00 00 00 02 8d a4
				15 01 00 00 00 00 02 8e 00
				15 01 00 00 00 00 02 8f a2
				15 01 00 00 00 00 02 90 06
				15 01 00 00 00 00 02 91 63
				15 01 00 00 00 00 02 92 30
				15 01 00 00 00 00 02 93 97
				15 01 00 00 00 00 02 94 25
				15 01 00 00 00 00 02 95 26
				15 01 00 00 00 00 02 96 41
				15 01 00 00 00 00 02 97 04
				15 01 00 00 00 00 02 98 04
				15 01 00 00 00 00 02 99 f0
				15 01 00 00 00 00 02 9a 00
				15 01 00 00 00 00 02 9b 00
				15 01 00 00 00 00 02 9c c8
				15 01 00 00 00 00 02 9d 50
				15 01 00 00 00 00 02 9e 26
				15 01 00 00 00 00 02 9f 25
				15 01 00 00 00 00 02 a0 26
				15 01 00 00 00 00 02 a2 00
				15 01 00 00 00 00 02 a3 33
				15 01 00 00 00 00 02 a5 40
				15 01 00 00 00 00 02 a6 40
				15 01 00 00 00 00 02 ac 91
				15 01 00 00 00 00 02 ad 66
				15 01 00 00 00 00 02 ae 66
				15 01 00 00 00 00 02 b1 40
				15 01 00 00 00 00 02 b2 40
				15 01 00 00 00 00 02 b4 40
				15 01 00 00 00 00 02 b5 40
				15 01 00 00 00 00 02 b7 40
				15 01 00 00 00 00 02 b8 40
				15 01 00 00 00 00 02 ba 22
				15 01 00 00 00 00 02 bb 00
				15 01 00 00 00 00 02 c2 01
				15 01 00 00 00 00 02 c3 01
				15 01 00 00 00 00 02 c4 01
				15 01 00 00 00 00 02 c5 01
				15 01 00 00 00 00 02 c6 01
				15 01 00 00 00 00 02 c8 00
				15 01 00 00 00 00 02 c9 00
				15 01 00 00 00 00 02 ca 00
				15 01 00 00 00 00 02 cd 00
				15 01 00 00 00 00 02 ce 00
				15 01 00 00 00 00 02 d6 04
				15 01 00 00 00 00 02 d7 00
				15 01 00 00 00 00 02 d8 0d
				15 01 00 00 00 00 02 d9 00
				15 01 00 00 00 00 02 da 00
				15 01 00 00 00 00 02 db 00
				15 01 00 00 00 00 02 dc 00
				15 01 00 00 00 00 02 dd 00
				15 01 00 00 00 00 02 de 00
				15 01 00 00 00 00 02 df 01
				15 01 00 00 00 00 02 e0 00
				15 01 00 00 00 00 02 e1 00
				15 01 00 00 00 00 02 e2 19
				15 01 00 00 00 00 02 e3 04
				15 01 00 00 00 00 02 e4 00
				15 01 00 00 00 00 02 e5 04
				15 01 00 00 00 00 02 e6 00
				15 01 00 00 00 00 02 e7 12
				15 01 00 00 00 00 02 e8 00
				15 01 00 00 00 00 02 e9 50
				15 01 00 00 00 00 02 ea 10
				15 01 00 00 00 00 02 eb 02
				15 01 00 00 00 00 02 ff 27
				15 01 00 00 00 00 02 fb 01
				15 01 00 00 00 00 02 ff 28
				15 01 00 00 00 00 02 fb 01
				15 01 00 00 00 00 02 60 0a
				15 01 00 00 00 00 02 63 32
				15 01 00 00 00 00 02 64 01
				15 01 00 00 00 00 02 68 da
				15 01 00 00 00 00 02 69 00
				15 01 00 00 00 00 02 ff 29
				15 01 00 00 00 00 02 fb 01
				15 01 00 00 00 00 02 60 0a
				15 01 00 00 00 00 02 63 32
				15 01 00 00 00 00 02 64 01
				15 01 00 00 00 00 02 68 da
				15 01 00 00 00 00 02 69 00
				15 01 00 00 00 00 02 ff e0
				15 01 00 00 00 00 02 fb 01
				15 01 00 00 00 00 02 35 40
				15 01 00 00 00 00 02 36 40
				15 01 00 00 00 00 02 37 00
				15 01 00 00 00 00 02 89 c6
				15 01 00 00 00 00 02 ff f0
				15 01 00 00 00 00 02 fb 01
				15 01 00 00 00 00 02 ea 40
				15 01 00 00 00 00 02 ff 10
				15 01 00 00 00 00 02 36 00
				15 01 00 00 00 00 02 35 00
				39 01 00 00 00 00 03 44 03 e8
				15 01 00 00 00 00 02 51 ff
				15 01 00 00 00 00 02 53 2c
				15 01 00 00 00 00 02 55 01
				05 01 00 00 0a 00 02 20 00
				15 01 00 00 00 00 02 bb 10
				05 01 00 00 78 00 02 11 00
				05 01 00 00 14 00 02 29 00];
		qcom,mdss-dsi-off-command = [05 01 00 00 14 00 02 28 00
				05 01 00 00 78 00 02 10 00];
		qcom,mdss-dsi-on-command-state = "dsi_lp_mode";
		qcom,mdss-dsi-off-command-state = "dsi_hs_mode";
		qcom,mdss-dsi-h-sync-pulse = <0>;
		qcom,mdss-dsi-traffic-mode = "non_burst_sync_event";
		qcom,mdss-dsi-lane-map = "lane_map_0123";
		qcom,mdss-dsi-bllp-eof-power-mode;
		qcom,mdss-dsi-bllp-power-mode;
		qcom,mdss-dsi-tx-eot-append;
		qcom,cmd-sync-wait-broadcast;
		qcom,mdss-dsi-lane-0-state;
		qcom,mdss-dsi-lane-1-state;
		qcom,mdss-dsi-lane-2-state;
		qcom,mdss-dsi-lane-3-state;
		qcom,mdss-dsi-wr-mem-start = <0x2c>;
		qcom,mdss-dsi-wr-mem-continue = <0x3c>;
		qcom,mdss-dsi-te-pin-select = <1>;
		qcom,mdss-dsi-te-dcs-command = <1>;
		qcom,mdss-dsi-te-check-enable;
		qcom,mdss-dsi-te-using-te-pin;
		qcom,mdss-dsi-panel-timings =
			[da 34 24 00 64 68 28 38 2a 03 04 00];
		qcom,mdss-dsi-t-clk-pre = <0x29>;
		qcom,mdss-dsi-t-clk-post = <0x03>;
		qcom,mdss-dsi-dma-trigger = "trigger_sw";
		qcom,mdss-dsi-mdp-trigger = "none";
		qcom,mdss-dsi-lp11-init;
		qcom,mdss-dsi-bl-pmic-control-type = "bl_ctrl_wled";
		qcom,mdss-dsi-bl-min-level = <1>;
		qcom,mdss-dsi-bl-max-level = <4095>;
		qcom,mdss-dsi-reset-sequence = <1 10>, <0 10>, <1 10>;
	};
};
