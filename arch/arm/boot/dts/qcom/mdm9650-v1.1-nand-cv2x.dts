/* Copyright (c) 2017, The Linux Foundation. All rights reserved.
 *
 * This program is free software; you can redistribute it and/or modify
 * it under the terms of the GNU General Public License version 2 and
 * only version 2 as published by the Free Software Foundation.
 *
 * This program is distributed in the hope that it will be useful,
 * but WITHOUT ANY WARRANTY; without even the implied warranty of
 * MERCHANTABILITY or FITNESS FOR A PARTICULAR PURPOSE.  See the
 * GNU General Public License for more details.
 */

/dts-v1/;

#include "mdm9650-cv2x.dtsi"

/ {
	model = "Qualcomm Technologies, Inc. MDM 9650 v1.1 CV2X";
	compatible = "qcom,mdm9650-ttp", "qcom,mdm9650", "qcom,ttp";
	qcom,board-id = <0x1e 1>, <0x1e 0x101>;

	qcom,rmtfs_sharedmem@0 {
		compatible = "qcom,sharedmem-uio";
		reg = <0x0 0x00100000>;
		reg-names = "rmtfs";
		qcom,client-id = <0x00000001>;
	};
};
