/* Copyright (c) 2014, The Linux Foundation. All rights reserved.
 *
 * This program is free software; you can redistribute it and/or modify
 * it under the terms of the GNU General Public License version 2 and
 * only version 2 as published by the Free Software Foundation.
 *
 * This program is distributed in the hope that it will be useful,
 * but WITHOUT ANY WARRANTY; without even the implied warranty of
 * MERCHANTABILITY or FITNESS FOR A PARTICULAR PURPOSE.  See the
 * GNU General Public License for more details.
 */

#include "mdm9630-v2.dtsi"

/ {
	qcom,msm-id = <0x100bb 0x20000>, <0x100e3 0x20000>, <0x100e4 0x20000>,
		      <0x100e5 0x20000>, <0x100e6 0x20000>, <0x100e7 0x20000>;
};

