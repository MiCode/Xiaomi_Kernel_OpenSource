/* Copyright (c) 2013-2014 The Linux Foundation. All rights reserved.
 *
 * This program is free software; you can redistribute it and/or modify
 * it under the terms of the GNU General Public License version 2 and
 * only version 2 as published by the Free Software Foundation.
 *
 * This program is distributed in the hope that it will be useful,
 * but WITHOUT ANY WARRANTY; without even the implied warranty of
 * MERCHANTABILITY or FITNESS FOR A PARTICULAR PURPOSE.  See the
 * GNU General Public License for more details.
 */

/dts-v1/;

#include "msmsamarium.dtsi"
#include "msmsamarium-cdp.dtsi"
#include "msmsamarium-camera.dtsi"
#include "msmsamarium-camera-sensor-cdp.dtsi"

/ {
	model = "Qualcomm Technologies, Inc. MSM SAMARIUM CDP";
	compatible = "qcom,msmsamarium-cdp", "qcom,msmsamarium", "qcom,cdp";
	qcom,board-id = <1 0>;
};

&slim_msm {
	tapan_codec {
		qcom,cdc-micbias1-ext-cap;
		qcom,cdc-micbias3-ext-cap;

		cdc-vdd-spkdrv-supply = <&ext_5v_vreg>;
		qcom,cdc-vdd-spkdrv-voltage = <5000000 5000000>;
		qcom,cdc-vdd-spkdrv-current = <1250000>;

		qcom,cdc-on-demand-supplies = "cdc-vdd-spkdrv";
	};
};
