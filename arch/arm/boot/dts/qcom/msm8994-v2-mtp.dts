/* Copyright (c) 2014, The Linux Foundation. All rights reserved.
 *
 * This program is free software; you can redistribute it and/or modify
 * it under the terms of the GNU General Public License version 2 and
 * only version 2 as published by the Free Software Foundation.
 *
 * This program is distributed in the hope that it will be useful,
 * but WITHOUT ANY WARRANTY; without even the implied warranty of
 * MERCHANTABILITY or FITNESS FOR A PARTICULAR PURPOSE.  See the
 * GNU General Public License for more details.
 */


/dts-v1/;

#include "msm8994-v2.dtsi"
#include "msm8994-pinctrl.dtsi"
#include "msm8994-mtp.dtsi"

/ {
	model = "Qualcomm Technologies, Inc. MSM8994v2 MTP";
	compatible = "qcom,msm8994-mtp", "qcom,msm8994", "qcom,mtp";
	qcom,board-id = <8 0>;
};
