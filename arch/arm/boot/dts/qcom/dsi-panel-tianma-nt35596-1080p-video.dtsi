/* Copyright (c) 2015, The Linux Foundation. All rights reserved.
 * Copyright (C) 2016 XiaoMi, Inc.
 *
 * This program is free software; you can redistribute it and/or modify
 * it under the terms of the GNU General Public License version 2 and
 * only version 2 as published by the Free Software Foundation.
 *
 * This program is distributed in the hope that it will be useful,
 * but WITHOUT ANY WARRANTY; without even the implied warranty of
 * MERCHANTABILITY or FITNESS FOR A PARTICULAR PURPOSE.  See the
 * GNU General Public License for more details.
 */
&mdss_mdp {
	dsi_tianma_nt35596_1080_vid: qcom,mdss_dsi_tianma_nt35596_1080p_video {
		qcom,mdss-dsi-panel-name = "tianma nt35596 1080p video mode dsi panel";
		qcom,mdss-dsi-panel-type = "dsi_video_mode";
		qcom,mdss-dsi-panel-framerate = <60>;
		qcom,mdss-dsi-virtual-channel-id = <0>;
		qcom,mdss-dsi-stream = <0>;
		qcom,mdss-dsi-panel-width = <1080>;
		qcom,mdss-dsi-panel-height = <1920>;
		qcom,mdss-dsi-h-front-porch = <98>;
		qcom,mdss-dsi-h-back-porch = <98>;
		qcom,mdss-dsi-h-pulse-width = <8>;
		qcom,mdss-dsi-h-sync-skew = <0>;
		qcom,mdss-dsi-v-back-porch = <8>;
		qcom,mdss-dsi-v-front-porch = <10>;
		qcom,mdss-dsi-v-pulse-width = <2>;
		qcom,mdss-dsi-h-left-border = <0>;
		qcom,mdss-dsi-h-right-border = <0>;
		qcom,mdss-dsi-v-top-border = <0>;
		qcom,mdss-dsi-v-bottom-border = <0>;
		qcom,mdss-dsi-bpp = <24>;
		qcom,mdss-dsi-underflow-color = <0xff>;
		qcom,mdss-dsi-border-color = <0>;
		qcom,mdss-dsi-h-sync-pulse = <0>;
		qcom,mdss-dsi-traffic-mode = "burst_mode";
		qcom,mdss-dsi-bllp-eof-power-mode;
		qcom,mdss-dsi-bllp-power-mode;
		qcom,mdss-dsi-lane-0-state;
		qcom,mdss-dsi-lane-1-state;
		qcom,mdss-dsi-lane-2-state;
		qcom,mdss-dsi-lane-3-state;
		qcom,mdss-dsi-panel-timings = [E6 38 26 00 68 6C 2A 3C 2C 03 04 00];
		qcom,mdss-dsi-t-clk-post = <0x02>;
		qcom,mdss-dsi-t-clk-pre = <0x2d>;
		qcom,mdss-dsi-bl-min-level = <16>;
		qcom,mdss-dsi-bl-max-level = <4095>;
		qcom,mdss-dsi-dma-trigger = "trigger_sw";
		qcom,mdss-dsi-mdp-trigger = "none";
		qcom,mdss-dsi-on-command = [
				23 01 00 00 00 00 02 FF EE
				23 01 00 00 0A 00 02 18 40
				23 01 00 00 14 00 02 18 00
				23 00 00 00 00 00 02 FB 01
				23 00 00 00 00 00 02 7C 31
				23 00 00 00 00 00 02 FF 01
				23 00 00 00 00 00 02 FB 01
				23 00 00 00 00 00 02 75 00
				23 00 00 00 00 00 02 76 00
				23 00 00 00 00 00 02 77 00
				23 00 00 00 00 00 02 78 21
				23 00 00 00 00 00 02 79 00
				23 00 00 00 00 00 02 7A 4A
				23 00 00 00 00 00 02 7B 00
				23 00 00 00 00 00 02 7C 66
				23 00 00 00 00 00 02 7D 00
				23 00 00 00 00 00 02 7E 7F
				23 00 00 00 00 00 02 7F 00
				23 00 00 00 00 00 02 80 94
				23 00 00 00 00 00 02 81 00
				23 00 00 00 00 00 02 82 A7
				23 00 00 00 00 00 02 83 00
				23 00 00 00 00 00 02 84 B8
				23 00 00 00 00 00 02 85 00
				23 00 00 00 00 00 02 86 C7
				23 00 00 00 00 00 02 87 00
				23 00 00 00 00 00 02 88 FB
				23 00 00 00 00 00 02 89 01
				23 00 00 00 00 00 02 8A 25
				23 00 00 00 00 00 02 8B 01
				23 00 00 00 00 00 02 8C 61
				23 00 00 00 00 00 02 8D 01
				23 00 00 00 00 00 02 8E 94
				23 00 00 00 00 00 02 8F 01
				23 00 00 00 00 00 02 90 E2
				23 00 00 00 00 00 02 91 02
				23 00 00 00 00 00 02 92 20
				23 00 00 00 00 00 02 93 02
				23 00 00 00 00 00 02 94 22
				23 00 00 00 00 00 02 95 02
				23 00 00 00 00 00 02 96 5C
				23 00 00 00 00 00 02 97 02
				23 00 00 00 00 00 02 98 9E
				23 00 00 00 00 00 02 99 02
				23 00 00 00 00 00 02 9A C9
				23 00 00 00 00 00 02 9B 03
				23 00 00 00 00 00 02 9C 01
				23 00 00 00 00 00 02 9D 03
				23 00 00 00 00 00 02 9E 28
				23 00 00 00 00 00 02 9F 03
				23 00 00 00 00 00 02 A0 55
				23 00 00 00 00 00 02 A2 03
				23 00 00 00 00 00 02 A3 62
				23 00 00 00 00 00 02 A4 03
				23 00 00 00 00 00 02 A5 6F
				23 00 00 00 00 00 02 A6 03
				23 00 00 00 00 00 02 A7 7E
				23 00 00 00 00 00 02 A9 03
				23 00 00 00 00 00 02 AA 8F
				23 00 00 00 00 00 02 AB 03
				23 00 00 00 00 00 02 AC 9C
				23 00 00 00 00 00 02 AD 03
				23 00 00 00 00 00 02 AE A2
				23 00 00 00 00 00 02 AF 03
				23 00 00 00 00 00 02 B0 AB
				23 00 00 00 00 00 02 B1 03
				23 00 00 00 00 00 02 B2 B2
				23 00 00 00 00 00 02 B3 00
				23 00 00 00 00 00 02 B4 00
				23 00 00 00 00 00 02 B5 00
				23 00 00 00 00 00 02 B6 21
				23 00 00 00 00 00 02 B7 00
				23 00 00 00 00 00 02 B8 4A
				23 00 00 00 00 00 02 B9 00
				23 00 00 00 00 00 02 BA 66
				23 00 00 00 00 00 02 BB 00
				23 00 00 00 00 00 02 BC 7F
				23 00 00 00 00 00 02 BD 00
				23 00 00 00 00 00 02 BE 94
				23 00 00 00 00 00 02 BF 00
				23 00 00 00 00 00 02 C0 A7
				23 00 00 00 00 00 02 C1 00
				23 00 00 00 00 00 02 C2 B8
				23 00 00 00 00 00 02 C3 00
				23 00 00 00 00 00 02 C4 C7
				23 00 00 00 00 00 02 C5 00
				23 00 00 00 00 00 02 C6 FB
				23 00 00 00 00 00 02 C7 01
				23 00 00 00 00 00 02 C8 25
				23 00 00 00 00 00 02 C9 01
				23 00 00 00 00 00 02 CA 61
				23 00 00 00 00 00 02 CB 01
				23 00 00 00 00 00 02 CC 94
				23 00 00 00 00 00 02 CD 01
				23 00 00 00 00 00 02 CE E2
				23 00 00 00 00 00 02 CF 02
				23 00 00 00 00 00 02 D0 20
				23 00 00 00 00 00 02 D1 02
				23 00 00 00 00 00 02 D2 22
				23 00 00 00 00 00 02 D3 02
				23 00 00 00 00 00 02 D4 5C
				23 00 00 00 00 00 02 D5 02
				23 00 00 00 00 00 02 D6 9E
				23 00 00 00 00 00 02 D7 02
				23 00 00 00 00 00 02 D8 C9
				23 00 00 00 00 00 02 D9 03
				23 00 00 00 00 00 02 DA 01
				23 00 00 00 00 00 02 DB 03
				23 00 00 00 00 00 02 DC 28
				23 00 00 00 00 00 02 DD 03
				23 00 00 00 00 00 02 DE 55
				23 00 00 00 00 00 02 DF 03
				23 00 00 00 00 00 02 E0 62
				23 00 00 00 00 00 02 E1 03
				23 00 00 00 00 00 02 E2 6F
				23 00 00 00 00 00 02 E3 03
				23 00 00 00 00 00 02 E4 7E
				23 00 00 00 00 00 02 E5 03
				23 00 00 00 00 00 02 E6 8F
				23 00 00 00 00 00 02 E7 03
				23 00 00 00 00 00 02 E8 9C
				23 00 00 00 00 00 02 E9 03
				23 00 00 00 00 00 02 EA A2
				23 00 00 00 00 00 02 EB 03
				23 00 00 00 00 00 02 EC AB
				23 00 00 00 00 00 02 ED 03
				23 00 00 00 00 00 02 EE B2
				23 00 00 00 00 00 02 EF 00
				23 00 00 00 00 00 02 F0 00
				23 00 00 00 00 00 02 F1 00
				23 00 00 00 00 00 02 F2 21
				23 00 00 00 00 00 02 F3 00
				23 00 00 00 00 00 02 F4 4A
				23 00 00 00 00 00 02 F5 00
				23 00 00 00 00 00 02 F6 66
				23 00 00 00 00 00 02 F7 00
				23 00 00 00 00 00 02 F8 7F
				23 00 00 00 00 00 02 F9 00
				23 00 00 00 00 00 02 FA 94
				23 00 00 00 00 00 02 FF 02
				23 00 00 00 00 00 02 FB 01
				23 00 00 00 00 00 02 00 00
				23 00 00 00 00 00 02 01 A7
				23 00 00 00 00 00 02 02 00
				23 00 00 00 00 00 02 03 B8
				23 00 00 00 00 00 02 04 00
				23 00 00 00 00 00 02 05 C7
				23 00 00 00 00 00 02 06 00
				23 00 00 00 00 00 02 07 FB
				23 00 00 00 00 00 02 08 01
				23 00 00 00 00 00 02 09 25
				23 00 00 00 00 00 02 0A 01
				23 00 00 00 00 00 02 0B 61
				23 00 00 00 00 00 02 0C 01
				23 00 00 00 00 00 02 0D 94
				23 00 00 00 00 00 02 0E 01
				23 00 00 00 00 00 02 0F E2
				23 00 00 00 00 00 02 10 02
				23 00 00 00 00 00 02 11 20
				23 00 00 00 00 00 02 12 02
				23 00 00 00 00 00 02 13 22
				23 00 00 00 00 00 02 14 02
				23 00 00 00 00 00 02 15 5C
				23 00 00 00 00 00 02 16 02
				23 00 00 00 00 00 02 17 9E
				23 00 00 00 00 00 02 18 02
				23 00 00 00 00 00 02 19 C9
				23 00 00 00 00 00 02 1A 03
				23 00 00 00 00 00 02 1B 01
				23 00 00 00 00 00 02 1C 03
				23 00 00 00 00 00 02 1D 28
				23 00 00 00 00 00 02 1E 03
				23 00 00 00 00 00 02 1F 55
				23 00 00 00 00 00 02 20 03
				23 00 00 00 00 00 02 21 62
				23 00 00 00 00 00 02 22 03
				23 00 00 00 00 00 02 23 6F
				23 00 00 00 00 00 02 24 03
				23 00 00 00 00 00 02 25 7E
				23 00 00 00 00 00 02 26 03
				23 00 00 00 00 00 02 27 8F
				23 00 00 00 00 00 02 28 03
				23 00 00 00 00 00 02 29 9C
				23 00 00 00 00 00 02 2A 03
				23 00 00 00 00 00 02 2B A2
				23 00 00 00 00 00 02 2D 03
				23 00 00 00 00 00 02 2F AB
				23 00 00 00 00 00 02 30 03
				23 00 00 00 00 00 02 31 B2
				23 00 00 00 00 00 02 32 00
				23 00 00 00 00 00 02 33 00
				23 00 00 00 00 00 02 34 00
				23 00 00 00 00 00 02 35 21
				23 00 00 00 00 00 02 36 00
				23 00 00 00 00 00 02 37 4A
				23 00 00 00 00 00 02 38 00
				23 00 00 00 00 00 02 39 66
				23 00 00 00 00 00 02 3A 00
				23 00 00 00 00 00 02 3B 7F
				23 00 00 00 00 00 02 3D 00
				23 00 00 00 00 00 02 3F 94
				23 00 00 00 00 00 02 40 00
				23 00 00 00 00 00 02 41 A7
				23 00 00 00 00 00 02 42 00
				23 00 00 00 00 00 02 43 B8
				23 00 00 00 00 00 02 44 00
				23 00 00 00 00 00 02 45 C7
				23 00 00 00 00 00 02 46 00
				23 00 00 00 00 00 02 47 FB
				23 00 00 00 00 00 02 48 01
				23 00 00 00 00 00 02 49 25
				23 00 00 00 00 00 02 4A 01
				23 00 00 00 00 00 02 4B 61
				23 00 00 00 00 00 02 4C 01
				23 00 00 00 00 00 02 4D 94
				23 00 00 00 00 00 02 4E 01
				23 00 00 00 00 00 02 4F E2
				23 00 00 00 00 00 02 50 02
				23 00 00 00 00 00 02 51 20
				23 00 00 00 00 00 02 52 02
				23 00 00 00 00 00 02 53 22
				23 00 00 00 00 00 02 54 02
				23 00 00 00 00 00 02 55 5C
				23 00 00 00 00 00 02 56 02
				23 00 00 00 00 00 02 58 9E
				23 00 00 00 00 00 02 59 02
				23 00 00 00 00 00 02 5A C9
				23 00 00 00 00 00 02 5B 03
				23 00 00 00 00 00 02 5C 01
				23 00 00 00 00 00 02 5D 03
				23 00 00 00 00 00 02 5E 28
				23 00 00 00 00 00 02 5F 03
				23 00 00 00 00 00 02 60 55
				23 00 00 00 00 00 02 61 03
				23 00 00 00 00 00 02 62 62
				23 00 00 00 00 00 02 63 03
				23 00 00 00 00 00 02 64 6F
				23 00 00 00 00 00 02 65 03
				23 00 00 00 00 00 02 66 7E
				23 00 00 00 00 00 02 67 03
				23 00 00 00 00 00 02 68 8F
				23 00 00 00 00 00 02 69 03
				23 00 00 00 00 00 02 6A 9C
				23 00 00 00 00 00 02 6B 03
				23 00 00 00 00 00 02 6C A2
				23 00 00 00 00 00 02 6D 03
				23 00 00 00 00 00 02 6E AB
				23 00 00 00 00 00 02 6F 03
				23 00 00 00 00 00 02 70 B2
				23 00 00 00 00 00 02 71 00
				23 00 00 00 00 00 02 72 00
				23 00 00 00 00 00 02 73 00
				23 00 00 00 00 00 02 74 1E
				23 00 00 00 00 00 02 75 00
				23 00 00 00 00 00 02 76 48
				23 00 00 00 00 00 02 77 00
				23 00 00 00 00 00 02 78 57
				23 00 00 00 00 00 02 79 00
				23 00 00 00 00 00 02 7A 6A
				23 00 00 00 00 00 02 7B 00
				23 00 00 00 00 00 02 7C 80
				23 00 00 00 00 00 02 7D 00
				23 00 00 00 00 00 02 7E 90
				23 00 00 00 00 00 02 7F 00
				23 00 00 00 00 00 02 80 A0
				23 00 00 00 00 00 02 81 00
				23 00 00 00 00 00 02 82 AE
				23 00 00 00 00 00 02 83 00
				23 00 00 00 00 00 02 84 E3
				23 00 00 00 00 00 02 85 01
				23 00 00 00 00 00 02 86 0E
				23 00 00 00 00 00 02 87 01
				23 00 00 00 00 00 02 88 50
				23 00 00 00 00 00 02 89 01
				23 00 00 00 00 00 02 8A 88
				23 00 00 00 00 00 02 8B 01
				23 00 00 00 00 00 02 8C DA
				23 00 00 00 00 00 02 8D 02
				23 00 00 00 00 00 02 8E 19
				23 00 00 00 00 00 02 8F 02
				23 00 00 00 00 00 02 90 1B
				23 00 00 00 00 00 02 91 02
				23 00 00 00 00 00 02 92 58
				23 00 00 00 00 00 02 93 02
				23 00 00 00 00 00 02 94 9C
				23 00 00 00 00 00 02 95 02
				23 00 00 00 00 00 02 96 C6
				23 00 00 00 00 00 02 97 03
				23 00 00 00 00 00 02 98 01
				23 00 00 00 00 00 02 99 03
				23 00 00 00 00 00 02 9A 28
				23 00 00 00 00 00 02 9B 03
				23 00 00 00 00 00 02 9C 55
				23 00 00 00 00 00 02 9D 03
				23 00 00 00 00 00 02 9E 62
				23 00 00 00 00 00 02 9F 03
				23 00 00 00 00 00 02 A0 6F
				23 00 00 00 00 00 02 A2 03
				23 00 00 00 00 00 02 A3 7E
				23 00 00 00 00 00 02 A4 03
				23 00 00 00 00 00 02 A5 8F
				23 00 00 00 00 00 02 A6 03
				23 00 00 00 00 00 02 A7 9C
				23 00 00 00 00 00 02 A9 03
				23 00 00 00 00 00 02 AA A2
				23 00 00 00 00 00 02 AB 03
				23 00 00 00 00 00 02 AC AB
				23 00 00 00 00 00 02 AD 03
				23 00 00 00 00 00 02 AE B2
				23 00 00 00 00 00 02 AF 00
				23 00 00 00 00 00 02 B0 00
				23 00 00 00 00 00 02 B1 00
				23 00 00 00 00 00 02 B2 1E
				23 00 00 00 00 00 02 B3 00
				23 00 00 00 00 00 02 B4 48
				23 00 00 00 00 00 02 B5 00
				23 00 00 00 00 00 02 B6 57
				23 00 00 00 00 00 02 B7 00
				23 00 00 00 00 00 02 B8 6A
				23 00 00 00 00 00 02 B9 00
				23 00 00 00 00 00 02 BA 80
				23 00 00 00 00 00 02 BB 00
				23 00 00 00 00 00 02 BC 90
				23 00 00 00 00 00 02 BD 00
				23 00 00 00 00 00 02 BE A0
				23 00 00 00 00 00 02 BF 00
				23 00 00 00 00 00 02 C0 AE
				23 00 00 00 00 00 02 C1 00
				23 00 00 00 00 00 02 C2 E3
				23 00 00 00 00 00 02 C3 01
				23 00 00 00 00 00 02 C4 0E
				23 00 00 00 00 00 02 C5 01
				23 00 00 00 00 00 02 C6 50
				23 00 00 00 00 00 02 C7 01
				23 00 00 00 00 00 02 C8 88
				23 00 00 00 00 00 02 C9 01
				23 00 00 00 00 00 02 CA DA
				23 00 00 00 00 00 02 CB 02
				23 00 00 00 00 00 02 CC 19
				23 00 00 00 00 00 02 CD 02
				23 00 00 00 00 00 02 CE 1B
				23 00 00 00 00 00 02 CF 02
				23 00 00 00 00 00 02 D0 58
				23 00 00 00 00 00 02 D1 02
				23 00 00 00 00 00 02 D2 9C
				23 00 00 00 00 00 02 D3 02
				23 00 00 00 00 00 02 D4 C6
				23 00 00 00 00 00 02 D5 03
				23 00 00 00 00 00 02 D6 01
				23 00 00 00 00 00 02 D7 03
				23 00 00 00 00 00 02 D8 28
				23 00 00 00 00 00 02 D9 03
				23 00 00 00 00 00 02 DA 55
				23 00 00 00 00 00 02 DB 03
				23 00 00 00 00 00 02 DC 62
				23 00 00 00 00 00 02 DD 03
				23 00 00 00 00 00 02 DE 6F
				23 00 00 00 00 00 02 DF 03
				23 00 00 00 00 00 02 E0 7E
				23 00 00 00 00 00 02 E1 03
				23 00 00 00 00 00 02 E2 8F
				23 00 00 00 00 00 02 E3 03
				23 00 00 00 00 00 02 E4 9C
				23 00 00 00 00 00 02 E5 03
				23 00 00 00 00 00 02 E6 A2
				23 00 00 00 00 00 02 E7 03
				23 00 00 00 00 00 02 E8 AB
				23 00 00 00 00 00 02 E9 03
				23 00 00 00 00 00 02 EA B2
				23 00 00 00 00 00 02 FF 00
				23 00 00 00 00 00 02 FF 00
				23 00 00 00 00 00 02 51 00
				23 00 00 00 00 00 02 53 2C
				23 00 00 00 00 00 02 55 00
				23 00 00 00 00 00 02 FF 00
				23 00 00 00 00 00 02 D3 0A
				23 01 00 00 00 00 02 D4 0A
				05 01 00 00 64 00 02 11 00
				05 01 00 00 00 00 02 29 00
				];
		qcom,mdss-dsi-off-command = [
				05 01 00 00 96 00 02 28 00
				05 01 00 00 3C 00 02 10 00];
		qcom,mdss-dsi-on-command-state = "dsi_lp_mode";
		qcom,mdss-dsi-off-command-state = "dsi_lp_mode";
		qcom,mdss-dsi-bl-pmic-control-type = "bl_ctrl_wled";
		qcom,mdss-dsi-reset-sequence = <1 10>, <0 1>, <1 10>, <0 1>, <1 20>;
		qcom,mdss-dsi-tx-eot-append;
	        qcom,cont-splash-enabled;
	        qcom,panel-supply-entries = <&dsi_panel_pwr_supply>;
	        qcom,mdss-pan-physical-width-dimension = <70>;
                qcom,mdss-pan-physical-height-dimension = <128>;

	        qcom,mdss-dsi-panel-status-command = [06 01 00 01 05 00 02 0A 08];
		qcom,mdss-dsi-panel-status-command-state = "dsi_hs_mode";
		qcom,mdss-dsi-panel-status-check-mode = "reg_read";
		qcom,mdss-dsi-panel-status-value = <0x9c>;
		qcom,esd-check-enabled;
	};
};
