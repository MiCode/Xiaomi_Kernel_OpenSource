/* Copyright (c) 2016-2017, The Linux Foundation. All rights reserved.
 *
 * This program is free software; you can redistribute it and/or modify
 * it under the terms of the GNU General Public License version 2 and
 * only version 2 as published by the Free Software Foundation.
 *
 * This program is distributed in the hope that it will be useful,
 * but WITHOUT ANY WARRANTY; without even the implied warranty of
 * MERCHANTABILITY or FITNESS FOR A PARTICULAR PURPOSE.  See the
 * GNU General Public License for more details.
 */

qcom,ascent_3450mah {
	/* Ascent_with_connector_3450mAh_averaged_MasterSlave_Jan6th2017 */
	qcom,max-voltage-uv = <4350000>;
	qcom,fg-cc-cv-threshold-mv = <4340>;
	qcom,fastchg-current-ma = <3450>;
	qcom,batt-id-kohm = <60>;
	qcom,battery-beta = <3435>;
	qcom,battery-type = "ascent_3450mah_averaged_masterslave_jan6th2017";
	qcom,checksum = <0x96AC>;
	qcom,gui-version = "PMI8998GUI - 2.0.0.54";
	qcom,fg-profile-data = [
		 9C 1F 85 05
		 82 0A 73 FC
		 2B 1D 72 EA
		 EE 03 66 0C
		 C8 17 F4 22
		 E0 45 1F 52
		 5C 00 00 00
		 10 00 00 00
		 00 00 4A C4
		 C7 BC 48 C2
		 0F 00 08 00
		 E1 DA 5D ED
		 8D FD B2 F3
		 96 E2 A7 12
		 7E F4 0E 3B
		 24 06 09 20
		 27 00 14 00
		 83 1F EE 05
		 1F 0A 45 FD
		 6B 1D 53 E5
		 EC 0B 31 14
		 44 18 49 23
		 18 45 A6 53
		 55 00 00 00
		 0E 00 00 00
		 00 00 61 CC
		 B7 C3 0F BC
		 0F 00 00 00
		 92 00 5D ED
		 E3 06 E0 00
		 75 FD 9C 03
		 47 DB B3 22
		 CB 33 CC FF
		 07 10 00 00
		 99 0D 99 45
		 0F 00 40 00
		 AB 01 0A FA
		 FF 00 00 00
		 00 00 00 00
		 00 00 00 00
		 00 00 00 00
		 00 00 00 00
		 00 00 00 00
		 00 00 00 00
		 00 00 00 00
		 00 00 00 00
		 00 00 00 00
		 00 00 00 00
		 00 00 00 00
		 00 00 00 00
		 00 00 00 00
		 00 00 00 00
		 00 00 00 00
		 00 00 00 00
		 00 00 00 00
		 00 00 00 00
	];
};
