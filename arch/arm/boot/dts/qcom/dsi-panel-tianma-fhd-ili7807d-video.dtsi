/* Copyright (c) 2015, The Linux Foundation. All rights reserved.
 * Copyright (C) 2020 XiaoMi, Inc.
 *
 * This program is free software; you can redistribute it and/or modify
 * it under the terms of the GNU General Public License version 2 and
 * only version 2 as published by the Free Software Foundation.
 *
 * This program is distributed in the hope that it will be useful,
 * but WITHOUT ANY WARRANTY; without even the implied warranty of
 * MERCHANTABILITY or FITNESS FOR A PARTICULAR PURPOSE.  See the
 * GNU General Public License for more details.
 */

/*---------------------------------------------------------------------------
 * This file is autogenerated file using gcdb parser. Please do not edit it.
 * Update input XML file to add a new entry or update variable in this file
 * VERSION = "1.0"
 *---------------------------------------------------------------------------
 */
&mdss_mdp {
	dsi_tianma_fhd_ili7807d_video: qcom,mdss_dsi_tianma_fhd_ili7807d_video {
		qcom,mdss-dsi-panel-name = "tianma fhd video dsi panel";
		qcom,mdss-dsi-panel-id = <0>;
		qcom,mdss-dsi-panel-model = "TIANMA FHD ILI7807D VIDEO PANEL";
		qcom,mdss-dsi-panel-sleepwrmod = <0>;
		qcom,mdss-dsi-panel-type = "dsi_video_mode";
		qcom,mdss-dsi-panel-framerate = <60>;
		qcom,mdss-dsi-virtual-channel-id = <0>;
		qcom,mdss-dsi-stream = <0>;
		qcom,mdss-dsi-panel-width = <1080>;
		qcom,mdss-dsi-panel-height = <2160>;
		qcom,mdss-dsi-h-front-porch = <140>;
		qcom,mdss-dsi-h-back-porch = <148>;
		qcom,mdss-dsi-h-pulse-width = <20>;
		qcom,mdss-dsi-h-sync-skew = <0>;
		qcom,mdss-dsi-v-back-porch = <36>;
		qcom,mdss-dsi-v-front-porch = <20>;
		qcom,mdss-dsi-v-pulse-width = <2>;
		qcom,mdss-dsi-h-left-border = <0>;
		qcom,mdss-dsi-h-right-border = <0>;
		qcom,mdss-dsi-v-top-border = <0>;
		qcom,mdss-dsi-v-bottom-border = <0>;
		qcom,mdss-dsi-bpp = <24>;
		qcom,mdss-dsi-color-order = "0";
		qcom,mdss-dsi-underflow-color = <0xff>;
		qcom,mdss-dsi-border-color = <0>;
		qcom,mdss-dsi-on-command = [
				29 00 00 00 00 00 04 FF 78 07 00
				29 00 00 00 00 00 03 51 0B 84
				15 00 00 00 00 00 02 53 24
				29 00 00 00 00 00 03 68 05 00
				15 00 00 00 00 00 02 35 00
				05 01 00 00 4B 00 02 11 00
				05 01 00 00 14 00 02 29 00
				29 00 00 00 00 00 04 FF 78 07 01
				29 00 00 00 00 00 02 35 22
				29 00 00 00 00 00 02 44 94
				29 00 00 00 00 00 02 B4 60
				29 01 00 00 00 00 02 63 0B
				29 00 00 00 00 00 04 FF 78 07 06
				29 00 00 00 00 00 02 0B 01
				29 00 00 00 00 00 02 0E 62
				29 00 00 00 00 00 02 0F 62
				29 00 00 00 00 00 02 A0 06
				29 00 00 00 00 00 02 A2 0B
				29 00 00 00 00 00 02 A6 11
				29 00 00 00 00 00 02 A7 03
				29 00 00 00 00 00 02 AE 14
				29 00 00 00 00 00 02 B2 33
				29 01 00 00 00 00 02 B3 00
				29 00 00 00 00 00 04 FF 78 07 05
				15 00 00 00 00 00 02 00 13
				15 00 00 00 00 00 02 01 14
				15 00 00 00 00 00 02 02 16
				15 00 00 00 00 00 02 03 40
				15 00 00 00 00 00 02 04 00
				15 00 00 00 00 00 02 07 90
				15 00 00 00 00 00 02 08 08
				15 00 00 00 00 00 02 28 16
				15 00 00 00 00 00 02 29 15
				15 00 00 00 00 00 02 2A 14
				15 00 00 00 00 00 02 2B 0D
				15 00 00 00 00 00 02 30 06
				15 00 00 00 00 00 02 31 00
				15 00 00 00 00 00 02 38 07
				15 00 00 00 00 00 02 39 09
				15 01 00 00 00 00 02 3A 0C
				15 00 00 00 00 00 02 40 00
				15 00 00 00 00 00 02 41 00
				15 00 00 00 00 00 02 42 00
				15 00 00 00 00 00 02 43 01
				15 00 00 00 00 00 02 44 01
				15 00 00 00 00 00 02 45 01
				15 01 00 00 00 00 02 46 01
				15 00 00 00 00 00 02 47 01
				15 00 00 00 00 00 02 48 01
				15 00 00 00 00 00 02 49 01
				15 00 00 00 00 00 02 4A 01
				15 00 00 00 00 00 02 4B 01
				15 00 00 00 00 00 02 4C 01
				15 00 00 00 00 00 02 4D 01
				15 00 00 00 00 00 02 4E 01
				15 01 00 00 00 00 02 4F 01
				15 00 00 00 00 00 02 50 01
				15 00 00 00 00 00 02 51 01
				15 00 00 00 00 00 02 52 01
				15 00 00 00 00 00 02 53 01
				15 00 00 00 00 00 02 54 01
				15 00 00 00 00 00 02 55 00
				15 00 00 00 00 00 02 56 00
				15 01 00 00 00 00 02 57 00
				15 00 00 00 00 00 02 33 00
				15 00 00 00 00 00 02 80 13
				15 00 00 00 00 00 02 81 50
				29 00 00 00 00 00 04 FF 78 07 07
				15 00 00 00 00 00 02 77 50
				15 00 00 00 00 00 02 44 07
				29 01 00 00 00 00 04 FF 78 07 00];
		qcom,mdss-dsi-off-command = [
				05 01 00 00 14 00 02 28 00
				05 01 00 00 4B 00 02 10 00];
		qcom,mdss-dsi-on-command-state = "dsi_lp_mode";
		qcom,mdss-dsi-off-command-state = "dsi_hs_mode";
		qcom,mdss-dsi-h-sync-pulse = <1>;
		qcom,mdss-dsi-traffic-mode = "burst_mode";
		qcom,mdss-dsi-bllp-eof-power-mode;
		qcom,mdss-dsi-bllp-power-mode;
		qcom,mdss-dsi-lp11-init;
		qcom,mdss-dsi-lane-0-state;
		qcom,mdss-dsi-lane-1-state;
		qcom,mdss-dsi-lane-2-state;
		qcom,mdss-dsi-lane-3-state;
		qcom,mdss-dsi-panel-timings =
					[ce 2e 1e 00 5a 5c 24 30 24 03 04 00];
		qcom,mdss-dsi-t-clk-post = <0x0A>;
		qcom,mdss-dsi-t-clk-pre = <0x35>;
		qcom,mdss-dsi-bl-min-level = <1>;
		qcom,mdss-dsi-bl-max-level = <4095>;
		qcom,mdss-brightness-max-level = <4095>;
		qcom,mdss-dsi-dma-trigger = "trigger_sw";
		qcom,mdss-dsi-mdp-trigger = "none";
		qcom,mdss-dsi-bl-pmic-control-type = "bl_ctrl_wled";
		qcom,mdss-dsi-reset-sequence = <1 1>, <0 1>, <1 10>;
		qcom,mdss-pan-physical-width-dimension = <78>;
		qcom,mdss-pan-physical-height-dimension = <156>;
		qcom,mdss-dsi-tx-eot-append;
		qcom,ulps-enabled;
		qcom,esd-err-irq-gpio = <&tlmm 59 0x2002>;
		qcom,esd-check-enabled;
		qcom,initial-esd-check-cmd = <0x0A 0x9C 20>;
		qcom,dispparam-enabled;
		qcom,mdss-panel-on-dimming-delay = <120>;
		qcom,mdss-dsi-dispparam-dimmingon-command = [
			15 01 00 00 01 00 02 53 2C];
		qcom,mdss-dsi-dispparam-cabcon-command = [
			29 00 00 00 00 00 04 FF 78 07 05
			15 00 00 00 00 00 02 2B 0D
			29 01 00 00 00 00 04 FF 78 07 00];
		qcom,mdss-dsi-dispparam-cabcstillon-command = [
			29 00 00 00 00 00 04 FF 78 07 05
			15 00 00 00 00 00 02 2B 0F
			29 01 00 00 00 00 04 FF 78 07 00];
		qcom,mdss-dsi-dispparam-cabcmovieon-command = [
			29 00 00 00 00 00 04 FF 78 07 05
			15 00 00 00 00 00 02 2B 0E
			29 01 00 00 00 00 04 FF 78 07 00];
		qcom,mdss-dsi-dispparam-cabcoff-command = [
			29 00 00 00 00 00 04 FF 78 07 05
			15 00 00 00 00 00 02 2B 08
			29 01 00 00 00 00 04 FF 78 07 00];
		qcom,mdss-dsi-dispparam-skin-ce-command = [
			29 00 00 00 00 00 04 FF 78 07 05
			15 00 00 00 00 00 02 31 10
			29 01 00 00 00 00 04 FF 78 07 00];
		qcom,mdss-dsi-dispparam-skin-ce-off-command = [
			29 00 00 00 00 00 04 FF 78 07 05
			15 00 00 00 00 00 02 31 00
			29 01 00 00 00 00 04 FF 78 07 00];
		qcom,mdss-dsi-dispparam-hbm-l1-on-command = [
			29 01 00 00 00 00 03 51 0C CC];
		qcom,mdss-dsi-dispparam-hbm-l2-on-command = [
			29 01 00 00 00 00 03 51 0E 65];
		qcom,mdss-dsi-dispparam-hbm-l3-on-command = [
			29 01 00 00 00 00 03 51 0F FF];
		qcom,mdss-dsi-dispparam-hbm-off-command = [
			29 01 00 00 00 00 03 51 0B 84];
	};
};
