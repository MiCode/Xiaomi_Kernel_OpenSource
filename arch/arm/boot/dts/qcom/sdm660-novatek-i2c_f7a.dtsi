/*
 * Synaptics DSX touchscreen driver
 *
 * Copyright (C) 2012-2016 Synaptics Incorporated. All rights reserved.
 *
 * Copyright (C) 2012 Alexandra Chin <alexandra.chin@tw.synaptics.com>
 * Copyright (C) 2012 Scott Lin <scott.lin@tw.synaptics.com>
 *
 * This program is free software; you can redistribute it and/or modify
 * it under the terms of the GNU General Public License as published by
 * the Free Software Foundation; either version 2 of the License, or
 * (at your option) any later version.
 *
 * This program is distributed in the hope that it will be useful,
 * but WITHOUT ANY WARRANTY; without even the implied warranty of
 * MERCHANTABILITY or FITNESS FOR A PARTICULAR PURPOSE. See the
 * GNU General Public License for more details.
 *
 * INFORMATION CONTAINED IN THIS DOCUMENT IS PROVIDED "AS-IS," AND SYNAPTICS
 * EXPRESSLY DISCLAIMS ALL EXPRESS AND IMPLIED WARRANTIES, INCLUDING ANY
 * IMPLIED WARRANTIES OF MERCHANTABILITY AND FITNESS FOR A PARTICULAR PURPOSE,
 * AND ANY WARRANTIES OF NON-INFRINGEMENT OF ANY INTELLECTUAL PROPERTY RIGHTS.
 * IN NO EVENT SHALL SYNAPTICS BE LIABLE FOR ANY DIRECT, INDIRECT, INCIDENTAL,
 * SPECIAL, PUNITIVE, OR CONSEQUENTIAL DAMAGES ARISING OUT OF OR IN CONNECTION
 * WITH THE USE OF THE INFORMATION CONTAINED IN THIS DOCUMENT, HOWEVER CAUSED
 * AND BASED ON ANY THEORY OF LIABILITY, WHETHER IN AN ACTION OF CONTRACT,
 * NEGLIGENCE OR OTHER TORTIOUS ACTION, AND EVEN IF SYNAPTICS WAS ADVISED OF
 * THE POSSIBILITY OF SUCH DAMAGE. IF A TRIBUNAL OF COMPETENT JURISDICTION DOES
 * NOT PERMIT THE DISCLAIMER OF DIRECT DAMAGES OR ANY OTHER DAMAGES, SYNAPTICS'
 * TOTAL CUMULATIVE LIABILITY TO ANY PARTY SHALL NOT EXCEED ONE HUNDRED U.S.
 * DOLLARS.
 */

&i2c_1{
    /* Novatek device tree node */
    status = "ok";
    novatek@62 {
        compatible = "novatek,NVT-ts";
        reg = <0x62>;
        interrupt-parent = <&tlmm>;
        interrupts = <67 0x2008>;
        //vdd-supply = <&pm8994_lvs2>;
        //avdd-supply = <&pm8994_l22>;
        vcc_i2c-supply=<&pm660_l11>;
        pinctrl-names = "pmx_ts_active", "pmx_ts_suspend";
        pinctrl-0 = <&ts_active>;
        pinctrl-1 = <&ts_int_suspend &ts_reset_suspend>;
        novatek,reset-gpio = <&tlmm 66 0x00>;
        novatek,irq-gpio = <&tlmm 67 0x2001>;

        /* MP */
        novatek,mp-support-dt;

        /* for Xiaomi F7A Tianma NVT36672A module TM6.30" */
        novatek-mp-criteria-5911@0 {

            #address-cells = <1>;
            #size-cells = <0>;
            compatible = "novatek-mp-criteria-5911";

            /* MP Config */
            IC_X_CFG_SIZE = <18>;
            IC_Y_CFG_SIZE = <36>;
            IC_KEY_CFG_SIZE = <4>;
            X_Channel = <18>;
            Y_Channel = <36>;
            AIN_X = <0 1 2 3 4 5 6 7 8 9 10 11 12 13 14 15 16 17>;
            AIN_Y = <0 1 2 3 4 5 6 7 8 9 10 11 12 13 14 15 16 17
                18 19 20 21 22 23 24 25 26 27 28 29 30 31 32 33 34 35>;

            AIN_KEY = <0 1 2 0xFF>;

            /* MP Criteria */
            PS_Config_Lmt_Short_Rawdata_P = <
                14000 14000 14000 14000 14000 14000 14000 14000 14000 14000 14000 14000 14000 14000 14000 14000 14000 14000
                14000 14000 14000 14000 14000 14000 14000 14000 14000 14000 14000 14000 14000 14000 14000 14000 14000 14000
                14000 14000 14000 14000 14000 14000 14000 14000 14000 14000 14000 14000 14000 14000 14000 14000 14000 14000
                14000 14000 14000 14000 14000 14000 14000 14000 14000 14000 14000 14000 14000 14000 14000 14000 14000 14000
                14000 14000 14000 14000 14000 14000 14000 14000 14000 14000 14000 14000 14000 14000 14000 14000 14000 14000
                14000 14000 14000 14000 14000 14000 14000 14000 14000 14000 14000 14000 14000 14000 14000 14000 14000 14000
                14000 14000 14000 14000 14000 14000 14000 14000 14000 14000 14000 14000 14000 14000 14000 14000 14000 14000
                14000 14000 14000 14000 14000 14000 14000 14000 14000 14000 14000 14000 14000 14000 14000 14000 14000 14000
                14000 14000 14000 14000 14000 14000 14000 14000 14000 14000 14000 14000 14000 14000 14000 14000 14000 14000
                14000 14000 14000 14000 14000 14000 14000 14000 14000 14000 14000 14000 14000 14000 14000 14000 14000 14000
                14000 14000 14000 14000 14000 14000 14000 14000 14000 14000 14000 14000 14000 14000 14000 14000 14000 14000
                14000 14000 14000 14000 14000 14000 14000 14000 14000 14000 14000 14000 14000 14000 14000 14000 14000 14000
                14000 14000 14000 14000 14000 14000 14000 14000 14000 14000 14000 14000 14000 14000 14000 14000 14000 14000
                14000 14000 14000 14000 14000 14000 14000 14000 14000 14000 14000 14000 14000 14000 14000 14000 14000 14000
                14000 14000 14000 14000 14000 14000 14000 14000 14000 14000 14000 14000 14000 14000 14000 14000 14000 14000
                14000 14000 14000 14000 14000 14000 14000 14000 14000 14000 14000 14000 14000 14000 14000 14000 14000 14000
                14000 14000 14000 14000 14000 14000 14000 14000 14000 14000 14000 14000 14000 14000 14000 14000 14000 14000
                14000 14000 14000 14000 14000 14000 14000 14000 14000 14000 14000 14000 14000 14000 14000 14000 14000 14000
                14000 14000 14000 14000 14000 14000 14000 14000 14000 14000 14000 14000 14000 14000 14000 14000 14000 14000
                14000 14000 14000 14000 14000 14000 14000 14000 14000 14000 14000 14000 14000 14000 14000 14000 14000 14000
                14000 14000 14000 14000 14000 14000 14000 14000 14000 14000 14000 14000 14000 14000 14000 14000 14000 14000
                14000 14000 14000 14000 14000 14000 14000 14000 14000 14000 14000 14000 14000 14000 14000 14000 14000 14000
                14000 14000 14000 14000 14000 14000 14000 14000 14000 14000 14000 14000 14000 14000 14000 14000 14000 14000
                14000 14000 14000 14000 14000 14000 14000 14000 14000 14000 14000 14000 14000 14000 14000 14000 14000 14000
                14000 14000 14000 14000 14000 14000 14000 14000 14000 14000 14000 14000 14000 14000 14000 14000 14000 14000
                14000 14000 14000 14000 14000 14000 14000 14000 14000 14000 14000 14000 14000 14000 14000 14000 14000 14000
                14000 14000 14000 14000 14000 14000 14000 14000 14000 14000 14000 14000 14000 14000 14000 14000 14000 14000
                14000 14000 14000 14000 14000 14000 14000 14000 14000 14000 14000 14000 14000 14000 14000 14000 14000 14000
                14000 14000 14000 14000 14000 14000 14000 14000 14000 14000 14000 14000 14000 14000 14000 14000 14000 14000
                14000 14000 14000 14000 14000 14000 14000 14000 14000 14000 14000 14000 14000 14000 14000 14000 14000 14000
                14000 14000 14000 14000 14000 14000 14000 14000 14000 14000 14000 14000 14000 14000 14000 14000 14000 14000
                14000 14000 14000 14000 14000 14000 14000 14000 14000 14000 14000 14000 14000 14000 14000 14000 14000 14000
                14000 14000 14000 14000 14000 14000 14000 14000 14000 14000 14000 14000 14000 14000 14000 14000 14000 14000
                14000 14000 14000 14000 14000 14000 14000 14000 14000 14000 14000 14000 14000 14000 14000 14000 14000 14000
                14000 14000 14000 14000 14000 14000 14000 14000 14000 14000 14000 14000 14000 14000 14000 14000 14000 14000
                14000 14000 14000 14000 14000 14000 14000 14000 14000 14000 14000 14000 14000 14000 14000 14000 14000 14000
                20000 20000 20000>;

            PS_Config_Lmt_Short_Rawdata_N = <
                11000 11000 11000 11000 11000 11000 11000 11000 11000 11000 11000 11000 11000 11000 11000 11000 11000 11000
                11000 11000 11000 11000 11000 11000 11000 11000 11000 11000 11000 11000 11000 11000 11000 11000 11000 11000
                11000 11000 11000 11000 11000 11000 11000 11000 11000 11000 11000 11000 11000 11000 11000 11000 11000 11000
                11000 11000 11000 11000 11000 11000 11000 11000 11000 11000 11000 11000 11000 11000 11000 11000 11000 11000
                11000 11000 11000 11000 11000 11000 11000 11000 11000 11000 11000 11000 11000 11000 11000 11000 11000 11000
                11000 11000 11000 11000 11000 11000 11000 11000 11000 11000 11000 11000 11000 11000 11000 11000 11000 11000
                11000 11000 11000 11000 11000 11000 11000 11000 11000 11000 11000 11000 11000 11000 11000 11000 11000 11000
                11000 11000 11000 11000 11000 11000 11000 11000 11000 11000 11000 11000 11000 11000 11000 11000 11000 11000
                11000 11000 11000 11000 11000 11000 11000 11000 11000 11000 11000 11000 11000 11000 11000 11000 11000 11000
                11000 11000 11000 11000 11000 11000 11000 11000 11000 11000 11000 11000 11000 11000 11000 11000 11000 11000
                11000 11000 11000 11000 11000 11000 11000 11000 11000 11000 11000 11000 11000 11000 11000 11000 11000 11000
                11000 11000 11000 11000 11000 11000 11000 11000 11000 11000 11000 11000 11000 11000 11000 11000 11000 11000
                11000 11000 11000 11000 11000 11000 11000 11000 11000 11000 11000 11000 11000 11000 11000 11000 11000 11000
                11000 11000 11000 11000 11000 11000 11000 11000 11000 11000 11000 11000 11000 11000 11000 11000 11000 11000
                11000 11000 11000 11000 11000 11000 11000 11000 11000 11000 11000 11000 11000 11000 11000 11000 11000 11000
                11000 11000 11000 11000 11000 11000 11000 11000 11000 11000 11000 11000 11000 11000 11000 11000 11000 11000
                11000 11000 11000 11000 11000 11000 11000 11000 11000 11000 11000 11000 11000 11000 11000 11000 11000 11000
                11000 11000 11000 11000 11000 11000 11000 11000 11000 11000 11000 11000 11000 11000 11000 11000 11000 11000
                11000 11000 11000 11000 11000 11000 11000 11000 11000 11000 11000 11000 11000 11000 11000 11000 11000 11000
                11000 11000 11000 11000 11000 11000 11000 11000 11000 11000 11000 11000 11000 11000 11000 11000 11000 11000
                11000 11000 11000 11000 11000 11000 11000 11000 11000 11000 11000 11000 11000 11000 11000 11000 11000 11000
                11000 11000 11000 11000 11000 11000 11000 11000 11000 11000 11000 11000 11000 11000 11000 11000 11000 11000
                11000 11000 11000 11000 11000 11000 11000 11000 11000 11000 11000 11000 11000 11000 11000 11000 11000 11000
                11000 11000 11000 11000 11000 11000 11000 11000 11000 11000 11000 11000 11000 11000 11000 11000 11000 11000
                11000 11000 11000 11000 11000 11000 11000 11000 11000 11000 11000 11000 11000 11000 11000 11000 11000 11000
                11000 11000 11000 11000 11000 11000 11000 11000 11000 11000 11000 11000 11000 11000 11000 11000 11000 11000
                11000 11000 11000 11000 11000 11000 11000 11000 11000 11000 11000 11000 11000 11000 11000 11000 11000 11000
                11000 11000 11000 11000 11000 11000 11000 11000 11000 11000 11000 11000 11000 11000 11000 11000 11000 11000
                11000 11000 11000 11000 11000 11000 11000 11000 11000 11000 11000 11000 11000 11000 11000 11000 11000 11000
                11000 11000 11000 11000 11000 11000 11000 11000 11000 11000 11000 11000 11000 11000 11000 11000 11000 11000
                11000 11000 11000 11000 11000 11000 11000 11000 11000 11000 11000 11000 11000 11000 11000 11000 11000 11000
                11000 11000 11000 11000 11000 11000 11000 11000 11000 11000 11000 11000 11000 11000 11000 11000 11000 11000
                11000 11000 11000 11000 11000 11000 11000 11000 11000 11000 11000 11000 11000 11000 11000 11000 11000 11000
                11000 11000 11000 11000 11000 11000 11000 11000 11000 11000 11000 11000 11000 11000 11000 11000 11000 11000
                11000 11000 11000 11000 11000 11000 11000 11000 11000 11000 11000 11000 11000 11000 11000 11000 11000 11000
                11000 11000 11000 11000 11000 11000 11000 11000 11000 11000 11000 11000 11000 11000 11000 11000 11000 11000
                11550 11550 11550>;

            PS_Config_Lmt_Short_Diff_P = <
                6300 6300 6300 6300 6300 6300 6300 6300 6300 6300 6300 6300 6300 6300 6300 6300 6300 6300
                6300 6300 6300 6300 6300 6300 6300 6300 6300 6300 6300 6300 6300 6300 6300 6300 6300 6300
                6300 6300 6300 6300 6300 6300 6300 6300 6300 6300 6300 6300 6300 6300 6300 6300 6300 6300
                6300 6300 6300 6300 6300 6300 6300 6300 6300 6300 6300 6300 6300 6300 6300 6300 6300 6300
                6300 6300 6300 6300 6300 6300 6300 6300 6300 6300 6300 6300 6300 6300 6300 6300 6300 6300
                6300 6300 6300 6300 6300 6300 6300 6300 6300 6300 6300 6300 6300 6300 6300 6300 6300 6300
                6300 6300 6300 6300 6300 6300 6300 6300 6300 6300 6300 6300 6300 6300 6300 6300 6300 6300
                6300 6300 6300 6300 6300 6300 6300 6300 6300 6300 6300 6300 6300 6300 6300 6300 6300 6300
                6300 6300 6300 6300 6300 6300 6300 6300 6300 6300 6300 6300 6300 6300 6300 6300 6300 6300
                6300 6300 6300 6300 6300 6300 6300 6300 6300 6300 6300 6300 6300 6300 6300 6300 6300 6300
                6300 6300 6300 6300 6300 6300 6300 6300 6300 6300 6300 6300 6300 6300 6300 6300 6300 6300
                6300 6300 6300 6300 6300 6300 6300 6300 6300 6300 6300 6300 6300 6300 6300 6300 6300 6300
                6300 6300 6300 6300 6300 6300 6300 6300 6300 6300 6300 6300 6300 6300 6300 6300 6300 6300
                6300 6300 6300 6300 6300 6300 6300 6300 6300 6300 6300 6300 6300 6300 6300 6300 6300 6300
                6300 6300 6300 6300 6300 6300 6300 6300 6300 6300 6300 6300 6300 6300 6300 6300 6300 6300
                6300 6300 6300 6300 6300 6300 6300 6300 6300 6300 6300 6300 6300 6300 6300 6300 6300 6300
                6300 6300 6300 6300 6300 6300 6300 6300 6300 6300 6300 6300 6300 6300 6300 6300 6300 6300
                6300 6300 6300 6300 6300 6300 6300 6300 6300 6300 6300 6300 6300 6300 6300 6300 6300 6300
                6300 6300 6300 6300 6300 6300 6300 6300 6300 6300 6300 6300 6300 6300 6300 6300 6300 6300
                6300 6300 6300 6300 6300 6300 6300 6300 6300 6300 6300 6300 6300 6300 6300 6300 6300 6300
                6300 6300 6300 6300 6300 6300 6300 6300 6300 6300 6300 6300 6300 6300 6300 6300 6300 6300
                6300 6300 6300 6300 6300 6300 6300 6300 6300 6300 6300 6300 6300 6300 6300 6300 6300 6300
                6300 6300 6300 6300 6300 6300 6300 6300 6300 6300 6300 6300 6300 6300 6300 6300 6300 6300
                6300 6300 6300 6300 6300 6300 6300 6300 6300 6300 6300 6300 6300 6300 6300 6300 6300 6300
                6300 6300 6300 6300 6300 6300 6300 6300 6300 6300 6300 6300 6300 6300 6300 6300 6300 6300
                6300 6300 6300 6300 6300 6300 6300 6300 6300 6300 6300 6300 6300 6300 6300 6300 6300 6300
                6300 6300 6300 6300 6300 6300 6300 6300 6300 6300 6300 6300 6300 6300 6300 6300 6300 6300
                6300 6300 6300 6300 6300 6300 6300 6300 6300 6300 6300 6300 6300 6300 6300 6300 6300 6300
                6300 6300 6300 6300 6300 6300 6300 6300 6300 6300 6300 6300 6300 6300 6300 6300 6300 6300
                6300 6300 6300 6300 6300 6300 6300 6300 6300 6300 6300 6300 6300 6300 6300 6300 6300 6300
                6300 6300 6300 6300 6300 6300 6300 6300 6300 6300 6300 6300 6300 6300 6300 6300 6300 6300
                6300 6300 6300 6300 6300 6300 6300 6300 6300 6300 6300 6300 6300 6300 6300 6300 6300 6300
                6300 6300 6300>;

            PS_Config_Lmt_Short_Diff_N = <
                0 0 0 0 0 0 0 0 0 0 0 0 0 0 0 0 0 0
                0 0 0 0 0 0 0 0 0 0 0 0 0 0 0 0 0 0
                0 0 0 0 0 0 0 0 0 0 0 0 0 0 0 0 0 0
                0 0 0 0 0 0 0 0 0 0 0 0 0 0 0 0 0 0
                0 0 0 0 0 0 0 0 0 0 0 0 0 0 0 0 0 0
                0 0 0 0 0 0 0 0 0 0 0 0 0 0 0 0 0 0
                0 0 0 0 0 0 0 0 0 0 0 0 0 0 0 0 0 0
                0 0 0 0 0 0 0 0 0 0 0 0 0 0 0 0 0 0
                0 0 0 0 0 0 0 0 0 0 0 0 0 0 0 0 0 0
                0 0 0 0 0 0 0 0 0 0 0 0 0 0 0 0 0 0
                0 0 0 0 0 0 0 0 0 0 0 0 0 0 0 0 0 0
                0 0 0 0 0 0 0 0 0 0 0 0 0 0 0 0 0 0
                0 0 0 0 0 0 0 0 0 0 0 0 0 0 0 0 0 0
                0 0 0 0 0 0 0 0 0 0 0 0 0 0 0 0 0 0
                0 0 0 0 0 0 0 0 0 0 0 0 0 0 0 0 0 0
                0 0 0 0 0 0 0 0 0 0 0 0 0 0 0 0 0 0
                0 0 0 0 0 0 0 0 0 0 0 0 0 0 0 0 0 0
                0 0 0 0 0 0 0 0 0 0 0 0 0 0 0 0 0 0
                0 0 0 0 0 0 0 0 0 0 0 0 0 0 0 0 0 0
                0 0 0 0 0 0 0 0 0 0 0 0 0 0 0 0 0 0
                0 0 0 0 0 0 0 0 0 0 0 0 0 0 0 0 0 0
                0 0 0 0 0 0 0 0 0 0 0 0 0 0 0 0 0 0
                0 0 0 0 0 0 0 0 0 0 0 0 0 0 0 0 0 0
                0 0 0 0 0 0 0 0 0 0 0 0 0 0 0 0 0 0
                0 0 0 0 0 0 0 0 0 0 0 0 0 0 0 0 0 0
                0 0 0 0 0 0 0 0 0 0 0 0 0 0 0 0 0 0
                0 0 0 0 0 0 0 0 0 0 0 0 0 0 0 0 0 0
                0 0 0 0 0 0 0 0 0 0 0 0 0 0 0 0 0 0
                0 0 0 0 0 0 0 0 0 0 0 0 0 0 0 0 0 0
                0 0 0 0 0 0 0 0 0 0 0 0 0 0 0 0 0 0
                0 0 0 0 0 0 0 0 0 0 0 0 0 0 0 0 0 0
                0 0 0 0 0 0 0 0 0 0 0 0 0 0 0 0 0 0
                0 0 0>;

            PS_Config_Lmt_Short_Base_P = <
                2000 2000 2000 2000 2000 2000 2000 2000 2000 2000 2000 2000 2000 2000 2000 2000 2000 2000
                2000 2000 2000 2000 2000 2000 2000 2000 2000 2000 2000 2000 2000 2000 2000 2000 2000 2000
                2000 2000 2000 2000 2000 2000 2000 2000 2000 2000 2000 2000 2000 2000 2000 2000 2000 2000
                2000 2000 2000 2000 2000 2000 2000 2000 2000 2000 2000 2000 2000 2000 2000 2000 2000 2000
                2000 2000 2000 2000 2000 2000 2000 2000 2000 2000 2000 2000 2000 2000 2000 2000 2000 2000
                2000 2000 2000 2000 2000 2000 2000 2000 2000 2000 2000 2000 2000 2000 2000 2000 2000 2000
                2000 2000 2000 2000 2000 2000 2000 2000 2000 2000 2000 2000 2000 2000 2000 2000 2000 2000
                2000 2000 2000 2000 2000 2000 2000 2000 2000 2000 2000 2000 2000 2000 2000 2000 2000 2000
                2000 2000 2000 2000 2000 2000 2000 2000 2000 2000 2000 2000 2000 2000 2000 2000 2000 2000
                2000 2000 2000 2000 2000 2000 2000 2000 2000 2000 2000 2000 2000 2000 2000 2000 2000 2000
                2000 2000 2000 2000 2000 2000 2000 2000 2000 2000 2000 2000 2000 2000 2000 2000 2000 2000
                2000 2000 2000 2000 2000 2000 2000 2000 2000 2000 2000 2000 2000 2000 2000 2000 2000 2000
                2000 2000 2000 2000 2000 2000 2000 2000 2000 2000 2000 2000 2000 2000 2000 2000 2000 2000
                2000 2000 2000 2000 2000 2000 2000 2000 2000 2000 2000 2000 2000 2000 2000 2000 2000 2000
                2000 2000 2000 2000 2000 2000 2000 2000 2000 2000 2000 2000 2000 2000 2000 2000 2000 2000
                2000 2000 2000 2000 2000 2000 2000 2000 2000 2000 2000 2000 2000 2000 2000 2000 2000 2000
                2000 2000 2000 2000 2000 2000 2000 2000 2000 2000 2000 2000 2000 2000 2000 2000 2000 2000
                2000 2000 2000 2000 2000 2000 2000 2000 2000 2000 2000 2000 2000 2000 2000 2000 2000 2000
                2000 2000 2000 2000 2000 2000 2000 2000 2000 2000 2000 2000 2000 2000 2000 2000 2000 2000
                2000 2000 2000 2000 2000 2000 2000 2000 2000 2000 2000 2000 2000 2000 2000 2000 2000 2000
                2000 2000 2000 2000 2000 2000 2000 2000 2000 2000 2000 2000 2000 2000 2000 2000 2000 2000
                2000 2000 2000 2000 2000 2000 2000 2000 2000 2000 2000 2000 2000 2000 2000 2000 2000 2000
                2000 2000 2000 2000 2000 2000 2000 2000 2000 2000 2000 2000 2000 2000 2000 2000 2000 2000
                2000 2000 2000 2000 2000 2000 2000 2000 2000 2000 2000 2000 2000 2000 2000 2000 2000 2000
                2000 2000 2000 2000 2000 2000 2000 2000 2000 2000 2000 2000 2000 2000 2000 2000 2000 2000
                2000 2000 2000 2000 2000 2000 2000 2000 2000 2000 2000 2000 2000 2000 2000 2000 2000 2000
                2000 2000 2000 2000 2000 2000 2000 2000 2000 2000 2000 2000 2000 2000 2000 2000 2000 2000
                2000 2000 2000 2000 2000 2000 2000 2000 2000 2000 2000 2000 2000 2000 2000 2000 2000 2000
                2000 2000 2000 2000 2000 2000 2000 2000 2000 2000 2000 2000 2000 2000 2000 2000 2000 2000
                2000 2000 2000 2000 2000 2000 2000 2000 2000 2000 2000 2000 2000 2000 2000 2000 2000 2000
                2000 2000 2000 2000 2000 2000 2000 2000 2000 2000 2000 2000 2000 2000 2000 2000 2000 2000
                2000 2000 2000 2000 2000 2000 2000 2000 2000 2000 2000 2000 2000 2000 2000 2000 2000 2000
                2000 2000 2000>;

            PS_Config_Lmt_Short_Base_N = <
                (-2000) (-2000) (-2000) (-2000) (-2000) (-2000) (-2000) (-2000) (-2000) (-2000) (-2000) (-2000) (-2000) (-2000) (-2000) (-2000) (-2000) (-2000)
                (-2000) (-2000) (-2000) (-2000) (-2000) (-2000) (-2000) (-2000) (-2000) (-2000) (-2000) (-2000) (-2000) (-2000) (-2000) (-2000) (-2000) (-2000)
                (-2000) (-2000) (-2000) (-2000) (-2000) (-2000) (-2000) (-2000) (-2000) (-2000) (-2000) (-2000) (-2000) (-2000) (-2000) (-2000) (-2000) (-2000)
                (-2000) (-2000) (-2000) (-2000) (-2000) (-2000) (-2000) (-2000) (-2000) (-2000) (-2000) (-2000) (-2000) (-2000) (-2000) (-2000) (-2000) (-2000)
                (-2000) (-2000) (-2000) (-2000) (-2000) (-2000) (-2000) (-2000) (-2000) (-2000) (-2000) (-2000) (-2000) (-2000) (-2000) (-2000) (-2000) (-2000)
                (-2000) (-2000) (-2000) (-2000) (-2000) (-2000) (-2000) (-2000) (-2000) (-2000) (-2000) (-2000) (-2000) (-2000) (-2000) (-2000) (-2000) (-2000)
                (-2000) (-2000) (-2000) (-2000) (-2000) (-2000) (-2000) (-2000) (-2000) (-2000) (-2000) (-2000) (-2000) (-2000) (-2000) (-2000) (-2000) (-2000)
                (-2000) (-2000) (-2000) (-2000) (-2000) (-2000) (-2000) (-2000) (-2000) (-2000) (-2000) (-2000) (-2000) (-2000) (-2000) (-2000) (-2000) (-2000)
                (-2000) (-2000) (-2000) (-2000) (-2000) (-2000) (-2000) (-2000) (-2000) (-2000) (-2000) (-2000) (-2000) (-2000) (-2000) (-2000) (-2000) (-2000)
                (-2000) (-2000) (-2000) (-2000) (-2000) (-2000) (-2000) (-2000) (-2000) (-2000) (-2000) (-2000) (-2000) (-2000) (-2000) (-2000) (-2000) (-2000)
                (-2000) (-2000) (-2000) (-2000) (-2000) (-2000) (-2000) (-2000) (-2000) (-2000) (-2000) (-2000) (-2000) (-2000) (-2000) (-2000) (-2000) (-2000)
                (-2000) (-2000) (-2000) (-2000) (-2000) (-2000) (-2000) (-2000) (-2000) (-2000) (-2000) (-2000) (-2000) (-2000) (-2000) (-2000) (-2000) (-2000)
                (-2000) (-2000) (-2000) (-2000) (-2000) (-2000) (-2000) (-2000) (-2000) (-2000) (-2000) (-2000) (-2000) (-2000) (-2000) (-2000) (-2000) (-2000)
                (-2000) (-2000) (-2000) (-2000) (-2000) (-2000) (-2000) (-2000) (-2000) (-2000) (-2000) (-2000) (-2000) (-2000) (-2000) (-2000) (-2000) (-2000)
                (-2000) (-2000) (-2000) (-2000) (-2000) (-2000) (-2000) (-2000) (-2000) (-2000) (-2000) (-2000) (-2000) (-2000) (-2000) (-2000) (-2000) (-2000)
                (-2000) (-2000) (-2000) (-2000) (-2000) (-2000) (-2000) (-2000) (-2000) (-2000) (-2000) (-2000) (-2000) (-2000) (-2000) (-2000) (-2000) (-2000)
                (-2000) (-2000) (-2000) (-2000) (-2000) (-2000) (-2000) (-2000) (-2000) (-2000) (-2000) (-2000) (-2000) (-2000) (-2000) (-2000) (-2000) (-2000)
                (-2000) (-2000) (-2000) (-2000) (-2000) (-2000) (-2000) (-2000) (-2000) (-2000) (-2000) (-2000) (-2000) (-2000) (-2000) (-2000) (-2000) (-2000)
                (-2000) (-2000) (-2000) (-2000) (-2000) (-2000) (-2000) (-2000) (-2000) (-2000) (-2000) (-2000) (-2000) (-2000) (-2000) (-2000) (-2000) (-2000)
                (-2000) (-2000) (-2000) (-2000) (-2000) (-2000) (-2000) (-2000) (-2000) (-2000) (-2000) (-2000) (-2000) (-2000) (-2000) (-2000) (-2000) (-2000)
                (-2000) (-2000) (-2000) (-2000) (-2000) (-2000) (-2000) (-2000) (-2000) (-2000) (-2000) (-2000) (-2000) (-2000) (-2000) (-2000) (-2000) (-2000)
                (-2000) (-2000) (-2000) (-2000) (-2000) (-2000) (-2000) (-2000) (-2000) (-2000) (-2000) (-2000) (-2000) (-2000) (-2000) (-2000) (-2000) (-2000)
                (-2000) (-2000) (-2000) (-2000) (-2000) (-2000) (-2000) (-2000) (-2000) (-2000) (-2000) (-2000) (-2000) (-2000) (-2000) (-2000) (-2000) (-2000)
                (-2000) (-2000) (-2000) (-2000) (-2000) (-2000) (-2000) (-2000) (-2000) (-2000) (-2000) (-2000) (-2000) (-2000) (-2000) (-2000) (-2000) (-2000)
                (-2000) (-2000) (-2000) (-2000) (-2000) (-2000) (-2000) (-2000) (-2000) (-2000) (-2000) (-2000) (-2000) (-2000) (-2000) (-2000) (-2000) (-2000)
                (-2000) (-2000) (-2000) (-2000) (-2000) (-2000) (-2000) (-2000) (-2000) (-2000) (-2000) (-2000) (-2000) (-2000) (-2000) (-2000) (-2000) (-2000)
                (-2000) (-2000) (-2000) (-2000) (-2000) (-2000) (-2000) (-2000) (-2000) (-2000) (-2000) (-2000) (-2000) (-2000) (-2000) (-2000) (-2000) (-2000)
                (-2000) (-2000) (-2000) (-2000) (-2000) (-2000) (-2000) (-2000) (-2000) (-2000) (-2000) (-2000) (-2000) (-2000) (-2000) (-2000) (-2000) (-2000)
                (-2000) (-2000) (-2000) (-2000) (-2000) (-2000) (-2000) (-2000) (-2000) (-2000) (-2000) (-2000) (-2000) (-2000) (-2000) (-2000) (-2000) (-2000)
                (-2000) (-2000) (-2000) (-2000) (-2000) (-2000) (-2000) (-2000) (-2000) (-2000) (-2000) (-2000) (-2000) (-2000) (-2000) (-2000) (-2000) (-2000)
                (-2000) (-2000) (-2000) (-2000) (-2000) (-2000) (-2000) (-2000) (-2000) (-2000) (-2000) (-2000) (-2000) (-2000) (-2000) (-2000) (-2000) (-2000)
                (-2000) (-2000) (-2000) (-2000) (-2000) (-2000) (-2000) (-2000) (-2000) (-2000) (-2000) (-2000) (-2000) (-2000) (-2000) (-2000) (-2000) (-2000)
                (-2000) (-2000) (-2000)>;

            PS_Config_Lmt_Open_Rawdata_P = <
                1899 2849 2960 2962 2967 2959 2964 2813 65535 65535 2838 3003 2990 2999 3011 3025 2905 1912
                2800 2957 2951 2954 2956 2947 2954 2936 2856 2887 2973 2992 2984 2992 3004 3016 3022 2833
                2981 2976 2970 2971 2974 2966 2970 2954 2940 2960 2973 2992 2985 2989 3003 3014 3020 3028
                2971 2971 2974 2975 2975 2966 2970 2952 2938 2959 2974 2995 2990 2994 3009 3022 3027 3032
                2993 2970 2966 2966 2965 2959 2962 2945 2932 2966 2980 2993 2992 2995 3007 3020 3027 3030
                2992 2969 2970 2969 2966 2960 2962 2943 2931 2971 2984 2997 2995 3002 3013 3022 3031 3032
                2985 2984 2980 2978 2976 2970 2973 2952 2945 2973 2988 2998 2998 3003 3014 3023 3031 3028
                2988 2994 2988 2985 2992 2983 2985 2965 2960 2981 2995 2995 2989 3007 3018 3025 3034 3028
                2998 2988 2985 2980 2980 2974 2978 2956 2951 2981 2997 3002 2994 3009 3022 3027 3032 3025
                3008 2985 2985 2980 2981 2973 2974 2955 2948 2993 3006 3009 3003 3017 3028 3034 3039 3032
                3002 2979 2978 2973 2967 2961 2967 2952 2943 2995 3003 3009 3007 3016 3023 3032 3037 3028
                2998 2981 2983 2976 2975 2969 2971 2955 2948 2980 2987 2994 2992 3006 3012 3017 3022 3012
                2987 2987 2989 2981 2981 2974 2975 2960 2954 2993 3001 3007 3004 3018 3025 3030 3030 3018
                2992 2984 2985 2976 2978 2969 2967 2959 2948 3001 3009 3016 3013 3025 3030 3034 3034 3022
                2993 2979 2987 2979 2978 2971 2967 2962 2952 2993 2999 3011 3006 3018 3022 3023 3020 3012
                2989 2974 2981 2974 2971 2962 2967 2959 2945 2987 2994 3003 3002 3016 3018 3023 3020 3007
                2989 2967 2975 2965 2965 2956 2961 2960 2936 2983 2988 2995 2997 3007 3008 3014 3012 3001
                2981 2964 2971 2962 2959 2950 2955 2952 2933 2974 2981 2987 2988 2998 2998 3003 2998 2990
                2973 2960 2964 2956 2955 2947 2952 2948 2927 2978 2985 2994 2993 3003 3006 3009 3002 2992
                2961 2965 2973 2965 2962 2954 2959 2955 2940 2965 2970 2981 2979 2989 2989 2997 2987 2980
                2957 2941 2946 2938 2936 2929 2936 2932 2922 2974 2979 2990 2989 2998 2998 3004 2999 2990
                2961 2947 2955 2946 2945 2938 2946 2941 2929 2954 2957 2975 2971 2981 2980 2985 2980 2970
                2941 2938 2941 2933 2932 2924 2933 2929 2915 2955 2959 2973 2970 2980 2980 2981 2975 2964
                2948 2924 2928 2918 2915 2910 2919 2917 2903 2957 2965 2978 2975 2981 2981 2984 2976 2966
                2684 2668 2674 2669 2665 2658 2665 2660 2654 2686 2687 2705 2702 2711 2715 2712 2708 2707
                2675 2670 2673 2668 2667 2659 2668 2664 2656 2675 2679 2692 2689 2701 2703 2702 2698 2697
                2673 2659 2663 2658 2655 2647 2655 2653 2645 2680 2682 2698 2697 2705 2708 2707 2705 2702
                2677 2658 2661 2655 2653 2649 2655 2651 2644 2680 2682 2697 2696 2703 2707 2705 2703 2700
                2661 2655 2658 2651 2645 2640 2651 2646 2637 2658 2660 2673 2670 2677 2679 2682 2680 2678
                2660 2645 2647 2641 2639 2633 2642 2635 2628 2665 2668 2679 2675 2683 2686 2686 2687 2684
                2656 2642 2642 2635 2635 2630 2639 2632 2626 2656 2660 2670 2668 2675 2677 2677 2678 2673
                2647 2626 2626 2618 2617 2613 2623 2613 2611 2655 2659 2669 2667 2675 2677 2679 2679 2674
                2644 2616 2614 2608 2608 2604 2614 2604 2599 2635 2639 2647 2645 2653 2655 2654 2656 2654
                2626 2614 2614 2608 2608 2603 2614 2602 2597 2627 2633 2640 2639 2649 2650 2653 2655 2659
                2379 2598 2597 2592 2590 2585 2602 2585 2579 2604 2613 2631 2617 2625 2625 2630 2631 2410
                1560 2485 2606 2600 2604 2600 2613 2598 2590 2593 2603 2622 2608 2614 2614 2617 2499 1560
                13000 13000 13000>;

            PS_Config_Lmt_Open_Rawdata_N = <
                1092 1638 1701 1703 1706 1700 1703 1616 (-65535) (-65535) 1631 1726 1719 1724 1730 1738 1670 1099
                1609 1700 1696 1697 1699 1694 1697 1687 1641 1660 1708 1719 1715 1719 1727 1733 1737 1628
                1714 1711 1707 1708 1709 1705 1707 1697 1689 1701 1708 1719 1716 1718 1726 1733 1735 1741
                1708 1708 1709 1710 1710 1705 1707 1697 1689 1700 1709 1722 1719 1721 1730 1737 1740 1743
                1720 1707 1705 1705 1704 1700 1703 1692 1685 1705 1713 1720 1719 1722 1728 1735 1740 1741
                1719 1706 1707 1706 1705 1701 1703 1692 1684 1708 1715 1722 1722 1725 1732 1737 1742 1743
                1716 1715 1713 1711 1711 1707 1708 1697 1692 1708 1717 1723 1723 1726 1733 1738 1742 1741
                1717 1721 1717 1716 1719 1714 1716 1704 1701 1714 1722 1722 1718 1728 1735 1738 1743 1741
                1723 1717 1716 1713 1713 1709 1711 1699 1696 1714 1722 1725 1721 1730 1737 1740 1743 1738
                1729 1716 1716 1713 1714 1708 1709 1698 1695 1720 1727 1730 1726 1734 1741 1743 1746 1743
                1725 1712 1711 1708 1706 1702 1706 1697 1692 1722 1726 1730 1728 1733 1738 1743 1746 1741
                1723 1714 1714 1711 1710 1706 1708 1698 1695 1713 1716 1721 1719 1727 1731 1734 1737 1731
                1716 1716 1718 1714 1714 1709 1710 1701 1697 1720 1724 1728 1727 1735 1738 1741 1741 1735
                1719 1715 1716 1711 1711 1706 1706 1700 1695 1724 1730 1733 1732 1738 1741 1743 1743 1737
                1720 1712 1716 1712 1711 1708 1706 1703 1697 1720 1724 1730 1727 1735 1737 1738 1735 1731
                1718 1709 1714 1709 1708 1703 1706 1700 1692 1716 1721 1726 1725 1733 1735 1738 1735 1728
                1718 1706 1710 1704 1704 1699 1702 1701 1687 1714 1717 1722 1722 1728 1729 1733 1731 1724
                1714 1703 1708 1703 1700 1695 1698 1697 1686 1709 1714 1716 1717 1723 1723 1726 1723 1719
                1708 1701 1703 1699 1698 1694 1697 1695 1682 1711 1716 1721 1720 1726 1727 1730 1725 1719
                1702 1704 1708 1704 1703 1697 1700 1698 1689 1704 1707 1714 1712 1718 1718 1722 1716 1713
                1700 1690 1693 1689 1687 1684 1687 1685 1679 1709 1712 1719 1718 1723 1723 1727 1724 1719
                1702 1694 1698 1693 1692 1689 1693 1690 1684 1697 1700 1710 1708 1714 1713 1716 1713 1707
                1690 1689 1690 1686 1685 1681 1686 1684 1676 1698 1700 1708 1707 1713 1713 1714 1710 1703
                1695 1681 1683 1677 1676 1673 1678 1676 1668 1700 1704 1711 1710 1714 1714 1715 1711 1705
                1543 1533 1537 1534 1532 1527 1532 1529 1525 1543 1544 1554 1553 1558 1560 1559 1557 1556
                1538 1535 1536 1533 1533 1528 1533 1531 1527 1538 1540 1547 1546 1552 1554 1553 1551 1550
                1536 1528 1530 1527 1526 1522 1526 1524 1520 1541 1541 1551 1550 1554 1557 1556 1554 1553
                1538 1527 1530 1526 1524 1522 1526 1524 1519 1541 1541 1550 1549 1554 1556 1554 1554 1551
                1530 1526 1527 1524 1520 1517 1524 1521 1516 1527 1529 1536 1535 1538 1540 1541 1541 1539
                1529 1520 1522 1518 1516 1514 1519 1514 1511 1532 1533 1540 1538 1542 1543 1543 1544 1543
                1527 1519 1519 1514 1514 1511 1516 1513 1509 1527 1529 1535 1533 1538 1538 1538 1539 1536
                1522 1509 1509 1505 1504 1502 1508 1502 1500 1526 1528 1534 1533 1538 1538 1540 1540 1537
                1519 1503 1503 1499 1499 1497 1503 1497 1494 1514 1516 1522 1520 1524 1526 1525 1527 1525
                1509 1503 1503 1499 1499 1496 1503 1495 1492 1510 1514 1517 1516 1522 1523 1524 1526 1528
                1368 1493 1492 1489 1489 1486 1495 1486 1482 1497 1502 1512 1504 1508 1508 1511 1512 1385
                897 1428 1497 1495 1497 1495 1502 1493 1489 1490 1496 1507 1499 1503 1503 1504 1436 897
                6500 6500 6500>;

            PS_Config_Lmt_FW_Rawdata_P = <
                1750 1750 1750 1750 1750 1750 1750 1750 65535 65535 1750 1750 1750 1750 1750 1750 1750 1750
                1750 1750 1750 1750 1750 1750 1750 1750 1750 1750 1750 1750 1750 1750 1750 1750 1750 1750
                1750 1750 1750 1750 1750 1750 1750 1750 1750 1750 1750 1750 1750 1750 1750 1750 1750 1750
                1750 1750 1750 1750 1750 1750 1750 1750 1750 1750 1750 1750 1750 1750 1750 1750 1750 1750
                1750 1750 1750 1750 1750 1750 1750 1750 1750 1750 1750 1750 1750 1750 1750 1750 1750 1750
                1750 1750 1750 1750 1750 1750 1750 1750 1750 1750 1750 1750 1750 1750 1750 1750 1750 1750
                1750 1750 1750 1750 1750 1750 1750 1750 1750 1750 1750 1750 1750 1750 1750 1750 1750 1750
                1750 1750 1750 1750 1750 1750 1750 1750 1750 1750 1750 1750 1750 1750 1750 1750 1750 1750
                1750 1750 1750 1750 1750 1750 1750 1750 1750 1750 1750 1750 1750 1750 1750 1750 1750 1750
                1750 1750 1750 1750 1750 1750 1750 1750 1750 1750 1750 1750 1750 1750 1750 1750 1750 1750
                1750 1750 1750 1750 1750 1750 1750 1750 1750 1750 1750 1750 1750 1750 1750 1750 1750 1750
                1750 1750 1750 1750 1750 1750 1750 1750 1750 1750 1750 1750 1750 1750 1750 1750 1750 1750
                1750 1750 1750 1750 1750 1750 1750 1750 1750 1750 1750 1750 1750 1750 1750 1750 1750 1750
                1750 1750 1750 1750 1750 1750 1750 1750 1750 1750 1750 1750 1750 1750 1750 1750 1750 1750
                1750 1750 1750 1750 1750 1750 1750 1750 1750 1750 1750 1750 1750 1750 1750 1750 1750 1750
                1750 1750 1750 1750 1750 1750 1750 1750 1750 1750 1750 1750 1750 1750 1750 1750 1750 1750
                1750 1750 1750 1750 1750 1750 1750 1750 1750 1750 1750 1750 1750 1750 1750 1750 1750 1750
                1750 1750 1750 1750 1750 1750 1750 1750 1750 1750 1750 1750 1750 1750 1750 1750 1750 1750
                1750 1750 1750 1750 1750 1750 1750 1750 1750 1750 1750 1750 1750 1750 1750 1750 1750 1750
                1750 1750 1750 1750 1750 1750 1750 1750 1750 1750 1750 1750 1750 1750 1750 1750 1750 1750
                1750 1750 1750 1750 1750 1750 1750 1750 1750 1750 1750 1750 1750 1750 1750 1750 1750 1750
                1750 1750 1750 1750 1750 1750 1750 1750 1750 1750 1750 1750 1750 1750 1750 1750 1750 1750
                1750 1750 1750 1750 1750 1750 1750 1750 1750 1750 1750 1750 1750 1750 1750 1750 1750 1750
                1750 1750 1750 1750 1750 1750 1750 1750 1750 1750 1750 1750 1750 1750 1750 1750 1750 1750
                1750 1750 1750 1750 1750 1750 1750 1750 1750 1750 1750 1750 1750 1750 1750 1750 1750 1750
                1750 1750 1750 1750 1750 1750 1750 1750 1750 1750 1750 1750 1750 1750 1750 1750 1750 1750
                1750 1750 1750 1750 1750 1750 1750 1750 1750 1750 1750 1750 1750 1750 1750 1750 1750 1750
                1750 1750 1750 1750 1750 1750 1750 1750 1750 1750 1750 1750 1750 1750 1750 1750 1750 1750
                1750 1750 1750 1750 1750 1750 1750 1750 1750 1750 1750 1750 1750 1750 1750 1750 1750 1750
                1750 1750 1750 1750 1750 1750 1750 1750 1750 1750 1750 1750 1750 1750 1750 1750 1750 1750
                1750 1750 1750 1750 1750 1750 1750 1750 1750 1750 1750 1750 1750 1750 1750 1750 1750 1750
                1750 1750 1750 1750 1750 1750 1750 1750 1750 1750 1750 1750 1750 1750 1750 1750 1750 1750
                1750 1750 1750 1750 1750 1750 1750 1750 1750 1750 1750 1750 1750 1750 1750 1750 1750 1750
                1750 1750 1750 1750 1750 1750 1750 1750 1750 1750 1750 1750 1750 1750 1750 1750 1750 1750
                1750 1750 1750 1750 1750 1750 1750 1750 1750 1750 1750 1750 1750 1750 1750 1750 1750 1750
                1750 1750 1750 1750 1750 1750 1750 1750 1750 1750 1750 1750 1750 1750 1750 1750 1750 1750
                2000 2000 2000>;

            PS_Config_Lmt_FW_Rawdata_N = <
                650 650 650 650 650 650 650 650 (-65535) (-65535) 650 650 650 650 650 650 650 650
                650 650 650 650 650 650 650 650 650 650 650 650 650 650 650 650 650 650
                650 650 650 650 650 650 650 650 650 650 650 650 650 650 650 650 650 650
                650 650 650 650 650 650 650 650 650 650 650 650 650 650 650 650 650 650
                650 650 650 650 650 650 650 650 650 650 650 650 650 650 650 650 650 650
                650 650 650 650 650 650 650 650 650 650 650 650 650 650 650 650 650 650
                650 650 650 650 650 650 650 650 650 650 650 650 650 650 650 650 650 650
                650 650 650 650 650 650 650 650 650 650 650 650 650 650 650 650 650 650
                650 650 650 650 650 650 650 650 650 650 650 650 650 650 650 650 650 650
                650 650 650 650 650 650 650 650 650 650 650 650 650 650 650 650 650 650
                650 650 650 650 650 650 650 650 650 650 650 650 650 650 650 650 650 650
                650 650 650 650 650 650 650 650 650 650 650 650 650 650 650 650 650 650
                650 650 650 650 650 650 650 650 650 650 650 650 650 650 650 650 650 650
                650 650 650 650 650 650 650 650 650 650 650 650 650 650 650 650 650 650
                650 650 650 650 650 650 650 650 650 650 650 650 650 650 650 650 650 650
                650 650 650 650 650 650 650 650 650 650 650 650 650 650 650 650 650 650
                650 650 650 650 650 650 650 650 650 650 650 650 650 650 650 650 650 650
                650 650 650 650 650 650 650 650 650 650 650 650 650 650 650 650 650 650
                650 650 650 650 650 650 650 650 650 650 650 650 650 650 650 650 650 650
                650 650 650 650 650 650 650 650 650 650 650 650 650 650 650 650 650 650
                650 650 650 650 650 650 650 650 650 650 650 650 650 650 650 650 650 650
                650 650 650 650 650 650 650 650 650 650 650 650 650 650 650 650 650 650
                650 650 650 650 650 650 650 650 650 650 650 650 650 650 650 650 650 650
                650 650 650 650 650 650 650 650 650 650 650 650 650 650 650 650 650 650
                650 650 650 650 650 650 650 650 650 650 650 650 650 650 650 650 650 650
                650 650 650 650 650 650 650 650 650 650 650 650 650 650 650 650 650 650
                650 650 650 650 650 650 650 650 650 650 650 650 650 650 650 650 650 650
                650 650 650 650 650 650 650 650 650 650 650 650 650 650 650 650 650 650
                650 650 650 650 650 650 650 650 650 650 650 650 650 650 650 650 650 650
                650 650 650 650 650 650 650 650 650 650 650 650 650 650 650 650 650 650
                650 650 650 650 650 650 650 650 650 650 650 650 650 650 650 650 650 650
                650 650 650 650 650 650 650 650 650 650 650 650 650 650 650 650 650 650
                650 650 650 650 650 650 650 650 650 650 650 650 650 650 650 650 650 650
                650 650 650 650 650 650 650 650 650 650 650 650 650 650 650 650 650 650
                650 650 650 650 650 650 650 650 650 650 650 650 650 650 650 650 650 650
                650 650 650 650 650 650 650 650 650 650 650 650 650 650 650 650 650 650
                400 400 400>;

            PS_Config_Lmt_FW_CC_P = <
                112 115 114 114 112 111 111 111 65535 65535 117 117 115 115 115 115 115 111
                115 115 114 112 112 111 110 110 110 111 114 114 111 111 112 112 114 115
                119 114 112 111 110 110 109 109 109 110 114 112 111 111 112 112 112 115
                120 115 112 112 112 111 110 110 110 111 115 114 112 112 114 114 115 117
                119 114 112 111 111 110 110 110 109 110 112 112 110 110 111 112 112 115
                120 115 114 112 112 111 111 110 110 111 115 112 112 111 112 112 114 116
                119 112 111 111 110 110 110 109 109 111 114 112 112 112 112 112 114 116
                120 115 112 112 112 111 111 110 110 115 115 115 114 114 114 115 115 119
                117 114 112 112 111 110 110 110 110 115 112 112 111 111 111 112 112 116
                120 115 114 114 112 111 112 111 111 117 112 112 111 111 112 112 112 116
                119 112 111 111 110 110 110 110 109 119 112 112 112 111 112 114 114 116
                120 112 112 112 110 110 110 110 110 120 114 114 114 112 114 115 115 120
                117 114 112 111 111 110 111 110 110 119 111 111 111 111 112 112 112 116
                117 115 114 114 112 112 112 112 111 119 112 112 112 112 112 112 114 117
                117 112 111 110 110 110 110 112 109 119 112 112 111 111 112 114 114 117
                120 114 112 112 111 111 111 114 110 119 114 112 112 112 114 115 115 120
                116 112 112 111 111 110 111 112 110 116 111 111 110 111 112 112 112 116
                119 114 114 112 112 111 112 112 111 117 114 112 111 112 112 112 114 119
                116 112 111 110 110 110 110 110 109 117 114 112 111 112 112 114 114 119
                119 114 112 112 111 111 111 112 111 120 115 114 114 114 114 115 115 120
                115 112 112 111 111 111 111 111 111 116 114 111 111 111 112 112 114 119
                117 115 114 114 112 112 114 112 112 117 112 112 111 112 112 114 115 120
                116 112 111 111 110 110 111 111 110 116 112 112 111 112 112 114 115 120
                119 112 112 112 111 111 112 112 110 116 115 115 114 115 115 116 117 122
                115 112 112 112 111 111 112 112 110 114 111 112 112 112 114 114 115 120
                116 115 115 114 112 114 115 115 112 114 112 114 112 114 114 115 116 121
                116 112 112 112 111 111 112 112 110 112 112 112 112 112 114 115 115 121
                119 115 115 114 112 114 115 116 112 115 114 114 114 115 115 116 119 122
                115 114 114 112 112 112 114 115 111 112 111 111 112 112 114 114 115 120
                119 115 115 115 115 115 115 115 112 115 114 114 114 115 115 116 119 122
                116 114 112 112 111 111 112 114 110 114 112 112 114 114 115 115 117 121
                119 115 115 114 114 114 115 115 112 115 115 115 115 116 116 117 120 125
                115 115 114 114 112 112 115 115 112 112 112 112 112 112 114 115 116 121
                117 115 115 115 115 115 117 117 114 112 112 111 112 112 114 115 116 124
                115 114 112 112 111 112 116 114 111 111 115 116 112 112 112 112 114 115
                115 112 112 112 112 112 116 115 111 110 115 115 111 110 110 110 112 110
                119 120 120>;

            PS_Config_Lmt_FW_CC_N = <
                69 70 69 69 69 68 68 68 (-65535) (-65535) 72 72 70 70 70 70 70 68
                70 70 69 69 69 68 67 67 67 68 69 69 68 68 69 69 69 70
                72 69 69 68 67 67 66 66 66 67 69 69 68 68 69 69 69 70
                73 70 69 69 69 68 67 67 67 68 70 69 69 69 69 69 70 72
                72 69 69 68 68 67 67 67 66 67 69 69 67 67 68 69 69 70
                73 70 69 69 69 68 68 67 67 68 70 69 69 68 69 69 69 71
                72 69 68 68 67 67 67 66 66 68 69 69 69 69 69 69 69 71
                73 70 69 69 69 68 68 67 67 70 70 70 69 69 69 70 70 72
                72 69 69 69 68 67 67 67 67 70 69 69 68 68 68 69 69 71
                73 70 69 69 69 68 69 68 68 72 69 69 68 68 69 69 69 71
                72 69 68 68 67 67 67 67 66 72 69 69 69 68 69 69 69 71
                73 69 69 69 67 67 67 67 67 73 69 69 69 69 69 70 70 73
                72 69 69 68 68 67 68 67 67 72 68 68 68 68 69 69 69 71
                72 70 69 69 69 69 69 69 68 72 69 69 69 69 69 69 69 72
                72 69 68 67 67 67 67 69 66 72 69 69 68 68 69 69 69 72
                73 69 69 69 68 68 68 69 67 72 69 69 69 69 69 70 70 73
                71 69 69 68 68 67 68 69 67 71 68 68 67 68 69 69 69 71
                72 69 69 69 69 68 69 69 68 72 69 69 68 69 69 69 69 72
                71 69 68 67 67 67 67 67 66 72 69 69 68 69 69 69 69 72
                72 69 69 69 68 68 68 69 68 73 70 69 69 69 69 70 70 73
                70 69 69 68 68 68 68 68 68 71 69 68 68 68 69 69 69 72
                72 70 69 69 69 69 69 69 69 72 69 69 68 69 69 69 70 73
                71 69 68 68 67 67 68 68 67 71 69 69 68 69 69 69 70 73
                72 69 69 69 68 68 69 69 67 71 70 70 69 70 70 71 72 75
                70 69 69 69 68 68 69 69 67 69 68 69 69 69 69 69 70 73
                71 70 70 69 69 69 70 70 69 69 69 69 69 69 69 70 71 74
                71 69 69 69 68 68 69 69 67 69 69 69 69 69 69 70 70 74
                72 70 70 69 69 69 70 71 69 70 69 69 69 70 70 71 72 75
                70 69 69 69 69 69 69 70 68 69 68 68 69 69 69 69 70 73
                72 70 70 70 70 70 70 70 69 70 69 69 69 70 70 71 72 75
                71 69 69 69 68 68 69 69 67 69 69 69 69 69 70 70 72 74
                72 70 70 69 69 69 70 70 69 70 70 70 70 71 71 72 73 76
                70 70 69 69 69 69 70 70 69 69 69 69 69 69 69 70 71 74
                72 70 70 70 70 70 72 72 69 69 69 68 69 69 69 70 71 76
                70 69 69 69 68 69 71 69 68 68 70 71 69 69 69 69 69 70
                70 69 69 69 69 69 71 70 68 67 70 70 68 67 67 67 69 67
                53 54 54>;

            PS_Config_Lmt_FW_CC_I_P = <
                25 25 25 25 25 25 25 25 25 25 25 25 25 25 25 25 25 25
                25 25 25 25 25 25 25 25 25 25 25 25 25 25 25 25 25 25
                25 25 25 25 25 25 25 25 25 25 25 25 25 25 25 25 25 25
                25 25 25 25 25 25 25 25 25 25 25 25 25 25 25 25 25 25
                25 25 25 25 25 25 25 25 25 25 25 25 25 25 25 25 25 25
                25 25 25 25 25 25 25 25 25 25 25 25 25 25 25 25 25 25
                25 25 25 25 25 25 25 25 25 25 25 25 25 25 25 25 25 25
                25 25 25 25 25 25 25 25 25 25 25 25 25 25 25 25 25 25
                25 25 25 25 25 25 25 25 25 25 25 25 25 25 25 25 25 25
                25 25 25 25 25 25 25 25 25 25 25 25 25 25 25 25 25 25
                25 25 25 25 25 25 25 25 25 25 25 25 25 25 25 25 25 25
                25 25 25 25 25 25 25 25 25 25 25 25 25 25 25 25 25 25
                25 25 25 25 25 25 25 25 25 25 25 25 25 25 25 25 25 25
                25 25 25 25 25 25 25 25 25 25 25 25 25 25 25 25 25 25
                25 25 25 25 25 25 25 25 25 25 25 25 25 25 25 25 25 25
                25 25 25 25 25 25 25 25 25 25 25 25 25 25 25 25 25 25
                25 25 25 25 25 25 25 25 25 25 25 25 25 25 25 25 25 25
                25 25 25 25 25 25 25 25 25 25 25 25 25 25 25 25 25 25
                25 25 25 25 25 25 25 25 25 25 25 25 25 25 25 25 25 25
                25 25 25 25 25 25 25 25 25 25 25 25 25 25 25 25 25 25
                25 25 25 25 25 25 25 25 25 25 25 25 25 25 25 25 25 25
                25 25 25 25 25 25 25 25 25 25 25 25 25 25 25 25 25 25
                25 25 25 25 25 25 25 25 25 25 25 25 25 25 25 25 25 25
                25 25 25 25 25 25 25 25 25 25 25 25 25 25 25 25 25 25
                25 25 25 25 25 25 25 25 25 25 25 25 25 25 25 25 25 25
                25 25 25 25 25 25 25 25 25 25 25 25 25 25 25 25 25 25
                25 25 25 25 25 25 25 25 25 25 25 25 25 25 25 25 25 25
                25 25 25 25 25 25 25 25 25 25 25 25 25 25 25 25 25 25
                25 25 25 25 25 25 25 25 25 25 25 25 25 25 25 25 25 25
                25 25 25 25 25 25 25 25 25 25 25 25 25 25 25 25 25 25
                25 25 25 25 25 25 25 25 25 25 25 25 25 25 25 25 25 25
                25 25 25 25 25 25 25 25 25 25 25 25 25 25 25 25 25 25
                25 25 25 25 25 25 25 25 25 25 25 25 25 25 25 25 25 25
                25 25 25 25 25 25 25 25 25 25 25 25 25 25 25 25 25 25
                25 25 25 25 25 25 25 25 25 25 25 25 25 25 25 25 25 25
                25 25 25 25 25 25 25 25 25 25 25 25 25 25 25 25 25 25
                25 25 25>;

            PS_Config_Lmt_FW_CC_I_N = <
                0 0 0 0 0 0 0 0 0 0 0 0 0 0 0 0 0 0
                0 0 0 0 0 0 0 0 0 0 0 0 0 0 0 0 0 0
                0 0 0 0 0 0 0 0 0 0 0 0 0 0 0 0 0 0
                0 0 0 0 0 0 0 0 0 0 0 0 0 0 0 0 0 0
                0 0 0 0 0 0 0 0 0 0 0 0 0 0 0 0 0 0
                0 0 0 0 0 0 0 0 0 0 0 0 0 0 0 0 0 0
                0 0 0 0 0 0 0 0 0 0 0 0 0 0 0 0 0 0
                0 0 0 0 0 0 0 0 0 0 0 0 0 0 0 0 0 0
                0 0 0 0 0 0 0 0 0 0 0 0 0 0 0 0 0 0
                0 0 0 0 0 0 0 0 0 0 0 0 0 0 0 0 0 0
                0 0 0 0 0 0 0 0 0 0 0 0 0 0 0 0 0 0
                0 0 0 0 0 0 0 0 0 0 0 0 0 0 0 0 0 0
                0 0 0 0 0 0 0 0 0 0 0 0 0 0 0 0 0 0
                0 0 0 0 0 0 0 0 0 0 0 0 0 0 0 0 0 0
                0 0 0 0 0 0 0 0 0 0 0 0 0 0 0 0 0 0
                0 0 0 0 0 0 0 0 0 0 0 0 0 0 0 0 0 0
                0 0 0 0 0 0 0 0 0 0 0 0 0 0 0 0 0 0
                0 0 0 0 0 0 0 0 0 0 0 0 0 0 0 0 0 0
                0 0 0 0 0 0 0 0 0 0 0 0 0 0 0 0 0 0
                0 0 0 0 0 0 0 0 0 0 0 0 0 0 0 0 0 0
                0 0 0 0 0 0 0 0 0 0 0 0 0 0 0 0 0 0
                0 0 0 0 0 0 0 0 0 0 0 0 0 0 0 0 0 0
                0 0 0 0 0 0 0 0 0 0 0 0 0 0 0 0 0 0
                0 0 0 0 0 0 0 0 0 0 0 0 0 0 0 0 0 0
                0 0 0 0 0 0 0 0 0 0 0 0 0 0 0 0 0 0
                0 0 0 0 0 0 0 0 0 0 0 0 0 0 0 0 0 0
                0 0 0 0 0 0 0 0 0 0 0 0 0 0 0 0 0 0
                0 0 0 0 0 0 0 0 0 0 0 0 0 0 0 0 0 0
                0 0 0 0 0 0 0 0 0 0 0 0 0 0 0 0 0 0
                0 0 0 0 0 0 0 0 0 0 0 0 0 0 0 0 0 0
                0 0 0 0 0 0 0 0 0 0 0 0 0 0 0 0 0 0
                0 0 0 0 0 0 0 0 0 0 0 0 0 0 0 0 0 0
                0 0 0 0 0 0 0 0 0 0 0 0 0 0 0 0 0 0
                0 0 0 0 0 0 0 0 0 0 0 0 0 0 0 0 0 0
                0 0 0 0 0 0 0 0 0 0 0 0 0 0 0 0 0 0
                0 0 0 0 0 0 0 0 0 0 0 0 0 0 0 0 0 0
                0 0 0>;

            PS_Config_Lmt_FW_CC_Q_P = <
                25 25 25 25 25 25 25 25 25 25 25 25 25 25 25 25 25 25
                25 25 25 25 25 25 25 25 25 25 25 25 25 25 25 25 25 25
                25 25 25 25 25 25 25 25 25 25 25 25 25 25 25 25 25 25
                25 25 25 25 25 25 25 25 25 25 25 25 25 25 25 25 25 25
                25 25 25 25 25 25 25 25 25 25 25 25 25 25 25 25 25 25
                25 25 25 25 25 25 25 25 25 25 25 25 25 25 25 25 25 25
                25 25 25 25 25 25 25 25 25 25 25 25 25 25 25 25 25 25
                25 25 25 25 25 25 25 25 25 25 25 25 25 25 25 25 25 25
                25 25 25 25 25 25 25 25 25 25 25 25 25 25 25 25 25 25
                25 25 25 25 25 25 25 25 25 25 25 25 25 25 25 25 25 25
                25 25 25 25 25 25 25 25 25 25 25 25 25 25 25 25 25 25
                25 25 25 25 25 25 25 25 25 25 25 25 25 25 25 25 25 25
                25 25 25 25 25 25 25 25 25 25 25 25 25 25 25 25 25 25
                25 25 25 25 25 25 25 25 25 25 25 25 25 25 25 25 25 25
                25 25 25 25 25 25 25 25 25 25 25 25 25 25 25 25 25 25
                25 25 25 25 25 25 25 25 25 25 25 25 25 25 25 25 25 25
                25 25 25 25 25 25 25 25 25 25 25 25 25 25 25 25 25 25
                25 25 25 25 25 25 25 25 25 25 25 25 25 25 25 25 25 25
                25 25 25 25 25 25 25 25 25 25 25 25 25 25 25 25 25 25
                25 25 25 25 25 25 25 25 25 25 25 25 25 25 25 25 25 25
                25 25 25 25 25 25 25 25 25 25 25 25 25 25 25 25 25 25
                25 25 25 25 25 25 25 25 25 25 25 25 25 25 25 25 25 25
                25 25 25 25 25 25 25 25 25 25 25 25 25 25 25 25 25 25
                25 25 25 25 25 25 25 25 25 25 25 25 25 25 25 25 25 25
                25 25 25 25 25 25 25 25 25 25 25 25 25 25 25 25 25 25
                25 25 25 25 25 25 25 25 25 25 25 25 25 25 25 25 25 25
                25 25 25 25 25 25 25 25 25 25 25 25 25 25 25 25 25 25
                25 25 25 25 25 25 25 25 25 25 25 25 25 25 25 25 25 25
                25 25 25 25 25 25 25 25 25 25 25 25 25 25 25 25 25 25
                25 25 25 25 25 25 25 25 25 25 25 25 25 25 25 25 25 25
                25 25 25 25 25 25 25 25 25 25 25 25 25 25 25 25 25 25
                25 25 25 25 25 25 25 25 25 25 25 25 25 25 25 25 25 25
                25 25 25 25 25 25 25 25 25 25 25 25 25 25 25 25 25 25
                25 25 25 25 25 25 25 25 25 25 25 25 25 25 25 25 25 25
                25 25 25 25 25 25 25 25 25 25 25 25 25 25 25 25 25 25
                25 25 25 25 25 25 25 25 25 25 25 25 25 25 25 25 25 25
                25 25 25>;

            PS_Config_Lmt_FW_CC_Q_N = <
                0 0 0 0 0 0 0 0 0 0 0 0 0 0 0 0 0 0
                0 0 0 0 0 0 0 0 0 0 0 0 0 0 0 0 0 0
                0 0 0 0 0 0 0 0 0 0 0 0 0 0 0 0 0 0
                0 0 0 0 0 0 0 0 0 0 0 0 0 0 0 0 0 0
                0 0 0 0 0 0 0 0 0 0 0 0 0 0 0 0 0 0
                0 0 0 0 0 0 0 0 0 0 0 0 0 0 0 0 0 0
                0 0 0 0 0 0 0 0 0 0 0 0 0 0 0 0 0 0
                0 0 0 0 0 0 0 0 0 0 0 0 0 0 0 0 0 0
                0 0 0 0 0 0 0 0 0 0 0 0 0 0 0 0 0 0
                0 0 0 0 0 0 0 0 0 0 0 0 0 0 0 0 0 0
                0 0 0 0 0 0 0 0 0 0 0 0 0 0 0 0 0 0
                0 0 0 0 0 0 0 0 0 0 0 0 0 0 0 0 0 0
                0 0 0 0 0 0 0 0 0 0 0 0 0 0 0 0 0 0
                0 0 0 0 0 0 0 0 0 0 0 0 0 0 0 0 0 0
                0 0 0 0 0 0 0 0 0 0 0 0 0 0 0 0 0 0
                0 0 0 0 0 0 0 0 0 0 0 0 0 0 0 0 0 0
                0 0 0 0 0 0 0 0 0 0 0 0 0 0 0 0 0 0
                0 0 0 0 0 0 0 0 0 0 0 0 0 0 0 0 0 0
                0 0 0 0 0 0 0 0 0 0 0 0 0 0 0 0 0 0
                0 0 0 0 0 0 0 0 0 0 0 0 0 0 0 0 0 0
                0 0 0 0 0 0 0 0 0 0 0 0 0 0 0 0 0 0
                0 0 0 0 0 0 0 0 0 0 0 0 0 0 0 0 0 0
                0 0 0 0 0 0 0 0 0 0 0 0 0 0 0 0 0 0
                0 0 0 0 0 0 0 0 0 0 0 0 0 0 0 0 0 0
                0 0 0 0 0 0 0 0 0 0 0 0 0 0 0 0 0 0
                0 0 0 0 0 0 0 0 0 0 0 0 0 0 0 0 0 0
                0 0 0 0 0 0 0 0 0 0 0 0 0 0 0 0 0 0
                0 0 0 0 0 0 0 0 0 0 0 0 0 0 0 0 0 0
                0 0 0 0 0 0 0 0 0 0 0 0 0 0 0 0 0 0
                0 0 0 0 0 0 0 0 0 0 0 0 0 0 0 0 0 0
                0 0 0 0 0 0 0 0 0 0 0 0 0 0 0 0 0 0
                0 0 0 0 0 0 0 0 0 0 0 0 0 0 0 0 0 0
                0 0 0 0 0 0 0 0 0 0 0 0 0 0 0 0 0 0
                0 0 0 0 0 0 0 0 0 0 0 0 0 0 0 0 0 0
                0 0 0 0 0 0 0 0 0 0 0 0 0 0 0 0 0 0
                0 0 0 0 0 0 0 0 0 0 0 0 0 0 0 0 0 0
                0 0 0>;

            PS_Config_Lmt_FW_Diff_P = <
                50 50 50 50 50 50 50 50 65535 65535 50 50 50 50 50 50 50 50
                50 50 50 50 50 50 50 50 50 50 50 50 50 50 50 50 50 50
                50 50 50 50 50 50 50 50 50 50 50 50 50 50 50 50 50 50
                50 50 50 50 50 50 50 50 50 50 50 50 50 50 50 50 50 50
                50 50 50 50 50 50 50 50 50 50 50 50 50 50 50 50 50 50
                50 50 50 50 50 50 50 50 50 50 50 50 50 50 50 50 50 50
                50 50 50 50 50 50 50 50 50 50 50 50 50 50 50 50 50 50
                50 50 50 50 50 50 50 50 50 50 50 50 50 50 50 50 50 50
                50 50 50 50 50 50 50 50 50 50 50 50 50 50 50 50 50 50
                50 50 50 50 50 50 50 50 50 50 50 50 50 50 50 50 50 50
                50 50 50 50 50 50 50 50 50 50 50 50 50 50 50 50 50 50
                50 50 50 50 50 50 50 50 50 50 50 50 50 50 50 50 50 50
                50 50 50 50 50 50 50 50 50 50 50 50 50 50 50 50 50 50
                50 50 50 50 50 50 50 50 50 50 50 50 50 50 50 50 50 50
                50 50 50 50 50 50 50 50 50 50 50 50 50 50 50 50 50 50
                50 50 50 50 50 50 50 50 50 50 50 50 50 50 50 50 50 50
                50 50 50 50 50 50 50 50 50 50 50 50 50 50 50 50 50 50
                50 50 50 50 50 50 50 50 50 50 50 50 50 50 50 50 50 50
                50 50 50 50 50 50 50 50 50 50 50 50 50 50 50 50 50 50
                50 50 50 50 50 50 50 50 50 50 50 50 50 50 50 50 50 50
                50 50 50 50 50 50 50 50 50 50 50 50 50 50 50 50 50 50
                50 50 50 50 50 50 50 50 50 50 50 50 50 50 50 50 50 50
                50 50 50 50 50 50 50 50 50 50 50 50 50 50 50 50 50 50
                50 50 50 50 50 50 50 50 50 50 50 50 50 50 50 50 50 50
                50 50 50 50 50 50 50 50 50 50 50 50 50 50 50 50 50 50
                50 50 50 50 50 50 50 50 50 50 50 50 50 50 50 50 50 50
                50 50 50 50 50 50 50 50 50 50 50 50 50 50 50 50 50 50
                50 50 50 50 50 50 50 50 50 50 50 50 50 50 50 50 50 50
                50 50 50 50 50 50 50 50 50 50 50 50 50 50 50 50 50 50
                50 50 50 50 50 50 50 50 50 50 50 50 50 50 50 50 50 50
                50 50 50 50 50 50 50 50 50 50 50 50 50 50 50 50 50 50
                50 50 50 50 50 50 50 50 50 50 50 50 50 50 50 50 50 50
                50 50 50 50 50 50 50 50 50 50 50 50 50 50 50 50 50 50
                50 50 50 50 50 50 50 50 50 50 50 50 50 50 50 50 50 50
                50 50 50 50 50 50 50 50 50 50 50 50 50 50 50 50 50 50
                50 50 50 50 50 50 50 50 50 50 50 50 50 50 50 50 50 50
                50 50 50>;

            PS_Config_Lmt_FW_Diff_N = <
                (-50) (-50) (-50) (-50) (-50) (-50) (-50) (-50) (-65535) (-65535) (-50) (-50) (-50) (-50) (-50) (-50) (-50) (-50)
                (-50) (-50) (-50) (-50) (-50) (-50) (-50) (-50) (-50) (-50) (-50) (-50) (-50) (-50) (-50) (-50) (-50) (-50)
                (-50) (-50) (-50) (-50) (-50) (-50) (-50) (-50) (-50) (-50) (-50) (-50) (-50) (-50) (-50) (-50) (-50) (-50)
                (-50) (-50) (-50) (-50) (-50) (-50) (-50) (-50) (-50) (-50) (-50) (-50) (-50) (-50) (-50) (-50) (-50) (-50)
                (-50) (-50) (-50) (-50) (-50) (-50) (-50) (-50) (-50) (-50) (-50) (-50) (-50) (-50) (-50) (-50) (-50) (-50)
                (-50) (-50) (-50) (-50) (-50) (-50) (-50) (-50) (-50) (-50) (-50) (-50) (-50) (-50) (-50) (-50) (-50) (-50)
                (-50) (-50) (-50) (-50) (-50) (-50) (-50) (-50) (-50) (-50) (-50) (-50) (-50) (-50) (-50) (-50) (-50) (-50)
                (-50) (-50) (-50) (-50) (-50) (-50) (-50) (-50) (-50) (-50) (-50) (-50) (-50) (-50) (-50) (-50) (-50) (-50)
                (-50) (-50) (-50) (-50) (-50) (-50) (-50) (-50) (-50) (-50) (-50) (-50) (-50) (-50) (-50) (-50) (-50) (-50)
                (-50) (-50) (-50) (-50) (-50) (-50) (-50) (-50) (-50) (-50) (-50) (-50) (-50) (-50) (-50) (-50) (-50) (-50)
                (-50) (-50) (-50) (-50) (-50) (-50) (-50) (-50) (-50) (-50) (-50) (-50) (-50) (-50) (-50) (-50) (-50) (-50)
                (-50) (-50) (-50) (-50) (-50) (-50) (-50) (-50) (-50) (-50) (-50) (-50) (-50) (-50) (-50) (-50) (-50) (-50)
                (-50) (-50) (-50) (-50) (-50) (-50) (-50) (-50) (-50) (-50) (-50) (-50) (-50) (-50) (-50) (-50) (-50) (-50)
                (-50) (-50) (-50) (-50) (-50) (-50) (-50) (-50) (-50) (-50) (-50) (-50) (-50) (-50) (-50) (-50) (-50) (-50)
                (-50) (-50) (-50) (-50) (-50) (-50) (-50) (-50) (-50) (-50) (-50) (-50) (-50) (-50) (-50) (-50) (-50) (-50)
                (-50) (-50) (-50) (-50) (-50) (-50) (-50) (-50) (-50) (-50) (-50) (-50) (-50) (-50) (-50) (-50) (-50) (-50)
                (-50) (-50) (-50) (-50) (-50) (-50) (-50) (-50) (-50) (-50) (-50) (-50) (-50) (-50) (-50) (-50) (-50) (-50)
                (-50) (-50) (-50) (-50) (-50) (-50) (-50) (-50) (-50) (-50) (-50) (-50) (-50) (-50) (-50) (-50) (-50) (-50)
                (-50) (-50) (-50) (-50) (-50) (-50) (-50) (-50) (-50) (-50) (-50) (-50) (-50) (-50) (-50) (-50) (-50) (-50)
                (-50) (-50) (-50) (-50) (-50) (-50) (-50) (-50) (-50) (-50) (-50) (-50) (-50) (-50) (-50) (-50) (-50) (-50)
                (-50) (-50) (-50) (-50) (-50) (-50) (-50) (-50) (-50) (-50) (-50) (-50) (-50) (-50) (-50) (-50) (-50) (-50)
                (-50) (-50) (-50) (-50) (-50) (-50) (-50) (-50) (-50) (-50) (-50) (-50) (-50) (-50) (-50) (-50) (-50) (-50)
                (-50) (-50) (-50) (-50) (-50) (-50) (-50) (-50) (-50) (-50) (-50) (-50) (-50) (-50) (-50) (-50) (-50) (-50)
                (-50) (-50) (-50) (-50) (-50) (-50) (-50) (-50) (-50) (-50) (-50) (-50) (-50) (-50) (-50) (-50) (-50) (-50)
                (-50) (-50) (-50) (-50) (-50) (-50) (-50) (-50) (-50) (-50) (-50) (-50) (-50) (-50) (-50) (-50) (-50) (-50)
                (-50) (-50) (-50) (-50) (-50) (-50) (-50) (-50) (-50) (-50) (-50) (-50) (-50) (-50) (-50) (-50) (-50) (-50)
                (-50) (-50) (-50) (-50) (-50) (-50) (-50) (-50) (-50) (-50) (-50) (-50) (-50) (-50) (-50) (-50) (-50) (-50)
                (-50) (-50) (-50) (-50) (-50) (-50) (-50) (-50) (-50) (-50) (-50) (-50) (-50) (-50) (-50) (-50) (-50) (-50)
                (-50) (-50) (-50) (-50) (-50) (-50) (-50) (-50) (-50) (-50) (-50) (-50) (-50) (-50) (-50) (-50) (-50) (-50)
                (-50) (-50) (-50) (-50) (-50) (-50) (-50) (-50) (-50) (-50) (-50) (-50) (-50) (-50) (-50) (-50) (-50) (-50)
                (-50) (-50) (-50) (-50) (-50) (-50) (-50) (-50) (-50) (-50) (-50) (-50) (-50) (-50) (-50) (-50) (-50) (-50)
                (-50) (-50) (-50) (-50) (-50) (-50) (-50) (-50) (-50) (-50) (-50) (-50) (-50) (-50) (-50) (-50) (-50) (-50)
                (-50) (-50) (-50) (-50) (-50) (-50) (-50) (-50) (-50) (-50) (-50) (-50) (-50) (-50) (-50) (-50) (-50) (-50)
                (-50) (-50) (-50) (-50) (-50) (-50) (-50) (-50) (-50) (-50) (-50) (-50) (-50) (-50) (-50) (-50) (-50) (-50)
                (-50) (-50) (-50) (-50) (-50) (-50) (-50) (-50) (-50) (-50) (-50) (-50) (-50) (-50) (-50) (-50) (-50) (-50)
                (-50) (-50) (-50) (-50) (-50) (-50) (-50) (-50) (-50) (-50) (-50) (-50) (-50) (-50) (-50) (-50) (-50) (-50)
                (-50) (-50) (-50)>;

            PS_Config_Diff_Test_Frame = <50>;
        };

        /* for Xiaomi F7A Shenchao NVT36672A module TM6.30" */
        novatek-mp-criteria-5913@0 {

            #address-cells = <1>;
            #size-cells = <0>;
            compatible = "novatek-mp-criteria-5913";

            /* MP Config */
            IC_X_CFG_SIZE = <18>;
            IC_Y_CFG_SIZE = <36>;
            IC_KEY_CFG_SIZE = <0>;
            X_Channel = <18>;
            Y_Channel = <36>;
            AIN_X = <0 1 2 3 4 5 6 7 8 9 10 11 12 13 14 15 16 17>;
            AIN_Y = <0 1 2 3 4 5 6 7 8 9 10 11 12 13 14 15 16 17
                18 19 20 21 22 23 24 25 26 27 28 29 30 31 32 33 34 35>;

            AIN_KEY = <0 1 2 0xFF>;

            /* MP Criteria */
            PS_Config_Lmt_Short_Rawdata_P = <
                14000 14000 14000 14000 14000 14000 14000 14000 14000 14000 14000 14000 14000 14000 14000 14000 14000 14000
                14000 14000 14000 14000 14000 14000 14000 14000 14000 14000 14000 14000 14000 14000 14000 14000 14000 14000
                14000 14000 14000 14000 14000 14000 14000 14000 14000 14000 14000 14000 14000 14000 14000 14000 14000 14000
                14000 14000 14000 14000 14000 14000 14000 14000 14000 14000 14000 14000 14000 14000 14000 14000 14000 14000
                14000 14000 14000 14000 14000 14000 14000 14000 14000 14000 14000 14000 14000 14000 14000 14000 14000 14000
                14000 14000 14000 14000 14000 14000 14000 14000 14000 14000 14000 14000 14000 14000 14000 14000 14000 14000
                14000 14000 14000 14000 14000 14000 14000 14000 14000 14000 14000 14000 14000 14000 14000 14000 14000 14000
                14000 14000 14000 14000 14000 14000 14000 14000 14000 14000 14000 14000 14000 14000 14000 14000 14000 14000
                14000 14000 14000 14000 14000 14000 14000 14000 14000 14000 14000 14000 14000 14000 14000 14000 14000 14000
                14000 14000 14000 14000 14000 14000 14000 14000 14000 14000 14000 14000 14000 14000 14000 14000 14000 14000
                14000 14000 14000 14000 14000 14000 14000 14000 14000 14000 14000 14000 14000 14000 14000 14000 14000 14000
                14000 14000 14000 14000 14000 14000 14000 14000 14000 14000 14000 14000 14000 14000 14000 14000 14000 14000
                14000 14000 14000 14000 14000 14000 14000 14000 14000 14000 14000 14000 14000 14000 14000 14000 14000 14000
                14000 14000 14000 14000 14000 14000 14000 14000 14000 14000 14000 14000 14000 14000 14000 14000 14000 14000
                14000 14000 14000 14000 14000 14000 14000 14000 14000 14000 14000 14000 14000 14000 14000 14000 14000 14000
                14000 14000 14000 14000 14000 14000 14000 14000 14000 14000 14000 14000 14000 14000 14000 14000 14000 14000
                14000 14000 14000 14000 14000 14000 14000 14000 14000 14000 14000 14000 14000 14000 14000 14000 14000 14000
                14000 14000 14000 14000 14000 14000 14000 14000 14000 14000 14000 14000 14000 14000 14000 14000 14000 14000
                14000 14000 14000 14000 14000 14000 14000 14000 14000 14000 14000 14000 14000 14000 14000 14000 14000 14000
                14000 14000 14000 14000 14000 14000 14000 14000 14000 14000 14000 14000 14000 14000 14000 14000 14000 14000
                14000 14000 14000 14000 14000 14000 14000 14000 14000 14000 14000 14000 14000 14000 14000 14000 14000 14000
                14000 14000 14000 14000 14000 14000 14000 14000 14000 14000 14000 14000 14000 14000 14000 14000 14000 14000
                14000 14000 14000 14000 14000 14000 14000 14000 14000 14000 14000 14000 14000 14000 14000 14000 14000 14000
                14000 14000 14000 14000 14000 14000 14000 14000 14000 14000 14000 14000 14000 14000 14000 14000 14000 14000
                14000 14000 14000 14000 14000 14000 14000 14000 14000 14000 14000 14000 14000 14000 14000 14000 14000 14000
                14000 14000 14000 14000 14000 14000 14000 14000 14000 14000 14000 14000 14000 14000 14000 14000 14000 14000
                14000 14000 14000 14000 14000 14000 14000 14000 14000 14000 14000 14000 14000 14000 14000 14000 14000 14000
                14000 14000 14000 14000 14000 14000 14000 14000 14000 14000 14000 14000 14000 14000 14000 14000 14000 14000
                14000 14000 14000 14000 14000 14000 14000 14000 14000 14000 14000 14000 14000 14000 14000 14000 14000 14000
                14000 14000 14000 14000 14000 14000 14000 14000 14000 14000 14000 14000 14000 14000 14000 14000 14000 14000
                14000 14000 14000 14000 14000 14000 14000 14000 14000 14000 14000 14000 14000 14000 14000 14000 14000 14000
                14000 14000 14000 14000 14000 14000 14000 14000 14000 14000 14000 14000 14000 14000 14000 14000 14000 14000
                14000 14000 14000 14000 14000 14000 14000 14000 14000 14000 14000 14000 14000 14000 14000 14000 14000 14000
                14000 14000 14000 14000 14000 14000 14000 14000 14000 14000 14000 14000 14000 14000 14000 14000 14000 14000
                14000 14000 14000 14000 14000 14000 14000 14000 14000 14000 14000 14000 14000 14000 14000 14000 14000 14000
                14000 14000 14000 14000 14000 14000 14000 14000 14000 14000 14000 14000 14000 14000 14000 14000 14000 14000
                20000 20000 20000>;

            PS_Config_Lmt_Short_Rawdata_N = <
                11000 11000 11000 11000 11000 11000 11000 11000 11000 11000 11000 11000 11000 11000 11000 11000 11000 11000
                11000 11000 11000 11000 11000 11000 11000 11000 11000 11000 11000 11000 11000 11000 11000 11000 11000 11000
                11000 11000 11000 11000 11000 11000 11000 11000 11000 11000 11000 11000 11000 11000 11000 11000 11000 11000
                11000 11000 11000 11000 11000 11000 11000 11000 11000 11000 11000 11000 11000 11000 11000 11000 11000 11000
                11000 11000 11000 11000 11000 11000 11000 11000 11000 11000 11000 11000 11000 11000 11000 11000 11000 11000
                11000 11000 11000 11000 11000 11000 11000 11000 11000 11000 11000 11000 11000 11000 11000 11000 11000 11000
                11000 11000 11000 11000 11000 11000 11000 11000 11000 11000 11000 11000 11000 11000 11000 11000 11000 11000
                11000 11000 11000 11000 11000 11000 11000 11000 11000 11000 11000 11000 11000 11000 11000 11000 11000 11000
                11000 11000 11000 11000 11000 11000 11000 11000 11000 11000 11000 11000 11000 11000 11000 11000 11000 11000
                11000 11000 11000 11000 11000 11000 11000 11000 11000 11000 11000 11000 11000 11000 11000 11000 11000 11000
                11000 11000 11000 11000 11000 11000 11000 11000 11000 11000 11000 11000 11000 11000 11000 11000 11000 11000
                11000 11000 11000 11000 11000 11000 11000 11000 11000 11000 11000 11000 11000 11000 11000 11000 11000 11000
                11000 11000 11000 11000 11000 11000 11000 11000 11000 11000 11000 11000 11000 11000 11000 11000 11000 11000
                11000 11000 11000 11000 11000 11000 11000 11000 11000 11000 11000 11000 11000 11000 11000 11000 11000 11000
                11000 11000 11000 11000 11000 11000 11000 11000 11000 11000 11000 11000 11000 11000 11000 11000 11000 11000
                11000 11000 11000 11000 11000 11000 11000 11000 11000 11000 11000 11000 11000 11000 11000 11000 11000 11000
                11000 11000 11000 11000 11000 11000 11000 11000 11000 11000 11000 11000 11000 11000 11000 11000 11000 11000
                11000 11000 11000 11000 11000 11000 11000 11000 11000 11000 11000 11000 11000 11000 11000 11000 11000 11000
                11000 11000 11000 11000 11000 11000 11000 11000 11000 11000 11000 11000 11000 11000 11000 11000 11000 11000
                11000 11000 11000 11000 11000 11000 11000 11000 11000 11000 11000 11000 11000 11000 11000 11000 11000 11000
                11000 11000 11000 11000 11000 11000 11000 11000 11000 11000 11000 11000 11000 11000 11000 11000 11000 11000
                11000 11000 11000 11000 11000 11000 11000 11000 11000 11000 11000 11000 11000 11000 11000 11000 11000 11000
                11000 11000 11000 11000 11000 11000 11000 11000 11000 11000 11000 11000 11000 11000 11000 11000 11000 11000
                11000 11000 11000 11000 11000 11000 11000 11000 11000 11000 11000 11000 11000 11000 11000 11000 11000 11000
                11000 11000 11000 11000 11000 11000 11000 11000 11000 11000 11000 11000 11000 11000 11000 11000 11000 11000
                11000 11000 11000 11000 11000 11000 11000 11000 11000 11000 11000 11000 11000 11000 11000 11000 11000 11000
                11000 11000 11000 11000 11000 11000 11000 11000 11000 11000 11000 11000 11000 11000 11000 11000 11000 11000
                11000 11000 11000 11000 11000 11000 11000 11000 11000 11000 11000 11000 11000 11000 11000 11000 11000 11000
                11000 11000 11000 11000 11000 11000 11000 11000 11000 11000 11000 11000 11000 11000 11000 11000 11000 11000
                11000 11000 11000 11000 11000 11000 11000 11000 11000 11000 11000 11000 11000 11000 11000 11000 11000 11000
                11000 11000 11000 11000 11000 11000 11000 11000 11000 11000 11000 11000 11000 11000 11000 11000 11000 11000
                11000 11000 11000 11000 11000 11000 11000 11000 11000 11000 11000 11000 11000 11000 11000 11000 11000 11000
                11000 11000 11000 11000 11000 11000 11000 11000 11000 11000 11000 11000 11000 11000 11000 11000 11000 11000
                11000 11000 11000 11000 11000 11000 11000 11000 11000 11000 11000 11000 11000 11000 11000 11000 11000 11000
                11000 11000 11000 11000 11000 11000 11000 11000 11000 11000 11000 11000 11000 11000 11000 11000 11000 11000
                11000 11000 11000 11000 11000 11000 11000 11000 11000 11000 11000 11000 11000 11000 11000 11000 11000 11000
                11550 11550 11550>;

            PS_Config_Lmt_Short_Diff_P = <
                6300 6300 6300 6300 6300 6300 6300 6300 6300 6300 6300 6300 6300 6300 6300 6300 6300 6300
                6300 6300 6300 6300 6300 6300 6300 6300 6300 6300 6300 6300 6300 6300 6300 6300 6300 6300
                6300 6300 6300 6300 6300 6300 6300 6300 6300 6300 6300 6300 6300 6300 6300 6300 6300 6300
                6300 6300 6300 6300 6300 6300 6300 6300 6300 6300 6300 6300 6300 6300 6300 6300 6300 6300
                6300 6300 6300 6300 6300 6300 6300 6300 6300 6300 6300 6300 6300 6300 6300 6300 6300 6300
                6300 6300 6300 6300 6300 6300 6300 6300 6300 6300 6300 6300 6300 6300 6300 6300 6300 6300
                6300 6300 6300 6300 6300 6300 6300 6300 6300 6300 6300 6300 6300 6300 6300 6300 6300 6300
                6300 6300 6300 6300 6300 6300 6300 6300 6300 6300 6300 6300 6300 6300 6300 6300 6300 6300
                6300 6300 6300 6300 6300 6300 6300 6300 6300 6300 6300 6300 6300 6300 6300 6300 6300 6300
                6300 6300 6300 6300 6300 6300 6300 6300 6300 6300 6300 6300 6300 6300 6300 6300 6300 6300
                6300 6300 6300 6300 6300 6300 6300 6300 6300 6300 6300 6300 6300 6300 6300 6300 6300 6300
                6300 6300 6300 6300 6300 6300 6300 6300 6300 6300 6300 6300 6300 6300 6300 6300 6300 6300
                6300 6300 6300 6300 6300 6300 6300 6300 6300 6300 6300 6300 6300 6300 6300 6300 6300 6300
                6300 6300 6300 6300 6300 6300 6300 6300 6300 6300 6300 6300 6300 6300 6300 6300 6300 6300
                6300 6300 6300 6300 6300 6300 6300 6300 6300 6300 6300 6300 6300 6300 6300 6300 6300 6300
                6300 6300 6300 6300 6300 6300 6300 6300 6300 6300 6300 6300 6300 6300 6300 6300 6300 6300
                6300 6300 6300 6300 6300 6300 6300 6300 6300 6300 6300 6300 6300 6300 6300 6300 6300 6300
                6300 6300 6300 6300 6300 6300 6300 6300 6300 6300 6300 6300 6300 6300 6300 6300 6300 6300
                6300 6300 6300 6300 6300 6300 6300 6300 6300 6300 6300 6300 6300 6300 6300 6300 6300 6300
                6300 6300 6300 6300 6300 6300 6300 6300 6300 6300 6300 6300 6300 6300 6300 6300 6300 6300
                6300 6300 6300 6300 6300 6300 6300 6300 6300 6300 6300 6300 6300 6300 6300 6300 6300 6300
                6300 6300 6300 6300 6300 6300 6300 6300 6300 6300 6300 6300 6300 6300 6300 6300 6300 6300
                6300 6300 6300 6300 6300 6300 6300 6300 6300 6300 6300 6300 6300 6300 6300 6300 6300 6300
                6300 6300 6300 6300 6300 6300 6300 6300 6300 6300 6300 6300 6300 6300 6300 6300 6300 6300
                6300 6300 6300 6300 6300 6300 6300 6300 6300 6300 6300 6300 6300 6300 6300 6300 6300 6300
                6300 6300 6300 6300 6300 6300 6300 6300 6300 6300 6300 6300 6300 6300 6300 6300 6300 6300
                6300 6300 6300 6300 6300 6300 6300 6300 6300 6300 6300 6300 6300 6300 6300 6300 6300 6300
                6300 6300 6300 6300 6300 6300 6300 6300 6300 6300 6300 6300 6300 6300 6300 6300 6300 6300
                6300 6300 6300 6300 6300 6300 6300 6300 6300 6300 6300 6300 6300 6300 6300 6300 6300 6300
                6300 6300 6300 6300 6300 6300 6300 6300 6300 6300 6300 6300 6300 6300 6300 6300 6300 6300
                6300 6300 6300 6300 6300 6300 6300 6300 6300 6300 6300 6300 6300 6300 6300 6300 6300 6300
                6300 6300 6300 6300 6300 6300 6300 6300 6300 6300 6300 6300 6300 6300 6300 6300 6300 6300
                6300 6300 6300>;

            PS_Config_Lmt_Short_Diff_N = <
                0 0 0 0 0 0 0 0 0 0 0 0 0 0 0 0 0 0
                0 0 0 0 0 0 0 0 0 0 0 0 0 0 0 0 0 0
                0 0 0 0 0 0 0 0 0 0 0 0 0 0 0 0 0 0
                0 0 0 0 0 0 0 0 0 0 0 0 0 0 0 0 0 0
                0 0 0 0 0 0 0 0 0 0 0 0 0 0 0 0 0 0
                0 0 0 0 0 0 0 0 0 0 0 0 0 0 0 0 0 0
                0 0 0 0 0 0 0 0 0 0 0 0 0 0 0 0 0 0
                0 0 0 0 0 0 0 0 0 0 0 0 0 0 0 0 0 0
                0 0 0 0 0 0 0 0 0 0 0 0 0 0 0 0 0 0
                0 0 0 0 0 0 0 0 0 0 0 0 0 0 0 0 0 0
                0 0 0 0 0 0 0 0 0 0 0 0 0 0 0 0 0 0
                0 0 0 0 0 0 0 0 0 0 0 0 0 0 0 0 0 0
                0 0 0 0 0 0 0 0 0 0 0 0 0 0 0 0 0 0
                0 0 0 0 0 0 0 0 0 0 0 0 0 0 0 0 0 0
                0 0 0 0 0 0 0 0 0 0 0 0 0 0 0 0 0 0
                0 0 0 0 0 0 0 0 0 0 0 0 0 0 0 0 0 0
                0 0 0 0 0 0 0 0 0 0 0 0 0 0 0 0 0 0
                0 0 0 0 0 0 0 0 0 0 0 0 0 0 0 0 0 0
                0 0 0 0 0 0 0 0 0 0 0 0 0 0 0 0 0 0
                0 0 0 0 0 0 0 0 0 0 0 0 0 0 0 0 0 0
                0 0 0 0 0 0 0 0 0 0 0 0 0 0 0 0 0 0
                0 0 0 0 0 0 0 0 0 0 0 0 0 0 0 0 0 0
                0 0 0 0 0 0 0 0 0 0 0 0 0 0 0 0 0 0
                0 0 0 0 0 0 0 0 0 0 0 0 0 0 0 0 0 0
                0 0 0 0 0 0 0 0 0 0 0 0 0 0 0 0 0 0
                0 0 0 0 0 0 0 0 0 0 0 0 0 0 0 0 0 0
                0 0 0 0 0 0 0 0 0 0 0 0 0 0 0 0 0 0
                0 0 0 0 0 0 0 0 0 0 0 0 0 0 0 0 0 0
                0 0 0 0 0 0 0 0 0 0 0 0 0 0 0 0 0 0
                0 0 0 0 0 0 0 0 0 0 0 0 0 0 0 0 0 0
                0 0 0 0 0 0 0 0 0 0 0 0 0 0 0 0 0 0
                0 0 0 0 0 0 0 0 0 0 0 0 0 0 0 0 0 0
                0 0 0>;

            PS_Config_Lmt_Short_Base_P = <
                2000 2000 2000 2000 2000 2000 2000 2000 2000 2000 2000 2000 2000 2000 2000 2000 2000 2000
                2000 2000 2000 2000 2000 2000 2000 2000 2000 2000 2000 2000 2000 2000 2000 2000 2000 2000
                2000 2000 2000 2000 2000 2000 2000 2000 2000 2000 2000 2000 2000 2000 2000 2000 2000 2000
                2000 2000 2000 2000 2000 2000 2000 2000 2000 2000 2000 2000 2000 2000 2000 2000 2000 2000
                2000 2000 2000 2000 2000 2000 2000 2000 2000 2000 2000 2000 2000 2000 2000 2000 2000 2000
                2000 2000 2000 2000 2000 2000 2000 2000 2000 2000 2000 2000 2000 2000 2000 2000 2000 2000
                2000 2000 2000 2000 2000 2000 2000 2000 2000 2000 2000 2000 2000 2000 2000 2000 2000 2000
                2000 2000 2000 2000 2000 2000 2000 2000 2000 2000 2000 2000 2000 2000 2000 2000 2000 2000
                2000 2000 2000 2000 2000 2000 2000 2000 2000 2000 2000 2000 2000 2000 2000 2000 2000 2000
                2000 2000 2000 2000 2000 2000 2000 2000 2000 2000 2000 2000 2000 2000 2000 2000 2000 2000
                2000 2000 2000 2000 2000 2000 2000 2000 2000 2000 2000 2000 2000 2000 2000 2000 2000 2000
                2000 2000 2000 2000 2000 2000 2000 2000 2000 2000 2000 2000 2000 2000 2000 2000 2000 2000
                2000 2000 2000 2000 2000 2000 2000 2000 2000 2000 2000 2000 2000 2000 2000 2000 2000 2000
                2000 2000 2000 2000 2000 2000 2000 2000 2000 2000 2000 2000 2000 2000 2000 2000 2000 2000
                2000 2000 2000 2000 2000 2000 2000 2000 2000 2000 2000 2000 2000 2000 2000 2000 2000 2000
                2000 2000 2000 2000 2000 2000 2000 2000 2000 2000 2000 2000 2000 2000 2000 2000 2000 2000
                2000 2000 2000 2000 2000 2000 2000 2000 2000 2000 2000 2000 2000 2000 2000 2000 2000 2000
                2000 2000 2000 2000 2000 2000 2000 2000 2000 2000 2000 2000 2000 2000 2000 2000 2000 2000
                2000 2000 2000 2000 2000 2000 2000 2000 2000 2000 2000 2000 2000 2000 2000 2000 2000 2000
                2000 2000 2000 2000 2000 2000 2000 2000 2000 2000 2000 2000 2000 2000 2000 2000 2000 2000
                2000 2000 2000 2000 2000 2000 2000 2000 2000 2000 2000 2000 2000 2000 2000 2000 2000 2000
                2000 2000 2000 2000 2000 2000 2000 2000 2000 2000 2000 2000 2000 2000 2000 2000 2000 2000
                2000 2000 2000 2000 2000 2000 2000 2000 2000 2000 2000 2000 2000 2000 2000 2000 2000 2000
                2000 2000 2000 2000 2000 2000 2000 2000 2000 2000 2000 2000 2000 2000 2000 2000 2000 2000
                2000 2000 2000 2000 2000 2000 2000 2000 2000 2000 2000 2000 2000 2000 2000 2000 2000 2000
                2000 2000 2000 2000 2000 2000 2000 2000 2000 2000 2000 2000 2000 2000 2000 2000 2000 2000
                2000 2000 2000 2000 2000 2000 2000 2000 2000 2000 2000 2000 2000 2000 2000 2000 2000 2000
                2000 2000 2000 2000 2000 2000 2000 2000 2000 2000 2000 2000 2000 2000 2000 2000 2000 2000
                2000 2000 2000 2000 2000 2000 2000 2000 2000 2000 2000 2000 2000 2000 2000 2000 2000 2000
                2000 2000 2000 2000 2000 2000 2000 2000 2000 2000 2000 2000 2000 2000 2000 2000 2000 2000
                2000 2000 2000 2000 2000 2000 2000 2000 2000 2000 2000 2000 2000 2000 2000 2000 2000 2000
                2000 2000 2000 2000 2000 2000 2000 2000 2000 2000 2000 2000 2000 2000 2000 2000 2000 2000
                2000 2000 2000>;

            PS_Config_Lmt_Short_Base_N = <
                (-2000) (-2000) (-2000) (-2000) (-2000) (-2000) (-2000) (-2000) (-2000) (-2000) (-2000) (-2000) (-2000) (-2000) (-2000) (-2000) (-2000) (-2000)
                (-2000) (-2000) (-2000) (-2000) (-2000) (-2000) (-2000) (-2000) (-2000) (-2000) (-2000) (-2000) (-2000) (-2000) (-2000) (-2000) (-2000) (-2000)
                (-2000) (-2000) (-2000) (-2000) (-2000) (-2000) (-2000) (-2000) (-2000) (-2000) (-2000) (-2000) (-2000) (-2000) (-2000) (-2000) (-2000) (-2000)
                (-2000) (-2000) (-2000) (-2000) (-2000) (-2000) (-2000) (-2000) (-2000) (-2000) (-2000) (-2000) (-2000) (-2000) (-2000) (-2000) (-2000) (-2000)
                (-2000) (-2000) (-2000) (-2000) (-2000) (-2000) (-2000) (-2000) (-2000) (-2000) (-2000) (-2000) (-2000) (-2000) (-2000) (-2000) (-2000) (-2000)
                (-2000) (-2000) (-2000) (-2000) (-2000) (-2000) (-2000) (-2000) (-2000) (-2000) (-2000) (-2000) (-2000) (-2000) (-2000) (-2000) (-2000) (-2000)
                (-2000) (-2000) (-2000) (-2000) (-2000) (-2000) (-2000) (-2000) (-2000) (-2000) (-2000) (-2000) (-2000) (-2000) (-2000) (-2000) (-2000) (-2000)
                (-2000) (-2000) (-2000) (-2000) (-2000) (-2000) (-2000) (-2000) (-2000) (-2000) (-2000) (-2000) (-2000) (-2000) (-2000) (-2000) (-2000) (-2000)
                (-2000) (-2000) (-2000) (-2000) (-2000) (-2000) (-2000) (-2000) (-2000) (-2000) (-2000) (-2000) (-2000) (-2000) (-2000) (-2000) (-2000) (-2000)
                (-2000) (-2000) (-2000) (-2000) (-2000) (-2000) (-2000) (-2000) (-2000) (-2000) (-2000) (-2000) (-2000) (-2000) (-2000) (-2000) (-2000) (-2000)
                (-2000) (-2000) (-2000) (-2000) (-2000) (-2000) (-2000) (-2000) (-2000) (-2000) (-2000) (-2000) (-2000) (-2000) (-2000) (-2000) (-2000) (-2000)
                (-2000) (-2000) (-2000) (-2000) (-2000) (-2000) (-2000) (-2000) (-2000) (-2000) (-2000) (-2000) (-2000) (-2000) (-2000) (-2000) (-2000) (-2000)
                (-2000) (-2000) (-2000) (-2000) (-2000) (-2000) (-2000) (-2000) (-2000) (-2000) (-2000) (-2000) (-2000) (-2000) (-2000) (-2000) (-2000) (-2000)
                (-2000) (-2000) (-2000) (-2000) (-2000) (-2000) (-2000) (-2000) (-2000) (-2000) (-2000) (-2000) (-2000) (-2000) (-2000) (-2000) (-2000) (-2000)
                (-2000) (-2000) (-2000) (-2000) (-2000) (-2000) (-2000) (-2000) (-2000) (-2000) (-2000) (-2000) (-2000) (-2000) (-2000) (-2000) (-2000) (-2000)
                (-2000) (-2000) (-2000) (-2000) (-2000) (-2000) (-2000) (-2000) (-2000) (-2000) (-2000) (-2000) (-2000) (-2000) (-2000) (-2000) (-2000) (-2000)
                (-2000) (-2000) (-2000) (-2000) (-2000) (-2000) (-2000) (-2000) (-2000) (-2000) (-2000) (-2000) (-2000) (-2000) (-2000) (-2000) (-2000) (-2000)
                (-2000) (-2000) (-2000) (-2000) (-2000) (-2000) (-2000) (-2000) (-2000) (-2000) (-2000) (-2000) (-2000) (-2000) (-2000) (-2000) (-2000) (-2000)
                (-2000) (-2000) (-2000) (-2000) (-2000) (-2000) (-2000) (-2000) (-2000) (-2000) (-2000) (-2000) (-2000) (-2000) (-2000) (-2000) (-2000) (-2000)
                (-2000) (-2000) (-2000) (-2000) (-2000) (-2000) (-2000) (-2000) (-2000) (-2000) (-2000) (-2000) (-2000) (-2000) (-2000) (-2000) (-2000) (-2000)
                (-2000) (-2000) (-2000) (-2000) (-2000) (-2000) (-2000) (-2000) (-2000) (-2000) (-2000) (-2000) (-2000) (-2000) (-2000) (-2000) (-2000) (-2000)
                (-2000) (-2000) (-2000) (-2000) (-2000) (-2000) (-2000) (-2000) (-2000) (-2000) (-2000) (-2000) (-2000) (-2000) (-2000) (-2000) (-2000) (-2000)
                (-2000) (-2000) (-2000) (-2000) (-2000) (-2000) (-2000) (-2000) (-2000) (-2000) (-2000) (-2000) (-2000) (-2000) (-2000) (-2000) (-2000) (-2000)
                (-2000) (-2000) (-2000) (-2000) (-2000) (-2000) (-2000) (-2000) (-2000) (-2000) (-2000) (-2000) (-2000) (-2000) (-2000) (-2000) (-2000) (-2000)
                (-2000) (-2000) (-2000) (-2000) (-2000) (-2000) (-2000) (-2000) (-2000) (-2000) (-2000) (-2000) (-2000) (-2000) (-2000) (-2000) (-2000) (-2000)
                (-2000) (-2000) (-2000) (-2000) (-2000) (-2000) (-2000) (-2000) (-2000) (-2000) (-2000) (-2000) (-2000) (-2000) (-2000) (-2000) (-2000) (-2000)
                (-2000) (-2000) (-2000) (-2000) (-2000) (-2000) (-2000) (-2000) (-2000) (-2000) (-2000) (-2000) (-2000) (-2000) (-2000) (-2000) (-2000) (-2000)
                (-2000) (-2000) (-2000) (-2000) (-2000) (-2000) (-2000) (-2000) (-2000) (-2000) (-2000) (-2000) (-2000) (-2000) (-2000) (-2000) (-2000) (-2000)
                (-2000) (-2000) (-2000) (-2000) (-2000) (-2000) (-2000) (-2000) (-2000) (-2000) (-2000) (-2000) (-2000) (-2000) (-2000) (-2000) (-2000) (-2000)
                (-2000) (-2000) (-2000) (-2000) (-2000) (-2000) (-2000) (-2000) (-2000) (-2000) (-2000) (-2000) (-2000) (-2000) (-2000) (-2000) (-2000) (-2000)
                (-2000) (-2000) (-2000) (-2000) (-2000) (-2000) (-2000) (-2000) (-2000) (-2000) (-2000) (-2000) (-2000) (-2000) (-2000) (-2000) (-2000) (-2000)
                (-2000) (-2000) (-2000) (-2000) (-2000) (-2000) (-2000) (-2000) (-2000) (-2000) (-2000) (-2000) (-2000) (-2000) (-2000) (-2000) (-2000) (-2000)
                (-2000) (-2000) (-2000)>;

            PS_Config_Lmt_Open_Rawdata_P = <
                65535	3409	3402	3402	3407	3393	3396	3342	65535	65535	3403	3465	3467	3478	3478	3467	3471	65535
                3098	3136	3137	3134	3137	3127	3130	3121	2950	2993	3168	3179	3180	3189	3190	3188	3185	3138
                3247	3216	3216	3214	3216	3205	3208	3197	3197	3251	3247	3259	3260	3270	3272	3267	3267	3284
                3173	3142	3143	3140	3141	3130	3133	3121	3123	3177	3173	3185	3186	3194	3198	3195	3195	3212
                3254	3221	3223	3219	3219	3208	3212	3199	3201	3257	3251	3264	3264	3273	3276	3273	3275	3293
                3179	3146	3147	3142	3142	3132	3136	3123	3125	3172	3167	3180	3181	3189	3193	3193	3194	3215
                3253	3219	3220	3216	3216	3206	3208	3195	3199	3249	3241	3257	3257	3266	3270	3270	3267	3288
                3180	3145	3147	3142	3143	3133	3136	3123	3128	3169	3163	3177	3176	3184	3188	3190	3188	3211
                3255	3220	3223	3218	3219	3207	3212	3197	3202	3245	3237	3253	3251	3260	3263	3267	3264	3290
                3169	3136	3138	3132	3133	3123	3128	3115	3117	3163	3156	3171	3168	3176	3179	3185	3182	3208
                3246	3211	3215	3208	3208	3199	3203	3190	3193	3244	3236	3247	3247	3255	3258	3264	3262	3288
                3167	3130	3136	3129	3129	3119	3124	3112	3115	3156	3146	3156	3155	3163	3166	3172	3171	3197
                3233	3199	3203	3197	3198	3188	3192	3180	3182	3228	3216	3225	3224	3233	3236	3244	3244	3271
                3155	3121	3125	3119	3120	3110	3114	3106	3104	3145	3136	3143	3142	3151	3154	3162	3163	3190
                3220	3185	3192	3185	3186	3176	3180	3175	3171	3219	3208	3216	3215	3224	3225	3234	3233	3262
                3136	3103	3108	3102	3103	3094	3101	3093	3089	3130	3124	3129	3127	3136	3140	3147	3147	3175
                3207	3173	3179	3172	3175	3164	3171	3169	3160	3207	3201	3203	3202	3211	3212	3221	3221	3251
                3121	3089	3094	3088	3088	3078	3086	3080	3075	3115	3104	3112	3108	3116	3119	3128	3128	3156
                3182	3149	3154	3146	3149	3140	3146	3140	3134	3189	3179	3186	3181	3190	3193	3202	3203	3231
                3099	3064	3071	3064	3065	3056	3064	3058	3055	3101	3090	3098	3093	3101	3104	3111	3112	3141
                3163	3129	3134	3128	3130	3121	3129	3121	3123	3168	3158	3164	3160	3168	3171	3179	3180	3210
                3078	3043	3049	3043	3045	3037	3047	3037	3037	3075	3064	3073	3068	3075	3078	3085	3086	3116
                3140	3107	3111	3106	3107	3099	3107	3099	3098	3149	3137	3146	3141	3149	3151	3156	3159	3189
                3054	3020	3024	3017	3020	3012	3021	3013	3012	3051	3041	3051	3045	3052	3054	3060	3062	3091
                2920	2887	2893	2889	2887	2880	2889	2881	2885	2929	2915	2924	2917	2925	2928	2933	2935	2964
                2842	2809	2813	2808	2809	2802	2811	2803	2807	2834	2824	2833	2826	2833	2835	2842	2844	2873
                2900	2865	2870	2864	2865	2859	2868	2861	2863	2899	2894	2900	2893	2900	2903	2908	2912	2943
                2817	2782	2787	2781	2782	2776	2785	2779	2779	2795	2794	2802	2796	2803	2804	2812	2813	2844
                2872	2841	2844	2839	2839	2833	2843	2834	2837	2856	2854	2864	2856	2863	2865	2872	2874	2903
                2783	2752	2756	2751	2751	2746	2755	2746	2748	2765	2763	2774	2766	2772	2774	2782	2783	2809
                2839	2807	2811	2804	2804	2799	2808	2798	2803	2826	2824	2835	2828	2833	2837	2843	2844	2872
                2753	2720	2724	2718	2718	2712	2722	2712	2716	2734	2731	2744	2735	2742	2744	2751	2752	2778
                2805	2774	2777	2772	2772	2765	2778	2765	2770	2791	2789	2802	2792	2800	2802	2808	2809	2837
                2356	2682	2685	2681	2681	2675	2690	2675	2679	2696	2692	2709	2696	2703	2705	2712	2712	2375
                2331	2733	2737	2731	2733	2726	2742	2725	2730	2757	2753	2772	2756	2764	2765	2772	2774	2362
                2161	2562	2666	2672	2673	2659	2675	2660	2665	2685	2682	2699	2685	2699	2700	2696	2595	2187
                13000 13000 13000>;

            PS_Config_Lmt_Open_Rawdata_N = <
                (-65535)	1835	1832	1832	1835	1827	1828	1800	(-65535)	(-65535)	1833	1866	1867	1873	1873	1867	1869	(-65535)
                1668	1688	1689	1688	1689	1684	1686	1681	1588	1611	1706	1712	1712	1717	1718	1716	1715	1690
                1749	1732	1732	1730	1732	1726	1728	1721	1721	1751	1749	1755	1756	1761	1762	1759	1759	1768
                1709	1692	1693	1691	1691	1686	1687	1681	1681	1711	1709	1715	1716	1720	1722	1721	1721	1730
                1752	1735	1735	1733	1733	1728	1730	1723	1723	1754	1751	1758	1758	1763	1764	1763	1763	1773
                1712	1694	1695	1692	1692	1686	1688	1681	1683	1708	1705	1712	1713	1717	1719	1719	1720	1731
                1751	1733	1734	1732	1732	1726	1728	1721	1723	1749	1745	1754	1754	1758	1761	1761	1759	1770
                1712	1693	1695	1692	1693	1687	1688	1681	1684	1707	1703	1711	1710	1714	1716	1718	1716	1729
                1753	1734	1735	1733	1733	1727	1730	1721	1724	1747	1743	1751	1751	1756	1757	1759	1758	1772
                1707	1688	1690	1686	1687	1681	1684	1677	1679	1703	1700	1707	1706	1710	1712	1715	1714	1728
                1748	1729	1731	1728	1728	1723	1725	1718	1719	1747	1742	1749	1749	1753	1754	1758	1756	1770
                1705	1686	1688	1685	1685	1679	1682	1676	1677	1700	1694	1700	1699	1703	1705	1708	1707	1721
                1741	1723	1725	1721	1722	1716	1719	1712	1714	1738	1732	1737	1736	1741	1742	1747	1747	1761
                1699	1681	1683	1679	1680	1674	1677	1672	1672	1693	1688	1693	1692	1697	1698	1702	1703	1718
                1734	1715	1719	1715	1716	1710	1712	1709	1707	1733	1728	1732	1731	1736	1737	1742	1741	1756
                1688	1671	1674	1670	1671	1666	1670	1665	1663	1686	1682	1685	1684	1688	1691	1695	1695	1709
                1727	1709	1712	1708	1709	1704	1707	1707	1702	1727	1723	1725	1724	1729	1730	1735	1735	1751
                1681	1663	1666	1663	1663	1658	1662	1658	1656	1677	1672	1676	1674	1678	1679	1684	1684	1700
                1714	1695	1698	1694	1695	1691	1694	1691	1688	1717	1712	1716	1713	1718	1719	1724	1725	1740
                1669	1650	1653	1650	1651	1646	1650	1646	1645	1670	1664	1668	1665	1670	1672	1675	1676	1691
                1703	1685	1688	1684	1686	1681	1685	1681	1681	1706	1700	1704	1702	1706	1707	1712	1712	1728
                1658	1639	1642	1639	1639	1635	1641	1635	1635	1656	1650	1655	1652	1656	1658	1661	1662	1678
                1691	1673	1675	1672	1673	1669	1673	1669	1668	1695	1689	1694	1691	1695	1697	1700	1701	1717
                1644	1626	1628	1625	1626	1622	1627	1623	1622	1643	1637	1643	1639	1644	1644	1648	1649	1665
                1572	1555	1558	1555	1555	1551	1555	1551	1553	1577	1569	1574	1571	1575	1576	1579	1581	1596
                1530	1513	1515	1512	1513	1509	1513	1509	1511	1526	1520	1525	1522	1525	1527	1530	1532	1547
                1562	1543	1546	1542	1543	1539	1544	1541	1541	1561	1558	1562	1558	1562	1563	1566	1568	1585
                1517	1498	1501	1497	1498	1495	1499	1497	1497	1505	1504	1509	1506	1509	1510	1514	1515	1532
                1546	1530	1532	1529	1529	1525	1531	1526	1527	1538	1537	1542	1538	1541	1543	1546	1548	1563
                1499	1482	1484	1481	1481	1478	1483	1478	1480	1489	1488	1494	1490	1492	1494	1498	1499	1513
                1529	1511	1513	1510	1510	1507	1512	1506	1509	1522	1520	1527	1523	1525	1527	1531	1532	1546
                1483	1464	1467	1464	1464	1460	1466	1460	1462	1472	1471	1478	1473	1476	1478	1481	1482	1496
                1511	1494	1495	1492	1492	1489	1496	1489	1492	1503	1502	1509	1504	1508	1509	1512	1513	1527
                1268	1444	1446	1443	1443	1441	1448	1441	1443	1452	1450	1459	1452	1455	1457	1460	1460	1279
                1255	1471	1474	1471	1471	1468	1476	1467	1470	1485	1483	1492	1484	1488	1489	1492	1494	1272
                1163	1380	1436	1439	1439	1432	1441	1432	1435	1446	1444	1453	1446	1453	1454	1452	1397	1177
                6500 6500 6500>;

            PS_Config_Lmt_FW_Rawdata_P = <
                65535	1750	1750	1750	1750	1750	1750	1750	65535	65535	1750	1750	1750	1750	1750	1750	1750	65535
                1750	1750	1750	1750	1750	1750	1750	1750	1750	1750	1750	1750	1750	1750	1750	1750	1750	1750
                1750	1750	1750	1750	1750	1750	1750	1750	1750	1750	1750	1750	1750	1750	1750	1750	1750	1750
                1750	1750	1750	1750	1750	1750	1750	1750	1750	1750	1750	1750	1750	1750	1750	1750	1750	1750
                1750	1750	1750	1750	1750	1750	1750	1750	1750	1750	1750	1750	1750	1750	1750	1750	1750	1750
                1750	1750	1750	1750	1750	1750	1750	1750	1750	1750	1750	1750	1750	1750	1750	1750	1750	1750
                1750	1750	1750	1750	1750	1750	1750	1750	1750	1750	1750	1750	1750	1750	1750	1750	1750	1750
                1750	1750	1750	1750	1750	1750	1750	1750	1750	1750	1750	1750	1750	1750	1750	1750	1750	1750
                1750	1750	1750	1750	1750	1750	1750	1750	1750	1750	1750	1750	1750	1750	1750	1750	1750	1750
                1750	1750	1750	1750	1750	1750	1750	1750	1750	1750	1750	1750	1750	1750	1750	1750	1750	1750
                1750	1750	1750	1750	1750	1750	1750	1750	1750	1750	1750	1750	1750	1750	1750	1750	1750	1750
                1750	1750	1750	1750	1750	1750	1750	1750	1750	1750	1750	1750	1750	1750	1750	1750	1750	1750
                1750	1750	1750	1750	1750	1750	1750	1750	1750	1750	1750	1750	1750	1750	1750	1750	1750	1750
                1750	1750	1750	1750	1750	1750	1750	1750	1750	1750	1750	1750	1750	1750	1750	1750	1750	1750
                1750	1750	1750	1750	1750	1750	1750	1750	1750	1750	1750	1750	1750	1750	1750	1750	1750	1750
                1750	1750	1750	1750	1750	1750	1750	1750	1750	1750	1750	1750	1750	1750	1750	1750	1750	1750
                1750	1750	1750	1750	1750	1750	1750	1750	1750	1750	1750	1750	1750	1750	1750	1750	1750	1750
                1750	1750	1750	1750	1750	1750	1750	1750	1750	1750	1750	1750	1750	1750	1750	1750	1750	1750
                1750	1750	1750	1750	1750	1750	1750	1750	1750	1750	1750	1750	1750	1750	1750	1750	1750	1750
                1750	1750	1750	1750	1750	1750	1750	1750	1750	1750	1750	1750	1750	1750	1750	1750	1750	1750
                1750	1750	1750	1750	1750	1750	1750	1750	1750	1750	1750	1750	1750	1750	1750	1750	1750	1750
                1750	1750	1750	1750	1750	1750	1750	1750	1750	1750	1750	1750	1750	1750	1750	1750	1750	1750
                1750	1750	1750	1750	1750	1750	1750	1750	1750	1750	1750	1750	1750	1750	1750	1750	1750	1750
                1750	1750	1750	1750	1750	1750	1750	1750	1750	1750	1750	1750	1750	1750	1750	1750	1750	1750
                1750	1750	1750	1750	1750	1750	1750	1750	1750	1750	1750	1750	1750	1750	1750	1750	1750	1750
                1750	1750	1750	1750	1750	1750	1750	1750	1750	1750	1750	1750	1750	1750	1750	1750	1750	1750
                1750	1750	1750	1750	1750	1750	1750	1750	1750	1750	1750	1750	1750	1750	1750	1750	1750	1750
                1750	1750	1750	1750	1750	1750	1750	1750	1750	1750	1750	1750	1750	1750	1750	1750	1750	1750
                1750	1750	1750	1750	1750	1750	1750	1750	1750	1750	1750	1750	1750	1750	1750	1750	1750	1750
                1750	1750	1750	1750	1750	1750	1750	1750	1750	1750	1750	1750	1750	1750	1750	1750	1750	1750
                1750	1750	1750	1750	1750	1750	1750	1750	1750	1750	1750	1750	1750	1750	1750	1750	1750	1750
                1750	1750	1750	1750	1750	1750	1750	1750	1750	1750	1750	1750	1750	1750	1750	1750	1750	1750
                1750	1750	1750	1750	1750	1750	1750	1750	1750	1750	1750	1750	1750	1750	1750	1750	1750	1750
                1750	1750	1750	1750	1750	1750	1750	1750	1750	1750	1750	1750	1750	1750	1750	1750	1750	1750
                1750	1750	1750	1750	1750	1750	1750	1750	1750	1750	1750	1750	1750	1750	1750	1750	1750	1750
                1750	1750	1750	1750	1750	1750	1750	1750	1750	1750	1750	1750	1750	1750	1750	1750	1750	1750
                2000 2000 2000>;

            PS_Config_Lmt_FW_Rawdata_N = <
                (-65535)	650	650	650	650	650	650	650	(-65535)	(-65535)	650	650	650	650	650	650	650	(-65535)
                650	650	650	650	650	650	650	650	650	650	650	650	650	650	650	650	650	650
                650	650	650	650	650	650	650	650	650	650	650	650	650	650	650	650	650	650
                650	650	650	650	650	650	650	650	650	650	650	650	650	650	650	650	650	650
                650	650	650	650	650	650	650	650	650	650	650	650	650	650	650	650	650	650
                650	650	650	650	650	650	650	650	650	650	650	650	650	650	650	650	650	650
                650	650	650	650	650	650	650	650	650	650	650	650	650	650	650	650	650	650
                650	650	650	650	650	650	650	650	650	650	650	650	650	650	650	650	650	650
                650	650	650	650	650	650	650	650	650	650	650	650	650	650	650	650	650	650
                650	650	650	650	650	650	650	650	650	650	650	650	650	650	650	650	650	650
                650	650	650	650	650	650	650	650	650	650	650	650	650	650	650	650	650	650
                650	650	650	650	650	650	650	650	650	650	650	650	650	650	650	650	650	650
                650	650	650	650	650	650	650	650	650	650	650	650	650	650	650	650	650	650
                650	650	650	650	650	650	650	650	650	650	650	650	650	650	650	650	650	650
                650	650	650	650	650	650	650	650	650	650	650	650	650	650	650	650	650	650
                650	650	650	650	650	650	650	650	650	650	650	650	650	650	650	650	650	650
                650	650	650	650	650	650	650	650	650	650	650	650	650	650	650	650	650	650
                650	650	650	650	650	650	650	650	650	650	650	650	650	650	650	650	650	650
                650	650	650	650	650	650	650	650	650	650	650	650	650	650	650	650	650	650
                650	650	650	650	650	650	650	650	650	650	650	650	650	650	650	650	650	650
                650	650	650	650	650	650	650	650	650	650	650	650	650	650	650	650	650	650
                650	650	650	650	650	650	650	650	650	650	650	650	650	650	650	650	650	650
                650	650	650	650	650	650	650	650	650	650	650	650	650	650	650	650	650	650
                650	650	650	650	650	650	650	650	650	650	650	650	650	650	650	650	650	650
                650	650	650	650	650	650	650	650	650	650	650	650	650	650	650	650	650	650
                650	650	650	650	650	650	650	650	650	650	650	650	650	650	650	650	650	650
                650	650	650	650	650	650	650	650	650	650	650	650	650	650	650	650	650	650
                650	650	650	650	650	650	650	650	650	650	650	650	650	650	650	650	650	650
                650	650	650	650	650	650	650	650	650	650	650	650	650	650	650	650	650	650
                650	650	650	650	650	650	650	650	650	650	650	650	650	650	650	650	650	650
                650	650	650	650	650	650	650	650	650	650	650	650	650	650	650	650	650	650
                650	650	650	650	650	650	650	650	650	650	650	650	650	650	650	650	650	650
                650	650	650	650	650	650	650	650	650	650	650	650	650	650	650	650	650	650
                650	650	650	650	650	650	650	650	650	650	650	650	650	650	650	650	650	650
                650	650	650	650	650	650	650	650	650	650	650	650	650	650	650	650	650	650
                650	650	650	650	650	650	650	650	650	650	650	650	650	650	650	650	650	650
                400 400 400>;

            PS_Config_Lmt_FW_CC_P = <
                65535	125	122	122	122	122	121	126	65535	65535	131	127	129	127	127	127	130	65535
                129	124	121	121	121	122	121	122	122	125	125	122	124	122	122	124	125	129
                126	121	121	121	121	121	120	121	121	129	127	126	126	126	126	126	127	131
                126	122	121	121	121	121	121	122	121	126	126	124	125	124	124	125	125	129
                126	122	121	121	121	121	121	122	121	127	126	125	126	126	125	125	126	130
                127	124	122	122	122	124	122	124	124	126	125	122	124	122	122	122	124	127
                125	121	120	120	120	121	120	121	121	129	127	126	126	126	126	126	126	130
                126	121	121	121	121	121	121	122	122	126	125	124	124	124	124	124	124	129
                126	121	121	121	121	121	121	122	121	127	126	125	125	125	124	124	125	129
                127	122	122	122	122	122	122	124	124	126	124	124	124	122	122	122	124	127
                125	121	121	120	120	121	121	121	121	130	127	126	126	125	125	125	126	129
                125	121	121	121	121	121	121	122	121	130	125	124	124	122	122	122	122	126
                125	121	121	121	121	121	121	124	122	131	126	124	124	124	122	124	124	127
                126	122	122	122	122	124	124	126	124	130	126	122	122	121	121	121	121	125
                124	121	121	120	121	121	121	125	121	133	129	126	126	125	125	125	125	129
                125	121	121	121	121	122	121	126	122	131	126	122	124	122	122	122	122	126
                125	121	121	121	121	122	122	124	122	131	126	124	124	122	122	122	122	126
                126	122	122	122	122	124	124	125	124	130	124	121	121	121	121	121	121	124
                124	121	121	121	121	121	121	122	121	133	127	125	125	124	124	124	124	127
                125	121	121	121	121	122	121	124	124	131	125	122	122	121	121	121	121	125
                124	121	121	121	121	122	122	122	122	133	125	124	124	122	122	122	122	126
                126	122	124	124	122	125	125	125	124	130	122	121	121	120	120	121	120	122
                124	121	121	121	121	122	121	122	121	134	126	125	126	124	124	122	122	126
                124	121	121	121	121	124	122	125	122	131	124	122	122	121	121	121	121	124
                122	120	120	121	121	121	121	124	121	130	124	121	121	121	120	120	120	124
                125	121	122	121	122	124	124	126	122	126	122	121	121	118	118	118	118	121
                122	120	120	120	120	121	121	124	121	126	126	124	124	121	121	121	121	125
                124	121	121	121	121	122	122	126	121	121	124	121	121	120	120	120	118	121
                124	121	121	121	121	122	122	125	121	121	125	121	121	120	120	120	120	122
                125	121	122	121	122	124	124	126	122	120	122	121	121	118	118	118	118	121
                121	120	120	120	120	121	121	124	121	122	126	124	122	121	121	121	121	124
                124	121	121	121	121	122	122	125	121	120	124	121	121	118	118	118	118	121
                124	121	121	121	121	122	122	126	121	121	125	121	121	120	120	120	120	122
                122	121	121	122	122	124	125	126	122	118	122	121	120	118	118	118	118	118
                120	120	120	120	120	121	124	124	120	121	126	124	121	121	121	121	121	121
                117	118	118	120	120	121	124	125	121	120	125	122	121	118	118	118	118	117
                119 120 120>;

            PS_Config_Lmt_FW_CC_N = <
                (-65535)	67	66	66	66	66	65	68	(-65535)	(-65535)	71	69	69	69	69	69	70	(-65535)
                69	67	65	65	65	66	65	66	66	67	67	66	67	66	66	67	67	69
                68	65	65	65	65	65	64	65	65	69	69	68	68	68	68	68	69	71
                68	66	65	65	65	65	65	66	65	68	68	67	67	67	67	67	67	69
                68	66	65	65	65	65	65	66	65	69	68	67	68	68	67	67	68	70
                69	67	66	66	66	67	66	67	67	68	67	66	67	66	66	66	67	69
                67	65	64	64	64	65	64	65	65	69	69	68	68	68	68	68	68	70
                68	65	65	65	65	65	65	66	66	68	67	67	67	67	67	67	67	69
                68	65	65	65	65	65	65	66	65	69	68	67	67	67	67	67	67	69
                69	66	66	66	66	66	66	67	67	68	67	67	67	66	66	66	67	69
                67	65	65	64	64	65	65	65	65	70	69	68	68	67	67	67	68	69
                67	65	65	65	65	65	65	66	65	70	67	67	67	66	66	66	66	68
                67	65	65	65	65	65	65	67	66	71	68	67	67	67	66	67	67	69
                68	66	66	66	66	67	67	68	67	70	68	66	66	65	65	65	65	67
                67	65	65	64	65	65	65	67	65	71	69	68	68	67	67	67	67	69
                67	65	65	65	65	66	65	68	66	71	68	66	67	66	66	66	66	68
                67	65	65	65	65	66	66	67	66	71	68	67	67	66	66	66	66	68
                68	66	66	66	66	67	67	67	67	70	67	65	65	65	65	65	65	67
                67	65	65	65	65	65	65	66	65	71	69	67	67	67	67	67	67	69
                67	65	65	65	65	66	65	67	67	71	67	66	66	65	65	65	65	67
                67	65	65	65	65	66	66	66	66	71	67	67	67	66	66	66	66	68
                68	66	67	67	66	67	67	67	67	70	66	65	65	64	64	65	64	66
                67	65	65	65	65	66	65	66	65	72	68	67	68	67	67	66	66	68
                67	65	65	65	65	67	66	67	66	71	67	66	66	65	65	65	65	67
                66	64	64	65	65	65	65	67	65	70	67	65	65	65	64	64	64	67
                67	65	66	65	66	67	67	68	66	68	66	65	65	64	64	64	64	65
                66	64	64	64	64	65	65	67	65	68	68	67	67	65	65	65	65	67
                67	65	65	65	65	66	66	68	65	65	67	65	65	64	64	64	64	65
                67	65	65	65	65	66	66	67	65	65	67	65	65	64	64	64	64	66
                67	65	66	65	66	67	67	68	66	64	66	65	65	64	64	64	64	65
                65	64	64	64	64	65	65	67	65	66	68	67	66	65	65	65	65	67
                67	65	65	65	65	66	66	67	65	64	67	65	65	64	64	64	64	65
                67	65	65	65	65	66	66	68	65	65	67	65	65	64	64	64	64	66
                66	65	65	66	66	67	67	68	66	64	66	65	64	64	64	64	64	64
                64	64	64	64	64	65	67	67	64	65	68	67	65	65	65	65	65	65
                63	64	64	64	64	65	67	67	65	64	67	66	65	64	64	64	64	63
                53 54 54>;

            PS_Config_Lmt_FW_CC_I_P = <
                25 25 25 25 25 25 25 25 25 25 25 25 25 25 25 25 25 25
                25 25 25 25 25 25 25 25 25 25 25 25 25 25 25 25 25 25
                25 25 25 25 25 25 25 25 25 25 25 25 25 25 25 25 25 25
                25 25 25 25 25 25 25 25 25 25 25 25 25 25 25 25 25 25
                25 25 25 25 25 25 25 25 25 25 25 25 25 25 25 25 25 25
                25 25 25 25 25 25 25 25 25 25 25 25 25 25 25 25 25 25
                25 25 25 25 25 25 25 25 25 25 25 25 25 25 25 25 25 25
                25 25 25 25 25 25 25 25 25 25 25 25 25 25 25 25 25 25
                25 25 25 25 25 25 25 25 25 25 25 25 25 25 25 25 25 25
                25 25 25 25 25 25 25 25 25 25 25 25 25 25 25 25 25 25
                25 25 25 25 25 25 25 25 25 25 25 25 25 25 25 25 25 25
                25 25 25 25 25 25 25 25 25 25 25 25 25 25 25 25 25 25
                25 25 25 25 25 25 25 25 25 25 25 25 25 25 25 25 25 25
                25 25 25 25 25 25 25 25 25 25 25 25 25 25 25 25 25 25
                25 25 25 25 25 25 25 25 25 25 25 25 25 25 25 25 25 25
                25 25 25 25 25 25 25 25 25 25 25 25 25 25 25 25 25 25
                25 25 25 25 25 25 25 25 25 25 25 25 25 25 25 25 25 25
                25 25 25 25 25 25 25 25 25 25 25 25 25 25 25 25 25 25
                25 25 25 25 25 25 25 25 25 25 25 25 25 25 25 25 25 25
                25 25 25 25 25 25 25 25 25 25 25 25 25 25 25 25 25 25
                25 25 25 25 25 25 25 25 25 25 25 25 25 25 25 25 25 25
                25 25 25 25 25 25 25 25 25 25 25 25 25 25 25 25 25 25
                25 25 25 25 25 25 25 25 25 25 25 25 25 25 25 25 25 25
                25 25 25 25 25 25 25 25 25 25 25 25 25 25 25 25 25 25
                25 25 25 25 25 25 25 25 25 25 25 25 25 25 25 25 25 25
                25 25 25 25 25 25 25 25 25 25 25 25 25 25 25 25 25 25
                25 25 25 25 25 25 25 25 25 25 25 25 25 25 25 25 25 25
                25 25 25 25 25 25 25 25 25 25 25 25 25 25 25 25 25 25
                25 25 25 25 25 25 25 25 25 25 25 25 25 25 25 25 25 25
                25 25 25 25 25 25 25 25 25 25 25 25 25 25 25 25 25 25
                25 25 25 25 25 25 25 25 25 25 25 25 25 25 25 25 25 25
                25 25 25 25 25 25 25 25 25 25 25 25 25 25 25 25 25 25
                25 25 25 25 25 25 25 25 25 25 25 25 25 25 25 25 25 25
                25 25 25 25 25 25 25 25 25 25 25 25 25 25 25 25 25 25
                25 25 25 25 25 25 25 25 25 25 25 25 25 25 25 25 25 25
                25 25 25 25 25 25 25 25 25 25 25 25 25 25 25 25 25 25
                25 25 25>;

            PS_Config_Lmt_FW_CC_I_N = <
                0 0 0 0 0 0 0 0 0 0 0 0 0 0 0 0 0 0
                0 0 0 0 0 0 0 0 0 0 0 0 0 0 0 0 0 0
                0 0 0 0 0 0 0 0 0 0 0 0 0 0 0 0 0 0
                0 0 0 0 0 0 0 0 0 0 0 0 0 0 0 0 0 0
                0 0 0 0 0 0 0 0 0 0 0 0 0 0 0 0 0 0
                0 0 0 0 0 0 0 0 0 0 0 0 0 0 0 0 0 0
                0 0 0 0 0 0 0 0 0 0 0 0 0 0 0 0 0 0
                0 0 0 0 0 0 0 0 0 0 0 0 0 0 0 0 0 0
                0 0 0 0 0 0 0 0 0 0 0 0 0 0 0 0 0 0
                0 0 0 0 0 0 0 0 0 0 0 0 0 0 0 0 0 0
                0 0 0 0 0 0 0 0 0 0 0 0 0 0 0 0 0 0
                0 0 0 0 0 0 0 0 0 0 0 0 0 0 0 0 0 0
                0 0 0 0 0 0 0 0 0 0 0 0 0 0 0 0 0 0
                0 0 0 0 0 0 0 0 0 0 0 0 0 0 0 0 0 0
                0 0 0 0 0 0 0 0 0 0 0 0 0 0 0 0 0 0
                0 0 0 0 0 0 0 0 0 0 0 0 0 0 0 0 0 0
                0 0 0 0 0 0 0 0 0 0 0 0 0 0 0 0 0 0
                0 0 0 0 0 0 0 0 0 0 0 0 0 0 0 0 0 0
                0 0 0 0 0 0 0 0 0 0 0 0 0 0 0 0 0 0
                0 0 0 0 0 0 0 0 0 0 0 0 0 0 0 0 0 0
                0 0 0 0 0 0 0 0 0 0 0 0 0 0 0 0 0 0
                0 0 0 0 0 0 0 0 0 0 0 0 0 0 0 0 0 0
                0 0 0 0 0 0 0 0 0 0 0 0 0 0 0 0 0 0
                0 0 0 0 0 0 0 0 0 0 0 0 0 0 0 0 0 0
                0 0 0 0 0 0 0 0 0 0 0 0 0 0 0 0 0 0
                0 0 0 0 0 0 0 0 0 0 0 0 0 0 0 0 0 0
                0 0 0 0 0 0 0 0 0 0 0 0 0 0 0 0 0 0
                0 0 0 0 0 0 0 0 0 0 0 0 0 0 0 0 0 0
                0 0 0 0 0 0 0 0 0 0 0 0 0 0 0 0 0 0
                0 0 0 0 0 0 0 0 0 0 0 0 0 0 0 0 0 0
                0 0 0 0 0 0 0 0 0 0 0 0 0 0 0 0 0 0
                0 0 0 0 0 0 0 0 0 0 0 0 0 0 0 0 0 0
                0 0 0 0 0 0 0 0 0 0 0 0 0 0 0 0 0 0
                0 0 0 0 0 0 0 0 0 0 0 0 0 0 0 0 0 0
                0 0 0 0 0 0 0 0 0 0 0 0 0 0 0 0 0 0
                0 0 0 0 0 0 0 0 0 0 0 0 0 0 0 0 0 0
                0 0 0>;

            PS_Config_Lmt_FW_CC_Q_P = <
                25 25 25 25 25 25 25 25 25 25 25 25 25 25 25 25 25 25
                25 25 25 25 25 25 25 25 25 25 25 25 25 25 25 25 25 25
                25 25 25 25 25 25 25 25 25 25 25 25 25 25 25 25 25 25
                25 25 25 25 25 25 25 25 25 25 25 25 25 25 25 25 25 25
                25 25 25 25 25 25 25 25 25 25 25 25 25 25 25 25 25 25
                25 25 25 25 25 25 25 25 25 25 25 25 25 25 25 25 25 25
                25 25 25 25 25 25 25 25 25 25 25 25 25 25 25 25 25 25
                25 25 25 25 25 25 25 25 25 25 25 25 25 25 25 25 25 25
                25 25 25 25 25 25 25 25 25 25 25 25 25 25 25 25 25 25
                25 25 25 25 25 25 25 25 25 25 25 25 25 25 25 25 25 25
                25 25 25 25 25 25 25 25 25 25 25 25 25 25 25 25 25 25
                25 25 25 25 25 25 25 25 25 25 25 25 25 25 25 25 25 25
                25 25 25 25 25 25 25 25 25 25 25 25 25 25 25 25 25 25
                25 25 25 25 25 25 25 25 25 25 25 25 25 25 25 25 25 25
                25 25 25 25 25 25 25 25 25 25 25 25 25 25 25 25 25 25
                25 25 25 25 25 25 25 25 25 25 25 25 25 25 25 25 25 25
                25 25 25 25 25 25 25 25 25 25 25 25 25 25 25 25 25 25
                25 25 25 25 25 25 25 25 25 25 25 25 25 25 25 25 25 25
                25 25 25 25 25 25 25 25 25 25 25 25 25 25 25 25 25 25
                25 25 25 25 25 25 25 25 25 25 25 25 25 25 25 25 25 25
                25 25 25 25 25 25 25 25 25 25 25 25 25 25 25 25 25 25
                25 25 25 25 25 25 25 25 25 25 25 25 25 25 25 25 25 25
                25 25 25 25 25 25 25 25 25 25 25 25 25 25 25 25 25 25
                25 25 25 25 25 25 25 25 25 25 25 25 25 25 25 25 25 25
                25 25 25 25 25 25 25 25 25 25 25 25 25 25 25 25 25 25
                25 25 25 25 25 25 25 25 25 25 25 25 25 25 25 25 25 25
                25 25 25 25 25 25 25 25 25 25 25 25 25 25 25 25 25 25
                25 25 25 25 25 25 25 25 25 25 25 25 25 25 25 25 25 25
                25 25 25 25 25 25 25 25 25 25 25 25 25 25 25 25 25 25
                25 25 25 25 25 25 25 25 25 25 25 25 25 25 25 25 25 25
                25 25 25 25 25 25 25 25 25 25 25 25 25 25 25 25 25 25
                25 25 25 25 25 25 25 25 25 25 25 25 25 25 25 25 25 25
                25 25 25 25 25 25 25 25 25 25 25 25 25 25 25 25 25 25
                25 25 25 25 25 25 25 25 25 25 25 25 25 25 25 25 25 25
                25 25 25 25 25 25 25 25 25 25 25 25 25 25 25 25 25 25
                25 25 25 25 25 25 25 25 25 25 25 25 25 25 25 25 25 25
                25 25 25>;

            PS_Config_Lmt_FW_CC_Q_N = <
                0 0 0 0 0 0 0 0 0 0 0 0 0 0 0 0 0 0
                0 0 0 0 0 0 0 0 0 0 0 0 0 0 0 0 0 0
                0 0 0 0 0 0 0 0 0 0 0 0 0 0 0 0 0 0
                0 0 0 0 0 0 0 0 0 0 0 0 0 0 0 0 0 0
                0 0 0 0 0 0 0 0 0 0 0 0 0 0 0 0 0 0
                0 0 0 0 0 0 0 0 0 0 0 0 0 0 0 0 0 0
                0 0 0 0 0 0 0 0 0 0 0 0 0 0 0 0 0 0
                0 0 0 0 0 0 0 0 0 0 0 0 0 0 0 0 0 0
                0 0 0 0 0 0 0 0 0 0 0 0 0 0 0 0 0 0
                0 0 0 0 0 0 0 0 0 0 0 0 0 0 0 0 0 0
                0 0 0 0 0 0 0 0 0 0 0 0 0 0 0 0 0 0
                0 0 0 0 0 0 0 0 0 0 0 0 0 0 0 0 0 0
                0 0 0 0 0 0 0 0 0 0 0 0 0 0 0 0 0 0
                0 0 0 0 0 0 0 0 0 0 0 0 0 0 0 0 0 0
                0 0 0 0 0 0 0 0 0 0 0 0 0 0 0 0 0 0
                0 0 0 0 0 0 0 0 0 0 0 0 0 0 0 0 0 0
                0 0 0 0 0 0 0 0 0 0 0 0 0 0 0 0 0 0
                0 0 0 0 0 0 0 0 0 0 0 0 0 0 0 0 0 0
                0 0 0 0 0 0 0 0 0 0 0 0 0 0 0 0 0 0
                0 0 0 0 0 0 0 0 0 0 0 0 0 0 0 0 0 0
                0 0 0 0 0 0 0 0 0 0 0 0 0 0 0 0 0 0
                0 0 0 0 0 0 0 0 0 0 0 0 0 0 0 0 0 0
                0 0 0 0 0 0 0 0 0 0 0 0 0 0 0 0 0 0
                0 0 0 0 0 0 0 0 0 0 0 0 0 0 0 0 0 0
                0 0 0 0 0 0 0 0 0 0 0 0 0 0 0 0 0 0
                0 0 0 0 0 0 0 0 0 0 0 0 0 0 0 0 0 0
                0 0 0 0 0 0 0 0 0 0 0 0 0 0 0 0 0 0
                0 0 0 0 0 0 0 0 0 0 0 0 0 0 0 0 0 0
                0 0 0 0 0 0 0 0 0 0 0 0 0 0 0 0 0 0
                0 0 0 0 0 0 0 0 0 0 0 0 0 0 0 0 0 0
                0 0 0 0 0 0 0 0 0 0 0 0 0 0 0 0 0 0
                0 0 0 0 0 0 0 0 0 0 0 0 0 0 0 0 0 0
                0 0 0 0 0 0 0 0 0 0 0 0 0 0 0 0 0 0
                0 0 0 0 0 0 0 0 0 0 0 0 0 0 0 0 0 0
                0 0 0 0 0 0 0 0 0 0 0 0 0 0 0 0 0 0
                0 0 0 0 0 0 0 0 0 0 0 0 0 0 0 0 0 0
                0 0 0>;

            PS_Config_Lmt_FW_Diff_P = <
                65535 50 50 50 50 50 50 50 65535 65535 50 50 50 50 50 50 50 65535
                50 50 50 50 50 50 50 50 50 50 50 50 50 50 50 50 50 50
                50 50 50 50 50 50 50 50 50 50 50 50 50 50 50 50 50 50
                50 50 50 50 50 50 50 50 50 50 50 50 50 50 50 50 50 50
                50 50 50 50 50 50 50 50 50 50 50 50 50 50 50 50 50 50
                50 50 50 50 50 50 50 50 50 50 50 50 50 50 50 50 50 50
                50 50 50 50 50 50 50 50 50 50 50 50 50 50 50 50 50 50
                50 50 50 50 50 50 50 50 50 50 50 50 50 50 50 50 50 50
                50 50 50 50 50 50 50 50 50 50 50 50 50 50 50 50 50 50
                50 50 50 50 50 50 50 50 50 50 50 50 50 50 50 50 50 50
                50 50 50 50 50 50 50 50 50 50 50 50 50 50 50 50 50 50
                50 50 50 50 50 50 50 50 50 50 50 50 50 50 50 50 50 50
                50 50 50 50 50 50 50 50 50 50 50 50 50 50 50 50 50 50
                50 50 50 50 50 50 50 50 50 50 50 50 50 50 50 50 50 50
                50 50 50 50 50 50 50 50 50 50 50 50 50 50 50 50 50 50
                50 50 50 50 50 50 50 50 50 50 50 50 50 50 50 50 50 50
                50 50 50 50 50 50 50 50 50 50 50 50 50 50 50 50 50 50
                50 50 50 50 50 50 50 50 50 50 50 50 50 50 50 50 50 50
                50 50 50 50 50 50 50 50 50 50 50 50 50 50 50 50 50 50
                50 50 50 50 50 50 50 50 50 50 50 50 50 50 50 50 50 50
                50 50 50 50 50 50 50 50 50 50 50 50 50 50 50 50 50 50
                50 50 50 50 50 50 50 50 50 50 50 50 50 50 50 50 50 50
                50 50 50 50 50 50 50 50 50 50 50 50 50 50 50 50 50 50
                50 50 50 50 50 50 50 50 50 50 50 50 50 50 50 50 50 50
                50 50 50 50 50 50 50 50 50 50 50 50 50 50 50 50 50 50
                50 50 50 50 50 50 50 50 50 50 50 50 50 50 50 50 50 50
                50 50 50 50 50 50 50 50 50 50 50 50 50 50 50 50 50 50
                50 50 50 50 50 50 50 50 50 50 50 50 50 50 50 50 50 50
                50 50 50 50 50 50 50 50 50 50 50 50 50 50 50 50 50 50
                50 50 50 50 50 50 50 50 50 50 50 50 50 50 50 50 50 50
                50 50 50 50 50 50 50 50 50 50 50 50 50 50 50 50 50 50
                50 50 50 50 50 50 50 50 50 50 50 50 50 50 50 50 50 50
                50 50 50 50 50 50 50 50 50 50 50 50 50 50 50 50 50 50
                50 50 50 50 50 50 50 50 50 50 50 50 50 50 50 50 50 50
                50 50 50 50 50 50 50 50 50 50 50 50 50 50 50 50 50 50
                50 50 50 50 50 50 50 50 50 50 50 50 50 50 50 50 50 50
                50 50 50>;

            PS_Config_Lmt_FW_Diff_N = <
                (-65535) (-50) (-50) (-50) (-50) (-50) (-50) (-50) (-65535) (-65535) (-50) (-50) (-50) (-50) (-50) (-50) (-50) (-65535)
                (-50) (-50) (-50) (-50) (-50) (-50) (-50) (-50) (-50) (-50) (-50) (-50) (-50) (-50) (-50) (-50) (-50) (-50)
                (-50) (-50) (-50) (-50) (-50) (-50) (-50) (-50) (-50) (-50) (-50) (-50) (-50) (-50) (-50) (-50) (-50) (-50)
                (-50) (-50) (-50) (-50) (-50) (-50) (-50) (-50) (-50) (-50) (-50) (-50) (-50) (-50) (-50) (-50) (-50) (-50)
                (-50) (-50) (-50) (-50) (-50) (-50) (-50) (-50) (-50) (-50) (-50) (-50) (-50) (-50) (-50) (-50) (-50) (-50)
                (-50) (-50) (-50) (-50) (-50) (-50) (-50) (-50) (-50) (-50) (-50) (-50) (-50) (-50) (-50) (-50) (-50) (-50)
                (-50) (-50) (-50) (-50) (-50) (-50) (-50) (-50) (-50) (-50) (-50) (-50) (-50) (-50) (-50) (-50) (-50) (-50)
                (-50) (-50) (-50) (-50) (-50) (-50) (-50) (-50) (-50) (-50) (-50) (-50) (-50) (-50) (-50) (-50) (-50) (-50)
                (-50) (-50) (-50) (-50) (-50) (-50) (-50) (-50) (-50) (-50) (-50) (-50) (-50) (-50) (-50) (-50) (-50) (-50)
                (-50) (-50) (-50) (-50) (-50) (-50) (-50) (-50) (-50) (-50) (-50) (-50) (-50) (-50) (-50) (-50) (-50) (-50)
                (-50) (-50) (-50) (-50) (-50) (-50) (-50) (-50) (-50) (-50) (-50) (-50) (-50) (-50) (-50) (-50) (-50) (-50)
                (-50) (-50) (-50) (-50) (-50) (-50) (-50) (-50) (-50) (-50) (-50) (-50) (-50) (-50) (-50) (-50) (-50) (-50)
                (-50) (-50) (-50) (-50) (-50) (-50) (-50) (-50) (-50) (-50) (-50) (-50) (-50) (-50) (-50) (-50) (-50) (-50)
                (-50) (-50) (-50) (-50) (-50) (-50) (-50) (-50) (-50) (-50) (-50) (-50) (-50) (-50) (-50) (-50) (-50) (-50)
                (-50) (-50) (-50) (-50) (-50) (-50) (-50) (-50) (-50) (-50) (-50) (-50) (-50) (-50) (-50) (-50) (-50) (-50)
                (-50) (-50) (-50) (-50) (-50) (-50) (-50) (-50) (-50) (-50) (-50) (-50) (-50) (-50) (-50) (-50) (-50) (-50)
                (-50) (-50) (-50) (-50) (-50) (-50) (-50) (-50) (-50) (-50) (-50) (-50) (-50) (-50) (-50) (-50) (-50) (-50)
                (-50) (-50) (-50) (-50) (-50) (-50) (-50) (-50) (-50) (-50) (-50) (-50) (-50) (-50) (-50) (-50) (-50) (-50)
                (-50) (-50) (-50) (-50) (-50) (-50) (-50) (-50) (-50) (-50) (-50) (-50) (-50) (-50) (-50) (-50) (-50) (-50)
                (-50) (-50) (-50) (-50) (-50) (-50) (-50) (-50) (-50) (-50) (-50) (-50) (-50) (-50) (-50) (-50) (-50) (-50)
                (-50) (-50) (-50) (-50) (-50) (-50) (-50) (-50) (-50) (-50) (-50) (-50) (-50) (-50) (-50) (-50) (-50) (-50)
                (-50) (-50) (-50) (-50) (-50) (-50) (-50) (-50) (-50) (-50) (-50) (-50) (-50) (-50) (-50) (-50) (-50) (-50)
                (-50) (-50) (-50) (-50) (-50) (-50) (-50) (-50) (-50) (-50) (-50) (-50) (-50) (-50) (-50) (-50) (-50) (-50)
                (-50) (-50) (-50) (-50) (-50) (-50) (-50) (-50) (-50) (-50) (-50) (-50) (-50) (-50) (-50) (-50) (-50) (-50)
                (-50) (-50) (-50) (-50) (-50) (-50) (-50) (-50) (-50) (-50) (-50) (-50) (-50) (-50) (-50) (-50) (-50) (-50)
                (-50) (-50) (-50) (-50) (-50) (-50) (-50) (-50) (-50) (-50) (-50) (-50) (-50) (-50) (-50) (-50) (-50) (-50)
                (-50) (-50) (-50) (-50) (-50) (-50) (-50) (-50) (-50) (-50) (-50) (-50) (-50) (-50) (-50) (-50) (-50) (-50)
                (-50) (-50) (-50) (-50) (-50) (-50) (-50) (-50) (-50) (-50) (-50) (-50) (-50) (-50) (-50) (-50) (-50) (-50)
                (-50) (-50) (-50) (-50) (-50) (-50) (-50) (-50) (-50) (-50) (-50) (-50) (-50) (-50) (-50) (-50) (-50) (-50)
                (-50) (-50) (-50) (-50) (-50) (-50) (-50) (-50) (-50) (-50) (-50) (-50) (-50) (-50) (-50) (-50) (-50) (-50)
                (-50) (-50) (-50) (-50) (-50) (-50) (-50) (-50) (-50) (-50) (-50) (-50) (-50) (-50) (-50) (-50) (-50) (-50)
                (-50) (-50) (-50) (-50) (-50) (-50) (-50) (-50) (-50) (-50) (-50) (-50) (-50) (-50) (-50) (-50) (-50) (-50)
                (-50) (-50) (-50) (-50) (-50) (-50) (-50) (-50) (-50) (-50) (-50) (-50) (-50) (-50) (-50) (-50) (-50) (-50)
                (-50) (-50) (-50) (-50) (-50) (-50) (-50) (-50) (-50) (-50) (-50) (-50) (-50) (-50) (-50) (-50) (-50) (-50)
                (-50) (-50) (-50) (-50) (-50) (-50) (-50) (-50) (-50) (-50) (-50) (-50) (-50) (-50) (-50) (-50) (-50) (-50)
                (-50) (-50) (-50) (-50) (-50) (-50) (-50) (-50) (-50) (-50) (-50) (-50) (-50) (-50) (-50) (-50) (-50) (-50)
                (-50) (-50) (-50)>;

            PS_Config_Diff_Test_Frame = <50>;
        };
    };
};
