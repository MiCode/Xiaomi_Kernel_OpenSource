/* Copyright (c) 2018, The Linux Foundation. All rights reserved.
 * Copyright (C) 2018 XiaoMi, Inc.
 *
 * This program is free software; you can redistribute it and/or modify
 * it under the terms of the GNU General Public License version 2 and
 * only version 2 as published by the Free Software Foundation.
 *
 * This program is distributed in the hope that it will be useful,
 * but WITHOUT ANY WARRANTY; without even the implied warranty of
 * MERCHANTABILITY or FITNESS FOR A PARTICULAR PURPOSE. See the
 * GNU General Public License for more details.
*/


/dts-v1/;
/plugin/;

#include <dt-bindings/clock/qcom,cpu-osm.h>
#include <dt-bindings/clock/qcom,rpmcc.h>
#include <dt-bindings/clock/qcom,mmcc-sdm660.h>
#include <dt-bindings/regulator/qcom,rpm-smd-regulator.h>
#include <dt-bindings/interrupt-controller/arm-gic.h>

#include "sdm660-cdp.dtsi"
#include "sdm660-external-codec.dtsi"

/ {
	model = "Qualcomm Technologies, Inc. SDM 660 PM660 + PM660L CDP F7A";
	compatible = "qcom,sdm660-cdp", "qcom,sdm660", "qcom,cdp";
	qcom,board-id = <1 0>;
	qcom,pmic-id = <0x0001001b 0x0101011a 0x0 0x0>,
			<0x0001001b 0x0201011a 0x0 0x0>,
			<0x0001001b 0x0102001a 0x0 0x0>;
};

/*&tavil_snd {
 qcom,msm-mbhc-hphl-swh = <0>;
 qcom,msm-mbhc-gnd-swh = <0>;
};

&tasha_snd {
 qcom,msm-mbhc-hphl-swh = <0>;
 qcom,msm-mbhc-gnd-swh = <0>;
};*/
