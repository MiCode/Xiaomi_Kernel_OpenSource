/* Copyright (c) 2016, The Linux Foundation. All rights reserved.
 *
 * This program is free software; you can redistribute it and/or modify
 * it under the terms of the GNU General Public License version 2 and
 * only version 2 as published by the Free Software Foundation.
 *
 * This program is distributed in the hope that it will be useful,
 * but WITHOUT ANY WARRANTY; without even the implied warranty of
 * MERCHANTABILITY or FITNESS FOR A PARTICULAR PURPOSE.  See the
 * GNU General Public License for more details.
 */


/dts-v1/;

#include "apq8096pro.dtsi"
#include "msm8996-liquid.dtsi"

/ {
	model = "Qualcomm Technologies, Inc. APQ 8096 pro LiQUID";
	compatible = "qcom,apq8096-liquid", "qcom,apq8096", "qcom,liquid";
	qcom,board-id = <9 0>;
};
