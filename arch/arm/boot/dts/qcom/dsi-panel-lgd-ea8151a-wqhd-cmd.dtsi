/* Copyright (c) 2015, The Linux Foundation. All rights reserved.
 * Copyright (C) 2018 XiaoMi, Inc.
 *
 * This program is free software; you can redistribute it and/or modify
 * it under the terms of the GNU General Public License version 2 and
 * only version 2 as published by the Free Software Foundation.
 *
 * This program is distributed in the hope that it will be useful,
 * but WITHOUT ANY WARRANTY; without even the implied warranty of
 * MERCHANTABILITY or FITNESS FOR A PARTICULAR PURPOSE.  See the
 * GNU General Public License for more details.
 */

/*---------------------------------------------------------------------------
 * This file is autogenerated file using gcdb parser. Please do not edit it.
 * Update input XML file to add a new entry or update variable in this file
 * VERSION = "1.0"
 *---------------------------------------------------------------------------*/
&soc {
	dsi_lgd_ea8151a_wqhd_cmd: qcom,mdss_dsi_lgd_ea8151a_wqhd_cmd {
		qcom,mdss-dsi-panel-name = "lgd ea8151a cmd wqhd oled panel";
		qcom,mdss-dsi-panel-sleepwrmod = <0>;
		qcom,mdss-dsi-panel-id = <4>;
		qcom,mdss-dsi-panel-type = "dsi_cmd_mode";
		qcom,mdss-dsi-panel-framerate = <60>;
		qcom,mdss-dsi-virtual-channel-id = <0>;
		qcom,mdss-dsi-stream = <0>;
		qcom,mdss-dsi-panel-width = <1440>;
		qcom,mdss-dsi-panel-height = <2560>;
		qcom,mdss-dsi-h-front-porch = <100>;
		qcom,mdss-dsi-h-back-porch = <68>;
		qcom,mdss-dsi-h-pulse-width = <16>;
		qcom,mdss-dsi-h-sync-skew = <0>;
		qcom,mdss-dsi-v-back-porch = <12>;
		qcom,mdss-dsi-v-front-porch = <12>;
		qcom,mdss-dsi-v-pulse-width = <8>;
		qcom,mdss-dsi-h-left-border = <0>;
		qcom,mdss-dsi-h-right-border = <0>;
		qcom,mdss-dsi-v-top-border = <0>;
		qcom,mdss-dsi-v-bottom-border = <0>;
		qcom,mdss-dsi-bpp = <24>;
		qcom,mdss-dsi-color-order = <0>;
		qcom,mdss-dsi-underflow-color = <0xff>;
		qcom,mdss-dsi-border-color = <0>;
		qcom,mdss-dsi-on-command = [
				39 01 00 00 05 00 03 7F 5A 5A
				15 01 00 00 00 00 02 02 01
				15 01 00 00 00 00 02 35 01
				15 01 00 00 00 00 02 36 02
				15 01 00 00 00 00 02 51 00
				15 01 00 00 00 00 02 53 20
				15 01 00 00 00 00 02 57 06
				15 01 00 00 00 00 02 5A 01
				05 01 00 00 78 00 02 11 00
				39 01 00 00 00 00 03 F0 5A 5A
				39 01 00 00 00 00 59 ea 11 00 00 89 30 80 0a 00 05 a0 00 10 02 d0 02 d0 02 00 02 68 00 20 01 bb 00 0a 00 0c 06 67 04 c5 18 00 10 f0 03 0c 20 00 06 0b 0b 33 0e 1c 2a 38 46 54 62 69 70 77 79 7b 7d 7e 01 02 01 00 09 40 09 be 19 fc 19 fa 19 f8 1a 38 1a 78 1a b6 2a f6 2b 34 2b 74 3b 74 6b f4
				39 01 00 00 00 00 03 F0 5A 5A
				39 01 00 00 00 00 03 F1 5A 5A
				39 01 00 00 00 00 03 F2 5A 5A
				15 01 00 00 00 00 02 B0 05
				15 01 00 00 00 00 02 E6 03
				15 01 00 00 00 00 02 B0 0B
				39 01 00 00 00 00 03 E3 A9 2A
				39 01 00 00 00 00 03 F2 5A 5A
				15 01 00 00 00 00 02 B0 04
				15 01 00 00 00 00 02 E5 11
				05 01 00 00 00 00 02 29 00
				];
		qcom,mdss-dsi-off-command = [
				05 01 00 00 14 00 02 28 00
				05 01 00 00 80 00 02 10 00];
		qcom,mdss-dsi-on-command-state = "dsi_lp_mode";
		qcom,mdss-dsi-off-command-state = "dsi_hs_mode";
		qcom,mdss-dsi-vr-on-command = [39 01 00 00 00 00 03 7f 5a 5a
				39 01 00 00 00 00 03 f0 5a 5a
				39 01 00 00 00 00 03 f1 5a 5a
				39 01 00 00 00 00 03 f2 5a 5a
				15 01 00 00 00 00 02 bf b0
				15 01 00 00 00 00 02 b0 0f
				39 01 00 00 00 00 03 bf c9 90
				15 01 00 00 00 00 02 51 01];
		qcom,mdss-dsi-vr-on-command-state = "dsi_lp_mode";
		qcom,mdss-dsi-vr-off-command = [39 01 00 00 00 00 03 7f 5a 5a
				39 01 00 00 00 00 03 f0 5a 5a
				39 01 00 00 00 00 03 f1 5a 5a
				39 01 00 00 00 00 03 f2 5a 5a
				15 01 00 00 00 00 02 bf b3
				39 01 00 00 00 00 03 7f 5a 5a];
		qcom,mdss-dsi-vr-off-command-state = "dsi_lp_mode";
		qcom,mdss-dsi-h-sync-pulse = <0>;
		qcom,mdss-dsi-traffic-mode = "non_burst_sync_event";
		qcom,mdss-dsi-bllp-eof-power-mode;
		qcom,mdss-dsi-bllp-power-mode;
		qcom,mdss-dsi-lp11-init;
		qcom,mdss-dsi-lane-0-state;
		qcom,mdss-dsi-lane-1-state;
		qcom,mdss-dsi-lane-2-state;
		qcom,mdss-dsi-lane-3-state;
		qcom,mdss-dsi-panel-timings = [00 1c 07 04 07 14 04 07 03 03 04 00];
		qcom,mdss-dsi-t-clk-post = <0x05>;
		qcom,mdss-dsi-t-clk-pre = <0x1b>;
		qcom,mdss-dsi-bl-min-level = <4>;
		qcom,mdss-dsi-bl-max-level = <254>;
		qcom,mdss-dsi-dma-trigger = "trigger_sw";
		qcom,mdss-dsi-mdp-trigger = "none";
		qcom,mdss-dsi-bl-pmic-control-type = "bl_ctrl_dcs";
		qcom,mdss-dsi-reset-sequence = <1 10>, <0 1>, <1 25>;
		qcom,mdss-pan-physical-width-dimension = <68>;
		qcom,mdss-pan-physical-height-dimension = <121>;
		qcom,mdss-dsi-tx-eot-append;
		/* p2 panel use gpio irp to triger esd directly */
		qcom,esd-err-irq-gpio = <&tlmm 52 0x2001>;
		qcom,mdss-dsi-panel-orientation = "180";
		qcom,panel-supply-entries = <&dsi_panel_pwr_supply_amoled>;
		qcom,dispparam-enabled;
		qcom,mdss-dsi-aod-mode;
		qcom,mdss-dsi-aodon-command = [
				05 01 00 00 00 00 02 28 00
				39 01 00 00 00 00 03 7f 5a 5a
				39 01 00 00 00 00 03 f0 5a 5a
				39 01 00 00 00 00 03 f1 5a 5a
				39 01 00 00 00 00 03 f2 5a 5a
				39 01 00 00 00 00 02 b0 0b
				39 01 00 00 00 00 02 c2 80
				05 01 00 00 00 00 02 39 00
				15 01 00 00 00 00 02 b0 19
				15 01 00 00 00 00 02 e5 1f
				39 01 00 00 00 00 06 E1 cc 14 14 24 24
				15 01 00 00 00 00 02 51 00
				05 01 00 00 05 00 02 29 00
		];
		qcom,mdss-dsi-aodon-command-state = "dsi_lp_mode";
		qcom,mdss-dsi-aodoff-command = [
				05 01 00 00 00 00 02 28 00
				39 01 00 00 05 00 03 7F 5A 5A
				39 01 00 00 00 00 03 f0 5a 5a
				39 01 00 00 00 00 03 f1 5a 5a
				39 01 00 00 00 00 03 f2 5a 5a
				39 01 00 00 00 00 02 b0 0b
				39 01 00 00 00 00 02 c2 40
				05 01 00 00 00 00 02 38 00
				39 01 00 00 00 00 02 b0 19
				39 01 00 00 00 00 02 e5 00
				39 01 00 00 00 00 06 E1 cc 14 14 0c 0a
				15 01 00 00 00 00 02 51 00
				05 01 00 00 40 00 02 29 00
		];
		qcom,mdss-dsi-aodoff-command-state = "dsi_lp_mode";
		qcom,mdss-dsi-aod-byteclk = <33146880>;
		qcom,mdss-dsi-aod-pclk = <44195840>;
		qcom,mdss-dsi-te-pin-select = <1>;
		qcom,mdss-dsi-te-dcs-command = <1>;
		qcom,mdss-dsi-te-check-enable;
		qcom,mdss-dsi-te-using-te-pin;
		qcom,mdss-dsi-wr-mem-start = <0x2c>;
		qcom,mdss-dsi-wr-mem-continue = <0x3c>;
		qcom,compression-mode = "dsc";
		qcom,config-select = <&dsi_lgd_mag_dsc_cmd_config0>;
		dsi_lgd_mag_dsc_cmd_config0: config0 {
			qcom,lm-split = <720 720>;
			qcom,mdss-dsc-encoders = <2>;
			qcom,mdss-dsc-slice-height = <16>;
			qcom,mdss-dsc-slice-width = <720>;
			qcom,mdss-dsc-slice-per-pkt = <2>;
			qcom,mdss-dsc-bit-per-component = <8>;
			qcom,mdss-dsc-bit-per-pixel = <8>;
			qcom,mdss-dsc-block-prediction-enable;
		};
	};
};
