/* Copyright (c) 2013-2014, The Linux Foundation. All rights reserved.
 * Copyright (C) 2018 XiaoMi, Inc.
 *
 * This program is free software; you can redistribute it and/or modify
 * it under the terms of the GNU General Public License version 2 and
 * only version 2 as published by the Free Software Foundation.
 *
 * This program is distributed in the hope that it will be useful,
 * but WITHOUT ANY WARRANTY; without even the implied warranty of
 * MERCHANTABILITY or FITNESS FOR A PARTICULAR PURPOSE.  See the
 * GNU General Public License for more details.
 */

/*---------------------------------------------------------------------------
 * This file is autogenerated file using gcdb parser. Please do not edit it.
 * Update input XML file to add a new entry or update variable in this file
 * VERSION = "1.0"
 *---------------------------------------------------------------------------*/
&mdss_mdp {
	dsi_jdi_scale_wqhd_cmd: qcom,mdss_dsi_jdi_scale_wqhd_command {
		qcom,mdss-dsi-panel-name = "jdi fbc20 wqhd cmd mode dsi panel";
		qcom,mdss-dsi-panel-id = <2>;
		qcom,mdss-dsi-panel-controller = <&mdss_dsi0>;
		qcom,mdss-dsi-panel-type = "dsi_cmd_mode";
		qcom,mdss-dsi-panel-destination = "display_1";
		qcom,mdss-dsi-panel-framerate = <60>;

		qcom,mdss-dsi-virtual-channel-id = <0>;
		qcom,mdss-dsi-stream = <0>;
		qcom,mdss-dsi-panel-width = <720>;
		qcom,mdss-dsi-panel-height = <1280>;
		qcom,mdss-dsi-h-front-porch = <154>;
		qcom,mdss-dsi-h-back-porch = <88>;
		qcom,mdss-dsi-h-pulse-width = <12>;
		qcom,mdss-dsi-h-sync-skew = <0>;
		qcom,mdss-dsi-v-back-porch = <7>;
		qcom,mdss-dsi-v-front-porch = <8>;
		qcom,mdss-dsi-v-pulse-width = <1>;
		qcom,mdss-dsi-h-left-border = <0>;
		qcom,mdss-dsi-h-right-border = <0>;
		qcom,mdss-dsi-v-top-border = <0>;
		qcom,mdss-dsi-v-bottom-border = <0>;
		qcom,mdss-dsi-bpp = <24>;
		qcom,mdss-dsi-underflow-color = <0xff>;
		qcom,mdss-dsi-border-color = <0>;
		qcom,mdss-dsi-on-command = [
			15 00 00 00 01 00 02 FF 20
			15 00 00 00 01 00 02 FB 01
			15 00 00 00 01 00 02 75 00
			15 00 00 00 01 00 02 76 00
			15 00 00 00 01 00 02 77 00
			15 00 00 00 01 00 02 78 20
			15 00 00 00 01 00 02 79 00
			15 00 00 00 01 00 02 7A 58
			15 00 00 00 01 00 02 7B 00
			15 00 00 00 01 00 02 7C 81
			15 00 00 00 01 00 02 7D 00
			15 00 00 00 01 00 02 7E 9F
			15 00 00 00 01 00 02 7F 00
			15 00 00 00 01 00 02 80 BA
			15 00 00 00 01 00 02 81 00
			15 00 00 00 01 00 02 82 D2
			15 00 00 00 01 00 02 83 00
			15 00 00 00 01 00 02 84 E8
			15 00 00 00 01 00 02 85 00
			15 00 00 00 01 00 02 86 FA
			15 00 00 00 01 00 02 87 01
			15 00 00 00 01 00 02 88 33
			15 00 00 00 01 00 02 89 01
			15 00 00 00 01 00 02 8A 5F
			15 00 00 00 01 00 02 8B 01
			15 00 00 00 01 00 02 8C 9F
			15 00 00 00 01 00 02 8D 01
			15 00 00 00 01 00 02 8E CF
			15 00 00 00 01 00 02 8F 02
			15 00 00 00 01 00 02 90 15
			15 00 00 00 01 00 02 91 02
			15 00 00 00 01 00 02 92 4F
			15 00 00 00 01 00 02 93 02
			15 00 00 00 01 00 02 94 51
			15 00 00 00 01 00 02 95 02
			15 00 00 00 01 00 02 96 84
			15 00 00 00 01 00 02 97 02
			15 00 00 00 01 00 02 98 BD
			15 00 00 00 01 00 02 99 02
			15 00 00 00 01 00 02 9A E0
			15 00 00 00 01 00 02 9B 03
			15 00 00 00 01 00 02 9C 10
			15 00 00 00 01 00 02 9D 03
			15 00 00 00 01 00 02 9E 36
			15 00 00 00 01 00 02 9F 03
			15 00 00 00 01 00 02 A0 67
			15 00 00 00 01 00 02 A2 03
			15 00 00 00 01 00 02 A3 76
			15 00 00 00 01 00 02 A4 03
			15 00 00 00 01 00 02 A5 86
			15 00 00 00 01 00 02 A6 03
			15 00 00 00 01 00 02 A7 98
			15 00 00 00 01 00 02 A9 03
			15 00 00 00 01 00 02 AA AC
			15 00 00 00 01 00 02 AB 03
			15 00 00 00 01 00 02 AC C1
			15 00 00 00 01 00 02 AD 03
			15 00 00 00 01 00 02 AE D8
			15 00 00 00 01 00 02 AF 03
			15 00 00 00 01 00 02 B0 F2
			15 00 00 00 01 00 02 B1 03
			15 00 00 00 01 00 02 B2 FF
			15 00 00 00 01 00 02 B3 00
			15 00 00 00 01 00 02 B4 00
			15 00 00 00 01 00 02 B5 00
			15 00 00 00 01 00 02 B6 20
			15 00 00 00 01 00 02 B7 00
			15 00 00 00 01 00 02 B8 58
			15 00 00 00 01 00 02 B9 00
			15 00 00 00 01 00 02 BA 81
			15 00 00 00 01 00 02 BB 00
			15 00 00 00 01 00 02 BC 9F
			15 00 00 00 01 00 02 BD 00
			15 00 00 00 01 00 02 BE BA
			15 00 00 00 01 00 02 BF 00
			15 00 00 00 01 00 02 C0 D2
			15 00 00 00 01 00 02 C1 00
			15 00 00 00 01 00 02 C2 E8
			15 00 00 00 01 00 02 C3 00
			15 00 00 00 01 00 02 C4 FA
			15 00 00 00 01 00 02 C5 01
			15 00 00 00 01 00 02 C6 33
			15 00 00 00 01 00 02 C7 01
			15 00 00 00 01 00 02 C8 5F
			15 00 00 00 01 00 02 C9 01
			15 00 00 00 01 00 02 CA 9F
			15 00 00 00 01 00 02 CB 01
			15 00 00 00 01 00 02 CC CF
			15 00 00 00 01 00 02 CD 02
			15 00 00 00 01 00 02 CE 15
			15 00 00 00 01 00 02 CF 02
			15 00 00 00 01 00 02 D0 4F
			15 00 00 00 01 00 02 D1 02
			15 00 00 00 01 00 02 D2 51
			15 00 00 00 01 00 02 D3 02
			15 00 00 00 01 00 02 D4 84
			15 00 00 00 01 00 02 D5 02
			15 00 00 00 01 00 02 D6 BD
			15 00 00 00 01 00 02 D7 02
			15 00 00 00 01 00 02 D8 E0
			15 00 00 00 01 00 02 D9 03
			15 00 00 00 01 00 02 DA 10
			15 00 00 00 01 00 02 DB 03
			15 00 00 00 01 00 02 DC 36
			15 00 00 00 01 00 02 DD 03
			15 00 00 00 01 00 02 DE 67
			15 00 00 00 01 00 02 DF 03
			15 00 00 00 01 00 02 E0 76
			15 00 00 00 01 00 02 E1 03
			15 00 00 00 01 00 02 E2 86
			15 00 00 00 01 00 02 E3 03
			15 00 00 00 01 00 02 E4 98
			15 00 00 00 01 00 02 E5 03
			15 00 00 00 01 00 02 E6 AC
			15 00 00 00 01 00 02 E7 03
			15 00 00 00 01 00 02 E8 C1
			15 00 00 00 01 00 02 E9 03
			15 00 00 00 01 00 02 EA D8
			15 00 00 00 01 00 02 EB 03
			15 00 00 00 01 00 02 EC F2
			15 00 00 00 01 00 02 ED 03
			15 00 00 00 01 00 02 EE FF
			15 00 00 00 01 00 02 EF 00
			15 00 00 00 01 00 02 F0 E0
			15 00 00 00 01 00 02 F1 00
			15 00 00 00 01 00 02 F2 E9
			15 00 00 00 01 00 02 F3 00
			15 00 00 00 01 00 02 F4 FB
			15 00 00 00 01 00 02 F5 01
			15 00 00 00 01 00 02 F6 0B
			15 00 00 00 01 00 02 F7 01
			15 00 00 00 01 00 02 F8 1A
			15 00 00 00 01 00 02 F9 01
			15 01 00 00 01 00 02 FA 27
			15 00 00 00 01 00 02 FF 21
			15 00 00 00 01 00 02 FB 01
			15 00 00 00 01 00 02 00 01
			15 00 00 00 01 00 02 01 33
			15 00 00 00 01 00 02 02 01
			15 00 00 00 01 00 02 03 3F
			15 00 00 00 01 00 02 04 01
			15 00 00 00 01 00 02 05 4A
			15 00 00 00 01 00 02 06 01
			15 00 00 00 01 00 02 07 71
			15 00 00 00 01 00 02 08 01
			15 00 00 00 01 00 02 09 8F
			15 00 00 00 01 00 02 0A 01
			15 00 00 00 01 00 02 0B C1
			15 00 00 00 01 00 02 0C 01
			15 00 00 00 01 00 02 0D E9
			15 00 00 00 01 00 02 0E 02
			15 00 00 00 01 00 02 0F 26
			15 00 00 00 01 00 02 10 02
			15 00 00 00 01 00 02 11 5A
			15 00 00 00 01 00 02 12 02
			15 00 00 00 01 00 02 13 5C
			15 00 00 00 01 00 02 14 02
			15 00 00 00 01 00 02 15 8E
			15 00 00 00 01 00 02 16 02
			15 00 00 00 01 00 02 17 C5
			15 00 00 00 01 00 02 18 02
			15 00 00 00 01 00 02 19 E8
			15 00 00 00 01 00 02 1A 03
			15 00 00 00 01 00 02 1B 17
			15 00 00 00 01 00 02 1C 03
			15 00 00 00 01 00 02 1D 39
			15 00 00 00 01 00 02 1E 03
			15 00 00 00 01 00 02 1F 67
			15 00 00 00 01 00 02 20 03
			15 00 00 00 01 00 02 21 76
			15 00 00 00 01 00 02 22 03
			15 00 00 00 01 00 02 23 86
			15 00 00 00 01 00 02 24 03
			15 00 00 00 01 00 02 25 98
			15 00 00 00 01 00 02 26 03
			15 00 00 00 01 00 02 27 AB
			15 00 00 00 01 00 02 28 03
			15 00 00 00 01 00 02 29 C0
			15 00 00 00 01 00 02 2A 03
			15 00 00 00 01 00 02 2B D8
			15 00 00 00 01 00 02 2D 03
			15 00 00 00 01 00 02 2F F2
			15 00 00 00 01 00 02 30 03
			15 00 00 00 01 00 02 31 FF
			15 00 00 00 01 00 02 32 00
			15 00 00 00 01 00 02 33 E0
			15 00 00 00 01 00 02 34 00
			15 00 00 00 01 00 02 35 E9
			15 00 00 00 01 00 02 36 00
			15 00 00 00 01 00 02 37 FB
			15 00 00 00 01 00 02 38 01
			15 00 00 00 01 00 02 39 0B
			15 00 00 00 01 00 02 3A 01
			15 00 00 00 01 00 02 3B 1A
			15 00 00 00 01 00 02 3D 01
			15 00 00 00 01 00 02 3F 27
			15 00 00 00 01 00 02 40 01
			15 00 00 00 01 00 02 41 33
			15 00 00 00 01 00 02 42 01
			15 00 00 00 01 00 02 43 3F
			15 00 00 00 01 00 02 44 01
			15 00 00 00 01 00 02 45 4A
			15 00 00 00 01 00 02 46 01
			15 00 00 00 01 00 02 47 71
			15 00 00 00 01 00 02 48 01
			15 00 00 00 01 00 02 49 8F
			15 00 00 00 01 00 02 4A 01
			15 00 00 00 01 00 02 4B C1
			15 00 00 00 01 00 02 4C 01
			15 00 00 00 01 00 02 4D E9
			15 00 00 00 01 00 02 4E 02
			15 00 00 00 01 00 02 4F 26
			15 00 00 00 01 00 02 50 02
			15 00 00 00 01 00 02 51 5A
			15 00 00 00 01 00 02 52 02
			15 00 00 00 01 00 02 53 5C
			15 00 00 00 01 00 02 54 02
			15 00 00 00 01 00 02 55 8E
			15 00 00 00 01 00 02 56 02
			15 00 00 00 01 00 02 58 C5
			15 00 00 00 01 00 02 59 02
			15 00 00 00 01 00 02 5A E8
			15 00 00 00 01 00 02 5B 03
			15 00 00 00 01 00 02 5C 17
			15 00 00 00 01 00 02 5D 03
			15 00 00 00 01 00 02 5E 39
			15 00 00 00 01 00 02 5F 03
			15 00 00 00 01 00 02 60 67
			15 00 00 00 01 00 02 61 03
			15 00 00 00 01 00 02 62 76
			15 00 00 00 01 00 02 63 03
			15 00 00 00 01 00 02 64 86
			15 00 00 00 01 00 02 65 03
			15 00 00 00 01 00 02 66 98
			15 00 00 00 01 00 02 67 03
			15 00 00 00 01 00 02 68 AB
			15 00 00 00 01 00 02 69 03
			15 00 00 00 01 00 02 6A C0
			15 00 00 00 01 00 02 6B 03
			15 00 00 00 01 00 02 6C D8
			15 00 00 00 01 00 02 6D 03
			15 00 00 00 01 00 02 6E F2
			15 00 00 00 01 00 02 6F 03
			15 00 00 00 01 00 02 70 FF
			15 00 00 00 01 00 02 71 00
			15 00 00 00 01 00 02 72 00
			15 00 00 00 01 00 02 73 00
			15 00 00 00 01 00 02 74 2F
			15 00 00 00 01 00 02 75 00
			15 00 00 00 01 00 02 76 7E
			15 00 00 00 01 00 02 77 00
			15 00 00 00 01 00 02 78 AD
			15 00 00 00 01 00 02 79 00
			15 00 00 00 01 00 02 7A C7
			15 00 00 00 01 00 02 7B 00
			15 00 00 00 01 00 02 7C E0
			15 00 00 00 01 00 02 7D 00
			15 00 00 00 01 00 02 7E F7
			15 00 00 00 01 00 02 7F 01
			15 00 00 00 01 00 02 80 09
			15 00 00 00 01 00 02 81 01
			15 00 00 00 01 00 02 82 19
			15 00 00 00 01 00 02 83 01
			15 00 00 00 01 00 02 84 4F
			15 00 00 00 01 00 02 85 01
			15 00 00 00 01 00 02 86 76
			15 00 00 00 01 00 02 87 01
			15 00 00 00 01 00 02 88 B2
			15 00 00 00 01 00 02 89 01
			15 00 00 00 01 00 02 8A DE
			15 00 00 00 01 00 02 8B 02
			15 00 00 00 01 00 02 8C 20
			15 00 00 00 01 00 02 8D 02
			15 00 00 00 01 00 02 8E 56
			15 00 00 00 01 00 02 8F 02
			15 00 00 00 01 00 02 90 58
			15 00 00 00 01 00 02 91 02
			15 00 00 00 01 00 02 92 8B
			15 00 00 00 01 00 02 93 02
			15 00 00 00 01 00 02 94 C2
			15 00 00 00 01 00 02 95 02
			15 00 00 00 01 00 02 96 E6
			15 00 00 00 01 00 02 97 03
			15 00 00 00 01 00 02 98 15
			15 00 00 00 01 00 02 99 03
			15 00 00 00 01 00 02 9A 35
			15 00 00 00 01 00 02 9B 03
			15 00 00 00 01 00 02 9C 64
			15 00 00 00 01 00 02 9D 03
			15 00 00 00 01 00 02 9E 73
			15 00 00 00 01 00 02 9F 03
			15 00 00 00 01 00 02 A0 83
			15 00 00 00 01 00 02 A2 03
			15 00 00 00 01 00 02 A3 95
			15 00 00 00 01 00 02 A4 03
			15 00 00 00 01 00 02 A5 A9
			15 00 00 00 01 00 02 A6 03
			15 00 00 00 01 00 02 A7 BF
			15 00 00 00 01 00 02 A9 03
			15 00 00 00 01 00 02 AA D7
			15 00 00 00 01 00 02 AB 03
			15 00 00 00 01 00 02 AC F1
			15 00 00 00 01 00 02 AD 03
			15 00 00 00 01 00 02 AE FF
			15 00 00 00 01 00 02 AF 00
			15 00 00 00 01 00 02 B0 00
			15 00 00 00 01 00 02 B1 00
			15 00 00 00 01 00 02 B2 2F
			15 00 00 00 01 00 02 B3 00
			15 00 00 00 01 00 02 B4 7E
			15 00 00 00 01 00 02 B5 00
			15 00 00 00 01 00 02 B6 AD
			15 00 00 00 01 00 02 B7 00
			15 00 00 00 01 00 02 B8 C7
			15 00 00 00 01 00 02 B9 00
			15 00 00 00 01 00 02 BA E0
			15 00 00 00 01 00 02 BB 00
			15 00 00 00 01 00 02 BC F7
			15 00 00 00 01 00 02 BD 01
			15 00 00 00 01 00 02 BE 09
			15 00 00 00 01 00 02 BF 01
			15 00 00 00 01 00 02 C0 19
			15 00 00 00 01 00 02 C1 01
			15 00 00 00 01 00 02 C2 4F
			15 00 00 00 01 00 02 C3 01
			15 00 00 00 01 00 02 C4 76
			15 00 00 00 01 00 02 C5 01
			15 00 00 00 01 00 02 C6 B2
			15 00 00 00 01 00 02 C7 01
			15 00 00 00 01 00 02 C8 DE
			15 00 00 00 01 00 02 C9 02
			15 00 00 00 01 00 02 CA 20
			15 00 00 00 01 00 02 CB 02
			15 00 00 00 01 00 02 CC 56
			15 00 00 00 01 00 02 CD 02
			15 00 00 00 01 00 02 CE 58
			15 00 00 00 01 00 02 CF 02
			15 00 00 00 01 00 02 D0 8B
			15 00 00 00 01 00 02 D1 02
			15 00 00 00 01 00 02 D2 C2
			15 00 00 00 01 00 02 D3 02
			15 00 00 00 01 00 02 D4 E6
			15 00 00 00 01 00 02 D5 03
			15 00 00 00 01 00 02 D6 15
			15 00 00 00 01 00 02 D7 03
			15 00 00 00 01 00 02 D8 35
			15 00 00 00 01 00 02 D9 03
			15 00 00 00 01 00 02 DA 64
			15 00 00 00 01 00 02 DB 03
			15 00 00 00 01 00 02 DC 73
			15 00 00 00 01 00 02 DD 03
			15 00 00 00 01 00 02 DE 83
			15 00 00 00 01 00 02 DF 03
			15 00 00 00 01 00 02 E0 95
			15 00 00 00 01 00 02 E1 03
			15 00 00 00 01 00 02 E2 A9
			15 00 00 00 01 00 02 E3 03
			15 00 00 00 01 00 02 E4 BF
			15 00 00 00 01 00 02 E5 03
			15 00 00 00 01 00 02 E6 D7
			15 00 00 00 01 00 02 E7 03
			15 00 00 00 01 00 02 E8 F1
			15 00 00 00 01 00 02 E9 03
			15 01 00 00 01 00 02 EA FF

			15 00 00 00 00 00 02 ff 23
			15 00 00 00 00 00 02 fb 01
			15 00 00 00 00 00 02 05 24

			15 00 00 00 00 00 02 ff 10
			15 00 00 00 00 00 02 51 ff
			15 00 00 00 00 00 02 53 2c
			15 00 00 00 00 00 02 55 00
			15 00 00 00 00 00 02 58 01
			15 00 00 00 00 00 02 35 00
			39 00 00 00 00 00 03 44 03 e8
			15 00 00 00 00 00 02 bb 10
			05 00 00 00 78 00 02 11 00
			05 01 00 00 78 00 02 29 00
			];
		qcom,mdss-dsi-on-commandasdf = [
			15 01 00 00 00 00 02 ff 24
			15 01 00 00 00 00 02 ec 01
			];
		qcom,mdss-dsi-off-command = [
			15 01 00 00 00 00 02 FF 10
			15 01 00 00 00 00 02 F0 AA
			15 01 00 00 00 00 02 F1 55
			15 01 00 00 00 00 02 F2 99
			05 01 00 00 02 00 02 28 00
			05 01 00 00 79 00 02 10 00
			];
		qcom,mdss-dsi-on-command-state = "dsi_lp_mode";
		qcom,mdss-dsi-off-command-state = "dsi_hs_mode";
		qcom,mdss-dsi-h-sync-pulse = <0>;
		qcom,mdss-dsi-traffic-mode = "burst_mode";
		qcom,mdss-dsi-bllp-eof-power-mode;
		qcom,mdss-dsi-bllp-power-mode;
		qcom,mdss-dsi-lane-0-state;
		qcom,mdss-dsi-lane-1-state;
		qcom,mdss-dsi-lane-2-state;
		qcom,mdss-dsi-lane-3-state;
		qcom,mdss-dsi-panel-timings = [b4 37 1d 00 96 94 20 3b 20 03 04 00];
		qcom,mdss-dsi-t-clk-post = <0x19>;
		qcom,mdss-dsi-t-clk-pre = <0x29>;
		qcom,mdss-brightness-max-level = <4095>;
		qcom,mdss-dsi-dma-trigger = "trigger_sw";
		qcom,mdss-dsi-mdp-trigger = "none";
		qcom,mdss-dsi-reset-sequence = <1 10>, <0 10>, <1 10>;
		qcom,mdss-pan-physical-width-dimension = <71>;
		qcom,mdss-pan-physical-height-dimension = <126>;

		qcom,mdss-dsi-te-pin-select = <1>;
		qcom,mdss-dsi-wr-mem-start = <0x2c>;
		qcom,mdss-dsi-wr-mem-continue = <0x3c>;
		qcom,mdss-dsi-te-dcs-command = <1>;
		qcom,mdss-dsi-te-check-enable;
		qcom,mdss-dsi-te-using-te-pin;

		qcom,dispparam-enabled;
		qcom,mdss-dsi-panel-broadcast-mode;

		qcom,mdss-dsi-dispparam-warm-command = [
			15 00 00 00 01 00 02 FF 20
			15 00 00 00 01 00 02 FB 01
			15 00 00 00 01 00 02 75 00
			15 00 00 00 01 00 02 76 00
			15 00 00 00 01 00 02 77 00
			15 00 00 00 01 00 02 78 20
			15 00 00 00 01 00 02 79 00
			15 00 00 00 01 00 02 7A 58
			15 00 00 00 01 00 02 7B 00
			15 00 00 00 01 00 02 7C 81
			15 00 00 00 01 00 02 7D 00
			15 00 00 00 01 00 02 7E 9F
			15 00 00 00 01 00 02 7F 00
			15 00 00 00 01 00 02 80 BA
			15 00 00 00 01 00 02 81 00
			15 00 00 00 01 00 02 82 D2
			15 00 00 00 01 00 02 83 00
			15 00 00 00 01 00 02 84 E8
			15 00 00 00 01 00 02 85 00
			15 00 00 00 01 00 02 86 FA
			15 00 00 00 01 00 02 87 01
			15 00 00 00 01 00 02 88 33
			15 00 00 00 01 00 02 89 01
			15 00 00 00 01 00 02 8A 5F
			15 00 00 00 01 00 02 8B 01
			15 00 00 00 01 00 02 8C 9F
			15 00 00 00 01 00 02 8D 01
			15 00 00 00 01 00 02 8E CF
			15 00 00 00 01 00 02 8F 02
			15 00 00 00 01 00 02 90 15
			15 00 00 00 01 00 02 91 02
			15 00 00 00 01 00 02 92 4F
			15 00 00 00 01 00 02 93 02
			15 00 00 00 01 00 02 94 51
			15 00 00 00 01 00 02 95 02
			15 00 00 00 01 00 02 96 84
			15 00 00 00 01 00 02 97 02
			15 00 00 00 01 00 02 98 BE
			15 00 00 00 01 00 02 99 02
			15 00 00 00 01 00 02 9A E2
			15 00 00 00 01 00 02 9B 03
			15 00 00 00 01 00 02 9C 11
			15 00 00 00 01 00 02 9D 03
			15 00 00 00 01 00 02 9E 36
			15 00 00 00 01 00 02 9F 03
			15 00 00 00 01 00 02 A0 67
			15 00 00 00 01 00 02 A2 03
			15 00 00 00 01 00 02 A3 76
			15 00 00 00 01 00 02 A4 03
			15 00 00 00 01 00 02 A5 86
			15 00 00 00 01 00 02 A6 03
			15 00 00 00 01 00 02 A7 98
			15 00 00 00 01 00 02 A9 03
			15 00 00 00 01 00 02 AA AC
			15 00 00 00 01 00 02 AB 03
			15 00 00 00 01 00 02 AC C1
			15 00 00 00 01 00 02 AD 03
			15 00 00 00 01 00 02 AE D8
			15 00 00 00 01 00 02 AF 03
			15 00 00 00 01 00 02 B0 F2
			15 00 00 00 01 00 02 B1 03
			15 00 00 00 01 00 02 B2 FF
			15 00 00 00 01 00 02 B3 00
			15 00 00 00 01 00 02 B4 00
			15 00 00 00 01 00 02 B5 00
			15 00 00 00 01 00 02 B6 20
			15 00 00 00 01 00 02 B7 00
			15 00 00 00 01 00 02 B8 58
			15 00 00 00 01 00 02 B9 00
			15 00 00 00 01 00 02 BA 81
			15 00 00 00 01 00 02 BB 00
			15 00 00 00 01 00 02 BC 9F
			15 00 00 00 01 00 02 BD 00
			15 00 00 00 01 00 02 BE BA
			15 00 00 00 01 00 02 BF 00
			15 00 00 00 01 00 02 C0 D2
			15 00 00 00 01 00 02 C1 00
			15 00 00 00 01 00 02 C2 E8
			15 00 00 00 01 00 02 C3 00
			15 00 00 00 01 00 02 C4 FA
			15 00 00 00 01 00 02 C5 01
			15 00 00 00 01 00 02 C6 33
			15 00 00 00 01 00 02 C7 01
			15 00 00 00 01 00 02 C8 5F
			15 00 00 00 01 00 02 C9 01
			15 00 00 00 01 00 02 CA 9F
			15 00 00 00 01 00 02 CB 01
			15 00 00 00 01 00 02 CC CF
			15 00 00 00 01 00 02 CD 02
			15 00 00 00 01 00 02 CE 15
			15 00 00 00 01 00 02 CF 02
			15 00 00 00 01 00 02 D0 4F
			15 00 00 00 01 00 02 D1 02
			15 00 00 00 01 00 02 D2 51
			15 00 00 00 01 00 02 D3 02
			15 00 00 00 01 00 02 D4 84
			15 00 00 00 01 00 02 D5 02
			15 00 00 00 01 00 02 D6 BE
			15 00 00 00 01 00 02 D7 02
			15 00 00 00 01 00 02 D8 E2
			15 00 00 00 01 00 02 D9 03
			15 00 00 00 01 00 02 DA 11
			15 00 00 00 01 00 02 DB 03
			15 00 00 00 01 00 02 DC 36
			15 00 00 00 01 00 02 DD 03
			15 00 00 00 01 00 02 DE 67
			15 00 00 00 01 00 02 DF 03
			15 00 00 00 01 00 02 E0 76
			15 00 00 00 01 00 02 E1 03
			15 00 00 00 01 00 02 E2 86
			15 00 00 00 01 00 02 E3 03
			15 00 00 00 01 00 02 E4 98
			15 00 00 00 01 00 02 E5 03
			15 00 00 00 01 00 02 E6 AC
			15 00 00 00 01 00 02 E7 03
			15 00 00 00 01 00 02 E8 C1
			15 00 00 00 01 00 02 E9 03
			15 00 00 00 01 00 02 EA D8
			15 00 00 00 01 00 02 EB 03
			15 00 00 00 01 00 02 EC F2
			15 00 00 00 01 00 02 ED 03
			15 00 00 00 01 00 02 EE FF
			15 00 00 00 01 00 02 EF 01
			15 00 00 00 01 00 02 F0 15
			15 00 00 00 01 00 02 F1 01
			15 00 00 00 01 00 02 F2 1C
			15 00 00 00 01 00 02 F3 01
			15 00 00 00 01 00 02 F4 29
			15 00 00 00 01 00 02 F5 01
			15 00 00 00 01 00 02 F6 35
			15 00 00 00 01 00 02 F7 01
			15 00 00 00 01 00 02 F8 40
			15 00 00 00 01 00 02 F9 01
			15 01 00 00 01 00 02 FA 4B
			15 00 00 00 01 00 02 FF 21
			15 00 00 00 01 00 02 FB 01
			15 00 00 00 01 00 02 00 01
			15 00 00 00 01 00 02 01 55
			15 00 00 00 01 00 02 02 01
			15 00 00 00 01 00 02 03 5F
			15 00 00 00 01 00 02 04 01
			15 00 00 00 01 00 02 05 68
			15 00 00 00 01 00 02 06 01
			15 00 00 00 01 00 02 07 87
			15 00 00 00 01 00 02 08 01
			15 00 00 00 01 00 02 09 A2
			15 00 00 00 01 00 02 0A 01
			15 00 00 00 01 00 02 0B CF
			15 00 00 00 01 00 02 0C 01
			15 00 00 00 01 00 02 0D F3
			15 00 00 00 01 00 02 0E 02
			15 00 00 00 01 00 02 0F 2D
			15 00 00 00 01 00 02 10 02
			15 00 00 00 01 00 02 11 5F
			15 00 00 00 01 00 02 12 02
			15 00 00 00 01 00 02 13 61
			15 00 00 00 01 00 02 14 02
			15 00 00 00 01 00 02 15 92
			15 00 00 00 01 00 02 16 02
			15 00 00 00 01 00 02 17 C9
			15 00 00 00 01 00 02 18 02
			15 00 00 00 01 00 02 19 ED
			15 00 00 00 01 00 02 1A 03
			15 00 00 00 01 00 02 1B 1B
			15 00 00 00 01 00 02 1C 03
			15 00 00 00 01 00 02 1D 3C
			15 00 00 00 01 00 02 1E 03
			15 00 00 00 01 00 02 1F 69
			15 00 00 00 01 00 02 20 03
			15 00 00 00 01 00 02 21 78
			15 00 00 00 01 00 02 22 03
			15 00 00 00 01 00 02 23 88
			15 00 00 00 01 00 02 24 03
			15 00 00 00 01 00 02 25 99
			15 00 00 00 01 00 02 26 03
			15 00 00 00 01 00 02 27 AC
			15 00 00 00 01 00 02 28 03
			15 00 00 00 01 00 02 29 C1
			15 00 00 00 01 00 02 2A 03
			15 00 00 00 01 00 02 2B D8
			15 00 00 00 01 00 02 2D 03
			15 00 00 00 01 00 02 2F F2
			15 00 00 00 01 00 02 30 03
			15 00 00 00 01 00 02 31 FF
			15 00 00 00 01 00 02 32 01
			15 00 00 00 01 00 02 33 15
			15 00 00 00 01 00 02 34 01
			15 00 00 00 01 00 02 35 1C
			15 00 00 00 01 00 02 36 01
			15 00 00 00 01 00 02 37 29
			15 00 00 00 01 00 02 38 01
			15 00 00 00 01 00 02 39 35
			15 00 00 00 01 00 02 3A 01
			15 00 00 00 01 00 02 3B 40
			15 00 00 00 01 00 02 3D 01
			15 00 00 00 01 00 02 3F 4B
			15 00 00 00 01 00 02 40 01
			15 00 00 00 01 00 02 41 55
			15 00 00 00 01 00 02 42 01
			15 00 00 00 01 00 02 43 5F
			15 00 00 00 01 00 02 44 01
			15 00 00 00 01 00 02 45 68
			15 00 00 00 01 00 02 46 01
			15 00 00 00 01 00 02 47 87
			15 00 00 00 01 00 02 48 01
			15 00 00 00 01 00 02 49 A2
			15 00 00 00 01 00 02 4A 01
			15 00 00 00 01 00 02 4B CF
			15 00 00 00 01 00 02 4C 01
			15 00 00 00 01 00 02 4D F3
			15 00 00 00 01 00 02 4E 02
			15 00 00 00 01 00 02 4F 2D
			15 00 00 00 01 00 02 50 02
			15 00 00 00 01 00 02 51 5F
			15 00 00 00 01 00 02 52 02
			15 00 00 00 01 00 02 53 61
			15 00 00 00 01 00 02 54 02
			15 00 00 00 01 00 02 55 92
			15 00 00 00 01 00 02 56 02
			15 00 00 00 01 00 02 58 C9
			15 00 00 00 01 00 02 59 02
			15 00 00 00 01 00 02 5A ED
			15 00 00 00 01 00 02 5B 03
			15 00 00 00 01 00 02 5C 1B
			15 00 00 00 01 00 02 5D 03
			15 00 00 00 01 00 02 5E 3C
			15 00 00 00 01 00 02 5F 03
			15 00 00 00 01 00 02 60 69
			15 00 00 00 01 00 02 61 03
			15 00 00 00 01 00 02 62 78
			15 00 00 00 01 00 02 63 03
			15 00 00 00 01 00 02 64 88
			15 00 00 00 01 00 02 65 03
			15 00 00 00 01 00 02 66 99
			15 00 00 00 01 00 02 67 03
			15 00 00 00 01 00 02 68 AC
			15 00 00 00 01 00 02 69 03
			15 00 00 00 01 00 02 6A C1
			15 00 00 00 01 00 02 6B 03
			15 00 00 00 01 00 02 6C D8
			15 00 00 00 01 00 02 6D 03
			15 00 00 00 01 00 02 6E F2
			15 00 00 00 01 00 02 6F 03
			15 00 00 00 01 00 02 70 FF
			15 00 00 00 01 00 02 71 01
			15 00 00 00 01 00 02 72 25
			15 00 00 00 01 00 02 73 01
			15 00 00 00 01 00 02 74 2D
			15 00 00 00 01 00 02 75 01
			15 00 00 00 01 00 02 76 39
			15 00 00 00 01 00 02 77 01
			15 00 00 00 01 00 02 78 45
			15 00 00 00 01 00 02 79 01
			15 00 00 00 01 00 02 7A 50
			15 00 00 00 01 00 02 7B 01
			15 00 00 00 01 00 02 7C 5A
			15 00 00 00 01 00 02 7D 01
			15 00 00 00 01 00 02 7E 63
			15 00 00 00 01 00 02 7F 01
			15 00 00 00 01 00 02 80 6C
			15 00 00 00 01 00 02 81 01
			15 00 00 00 01 00 02 82 75
			15 00 00 00 01 00 02 83 01
			15 00 00 00 01 00 02 84 94
			15 00 00 00 01 00 02 85 01
			15 00 00 00 01 00 02 86 AE
			15 00 00 00 01 00 02 87 01
			15 00 00 00 01 00 02 88 D8
			15 00 00 00 01 00 02 89 01
			15 00 00 00 01 00 02 8A FB
			15 00 00 00 01 00 02 8B 02
			15 00 00 00 01 00 02 8C 32
			15 00 00 00 01 00 02 8D 02
			15 00 00 00 01 00 02 8E 63
			15 00 00 00 01 00 02 8F 02
			15 00 00 00 01 00 02 90 65
			15 00 00 00 01 00 02 91 02
			15 00 00 00 01 00 02 92 95
			15 00 00 00 01 00 02 93 02
			15 00 00 00 01 00 02 94 CC
			15 00 00 00 01 00 02 95 02
			15 00 00 00 01 00 02 96 F0
			15 00 00 00 01 00 02 97 03
			15 00 00 00 01 00 02 98 1D
			15 00 00 00 01 00 02 99 03
			15 00 00 00 01 00 02 9A 3B
			15 00 00 00 01 00 02 9B 03
			15 00 00 00 01 00 02 9C 68
			15 00 00 00 01 00 02 9D 03
			15 00 00 00 01 00 02 9E 77
			15 00 00 00 01 00 02 9F 03
			15 00 00 00 01 00 02 A0 86
			15 00 00 00 01 00 02 A2 03
			15 00 00 00 01 00 02 A3 98
			15 00 00 00 01 00 02 A4 03
			15 00 00 00 01 00 02 A5 AB
			15 00 00 00 01 00 02 A6 03
			15 00 00 00 01 00 02 A7 C0
			15 00 00 00 01 00 02 A9 03
			15 00 00 00 01 00 02 AA D8
			15 00 00 00 01 00 02 AB 03
			15 00 00 00 01 00 02 AC F2
			15 00 00 00 01 00 02 AD 03
			15 00 00 00 01 00 02 AE FF
			15 00 00 00 01 00 02 AF 01
			15 00 00 00 01 00 02 B0 25
			15 00 00 00 01 00 02 B1 01
			15 00 00 00 01 00 02 B2 2D
			15 00 00 00 01 00 02 B3 01
			15 00 00 00 01 00 02 B4 39
			15 00 00 00 01 00 02 B5 01
			15 00 00 00 01 00 02 B6 45
			15 00 00 00 01 00 02 B7 01
			15 00 00 00 01 00 02 B8 50
			15 00 00 00 01 00 02 B9 01
			15 00 00 00 01 00 02 BA 5A
			15 00 00 00 01 00 02 BB 01
			15 00 00 00 01 00 02 BC 63
			15 00 00 00 01 00 02 BD 01
			15 00 00 00 01 00 02 BE 6C
			15 00 00 00 01 00 02 BF 01
			15 00 00 00 01 00 02 C0 75
			15 00 00 00 01 00 02 C1 01
			15 00 00 00 01 00 02 C2 94
			15 00 00 00 01 00 02 C3 01
			15 00 00 00 01 00 02 C4 AE
			15 00 00 00 01 00 02 C5 01
			15 00 00 00 01 00 02 C6 D8
			15 00 00 00 01 00 02 C7 01
			15 00 00 00 01 00 02 C8 FB
			15 00 00 00 01 00 02 C9 02
			15 00 00 00 01 00 02 CA 32
			15 00 00 00 01 00 02 CB 02
			15 00 00 00 01 00 02 CC 63
			15 00 00 00 01 00 02 CD 02
			15 00 00 00 01 00 02 CE 65
			15 00 00 00 01 00 02 CF 02
			15 00 00 00 01 00 02 D0 95
			15 00 00 00 01 00 02 D1 02
			15 00 00 00 01 00 02 D2 CC
			15 00 00 00 01 00 02 D3 02
			15 00 00 00 01 00 02 D4 F0
			15 00 00 00 01 00 02 D5 03
			15 00 00 00 01 00 02 D6 1D
			15 00 00 00 01 00 02 D7 03
			15 00 00 00 01 00 02 D8 3B
			15 00 00 00 01 00 02 D9 03
			15 00 00 00 01 00 02 DA 68
			15 00 00 00 01 00 02 DB 03
			15 00 00 00 01 00 02 DC 77
			15 00 00 00 01 00 02 DD 03
			15 00 00 00 01 00 02 DE 86
			15 00 00 00 01 00 02 DF 03
			15 00 00 00 01 00 02 E0 98
			15 00 00 00 01 00 02 E1 03
			15 00 00 00 01 00 02 E2 AB
			15 00 00 00 01 00 02 E3 03
			15 00 00 00 01 00 02 E4 C0
			15 00 00 00 01 00 02 E5 03
			15 00 00 00 01 00 02 E6 D8
			15 00 00 00 01 00 02 E7 03
			15 00 00 00 01 00 02 E8 F2
			15 00 00 00 01 00 02 E9 03
			15 00 00 00 01 00 02 EA FF
			15 01 00 00 01 00 02 FF 10
			];
		qcom,mdss-dsi-dispparam-warm-command-state = "dsi_hs_mode";
		qcom,mdss-dsi-dispparam-default-command = [
			15 00 00 00 01 00 02 FF 20
			15 00 00 00 01 00 02 FB 01
			15 00 00 00 01 00 02 75 00
			15 00 00 00 01 00 02 76 00
			15 00 00 00 01 00 02 77 00
			15 00 00 00 01 00 02 78 20
			15 00 00 00 01 00 02 79 00
			15 00 00 00 01 00 02 7A 58
			15 00 00 00 01 00 02 7B 00
			15 00 00 00 01 00 02 7C 81
			15 00 00 00 01 00 02 7D 00
			15 00 00 00 01 00 02 7E 9F
			15 00 00 00 01 00 02 7F 00
			15 00 00 00 01 00 02 80 BA
			15 00 00 00 01 00 02 81 00
			15 00 00 00 01 00 02 82 D2
			15 00 00 00 01 00 02 83 00
			15 00 00 00 01 00 02 84 E8
			15 00 00 00 01 00 02 85 00
			15 00 00 00 01 00 02 86 FA
			15 00 00 00 01 00 02 87 01
			15 00 00 00 01 00 02 88 33
			15 00 00 00 01 00 02 89 01
			15 00 00 00 01 00 02 8A 5F
			15 00 00 00 01 00 02 8B 01
			15 00 00 00 01 00 02 8C 9F
			15 00 00 00 01 00 02 8D 01
			15 00 00 00 01 00 02 8E CF
			15 00 00 00 01 00 02 8F 02
			15 00 00 00 01 00 02 90 15
			15 00 00 00 01 00 02 91 02
			15 00 00 00 01 00 02 92 4F
			15 00 00 00 01 00 02 93 02
			15 00 00 00 01 00 02 94 51
			15 00 00 00 01 00 02 95 02
			15 00 00 00 01 00 02 96 84
			15 00 00 00 01 00 02 97 02
			15 00 00 00 01 00 02 98 BD
			15 00 00 00 01 00 02 99 02
			15 00 00 00 01 00 02 9A E0
			15 00 00 00 01 00 02 9B 03
			15 00 00 00 01 00 02 9C 10
			15 00 00 00 01 00 02 9D 03
			15 00 00 00 01 00 02 9E 36
			15 00 00 00 01 00 02 9F 03
			15 00 00 00 01 00 02 A0 67
			15 00 00 00 01 00 02 A2 03
			15 00 00 00 01 00 02 A3 76
			15 00 00 00 01 00 02 A4 03
			15 00 00 00 01 00 02 A5 86
			15 00 00 00 01 00 02 A6 03
			15 00 00 00 01 00 02 A7 98
			15 00 00 00 01 00 02 A9 03
			15 00 00 00 01 00 02 AA AC
			15 00 00 00 01 00 02 AB 03
			15 00 00 00 01 00 02 AC C1
			15 00 00 00 01 00 02 AD 03
			15 00 00 00 01 00 02 AE D8
			15 00 00 00 01 00 02 AF 03
			15 00 00 00 01 00 02 B0 F2
			15 00 00 00 01 00 02 B1 03
			15 00 00 00 01 00 02 B2 FF
			15 00 00 00 01 00 02 B3 00
			15 00 00 00 01 00 02 B4 00
			15 00 00 00 01 00 02 B5 00
			15 00 00 00 01 00 02 B6 20
			15 00 00 00 01 00 02 B7 00
			15 00 00 00 01 00 02 B8 58
			15 00 00 00 01 00 02 B9 00
			15 00 00 00 01 00 02 BA 81
			15 00 00 00 01 00 02 BB 00
			15 00 00 00 01 00 02 BC 9F
			15 00 00 00 01 00 02 BD 00
			15 00 00 00 01 00 02 BE BA
			15 00 00 00 01 00 02 BF 00
			15 00 00 00 01 00 02 C0 D2
			15 00 00 00 01 00 02 C1 00
			15 00 00 00 01 00 02 C2 E8
			15 00 00 00 01 00 02 C3 00
			15 00 00 00 01 00 02 C4 FA
			15 00 00 00 01 00 02 C5 01
			15 00 00 00 01 00 02 C6 33
			15 00 00 00 01 00 02 C7 01
			15 00 00 00 01 00 02 C8 5F
			15 00 00 00 01 00 02 C9 01
			15 00 00 00 01 00 02 CA 9F
			15 00 00 00 01 00 02 CB 01
			15 00 00 00 01 00 02 CC CF
			15 00 00 00 01 00 02 CD 02
			15 00 00 00 01 00 02 CE 15
			15 00 00 00 01 00 02 CF 02
			15 00 00 00 01 00 02 D0 4F
			15 00 00 00 01 00 02 D1 02
			15 00 00 00 01 00 02 D2 51
			15 00 00 00 01 00 02 D3 02
			15 00 00 00 01 00 02 D4 84
			15 00 00 00 01 00 02 D5 02
			15 00 00 00 01 00 02 D6 BD
			15 00 00 00 01 00 02 D7 02
			15 00 00 00 01 00 02 D8 E0
			15 00 00 00 01 00 02 D9 03
			15 00 00 00 01 00 02 DA 10
			15 00 00 00 01 00 02 DB 03
			15 00 00 00 01 00 02 DC 36
			15 00 00 00 01 00 02 DD 03
			15 00 00 00 01 00 02 DE 67
			15 00 00 00 01 00 02 DF 03
			15 00 00 00 01 00 02 E0 76
			15 00 00 00 01 00 02 E1 03
			15 00 00 00 01 00 02 E2 86
			15 00 00 00 01 00 02 E3 03
			15 00 00 00 01 00 02 E4 98
			15 00 00 00 01 00 02 E5 03
			15 00 00 00 01 00 02 E6 AC
			15 00 00 00 01 00 02 E7 03
			15 00 00 00 01 00 02 E8 C1
			15 00 00 00 01 00 02 E9 03
			15 00 00 00 01 00 02 EA D8
			15 00 00 00 01 00 02 EB 03
			15 00 00 00 01 00 02 EC F2
			15 00 00 00 01 00 02 ED 03
			15 00 00 00 01 00 02 EE FF
			15 00 00 00 01 00 02 EF 00
			15 00 00 00 01 00 02 F0 E0
			15 00 00 00 01 00 02 F1 00
			15 00 00 00 01 00 02 F2 E9
			15 00 00 00 01 00 02 F3 00
			15 00 00 00 01 00 02 F4 FB
			15 00 00 00 01 00 02 F5 01
			15 00 00 00 01 00 02 F6 0B
			15 00 00 00 01 00 02 F7 01
			15 00 00 00 01 00 02 F8 1A
			15 00 00 00 01 00 02 F9 01
			15 01 00 00 01 00 02 FA 27
			15 00 00 00 01 00 02 FF 21
			15 00 00 00 01 00 02 FB 01
			15 00 00 00 01 00 02 00 01
			15 00 00 00 01 00 02 01 33
			15 00 00 00 01 00 02 02 01
			15 00 00 00 01 00 02 03 3F
			15 00 00 00 01 00 02 04 01
			15 00 00 00 01 00 02 05 4A
			15 00 00 00 01 00 02 06 01
			15 00 00 00 01 00 02 07 71
			15 00 00 00 01 00 02 08 01
			15 00 00 00 01 00 02 09 8F
			15 00 00 00 01 00 02 0A 01
			15 00 00 00 01 00 02 0B C1
			15 00 00 00 01 00 02 0C 01
			15 00 00 00 01 00 02 0D E9
			15 00 00 00 01 00 02 0E 02
			15 00 00 00 01 00 02 0F 26
			15 00 00 00 01 00 02 10 02
			15 00 00 00 01 00 02 11 5A
			15 00 00 00 01 00 02 12 02
			15 00 00 00 01 00 02 13 5C
			15 00 00 00 01 00 02 14 02
			15 00 00 00 01 00 02 15 8E
			15 00 00 00 01 00 02 16 02
			15 00 00 00 01 00 02 17 C5
			15 00 00 00 01 00 02 18 02
			15 00 00 00 01 00 02 19 E8
			15 00 00 00 01 00 02 1A 03
			15 00 00 00 01 00 02 1B 17
			15 00 00 00 01 00 02 1C 03
			15 00 00 00 01 00 02 1D 39
			15 00 00 00 01 00 02 1E 03
			15 00 00 00 01 00 02 1F 67
			15 00 00 00 01 00 02 20 03
			15 00 00 00 01 00 02 21 76
			15 00 00 00 01 00 02 22 03
			15 00 00 00 01 00 02 23 86
			15 00 00 00 01 00 02 24 03
			15 00 00 00 01 00 02 25 98
			15 00 00 00 01 00 02 26 03
			15 00 00 00 01 00 02 27 AB
			15 00 00 00 01 00 02 28 03
			15 00 00 00 01 00 02 29 C0
			15 00 00 00 01 00 02 2A 03
			15 00 00 00 01 00 02 2B D8
			15 00 00 00 01 00 02 2D 03
			15 00 00 00 01 00 02 2F F2
			15 00 00 00 01 00 02 30 03
			15 00 00 00 01 00 02 31 FF
			15 00 00 00 01 00 02 32 00
			15 00 00 00 01 00 02 33 E0
			15 00 00 00 01 00 02 34 00
			15 00 00 00 01 00 02 35 E9
			15 00 00 00 01 00 02 36 00
			15 00 00 00 01 00 02 37 FB
			15 00 00 00 01 00 02 38 01
			15 00 00 00 01 00 02 39 0B
			15 00 00 00 01 00 02 3A 01
			15 00 00 00 01 00 02 3B 1A
			15 00 00 00 01 00 02 3D 01
			15 00 00 00 01 00 02 3F 27
			15 00 00 00 01 00 02 40 01
			15 00 00 00 01 00 02 41 33
			15 00 00 00 01 00 02 42 01
			15 00 00 00 01 00 02 43 3F
			15 00 00 00 01 00 02 44 01
			15 00 00 00 01 00 02 45 4A
			15 00 00 00 01 00 02 46 01
			15 00 00 00 01 00 02 47 71
			15 00 00 00 01 00 02 48 01
			15 00 00 00 01 00 02 49 8F
			15 00 00 00 01 00 02 4A 01
			15 00 00 00 01 00 02 4B C1
			15 00 00 00 01 00 02 4C 01
			15 00 00 00 01 00 02 4D E9
			15 00 00 00 01 00 02 4E 02
			15 00 00 00 01 00 02 4F 26
			15 00 00 00 01 00 02 50 02
			15 00 00 00 01 00 02 51 5A
			15 00 00 00 01 00 02 52 02
			15 00 00 00 01 00 02 53 5C
			15 00 00 00 01 00 02 54 02
			15 00 00 00 01 00 02 55 8E
			15 00 00 00 01 00 02 56 02
			15 00 00 00 01 00 02 58 C5
			15 00 00 00 01 00 02 59 02
			15 00 00 00 01 00 02 5A E8
			15 00 00 00 01 00 02 5B 03
			15 00 00 00 01 00 02 5C 17
			15 00 00 00 01 00 02 5D 03
			15 00 00 00 01 00 02 5E 39
			15 00 00 00 01 00 02 5F 03
			15 00 00 00 01 00 02 60 67
			15 00 00 00 01 00 02 61 03
			15 00 00 00 01 00 02 62 76
			15 00 00 00 01 00 02 63 03
			15 00 00 00 01 00 02 64 86
			15 00 00 00 01 00 02 65 03
			15 00 00 00 01 00 02 66 98
			15 00 00 00 01 00 02 67 03
			15 00 00 00 01 00 02 68 AB
			15 00 00 00 01 00 02 69 03
			15 00 00 00 01 00 02 6A C0
			15 00 00 00 01 00 02 6B 03
			15 00 00 00 01 00 02 6C D8
			15 00 00 00 01 00 02 6D 03
			15 00 00 00 01 00 02 6E F2
			15 00 00 00 01 00 02 6F 03
			15 00 00 00 01 00 02 70 FF
			15 00 00 00 01 00 02 71 00
			15 00 00 00 01 00 02 72 00
			15 00 00 00 01 00 02 73 00
			15 00 00 00 01 00 02 74 2F
			15 00 00 00 01 00 02 75 00
			15 00 00 00 01 00 02 76 7E
			15 00 00 00 01 00 02 77 00
			15 00 00 00 01 00 02 78 AD
			15 00 00 00 01 00 02 79 00
			15 00 00 00 01 00 02 7A C7
			15 00 00 00 01 00 02 7B 00
			15 00 00 00 01 00 02 7C E0
			15 00 00 00 01 00 02 7D 00
			15 00 00 00 01 00 02 7E F7
			15 00 00 00 01 00 02 7F 01
			15 00 00 00 01 00 02 80 09
			15 00 00 00 01 00 02 81 01
			15 00 00 00 01 00 02 82 19
			15 00 00 00 01 00 02 83 01
			15 00 00 00 01 00 02 84 4F
			15 00 00 00 01 00 02 85 01
			15 00 00 00 01 00 02 86 76
			15 00 00 00 01 00 02 87 01
			15 00 00 00 01 00 02 88 B2
			15 00 00 00 01 00 02 89 01
			15 00 00 00 01 00 02 8A DE
			15 00 00 00 01 00 02 8B 02
			15 00 00 00 01 00 02 8C 20
			15 00 00 00 01 00 02 8D 02
			15 00 00 00 01 00 02 8E 56
			15 00 00 00 01 00 02 8F 02
			15 00 00 00 01 00 02 90 58
			15 00 00 00 01 00 02 91 02
			15 00 00 00 01 00 02 92 8B
			15 00 00 00 01 00 02 93 02
			15 00 00 00 01 00 02 94 C2
			15 00 00 00 01 00 02 95 02
			15 00 00 00 01 00 02 96 E6
			15 00 00 00 01 00 02 97 03
			15 00 00 00 01 00 02 98 15
			15 00 00 00 01 00 02 99 03
			15 00 00 00 01 00 02 9A 35
			15 00 00 00 01 00 02 9B 03
			15 00 00 00 01 00 02 9C 64
			15 00 00 00 01 00 02 9D 03
			15 00 00 00 01 00 02 9E 73
			15 00 00 00 01 00 02 9F 03
			15 00 00 00 01 00 02 A0 83
			15 00 00 00 01 00 02 A2 03
			15 00 00 00 01 00 02 A3 95
			15 00 00 00 01 00 02 A4 03
			15 00 00 00 01 00 02 A5 A9
			15 00 00 00 01 00 02 A6 03
			15 00 00 00 01 00 02 A7 BF
			15 00 00 00 01 00 02 A9 03
			15 00 00 00 01 00 02 AA D7
			15 00 00 00 01 00 02 AB 03
			15 00 00 00 01 00 02 AC F1
			15 00 00 00 01 00 02 AD 03
			15 00 00 00 01 00 02 AE FF
			15 00 00 00 01 00 02 AF 00
			15 00 00 00 01 00 02 B0 00
			15 00 00 00 01 00 02 B1 00
			15 00 00 00 01 00 02 B2 2F
			15 00 00 00 01 00 02 B3 00
			15 00 00 00 01 00 02 B4 7E
			15 00 00 00 01 00 02 B5 00
			15 00 00 00 01 00 02 B6 AD
			15 00 00 00 01 00 02 B7 00
			15 00 00 00 01 00 02 B8 C7
			15 00 00 00 01 00 02 B9 00
			15 00 00 00 01 00 02 BA E0
			15 00 00 00 01 00 02 BB 00
			15 00 00 00 01 00 02 BC F7
			15 00 00 00 01 00 02 BD 01
			15 00 00 00 01 00 02 BE 09
			15 00 00 00 01 00 02 BF 01
			15 00 00 00 01 00 02 C0 19
			15 00 00 00 01 00 02 C1 01
			15 00 00 00 01 00 02 C2 4F
			15 00 00 00 01 00 02 C3 01
			15 00 00 00 01 00 02 C4 76
			15 00 00 00 01 00 02 C5 01
			15 00 00 00 01 00 02 C6 B2
			15 00 00 00 01 00 02 C7 01
			15 00 00 00 01 00 02 C8 DE
			15 00 00 00 01 00 02 C9 02
			15 00 00 00 01 00 02 CA 20
			15 00 00 00 01 00 02 CB 02
			15 00 00 00 01 00 02 CC 56
			15 00 00 00 01 00 02 CD 02
			15 00 00 00 01 00 02 CE 58
			15 00 00 00 01 00 02 CF 02
			15 00 00 00 01 00 02 D0 8B
			15 00 00 00 01 00 02 D1 02
			15 00 00 00 01 00 02 D2 C2
			15 00 00 00 01 00 02 D3 02
			15 00 00 00 01 00 02 D4 E6
			15 00 00 00 01 00 02 D5 03
			15 00 00 00 01 00 02 D6 15
			15 00 00 00 01 00 02 D7 03
			15 00 00 00 01 00 02 D8 35
			15 00 00 00 01 00 02 D9 03
			15 00 00 00 01 00 02 DA 64
			15 00 00 00 01 00 02 DB 03
			15 00 00 00 01 00 02 DC 73
			15 00 00 00 01 00 02 DD 03
			15 00 00 00 01 00 02 DE 83
			15 00 00 00 01 00 02 DF 03
			15 00 00 00 01 00 02 E0 95
			15 00 00 00 01 00 02 E1 03
			15 00 00 00 01 00 02 E2 A9
			15 00 00 00 01 00 02 E3 03
			15 00 00 00 01 00 02 E4 BF
			15 00 00 00 01 00 02 E5 03
			15 00 00 00 01 00 02 E6 D7
			15 00 00 00 01 00 02 E7 03
			15 00 00 00 01 00 02 E8 F1
			15 00 00 00 01 00 02 E9 03
			15 00 00 00 01 00 02 EA FF
			15 01 00 00 01 00 02 FF 10
			];
		qcom,mdss-dsi-dispparam-default-command-state = "dsi_hs_mode";
		qcom,mdss-dsi-dispparam-cold-command = [
			15 00 00 00 01 00 02 FF 20
			15 00 00 00 01 00 02 FB 01
			15 00 00 00 01 00 02 75 01
			15 00 00 00 01 00 02 76 03
			15 00 00 00 01 00 02 77 01
			15 00 00 00 01 00 02 78 0C
			15 00 00 00 01 00 02 79 01
			15 00 00 00 01 00 02 7A 1A
			15 00 00 00 01 00 02 7B 01
			15 00 00 00 01 00 02 7C 28
			15 00 00 00 01 00 02 7D 01
			15 00 00 00 01 00 02 7E 35
			15 00 00 00 01 00 02 7F 01
			15 00 00 00 01 00 02 80 41
			15 00 00 00 01 00 02 81 01
			15 00 00 00 01 00 02 82 4C
			15 00 00 00 01 00 02 83 01
			15 00 00 00 01 00 02 84 57
			15 00 00 00 01 00 02 85 01
			15 00 00 00 01 00 02 86 62
			15 00 00 00 01 00 02 87 01
			15 00 00 00 01 00 02 88 84
			15 00 00 00 01 00 02 89 01
			15 00 00 00 01 00 02 8A A1
			15 00 00 00 01 00 02 8B 01
			15 00 00 00 01 00 02 8C D1
			15 00 00 00 01 00 02 8D 01
			15 00 00 00 01 00 02 8E F7
			15 00 00 00 01 00 02 8F 02
			15 00 00 00 01 00 02 90 33
			15 00 00 00 01 00 02 91 02
			15 00 00 00 01 00 02 92 68
			15 00 00 00 01 00 02 93 02
			15 00 00 00 01 00 02 94 6A
			15 00 00 00 01 00 02 95 02
			15 00 00 00 01 00 02 96 9D
			15 00 00 00 01 00 02 97 02
			15 00 00 00 01 00 02 98 D6
			15 00 00 00 01 00 02 99 02
			15 00 00 00 01 00 02 9A FC
			15 00 00 00 01 00 02 9B 03
			15 00 00 00 01 00 02 9C 2D
			15 00 00 00 01 00 02 9D 03
			15 00 00 00 01 00 02 9E 53
			15 00 00 00 01 00 02 9F 03
			15 00 00 00 01 00 02 A0 80
			15 00 00 00 01 00 02 A2 03
			15 00 00 00 01 00 02 A3 8D
			15 00 00 00 01 00 02 A4 03
			15 00 00 00 01 00 02 A5 9C
			15 00 00 00 01 00 02 A6 03
			15 00 00 00 01 00 02 A7 AB
			15 00 00 00 01 00 02 A9 03
			15 00 00 00 01 00 02 AA BC
			15 00 00 00 01 00 02 AB 03
			15 00 00 00 01 00 02 AC CD
			15 00 00 00 01 00 02 AD 03
			15 00 00 00 01 00 02 AE E0
			15 00 00 00 01 00 02 AF 03
			15 00 00 00 01 00 02 B0 F5
			15 00 00 00 01 00 02 B1 03
			15 00 00 00 01 00 02 B2 FF
			15 00 00 00 01 00 02 B3 01
			15 00 00 00 01 00 02 B4 03
			15 00 00 00 01 00 02 B5 01
			15 00 00 00 01 00 02 B6 0C
			15 00 00 00 01 00 02 B7 01
			15 00 00 00 01 00 02 B8 1A
			15 00 00 00 01 00 02 B9 01
			15 00 00 00 01 00 02 BA 28
			15 00 00 00 01 00 02 BB 01
			15 00 00 00 01 00 02 BC 35
			15 00 00 00 01 00 02 BD 01
			15 00 00 00 01 00 02 BE 41
			15 00 00 00 01 00 02 BF 01
			15 00 00 00 01 00 02 C0 4C
			15 00 00 00 01 00 02 C1 01
			15 00 00 00 01 00 02 C2 57
			15 00 00 00 01 00 02 C3 01
			15 00 00 00 01 00 02 C4 62
			15 00 00 00 01 00 02 C5 01
			15 00 00 00 01 00 02 C6 84
			15 00 00 00 01 00 02 C7 01
			15 00 00 00 01 00 02 C8 A1
			15 00 00 00 01 00 02 C9 01
			15 00 00 00 01 00 02 CA D1
			15 00 00 00 01 00 02 CB 01
			15 00 00 00 01 00 02 CC F7
			15 00 00 00 01 00 02 CD 02
			15 00 00 00 01 00 02 CE 33
			15 00 00 00 01 00 02 CF 02
			15 00 00 00 01 00 02 D0 68
			15 00 00 00 01 00 02 D1 02
			15 00 00 00 01 00 02 D2 6A
			15 00 00 00 01 00 02 D3 02
			15 00 00 00 01 00 02 D4 9D
			15 00 00 00 01 00 02 D5 02
			15 00 00 00 01 00 02 D6 D6
			15 00 00 00 01 00 02 D7 02
			15 00 00 00 01 00 02 D8 FC
			15 00 00 00 01 00 02 D9 03
			15 00 00 00 01 00 02 DA 2D
			15 00 00 00 01 00 02 DB 03
			15 00 00 00 01 00 02 DC 53
			15 00 00 00 01 00 02 DD 03
			15 00 00 00 01 00 02 DE 80
			15 00 00 00 01 00 02 DF 03
			15 00 00 00 01 00 02 E0 8D
			15 00 00 00 01 00 02 E1 03
			15 00 00 00 01 00 02 E2 9C
			15 00 00 00 01 00 02 E3 03
			15 00 00 00 01 00 02 E4 AB
			15 00 00 00 01 00 02 E5 03
			15 00 00 00 01 00 02 E6 BC
			15 00 00 00 01 00 02 E7 03
			15 00 00 00 01 00 02 E8 CD
			15 00 00 00 01 00 02 E9 03
			15 00 00 00 01 00 02 EA E0
			15 00 00 00 01 00 02 EB 03
			15 00 00 00 01 00 02 EC F5
			15 00 00 00 01 00 02 ED 03
			15 00 00 00 01 00 02 EE FF
			15 00 00 00 01 00 02 EF 01
			15 00 00 00 01 00 02 F0 0D
			15 00 00 00 01 00 02 F1 01
			15 00 00 00 01 00 02 F2 15
			15 00 00 00 01 00 02 F3 01
			15 00 00 00 01 00 02 F4 23
			15 00 00 00 01 00 02 F5 01
			15 00 00 00 01 00 02 F6 31
			15 00 00 00 01 00 02 F7 01
			15 00 00 00 01 00 02 F8 3D
			15 00 00 00 01 00 02 F9 01
			15 01 00 00 01 00 02 FA 49
			15 00 00 00 01 00 02 FF 21
			15 00 00 00 01 00 02 FB 01
			15 00 00 00 01 00 02 00 01
			15 00 00 00 01 00 02 01 54
			15 00 00 00 01 00 02 02 01
			15 00 00 00 01 00 02 03 5F
			15 00 00 00 01 00 02 04 01
			15 00 00 00 01 00 02 05 69
			15 00 00 00 01 00 02 06 01
			15 00 00 00 01 00 02 07 8A
			15 00 00 00 01 00 02 08 01
			15 00 00 00 01 00 02 09 A8
			15 00 00 00 01 00 02 0A 01
			15 00 00 00 01 00 02 0B D6
			15 00 00 00 01 00 02 0C 01
			15 00 00 00 01 00 02 0D FB
			15 00 00 00 01 00 02 0E 02
			15 00 00 00 01 00 02 0F 37
			15 00 00 00 01 00 02 10 02
			15 00 00 00 01 00 02 11 6A
			15 00 00 00 01 00 02 12 02
			15 00 00 00 01 00 02 13 6C
			15 00 00 00 01 00 02 14 02
			15 00 00 00 01 00 02 15 9E
			15 00 00 00 01 00 02 16 02
			15 00 00 00 01 00 02 17 D8
			15 00 00 00 01 00 02 18 02
			15 00 00 00 01 00 02 19 FE
			15 00 00 00 01 00 02 1A 03
			15 00 00 00 01 00 02 1B 2D
			15 00 00 00 01 00 02 1C 03
			15 00 00 00 01 00 02 1D 4E
			15 00 00 00 01 00 02 1E 03
			15 00 00 00 01 00 02 1F 7A
			15 00 00 00 01 00 02 20 03
			15 00 00 00 01 00 02 21 87
			15 00 00 00 01 00 02 22 03
			15 00 00 00 01 00 02 23 96
			15 00 00 00 01 00 02 24 03
			15 00 00 00 01 00 02 25 A5
			15 00 00 00 01 00 02 26 03
			15 00 00 00 01 00 02 27 B6
			15 00 00 00 01 00 02 28 03
			15 00 00 00 01 00 02 29 C9
			15 00 00 00 01 00 02 2A 03
			15 00 00 00 01 00 02 2B DD
			15 00 00 00 01 00 02 2D 03
			15 00 00 00 01 00 02 2F F4
			15 00 00 00 01 00 02 30 03
			15 00 00 00 01 00 02 31 FF
			15 00 00 00 01 00 02 32 01
			15 00 00 00 01 00 02 33 0D
			15 00 00 00 01 00 02 34 01
			15 00 00 00 01 00 02 35 15
			15 00 00 00 01 00 02 36 01
			15 00 00 00 01 00 02 37 23
			15 00 00 00 01 00 02 38 01
			15 00 00 00 01 00 02 39 31
			15 00 00 00 01 00 02 3A 01
			15 00 00 00 01 00 02 3B 3D
			15 00 00 00 01 00 02 3D 01
			15 00 00 00 01 00 02 3F 49
			15 00 00 00 01 00 02 40 01
			15 00 00 00 01 00 02 41 54
			15 00 00 00 01 00 02 42 01
			15 00 00 00 01 00 02 43 5F
			15 00 00 00 01 00 02 44 01
			15 00 00 00 01 00 02 45 69
			15 00 00 00 01 00 02 46 01
			15 00 00 00 01 00 02 47 8A
			15 00 00 00 01 00 02 48 01
			15 00 00 00 01 00 02 49 A8
			15 00 00 00 01 00 02 4A 01
			15 00 00 00 01 00 02 4B D6
			15 00 00 00 01 00 02 4C 01
			15 00 00 00 01 00 02 4D FB
			15 00 00 00 01 00 02 4E 02
			15 00 00 00 01 00 02 4F 37
			15 00 00 00 01 00 02 50 02
			15 00 00 00 01 00 02 51 6A
			15 00 00 00 01 00 02 52 02
			15 00 00 00 01 00 02 53 6C
			15 00 00 00 01 00 02 54 02
			15 00 00 00 01 00 02 55 9E
			15 00 00 00 01 00 02 56 02
			15 00 00 00 01 00 02 58 D8
			15 00 00 00 01 00 02 59 02
			15 00 00 00 01 00 02 5A FE
			15 00 00 00 01 00 02 5B 03
			15 00 00 00 01 00 02 5C 2D
			15 00 00 00 01 00 02 5D 03
			15 00 00 00 01 00 02 5E 4E
			15 00 00 00 01 00 02 5F 03
			15 00 00 00 01 00 02 60 7A
			15 00 00 00 01 00 02 61 03
			15 00 00 00 01 00 02 62 87
			15 00 00 00 01 00 02 63 03
			15 00 00 00 01 00 02 64 96
			15 00 00 00 01 00 02 65 03
			15 00 00 00 01 00 02 66 A5
			15 00 00 00 01 00 02 67 03
			15 00 00 00 01 00 02 68 B6
			15 00 00 00 01 00 02 69 03
			15 00 00 00 01 00 02 6A C9
			15 00 00 00 01 00 02 6B 03
			15 00 00 00 01 00 02 6C DD
			15 00 00 00 01 00 02 6D 03
			15 00 00 00 01 00 02 6E F4
			15 00 00 00 01 00 02 6F 03
			15 00 00 00 01 00 02 70 FF
			15 00 00 00 01 00 02 71 00
			15 00 00 00 01 00 02 72 00
			15 00 00 00 01 00 02 73 00
			15 00 00 00 01 00 02 74 31
			15 00 00 00 01 00 02 75 00
			15 00 00 00 01 00 02 76 84
			15 00 00 00 01 00 02 77 00
			15 00 00 00 01 00 02 78 B4
			15 00 00 00 01 00 02 79 00
			15 00 00 00 01 00 02 7A CF
			15 00 00 00 01 00 02 7B 00
			15 00 00 00 01 00 02 7C E8
			15 00 00 00 01 00 02 7D 00
			15 00 00 00 01 00 02 7E FF
			15 00 00 00 01 00 02 7F 01
			15 00 00 00 01 00 02 80 13
			15 00 00 00 01 00 02 81 01
			15 00 00 00 01 00 02 82 23
			15 00 00 00 01 00 02 83 01
			15 00 00 00 01 00 02 84 5A
			15 00 00 00 01 00 02 85 01
			15 00 00 00 01 00 02 86 82
			15 00 00 00 01 00 02 87 01
			15 00 00 00 01 00 02 88 BD
			15 00 00 00 01 00 02 89 01
			15 00 00 00 01 00 02 8A EA
			15 00 00 00 01 00 02 8B 02
			15 00 00 00 01 00 02 8C 2C
			15 00 00 00 01 00 02 8D 02
			15 00 00 00 01 00 02 8E 62
			15 00 00 00 01 00 02 8F 02
			15 00 00 00 01 00 02 90 64
			15 00 00 00 01 00 02 91 02
			15 00 00 00 01 00 02 92 98
			15 00 00 00 01 00 02 93 02
			15 00 00 00 01 00 02 94 D3
			15 00 00 00 01 00 02 95 02
			15 00 00 00 01 00 02 96 F9
			15 00 00 00 01 00 02 97 03
			15 00 00 00 01 00 02 98 29
			15 00 00 00 01 00 02 99 03
			15 00 00 00 01 00 02 9A 4A
			15 00 00 00 01 00 02 9B 03
			15 00 00 00 01 00 02 9C 77
			15 00 00 00 01 00 02 9D 03
			15 00 00 00 01 00 02 9E 84
			15 00 00 00 01 00 02 9F 03
			15 00 00 00 01 00 02 A0 93
			15 00 00 00 01 00 02 A2 03
			15 00 00 00 01 00 02 A3 A3
			15 00 00 00 01 00 02 A4 03
			15 00 00 00 01 00 02 A5 B5
			15 00 00 00 01 00 02 A6 03
			15 00 00 00 01 00 02 A7 C8
			15 00 00 00 01 00 02 A9 03
			15 00 00 00 01 00 02 AA DD
			15 00 00 00 01 00 02 AB 03
			15 00 00 00 01 00 02 AC F3
			15 00 00 00 01 00 02 AD 03
			15 00 00 00 01 00 02 AE FF
			15 00 00 00 01 00 02 AF 00
			15 00 00 00 01 00 02 B0 00
			15 00 00 00 01 00 02 B1 00
			15 00 00 00 01 00 02 B2 31
			15 00 00 00 01 00 02 B3 00
			15 00 00 00 01 00 02 B4 84
			15 00 00 00 01 00 02 B5 00
			15 00 00 00 01 00 02 B6 B4
			15 00 00 00 01 00 02 B7 00
			15 00 00 00 01 00 02 B8 CF
			15 00 00 00 01 00 02 B9 00
			15 00 00 00 01 00 02 BA E8
			15 00 00 00 01 00 02 BB 00
			15 00 00 00 01 00 02 BC FF
			15 00 00 00 01 00 02 BD 01
			15 00 00 00 01 00 02 BE 13
			15 00 00 00 01 00 02 BF 01
			15 00 00 00 01 00 02 C0 23
			15 00 00 00 01 00 02 C1 01
			15 00 00 00 01 00 02 C2 5A
			15 00 00 00 01 00 02 C3 01
			15 00 00 00 01 00 02 C4 82
			15 00 00 00 01 00 02 C5 01
			15 00 00 00 01 00 02 C6 BD
			15 00 00 00 01 00 02 C7 01
			15 00 00 00 01 00 02 C8 EA
			15 00 00 00 01 00 02 C9 02
			15 00 00 00 01 00 02 CA 2C
			15 00 00 00 01 00 02 CB 02
			15 00 00 00 01 00 02 CC 62
			15 00 00 00 01 00 02 CD 02
			15 00 00 00 01 00 02 CE 64
			15 00 00 00 01 00 02 CF 02
			15 00 00 00 01 00 02 D0 98
			15 00 00 00 01 00 02 D1 02
			15 00 00 00 01 00 02 D2 D3
			15 00 00 00 01 00 02 D3 02
			15 00 00 00 01 00 02 D4 F9
			15 00 00 00 01 00 02 D5 03
			15 00 00 00 01 00 02 D6 29
			15 00 00 00 01 00 02 D7 03
			15 00 00 00 01 00 02 D8 4A
			15 00 00 00 01 00 02 D9 03
			15 00 00 00 01 00 02 DA 77
			15 00 00 00 01 00 02 DB 03
			15 00 00 00 01 00 02 DC 84
			15 00 00 00 01 00 02 DD 03
			15 00 00 00 01 00 02 DE 93
			15 00 00 00 01 00 02 DF 03
			15 00 00 00 01 00 02 E0 A3
			15 00 00 00 01 00 02 E1 03
			15 00 00 00 01 00 02 E2 B5
			15 00 00 00 01 00 02 E3 03
			15 00 00 00 01 00 02 E4 C8
			15 00 00 00 01 00 02 E5 03
			15 00 00 00 01 00 02 E6 DD
			15 00 00 00 01 00 02 E7 03
			15 00 00 00 01 00 02 E8 F3
			15 00 00 00 01 00 02 E9 03
			15 00 00 00 01 00 02 EA FF
			15 01 00 00 01 00 02 FF 10
			];
		qcom,mdss-dsi-dispparam-cold-command-state = "dsi_hs_mode";
		qcom,mdss-dsi-dispparam-ceon-command = [
                        15 00 00 00 01 00 02 FF 10
                        15 01 00 00 10 00 02 55 80
                        ];
                qcom,mdss-dsi-dispparam-ceoff-command = [
                        15 00 00 00 01 00 02 FF 10
                        15 01 00 00 10 00 02 55 00
                        ];
                qcom,mdss-dsi-dispparam-cabcon-command = [
                        15 00 00 00 01 00 02 FF 10
                        15 00 00 00 01 00 02 51 FF
                        15 00 00 00 01 00 02 53 2C
                        15 01 00 00 01 00 02 55 02
                        ];
                qcom,mdss-dsi-dispparam-cabcguion-command = [
                        15 00 00 00 01 00 02 FF 10
                        15 01 00 00 01 00 02 55 01
                        ];
                qcom,mdss-dsi-dispparam-cabcstillon-command = [
                        15 00 00 00 01 00 02 FF 10
                        15 01 00 00 01 00 02 55 02
                        ];
                qcom,mdss-dsi-dispparam-cabcmovieon-command = [
                        15 00 00 00 01 00 02 FF 10
                        15 01 00 00 01 00 02 55 03
                        ];
                qcom,mdss-dsi-dispparam-cabcoff-command = [
                        15 00 00 00 01 00 02 FF 10
                        15 01 00 00 01 00 02 55 00
                        ];
		qcom,mdss-dsi-dispparam-papermode-command = [
			15 01 00 00 78 00 02 FF 20
			15 00 00 00 01 00 02 FB 01

			15 00 00 00 01 00 02 75 00
			15 00 00 00 01 00 02 76 C8
			15 00 00 00 01 00 02 77 00
			15 00 00 00 01 00 02 78 D3
			15 00 00 00 01 00 02 79 00
			15 00 00 00 01 00 02 7A E7
			15 00 00 00 01 00 02 7B 00
			15 00 00 00 01 00 02 7C F8
			15 00 00 00 01 00 02 7D 01
			15 00 00 00 01 00 02 7E 08
			15 00 00 00 01 00 02 7F 01
			15 00 00 00 01 00 02 80 17
			15 00 00 00 01 00 02 81 01
			15 00 00 00 01 00 02 82 24
			15 00 00 00 01 00 02 83 01
			15 00 00 00 01 00 02 84 30
			15 00 00 00 01 00 02 85 01
			15 00 00 00 01 00 02 86 3C
			15 00 00 00 01 00 02 87 01
			15 00 00 00 01 00 02 88 64
			15 00 00 00 01 00 02 89 01
			15 00 00 00 01 00 02 8A 84
			15 00 00 00 01 00 02 8B 01
			15 00 00 00 01 00 02 8C B8
			15 00 00 00 01 00 02 8D 01
			15 00 00 00 01 00 02 8E E0
			15 00 00 00 01 00 02 8F 02
			15 00 00 00 01 00 02 90 1F
			15 00 00 00 01 00 02 91 02
			15 00 00 00 01 00 02 92 54
			15 00 00 00 01 00 02 93 02
			15 00 00 00 01 00 02 94 56
			15 00 00 00 01 00 02 95 02
			15 00 00 00 01 00 02 96 8A
			15 00 00 00 01 00 02 97 02
			15 00 00 00 01 00 02 98 C1
			15 00 00 00 01 00 02 99 02
			15 00 00 00 01 00 02 9A E1
			15 00 00 00 01 00 02 9B 03
			15 00 00 00 01 00 02 9C 0A
			15 00 00 00 01 00 02 9D 03
			15 00 00 00 01 00 02 9E 33
			15 00 00 00 01 00 02 9F 03
			15 00 00 00 01 00 02 A0 58
			15 00 00 00 01 00 02 A2 03
			15 00 00 00 01 00 02 A3 63
			15 00 00 00 01 00 02 A4 03
			15 00 00 00 01 00 02 A5 6F
			15 00 00 00 01 00 02 A6 03
			15 00 00 00 01 00 02 A7 7C
			15 00 00 00 01 00 02 A9 03
			15 00 00 00 01 00 02 AA 8A
			15 00 00 00 01 00 02 AB 03
			15 00 00 00 01 00 02 AC 9A
			15 00 00 00 01 00 02 AD 03
			15 00 00 00 01 00 02 AE AB
			15 00 00 00 01 00 02 AF 03
			15 00 00 00 01 00 02 B0 B6
			15 00 00 00 01 00 02 B1 03
			15 00 00 00 01 00 02 B2 FE

			15 00 00 00 01 00 02 B3 00
			15 00 00 00 01 00 02 B4 C8
			15 00 00 00 01 00 02 B5 00
			15 00 00 00 01 00 02 B6 D3
			15 00 00 00 01 00 02 B7 00
			15 00 00 00 01 00 02 B8 E7
			15 00 00 00 01 00 02 B9 00
			15 00 00 00 01 00 02 BA F8
			15 00 00 00 01 00 02 BB 01
			15 00 00 00 01 00 02 BC 08
			15 00 00 00 01 00 02 BD 01
			15 00 00 00 01 00 02 BE 17
			15 00 00 00 01 00 02 BF 01
			15 00 00 00 01 00 02 C0 24
			15 00 00 00 01 00 02 C1 01
			15 00 00 00 01 00 02 C2 30
			15 00 00 00 01 00 02 C3 01
			15 00 00 00 01 00 02 C4 3C
			15 00 00 00 01 00 02 C5 01
			15 00 00 00 01 00 02 C6 64
			15 00 00 00 01 00 02 C7 01
			15 00 00 00 01 00 02 C8 84
			15 00 00 00 01 00 02 C9 01
			15 00 00 00 01 00 02 CA B8
			15 00 00 00 01 00 02 CB 01
			15 00 00 00 01 00 02 CC E0
			15 00 00 00 01 00 02 CD 02
			15 00 00 00 01 00 02 CE 1F
			15 00 00 00 01 00 02 CF 02
			15 00 00 00 01 00 02 D0 54
			15 00 00 00 01 00 02 D1 02
			15 00 00 00 01 00 02 D2 56
			15 00 00 00 01 00 02 D3 02
			15 00 00 00 01 00 02 D4 8A
			15 00 00 00 01 00 02 D5 02
			15 00 00 00 01 00 02 D6 C1
			15 00 00 00 01 00 02 D7 02
			15 00 00 00 01 00 02 D8 E1
			15 00 00 00 01 00 02 D9 03
			15 00 00 00 01 00 02 DA 0A
			15 00 00 00 01 00 02 DB 03
			15 00 00 00 01 00 02 DC 33
			15 00 00 00 01 00 02 DD 03
			15 00 00 00 01 00 02 DE 58
			15 00 00 00 01 00 02 DF 03
			15 00 00 00 01 00 02 E0 63
			15 00 00 00 01 00 02 E1 03
			15 00 00 00 01 00 02 E2 6F
			15 00 00 00 01 00 02 E3 03
			15 00 00 00 01 00 02 E4 7C
			15 00 00 00 01 00 02 E5 03
			15 00 00 00 01 00 02 E6 8A
			15 00 00 00 01 00 02 E7 03
			15 00 00 00 01 00 02 E8 9A
			15 00 00 00 01 00 02 E9 03
			15 00 00 00 01 00 02 EA AB
			15 00 00 00 01 00 02 EB 03
			15 00 00 00 01 00 02 EC B6
			15 00 00 00 01 00 02 ED 03
			15 00 00 00 01 00 02 EE FE

			15 00 00 00 01 00 02 EF 00
			15 00 00 00 01 00 02 F0 C8
			15 00 00 00 01 00 02 F1 00
			15 00 00 00 01 00 02 F2 D3
			15 00 00 00 01 00 02 F3 00
			15 00 00 00 01 00 02 F4 E8
			15 00 00 00 01 00 02 F5 00
			15 00 00 00 01 00 02 F6 FA
			15 00 00 00 01 00 02 F7 01
			15 00 00 00 01 00 02 F8 0B
			15 00 00 00 01 00 02 F9 01
			15 00 00 00 01 00 02 FA 19

			15 00 00 00 01 00 02 FF 21
			15 00 00 00 01 00 02 FB 01

			15 00 00 00 01 00 02 00 01
			15 00 00 00 01 00 02 01 27
			15 00 00 00 01 00 02 02 01
			15 00 00 00 01 00 02 03 34
			15 00 00 00 01 00 02 04 01
			15 00 00 00 01 00 02 05 3F
			15 00 00 00 01 00 02 06 01
			15 00 00 00 01 00 02 07 67
			15 00 00 00 01 00 02 08 01
			15 00 00 00 01 00 02 09 88
			15 00 00 00 01 00 02 0A 01
			15 00 00 00 01 00 02 0B BB
			15 00 00 00 01 00 02 0C 01
			15 00 00 00 01 00 02 0D E3
			15 00 00 00 01 00 02 0E 02
			15 00 00 00 01 00 02 0F 22
			15 00 00 00 01 00 02 10 02
			15 00 00 00 01 00 02 11 57
			15 00 00 00 01 00 02 12 02
			15 00 00 00 01 00 02 13 59
			15 00 00 00 01 00 02 14 02
			15 00 00 00 01 00 02 15 8C
			15 00 00 00 01 00 02 16 02
			15 00 00 00 01 00 02 17 C3
			15 00 00 00 01 00 02 18 02
			15 00 00 00 01 00 02 19 E2
			15 00 00 00 01 00 02 1A 03
			15 00 00 00 01 00 02 1B 0C
			15 00 00 00 01 00 02 1C 03
			15 00 00 00 01 00 02 1D 35
			15 00 00 00 01 00 02 1E 03
			15 00 00 00 01 00 02 1F 5B
			15 00 00 00 01 00 02 20 03
			15 00 00 00 01 00 02 21 67
			15 00 00 00 01 00 02 22 03
			15 00 00 00 01 00 02 23 73
			15 00 00 00 01 00 02 24 03
			15 00 00 00 01 00 02 25 82
			15 00 00 00 01 00 02 26 03
			15 00 00 00 01 00 02 27 93
			15 00 00 00 01 00 02 28 03
			15 00 00 00 01 00 02 29 A7
			15 00 00 00 01 00 02 2A 03
			15 00 00 00 01 00 02 2B B8
			15 00 00 00 01 00 02 2D 03
			15 00 00 00 01 00 02 2F C3
			15 00 00 00 01 00 02 30 03
			15 00 00 00 01 00 02 31 FE


			15 00 00 00 01 00 02 32 00
			15 00 00 00 01 00 02 33 C8
			15 00 00 00 01 00 02 34 00
			15 00 00 00 01 00 02 35 D3
			15 00 00 00 01 00 02 36 00
			15 00 00 00 01 00 02 37 E8
			15 00 00 00 01 00 02 38 00
			15 00 00 00 01 00 02 39 FA
			15 00 00 00 01 00 02 3A 01
			15 00 00 00 01 00 02 3B 0B
			15 00 00 00 01 00 02 3D 01
			15 00 00 00 01 00 02 3F 19
			15 00 00 00 01 00 02 40 01
			15 00 00 00 01 00 02 41 27
			15 00 00 00 01 00 02 42 01
			15 00 00 00 01 00 02 43 34
			15 00 00 00 01 00 02 44 01
			15 00 00 00 01 00 02 45 3F
			15 00 00 00 01 00 02 46 01
			15 00 00 00 01 00 02 47 67
			15 00 00 00 01 00 02 48 01
			15 00 00 00 01 00 02 49 88
			15 00 00 00 01 00 02 4A 01
			15 00 00 00 01 00 02 4B BB
			15 00 00 00 01 00 02 4C 01
			15 00 00 00 01 00 02 4D E3
			15 00 00 00 01 00 02 4E 02
			15 00 00 00 01 00 02 4F 22
			15 00 00 00 01 00 02 50 02
			15 00 00 00 01 00 02 51 57
			15 00 00 00 01 00 02 52 02
			15 00 00 00 01 00 02 53 59
			15 00 00 00 01 00 02 54 02
			15 00 00 00 01 00 02 55 8C
			15 00 00 00 01 00 02 56 02
			15 00 00 00 01 00 02 58 C3
			15 00 00 00 01 00 02 59 02
			15 00 00 00 01 00 02 5A E2
			15 00 00 00 01 00 02 5B 03
			15 00 00 00 01 00 02 5C 0C
			15 00 00 00 01 00 02 5D 03
			15 00 00 00 01 00 02 5E 35
			15 00 00 00 01 00 02 5F 03
			15 00 00 00 01 00 02 60 5B
			15 00 00 00 01 00 02 61 03
			15 00 00 00 01 00 02 62 67
			15 00 00 00 01 00 02 63 03
			15 00 00 00 01 00 02 64 73
			15 00 00 00 01 00 02 65 03
			15 00 00 00 01 00 02 66 82
			15 00 00 00 01 00 02 67 03
			15 00 00 00 01 00 02 68 93
			15 00 00 00 01 00 02 69 03
			15 00 00 00 01 00 02 6A A7
			15 00 00 00 01 00 02 6B 03
			15 00 00 00 01 00 02 6C B8
			15 00 00 00 01 00 02 6D 03
			15 00 00 00 01 00 02 6E C3
			15 00 00 00 01 00 02 6F 03
			15 00 00 00 01 00 02 70 FE

			15 00 00 00 01 00 02 71 02
			15 00 00 00 01 00 02 72 34
			15 00 00 00 01 00 02 73 02
			15 00 00 00 01 00 02 74 35
			15 00 00 00 01 00 02 75 02
			15 00 00 00 01 00 02 76 37
			15 00 00 00 01 00 02 77 02
			15 00 00 00 01 00 02 78 39
			15 00 00 00 01 00 02 79 02
			15 00 00 00 01 00 02 7A 3B
			15 00 00 00 01 00 02 7B 02
			15 00 00 00 01 00 02 7C 3D
			15 00 00 00 01 00 02 7D 02
			15 00 00 00 01 00 02 7E 3F
			15 00 00 00 01 00 02 7F 02
			15 00 00 00 01 00 02 80 41
			15 00 00 00 01 00 02 81 02
			15 00 00 00 01 00 02 82 42
			15 00 00 00 01 00 02 83 02
			15 00 00 00 01 00 02 84 4A
			15 00 00 00 01 00 02 85 02
			15 00 00 00 01 00 02 86 52
			15 00 00 00 01 00 02 87 02
			15 00 00 00 01 00 02 88 61
			15 00 00 00 01 00 02 89 02
			15 00 00 00 01 00 02 8A 6F
			15 00 00 00 01 00 02 8B 02
			15 00 00 00 01 00 02 8C 8D
			15 00 00 00 01 00 02 8D 02
			15 00 00 00 01 00 02 8E AD
			15 00 00 00 01 00 02 8F 02
			15 00 00 00 01 00 02 90 AE
			15 00 00 00 01 00 02 91 02
			15 00 00 00 01 00 02 92 D0
			15 00 00 00 01 00 02 93 02
			15 00 00 00 01 00 02 94 F9
			15 00 00 00 01 00 02 95 03
			15 00 00 00 01 00 02 96 17
			15 00 00 00 01 00 02 97 03
			15 00 00 00 01 00 02 98 4A
			15 00 00 00 01 00 02 99 03
			15 00 00 00 01 00 02 9A 5F
			15 00 00 00 01 00 02 9B 03
			15 00 00 00 01 00 02 9C 77
			15 00 00 00 01 00 02 9D 03
			15 00 00 00 01 00 02 9E 7D
			15 00 00 00 01 00 02 9F 03
			15 00 00 00 01 00 02 A0 83
			15 00 00 00 01 00 02 A2 03
			15 00 00 00 01 00 02 A3 89
			15 00 00 00 01 00 02 A4 03
			15 00 00 00 01 00 02 A5 D9
			15 00 00 00 01 00 02 A6 03
			15 00 00 00 01 00 02 A7 C8
			15 00 00 00 01 00 02 A9 03
			15 00 00 00 01 00 02 AA F9
			15 00 00 00 01 00 02 AB 03
			15 00 00 00 01 00 02 AC FB
			15 00 00 00 01 00 02 AD 03
			15 00 00 00 01 00 02 AE FE

			15 00 00 00 01 00 02 AF 02
			15 00 00 00 01 00 02 B0 34
			15 00 00 00 01 00 02 B1 02
			15 00 00 00 01 00 02 B2 35
			15 00 00 00 01 00 02 B3 02
			15 00 00 00 01 00 02 B4 37
			15 00 00 00 01 00 02 B5 02
			15 00 00 00 01 00 02 B6 39
			15 00 00 00 01 00 02 B7 02
			15 00 00 00 01 00 02 B8 3B
			15 00 00 00 01 00 02 B9 02
			15 00 00 00 01 00 02 BA 3D
			15 00 00 00 01 00 02 BB 02
			15 00 00 00 01 00 02 BC 3F
			15 00 00 00 01 00 02 BD 02
			15 00 00 00 01 00 02 BE 41
			15 00 00 00 01 00 02 BF 02
			15 00 00 00 01 00 02 C0 42
			15 00 00 00 01 00 02 C1 02
			15 00 00 00 01 00 02 C2 4A
			15 00 00 00 01 00 02 C3 02
			15 00 00 00 01 00 02 C4 52
			15 00 00 00 01 00 02 C5 02
			15 00 00 00 01 00 02 C6 61
			15 00 00 00 01 00 02 C7 02
			15 00 00 00 01 00 02 C8 6F
			15 00 00 00 01 00 02 C9 02
			15 00 00 00 01 00 02 CA 8D
			15 00 00 00 01 00 02 CB 02
			15 00 00 00 01 00 02 CC AD
			15 00 00 00 01 00 02 CD 02
			15 00 00 00 01 00 02 CE AE
			15 00 00 00 01 00 02 CF 02
			15 00 00 00 01 00 02 D0 D0
			15 00 00 00 01 00 02 D1 02
			15 00 00 00 01 00 02 D2 F9
			15 00 00 00 01 00 02 D3 03
			15 00 00 00 01 00 02 D4 17
			15 00 00 00 01 00 02 D5 03
			15 00 00 00 01 00 02 D6 4A
			15 00 00 00 01 00 02 D7 03
			15 00 00 00 01 00 02 D8 5F
			15 00 00 00 01 00 02 D9 03
			15 00 00 00 01 00 02 DA 77
			15 00 00 00 01 00 02 DB 03
			15 00 00 00 01 00 02 DC 7D
			15 00 00 00 01 00 02 DD 03
			15 00 00 00 01 00 02 DE 83
			15 00 00 00 01 00 02 DF 03
			15 00 00 00 01 00 02 E0 89
			15 00 00 00 01 00 02 E1 03
			15 00 00 00 01 00 02 E2 D9
			15 00 00 00 01 00 02 E3 03
			15 00 00 00 01 00 02 E4 C8
			15 00 00 00 01 00 02 E5 03
			15 00 00 00 01 00 02 E6 F9
			15 00 00 00 01 00 02 E7 03
			15 00 00 00 01 00 02 E8 FB
			15 00 00 00 01 00 02 E9 03
			15 00 00 00 01 00 02 EA FE

			15 00 00 00 01 00 02 FB 01
			15 01 00 00 01 00 02 FF 10
			];
		qcom,mdss-dsi-dispparam-papermode-state = "dsi_hs_mode";
		qcom,mdss-dsi-dispparam-papermode1-command = [
			15 01 00 00 78 00 02 FF 20
			15 00 00 00 01 00 02 FB 01

			15 00 00 00 01 00 02 75 00
			15 00 00 00 01 00 02 76 C8
			15 00 00 00 01 00 02 77 00
			15 00 00 00 01 00 02 78 D3
			15 00 00 00 01 00 02 79 00
			15 00 00 00 01 00 02 7A E7
			15 00 00 00 01 00 02 7B 00
			15 00 00 00 01 00 02 7C F8
			15 00 00 00 01 00 02 7D 01
			15 00 00 00 01 00 02 7E 08
			15 00 00 00 01 00 02 7F 01
			15 00 00 00 01 00 02 80 17
			15 00 00 00 01 00 02 81 01
			15 00 00 00 01 00 02 82 24
			15 00 00 00 01 00 02 83 01
			15 00 00 00 01 00 02 84 30
			15 00 00 00 01 00 02 85 01
			15 00 00 00 01 00 02 86 3C
			15 00 00 00 01 00 02 87 01
			15 00 00 00 01 00 02 88 64
			15 00 00 00 01 00 02 89 01
			15 00 00 00 01 00 02 8A 84
			15 00 00 00 01 00 02 8B 01
			15 00 00 00 01 00 02 8C B8
			15 00 00 00 01 00 02 8D 01
			15 00 00 00 01 00 02 8E E0
			15 00 00 00 01 00 02 8F 02
			15 00 00 00 01 00 02 90 1F
			15 00 00 00 01 00 02 91 02
			15 00 00 00 01 00 02 92 54
			15 00 00 00 01 00 02 93 02
			15 00 00 00 01 00 02 94 56
			15 00 00 00 01 00 02 95 02
			15 00 00 00 01 00 02 96 8A
			15 00 00 00 01 00 02 97 02
			15 00 00 00 01 00 02 98 C1
			15 00 00 00 01 00 02 99 02
			15 00 00 00 01 00 02 9A E1
			15 00 00 00 01 00 02 9B 03
			15 00 00 00 01 00 02 9C 0A
			15 00 00 00 01 00 02 9D 03
			15 00 00 00 01 00 02 9E 33
			15 00 00 00 01 00 02 9F 03
			15 00 00 00 01 00 02 A0 58
			15 00 00 00 01 00 02 A2 03
			15 00 00 00 01 00 02 A3 63
			15 00 00 00 01 00 02 A4 03
			15 00 00 00 01 00 02 A5 6F
			15 00 00 00 01 00 02 A6 03
			15 00 00 00 01 00 02 A7 7C
			15 00 00 00 01 00 02 A9 03
			15 00 00 00 01 00 02 AA 8A
			15 00 00 00 01 00 02 AB 03
			15 00 00 00 01 00 02 AC 9A
			15 00 00 00 01 00 02 AD 03
			15 00 00 00 01 00 02 AE AB
			15 00 00 00 01 00 02 AF 03
			15 00 00 00 01 00 02 B0 B6
			15 00 00 00 01 00 02 B1 03
			15 00 00 00 01 00 02 B2 FE

			15 00 00 00 01 00 02 B3 00
			15 00 00 00 01 00 02 B4 C8
			15 00 00 00 01 00 02 B5 00
			15 00 00 00 01 00 02 B6 D3
			15 00 00 00 01 00 02 B7 00
			15 00 00 00 01 00 02 B8 E7
			15 00 00 00 01 00 02 B9 00
			15 00 00 00 01 00 02 BA F8
			15 00 00 00 01 00 02 BB 01
			15 00 00 00 01 00 02 BC 08
			15 00 00 00 01 00 02 BD 01
			15 00 00 00 01 00 02 BE 17
			15 00 00 00 01 00 02 BF 01
			15 00 00 00 01 00 02 C0 24
			15 00 00 00 01 00 02 C1 01
			15 00 00 00 01 00 02 C2 30
			15 00 00 00 01 00 02 C3 01
			15 00 00 00 01 00 02 C4 3C
			15 00 00 00 01 00 02 C5 01
			15 00 00 00 01 00 02 C6 64
			15 00 00 00 01 00 02 C7 01
			15 00 00 00 01 00 02 C8 84
			15 00 00 00 01 00 02 C9 01
			15 00 00 00 01 00 02 CA B8
			15 00 00 00 01 00 02 CB 01
			15 00 00 00 01 00 02 CC E0
			15 00 00 00 01 00 02 CD 02
			15 00 00 00 01 00 02 CE 1F
			15 00 00 00 01 00 02 CF 02
			15 00 00 00 01 00 02 D0 54
			15 00 00 00 01 00 02 D1 02
			15 00 00 00 01 00 02 D2 56
			15 00 00 00 01 00 02 D3 02
			15 00 00 00 01 00 02 D4 8A
			15 00 00 00 01 00 02 D5 02
			15 00 00 00 01 00 02 D6 C1
			15 00 00 00 01 00 02 D7 02
			15 00 00 00 01 00 02 D8 E1
			15 00 00 00 01 00 02 D9 03
			15 00 00 00 01 00 02 DA 0A
			15 00 00 00 01 00 02 DB 03
			15 00 00 00 01 00 02 DC 33
			15 00 00 00 01 00 02 DD 03
			15 00 00 00 01 00 02 DE 58
			15 00 00 00 01 00 02 DF 03
			15 00 00 00 01 00 02 E0 63
			15 00 00 00 01 00 02 E1 03
			15 00 00 00 01 00 02 E2 6F
			15 00 00 00 01 00 02 E3 03
			15 00 00 00 01 00 02 E4 7C
			15 00 00 00 01 00 02 E5 03
			15 00 00 00 01 00 02 E6 8A
			15 00 00 00 01 00 02 E7 03
			15 00 00 00 01 00 02 E8 9A
			15 00 00 00 01 00 02 E9 03
			15 00 00 00 01 00 02 EA AB
			15 00 00 00 01 00 02 EB 03
			15 00 00 00 01 00 02 EC B6
			15 00 00 00 01 00 02 ED 03
			15 00 00 00 01 00 02 EE FE

			15 00 00 00 01 00 02 EF 00
			15 00 00 00 01 00 02 F0 C8
			15 00 00 00 01 00 02 F1 00
			15 00 00 00 01 00 02 F2 D3
			15 00 00 00 01 00 02 F3 00
			15 00 00 00 01 00 02 F4 E8
			15 00 00 00 01 00 02 F5 00
			15 00 00 00 01 00 02 F6 FA
			15 00 00 00 01 00 02 F7 01
			15 00 00 00 01 00 02 F8 0B
			15 00 00 00 01 00 02 F9 01
			15 00 00 00 01 00 02 FA 19

			15 00 00 00 01 00 02 FF 21
			15 00 00 00 01 00 02 FB 01

			15 00 00 00 01 00 02 00 01
			15 00 00 00 01 00 02 01 27
			15 00 00 00 01 00 02 02 01
			15 00 00 00 01 00 02 03 34
			15 00 00 00 01 00 02 04 01
			15 00 00 00 01 00 02 05 3F
			15 00 00 00 01 00 02 06 01
			15 00 00 00 01 00 02 07 67
			15 00 00 00 01 00 02 08 01
			15 00 00 00 01 00 02 09 88
			15 00 00 00 01 00 02 0A 01
			15 00 00 00 01 00 02 0B BB
			15 00 00 00 01 00 02 0C 01
			15 00 00 00 01 00 02 0D E3
			15 00 00 00 01 00 02 0E 02
			15 00 00 00 01 00 02 0F 22
			15 00 00 00 01 00 02 10 02
			15 00 00 00 01 00 02 11 57
			15 00 00 00 01 00 02 12 02
			15 00 00 00 01 00 02 13 59
			15 00 00 00 01 00 02 14 02
			15 00 00 00 01 00 02 15 8C
			15 00 00 00 01 00 02 16 02
			15 00 00 00 01 00 02 17 C3
			15 00 00 00 01 00 02 18 02
			15 00 00 00 01 00 02 19 E2
			15 00 00 00 01 00 02 1A 03
			15 00 00 00 01 00 02 1B 0C
			15 00 00 00 01 00 02 1C 03
			15 00 00 00 01 00 02 1D 35
			15 00 00 00 01 00 02 1E 03
			15 00 00 00 01 00 02 1F 5B
			15 00 00 00 01 00 02 20 03
			15 00 00 00 01 00 02 21 67
			15 00 00 00 01 00 02 22 03
			15 00 00 00 01 00 02 23 73
			15 00 00 00 01 00 02 24 03
			15 00 00 00 01 00 02 25 82
			15 00 00 00 01 00 02 26 03
			15 00 00 00 01 00 02 27 93
			15 00 00 00 01 00 02 28 03
			15 00 00 00 01 00 02 29 A7
			15 00 00 00 01 00 02 2A 03
			15 00 00 00 01 00 02 2B B8
			15 00 00 00 01 00 02 2D 03
			15 00 00 00 01 00 02 2F C3
			15 00 00 00 01 00 02 30 03
			15 00 00 00 01 00 02 31 FE


			15 00 00 00 01 00 02 32 00
			15 00 00 00 01 00 02 33 C8
			15 00 00 00 01 00 02 34 00
			15 00 00 00 01 00 02 35 D3
			15 00 00 00 01 00 02 36 00
			15 00 00 00 01 00 02 37 E8
			15 00 00 00 01 00 02 38 00
			15 00 00 00 01 00 02 39 FA
			15 00 00 00 01 00 02 3A 01
			15 00 00 00 01 00 02 3B 0B
			15 00 00 00 01 00 02 3D 01
			15 00 00 00 01 00 02 3F 19
			15 00 00 00 01 00 02 40 01
			15 00 00 00 01 00 02 41 27
			15 00 00 00 01 00 02 42 01
			15 00 00 00 01 00 02 43 34
			15 00 00 00 01 00 02 44 01
			15 00 00 00 01 00 02 45 3F
			15 00 00 00 01 00 02 46 01
			15 00 00 00 01 00 02 47 67
			15 00 00 00 01 00 02 48 01
			15 00 00 00 01 00 02 49 88
			15 00 00 00 01 00 02 4A 01
			15 00 00 00 01 00 02 4B BB
			15 00 00 00 01 00 02 4C 01
			15 00 00 00 01 00 02 4D E3
			15 00 00 00 01 00 02 4E 02
			15 00 00 00 01 00 02 4F 22
			15 00 00 00 01 00 02 50 02
			15 00 00 00 01 00 02 51 57
			15 00 00 00 01 00 02 52 02
			15 00 00 00 01 00 02 53 59
			15 00 00 00 01 00 02 54 02
			15 00 00 00 01 00 02 55 8C
			15 00 00 00 01 00 02 56 02
			15 00 00 00 01 00 02 58 C3
			15 00 00 00 01 00 02 59 02
			15 00 00 00 01 00 02 5A E2
			15 00 00 00 01 00 02 5B 03
			15 00 00 00 01 00 02 5C 0C
			15 00 00 00 01 00 02 5D 03
			15 00 00 00 01 00 02 5E 35
			15 00 00 00 01 00 02 5F 03
			15 00 00 00 01 00 02 60 5B
			15 00 00 00 01 00 02 61 03
			15 00 00 00 01 00 02 62 67
			15 00 00 00 01 00 02 63 03
			15 00 00 00 01 00 02 64 73
			15 00 00 00 01 00 02 65 03
			15 00 00 00 01 00 02 66 82
			15 00 00 00 01 00 02 67 03
			15 00 00 00 01 00 02 68 93
			15 00 00 00 01 00 02 69 03
			15 00 00 00 01 00 02 6A A7
			15 00 00 00 01 00 02 6B 03
			15 00 00 00 01 00 02 6C B8
			15 00 00 00 01 00 02 6D 03
			15 00 00 00 01 00 02 6E C3
			15 00 00 00 01 00 02 6F 03
			15 00 00 00 01 00 02 70 FE


			15 00 00 00 01 00 02 71 01
			15 00 00 00 01 00 02 72 52
			15 00 00 00 01 00 02 73 01
			15 00 00 00 01 00 02 74 56
			15 00 00 00 01 00 02 75 01
			15 00 00 00 01 00 02 76 5F
			15 00 00 00 01 00 02 77 01
			15 00 00 00 01 00 02 78 67
			15 00 00 00 01 00 02 79 01
			15 00 00 00 01 00 02 7A 6F
			15 00 00 00 01 00 02 7B 01
			15 00 00 00 01 00 02 7C 77
			15 00 00 00 01 00 02 7D 01
			15 00 00 00 01 00 02 7E 7E
			15 00 00 00 01 00 02 7F 01
			15 00 00 00 01 00 02 80 85
			15 00 00 00 01 00 02 81 01
			15 00 00 00 01 00 02 82 8C
			15 00 00 00 01 00 02 83 01
			15 00 00 00 01 00 02 84 A4
			15 00 00 00 01 00 02 85 01
			15 00 00 00 01 00 02 86 BA
			15 00 00 00 01 00 02 87 01
			15 00 00 00 01 00 02 88 DF
			15 00 00 00 01 00 02 89 01
			15 00 00 00 01 00 02 8A FF
			15 00 00 00 01 00 02 8B 02
			15 00 00 00 01 00 02 8C 34
			15 00 00 00 01 00 02 8D 02
			15 00 00 00 01 00 02 8E 64
			15 00 00 00 01 00 02 8F 02
			15 00 00 00 01 00 02 90 65
			15 00 00 00 01 00 02 91 02
			15 00 00 00 01 00 02 92 95
			15 00 00 00 01 00 02 93 02
			15 00 00 00 01 00 02 94 CA
			15 00 00 00 01 00 02 95 02
			15 00 00 00 01 00 02 96 E9
			15 00 00 00 01 00 02 97 03
			15 00 00 00 01 00 02 98 13
			15 00 00 00 01 00 02 99 03
			15 00 00 00 01 00 02 9A 3B
			15 00 00 00 01 00 02 9B 03
			15 00 00 00 01 00 02 9C 5E
			15 00 00 00 01 00 02 9D 03
			15 00 00 00 01 00 02 9E 69
			15 00 00 00 01 00 02 9F 03
			15 00 00 00 01 00 02 A0 74
			15 00 00 00 01 00 02 A2 03
			15 00 00 00 01 00 02 A3 81
			15 00 00 00 01 00 02 A4 03
			15 00 00 00 01 00 02 A5 8E
			15 00 00 00 01 00 02 A6 03
			15 00 00 00 01 00 02 A7 9E
			15 00 00 00 01 00 02 A9 03
			15 00 00 00 01 00 02 AA AD
			15 00 00 00 01 00 02 AB 03
			15 00 00 00 01 00 02 AC B6
			15 00 00 00 01 00 02 AD 03
			15 00 00 00 01 00 02 AE FE

			15 00 00 00 01 00 02 AF 01
			15 00 00 00 01 00 02 B0 52
			15 00 00 00 01 00 02 B1 01
			15 00 00 00 01 00 02 B2 56
			15 00 00 00 01 00 02 B3 01
			15 00 00 00 01 00 02 B4 5F
			15 00 00 00 01 00 02 B5 01
			15 00 00 00 01 00 02 B6 67
			15 00 00 00 01 00 02 B7 01
			15 00 00 00 01 00 02 B8 6F
			15 00 00 00 01 00 02 B9 01
			15 00 00 00 01 00 02 BA 77
			15 00 00 00 01 00 02 BB 01
			15 00 00 00 01 00 02 BC 7E
			15 00 00 00 01 00 02 BD 01
			15 00 00 00 01 00 02 BE 85
			15 00 00 00 01 00 02 BF 01
			15 00 00 00 01 00 02 C0 8C
			15 00 00 00 01 00 02 C1 01
			15 00 00 00 01 00 02 C2 A4
			15 00 00 00 01 00 02 C3 01
			15 00 00 00 01 00 02 C4 BA
			15 00 00 00 01 00 02 C5 01
			15 00 00 00 01 00 02 C6 DF
			15 00 00 00 01 00 02 C7 01
			15 00 00 00 01 00 02 C8 FF
			15 00 00 00 01 00 02 C9 02
			15 00 00 00 01 00 02 CA 34
			15 00 00 00 01 00 02 CB 02
			15 00 00 00 01 00 02 CC 64
			15 00 00 00 01 00 02 CD 02
			15 00 00 00 01 00 02 CE 65
			15 00 00 00 01 00 02 CF 02
			15 00 00 00 01 00 02 D0 95
			15 00 00 00 01 00 02 D1 02
			15 00 00 00 01 00 02 D2 CA
			15 00 00 00 01 00 02 D3 02
			15 00 00 00 01 00 02 D4 E9
			15 00 00 00 01 00 02 D5 03
			15 00 00 00 01 00 02 D6 13
			15 00 00 00 01 00 02 D7 03
			15 00 00 00 01 00 02 D8 3B
			15 00 00 00 01 00 02 D9 03
			15 00 00 00 01 00 02 DA 5E
			15 00 00 00 01 00 02 DB 03
			15 00 00 00 01 00 02 DC 69
			15 00 00 00 01 00 02 DD 03
			15 00 00 00 01 00 02 DE 74
			15 00 00 00 01 00 02 DF 03
			15 00 00 00 01 00 02 E0 81
			15 00 00 00 01 00 02 E1 03
			15 00 00 00 01 00 02 E2 8E
			15 00 00 00 01 00 02 E3 03
			15 00 00 00 01 00 02 E4 9E
			15 00 00 00 01 00 02 E5 03
			15 00 00 00 01 00 02 E6 AD
			15 00 00 00 01 00 02 E7 03
			15 00 00 00 01 00 02 E8 B6
			15 00 00 00 01 00 02 E9 03
			15 00 00 00 01 00 02 EA FE

			15 00 00 00 01 00 02 FB 01
			15 01 00 00 01 00 02 FF 10
			];
		qcom,mdss-dsi-dispparam-papermode1-state = "dsi_hs_mode";
		qcom,mdss-dsi-dispparam-papermode2-command = [
			15 01 00 00 78 00 02 FF 20
			15 00 00 00 01 00 02 FB 01

			15 00 00 00 01 00 02 75 00
			15 00 00 00 01 00 02 76 C8
			15 00 00 00 01 00 02 77 00
			15 00 00 00 01 00 02 78 D3
			15 00 00 00 01 00 02 79 00
			15 00 00 00 01 00 02 7A E7
			15 00 00 00 01 00 02 7B 00
			15 00 00 00 01 00 02 7C F8
			15 00 00 00 01 00 02 7D 01
			15 00 00 00 01 00 02 7E 08
			15 00 00 00 01 00 02 7F 01
			15 00 00 00 01 00 02 80 17
			15 00 00 00 01 00 02 81 01
			15 00 00 00 01 00 02 82 24
			15 00 00 00 01 00 02 83 01
			15 00 00 00 01 00 02 84 30
			15 00 00 00 01 00 02 85 01
			15 00 00 00 01 00 02 86 3C
			15 00 00 00 01 00 02 87 01
			15 00 00 00 01 00 02 88 64
			15 00 00 00 01 00 02 89 01
			15 00 00 00 01 00 02 8A 84
			15 00 00 00 01 00 02 8B 01
			15 00 00 00 01 00 02 8C B8
			15 00 00 00 01 00 02 8D 01
			15 00 00 00 01 00 02 8E E0
			15 00 00 00 01 00 02 8F 02
			15 00 00 00 01 00 02 90 1F
			15 00 00 00 01 00 02 91 02
			15 00 00 00 01 00 02 92 54
			15 00 00 00 01 00 02 93 02
			15 00 00 00 01 00 02 94 56
			15 00 00 00 01 00 02 95 02
			15 00 00 00 01 00 02 96 8A
			15 00 00 00 01 00 02 97 02
			15 00 00 00 01 00 02 98 C1
			15 00 00 00 01 00 02 99 02
			15 00 00 00 01 00 02 9A E1
			15 00 00 00 01 00 02 9B 03
			15 00 00 00 01 00 02 9C 0A
			15 00 00 00 01 00 02 9D 03
			15 00 00 00 01 00 02 9E 33
			15 00 00 00 01 00 02 9F 03
			15 00 00 00 01 00 02 A0 58
			15 00 00 00 01 00 02 A2 03
			15 00 00 00 01 00 02 A3 63
			15 00 00 00 01 00 02 A4 03
			15 00 00 00 01 00 02 A5 6F
			15 00 00 00 01 00 02 A6 03
			15 00 00 00 01 00 02 A7 7C
			15 00 00 00 01 00 02 A9 03
			15 00 00 00 01 00 02 AA 8A
			15 00 00 00 01 00 02 AB 03
			15 00 00 00 01 00 02 AC 9A
			15 00 00 00 01 00 02 AD 03
			15 00 00 00 01 00 02 AE AB
			15 00 00 00 01 00 02 AF 03
			15 00 00 00 01 00 02 B0 B6
			15 00 00 00 01 00 02 B1 03
			15 00 00 00 01 00 02 B2 FE

			15 00 00 00 01 00 02 B3 00
			15 00 00 00 01 00 02 B4 C8
			15 00 00 00 01 00 02 B5 00
			15 00 00 00 01 00 02 B6 D3
			15 00 00 00 01 00 02 B7 00
			15 00 00 00 01 00 02 B8 E7
			15 00 00 00 01 00 02 B9 00
			15 00 00 00 01 00 02 BA F8
			15 00 00 00 01 00 02 BB 01
			15 00 00 00 01 00 02 BC 08
			15 00 00 00 01 00 02 BD 01
			15 00 00 00 01 00 02 BE 17
			15 00 00 00 01 00 02 BF 01
			15 00 00 00 01 00 02 C0 24
			15 00 00 00 01 00 02 C1 01
			15 00 00 00 01 00 02 C2 30
			15 00 00 00 01 00 02 C3 01
			15 00 00 00 01 00 02 C4 3C
			15 00 00 00 01 00 02 C5 01
			15 00 00 00 01 00 02 C6 64
			15 00 00 00 01 00 02 C7 01
			15 00 00 00 01 00 02 C8 84
			15 00 00 00 01 00 02 C9 01
			15 00 00 00 01 00 02 CA B8
			15 00 00 00 01 00 02 CB 01
			15 00 00 00 01 00 02 CC E0
			15 00 00 00 01 00 02 CD 02
			15 00 00 00 01 00 02 CE 1F
			15 00 00 00 01 00 02 CF 02
			15 00 00 00 01 00 02 D0 54
			15 00 00 00 01 00 02 D1 02
			15 00 00 00 01 00 02 D2 56
			15 00 00 00 01 00 02 D3 02
			15 00 00 00 01 00 02 D4 8A
			15 00 00 00 01 00 02 D5 02
			15 00 00 00 01 00 02 D6 C1
			15 00 00 00 01 00 02 D7 02
			15 00 00 00 01 00 02 D8 E1
			15 00 00 00 01 00 02 D9 03
			15 00 00 00 01 00 02 DA 0A
			15 00 00 00 01 00 02 DB 03
			15 00 00 00 01 00 02 DC 33
			15 00 00 00 01 00 02 DD 03
			15 00 00 00 01 00 02 DE 58
			15 00 00 00 01 00 02 DF 03
			15 00 00 00 01 00 02 E0 63
			15 00 00 00 01 00 02 E1 03
			15 00 00 00 01 00 02 E2 6F
			15 00 00 00 01 00 02 E3 03
			15 00 00 00 01 00 02 E4 7C
			15 00 00 00 01 00 02 E5 03
			15 00 00 00 01 00 02 E6 8A
			15 00 00 00 01 00 02 E7 03
			15 00 00 00 01 00 02 E8 9A
			15 00 00 00 01 00 02 E9 03
			15 00 00 00 01 00 02 EA AB
			15 00 00 00 01 00 02 EB 03
			15 00 00 00 01 00 02 EC B6
			15 00 00 00 01 00 02 ED 03
			15 00 00 00 01 00 02 EE FE

			15 00 00 00 01 00 02 EF 00
			15 00 00 00 01 00 02 F0 C8
			15 00 00 00 01 00 02 F1 00
			15 00 00 00 01 00 02 F2 D3
			15 00 00 00 01 00 02 F3 00
			15 00 00 00 01 00 02 F4 E8
			15 00 00 00 01 00 02 F5 00
			15 00 00 00 01 00 02 F6 FA
			15 00 00 00 01 00 02 F7 01
			15 00 00 00 01 00 02 F8 0B
			15 00 00 00 01 00 02 F9 01
			15 00 00 00 01 00 02 FA 19

			15 00 00 00 01 00 02 FF 21
			15 00 00 00 01 00 02 FB 01

			15 00 00 00 01 00 02 00 01
			15 00 00 00 01 00 02 01 27
			15 00 00 00 01 00 02 02 01
			15 00 00 00 01 00 02 03 34
			15 00 00 00 01 00 02 04 01
			15 00 00 00 01 00 02 05 3F
			15 00 00 00 01 00 02 06 01
			15 00 00 00 01 00 02 07 67
			15 00 00 00 01 00 02 08 01
			15 00 00 00 01 00 02 09 88
			15 00 00 00 01 00 02 0A 01
			15 00 00 00 01 00 02 0B BB
			15 00 00 00 01 00 02 0C 01
			15 00 00 00 01 00 02 0D E3
			15 00 00 00 01 00 02 0E 02
			15 00 00 00 01 00 02 0F 22
			15 00 00 00 01 00 02 10 02
			15 00 00 00 01 00 02 11 57
			15 00 00 00 01 00 02 12 02
			15 00 00 00 01 00 02 13 59
			15 00 00 00 01 00 02 14 02
			15 00 00 00 01 00 02 15 8C
			15 00 00 00 01 00 02 16 02
			15 00 00 00 01 00 02 17 C3
			15 00 00 00 01 00 02 18 02
			15 00 00 00 01 00 02 19 E2
			15 00 00 00 01 00 02 1A 03
			15 00 00 00 01 00 02 1B 0C
			15 00 00 00 01 00 02 1C 03
			15 00 00 00 01 00 02 1D 35
			15 00 00 00 01 00 02 1E 03
			15 00 00 00 01 00 02 1F 5B
			15 00 00 00 01 00 02 20 03
			15 00 00 00 01 00 02 21 67
			15 00 00 00 01 00 02 22 03
			15 00 00 00 01 00 02 23 73
			15 00 00 00 01 00 02 24 03
			15 00 00 00 01 00 02 25 82
			15 00 00 00 01 00 02 26 03
			15 00 00 00 01 00 02 27 93
			15 00 00 00 01 00 02 28 03
			15 00 00 00 01 00 02 29 A7
			15 00 00 00 01 00 02 2A 03
			15 00 00 00 01 00 02 2B B8
			15 00 00 00 01 00 02 2D 03
			15 00 00 00 01 00 02 2F C3
			15 00 00 00 01 00 02 30 03
			15 00 00 00 01 00 02 31 FE

			15 00 00 00 01 00 02 32 00
			15 00 00 00 01 00 02 33 C8
			15 00 00 00 01 00 02 34 00
			15 00 00 00 01 00 02 35 D3
			15 00 00 00 01 00 02 36 00
			15 00 00 00 01 00 02 37 E8
			15 00 00 00 01 00 02 38 00
			15 00 00 00 01 00 02 39 FA
			15 00 00 00 01 00 02 3A 01
			15 00 00 00 01 00 02 3B 0B
			15 00 00 00 01 00 02 3D 01
			15 00 00 00 01 00 02 3F 19
			15 00 00 00 01 00 02 40 01
			15 00 00 00 01 00 02 41 27
			15 00 00 00 01 00 02 42 01
			15 00 00 00 01 00 02 43 34
			15 00 00 00 01 00 02 44 01
			15 00 00 00 01 00 02 45 3F
			15 00 00 00 01 00 02 46 01
			15 00 00 00 01 00 02 47 67
			15 00 00 00 01 00 02 48 01
			15 00 00 00 01 00 02 49 88
			15 00 00 00 01 00 02 4A 01
			15 00 00 00 01 00 02 4B BB
			15 00 00 00 01 00 02 4C 01
			15 00 00 00 01 00 02 4D E3
			15 00 00 00 01 00 02 4E 02
			15 00 00 00 01 00 02 4F 22
			15 00 00 00 01 00 02 50 02
			15 00 00 00 01 00 02 51 57
			15 00 00 00 01 00 02 52 02
			15 00 00 00 01 00 02 53 59
			15 00 00 00 01 00 02 54 02
			15 00 00 00 01 00 02 55 8C
			15 00 00 00 01 00 02 56 02
			15 00 00 00 01 00 02 58 C3
			15 00 00 00 01 00 02 59 02
			15 00 00 00 01 00 02 5A E2
			15 00 00 00 01 00 02 5B 03
			15 00 00 00 01 00 02 5C 0C
			15 00 00 00 01 00 02 5D 03
			15 00 00 00 01 00 02 5E 35
			15 00 00 00 01 00 02 5F 03
			15 00 00 00 01 00 02 60 5B
			15 00 00 00 01 00 02 61 03
			15 00 00 00 01 00 02 62 67
			15 00 00 00 01 00 02 63 03
			15 00 00 00 01 00 02 64 73
			15 00 00 00 01 00 02 65 03
			15 00 00 00 01 00 02 66 82
			15 00 00 00 01 00 02 67 03
			15 00 00 00 01 00 02 68 93
			15 00 00 00 01 00 02 69 03
			15 00 00 00 01 00 02 6A A7
			15 00 00 00 01 00 02 6B 03
			15 00 00 00 01 00 02 6C B8
			15 00 00 00 01 00 02 6D 03
			15 00 00 00 01 00 02 6E C3
			15 00 00 00 01 00 02 6F 03
			15 00 00 00 01 00 02 70 FE

			15 00 00 00 01 00 02 71 01
			15 00 00 00 01 00 02 72 82
			15 00 00 00 01 00 02 73 01
			15 00 00 00 01 00 02 74 85
			15 00 00 00 01 00 02 75 01
			15 00 00 00 01 00 02 76 8C
			15 00 00 00 01 00 02 77 01
			15 00 00 00 01 00 02 78 92
			15 00 00 00 01 00 02 79 01
			15 00 00 00 01 00 02 7A 98
			15 00 00 00 01 00 02 7B 01
			15 00 00 00 01 00 02 7C 9E
			15 00 00 00 01 00 02 7D 01
			15 00 00 00 01 00 02 7E A3
			15 00 00 00 01 00 02 7F 01
			15 00 00 00 01 00 02 80 A9
			15 00 00 00 01 00 02 81 01
			15 00 00 00 01 00 02 82 AE
			15 00 00 00 01 00 02 83 01
			15 00 00 00 01 00 02 84 C2
			15 00 00 00 01 00 02 85 01
			15 00 00 00 01 00 02 86 D4
			15 00 00 00 01 00 02 87 01
			15 00 00 00 01 00 02 88 F3
			15 00 00 00 01 00 02 89 02
			15 00 00 00 01 00 02 8A 0F
			15 00 00 00 01 00 02 8B 02
			15 00 00 00 01 00 02 8C 3F
			15 00 00 00 01 00 02 8D 02
			15 00 00 00 01 00 02 8E 6D
			15 00 00 00 01 00 02 8F 02
			15 00 00 00 01 00 02 90 6E
			15 00 00 00 01 00 02 91 02
			15 00 00 00 01 00 02 92 9C
			15 00 00 00 01 00 02 93 02
			15 00 00 00 01 00 02 94 CF
			15 00 00 00 01 00 02 95 02
			15 00 00 00 01 00 02 96 ED
			15 00 00 00 01 00 02 97 03
			15 00 00 00 01 00 02 98 22
			15 00 00 00 01 00 02 99 03
			15 00 00 00 01 00 02 9A 3F
			15 00 00 00 01 00 02 9B 03
			15 00 00 00 01 00 02 9C 62
			15 00 00 00 01 00 02 9D 03
			15 00 00 00 01 00 02 9E 6C
			15 00 00 00 01 00 02 9F 03
			15 00 00 00 01 00 02 A0 77
			15 00 00 00 01 00 02 A2 03
			15 00 00 00 01 00 02 A3 83
			15 00 00 00 01 00 02 A4 03
			15 00 00 00 01 00 02 A5 91
			15 00 00 00 01 00 02 A6 03
			15 00 00 00 01 00 02 A7 9F
			15 00 00 00 01 00 02 A9 03
			15 00 00 00 01 00 02 AA AE
			15 00 00 00 01 00 02 AB 03
			15 00 00 00 01 00 02 AC B7
			15 00 00 00 01 00 02 AD 03
			15 00 00 00 01 00 02 AE FE

			15 00 00 00 01 00 02 AF 01
			15 00 00 00 01 00 02 B0 82
			15 00 00 00 01 00 02 B1 01
			15 00 00 00 01 00 02 B2 85
			15 00 00 00 01 00 02 B3 01
			15 00 00 00 01 00 02 B4 8C
			15 00 00 00 01 00 02 B5 01
			15 00 00 00 01 00 02 B6 92
			15 00 00 00 01 00 02 B7 01
			15 00 00 00 01 00 02 B8 98
			15 00 00 00 01 00 02 B9 01
			15 00 00 00 01 00 02 BA 9E
			15 00 00 00 01 00 02 BB 01
			15 00 00 00 01 00 02 BC A3
			15 00 00 00 01 00 02 BD 01
			15 00 00 00 01 00 02 BE A9
			15 00 00 00 01 00 02 BF 01
			15 00 00 00 01 00 02 C0 AE
			15 00 00 00 01 00 02 C1 01
			15 00 00 00 01 00 02 C2 C2
			15 00 00 00 01 00 02 C3 01
			15 00 00 00 01 00 02 C4 D4
			15 00 00 00 01 00 02 C5 01
			15 00 00 00 01 00 02 C6 F3
			15 00 00 00 01 00 02 C7 02
			15 00 00 00 01 00 02 C8 0F
			15 00 00 00 01 00 02 C9 02
			15 00 00 00 01 00 02 CA 3F
			15 00 00 00 01 00 02 CB 02
			15 00 00 00 01 00 02 CC 6D
			15 00 00 00 01 00 02 CD 02
			15 00 00 00 01 00 02 CE 6E
			15 00 00 00 01 00 02 CF 02
			15 00 00 00 01 00 02 D0 9C
			15 00 00 00 01 00 02 D1 02
			15 00 00 00 01 00 02 D2 CF
			15 00 00 00 01 00 02 D3 02
			15 00 00 00 01 00 02 D4 ED
			15 00 00 00 01 00 02 D5 03
			15 00 00 00 01 00 02 D6 22
			15 00 00 00 01 00 02 D7 03
			15 00 00 00 01 00 02 D8 3F
			15 00 00 00 01 00 02 D9 03
			15 00 00 00 01 00 02 DA 62
			15 00 00 00 01 00 02 DB 03
			15 00 00 00 01 00 02 DC 6C
			15 00 00 00 01 00 02 DD 03
			15 00 00 00 01 00 02 DE 77
			15 00 00 00 01 00 02 DF 03
			15 00 00 00 01 00 02 E0 83
			15 00 00 00 01 00 02 E1 03
			15 00 00 00 01 00 02 E2 91
			15 00 00 00 01 00 02 E3 03
			15 00 00 00 01 00 02 E4 9F
			15 00 00 00 01 00 02 E5 03
			15 00 00 00 01 00 02 E6 AE
			15 00 00 00 01 00 02 E7 03
			15 00 00 00 01 00 02 E8 B7
			15 00 00 00 01 00 02 E9 03
			15 00 00 00 01 00 02 EA FE

			15 00 00 00 01 00 02 FB 01
			15 01 00 00 01 00 02 FF 10
			];
		qcom,mdss-dsi-dispparam-papermode2-state = "dsi_hs_mode";
		qcom,mdss-dsi-dispparam-papermode3-command = [
			15 01 00 00 78 00 02 FF 20
			15 00 00 00 01 00 02 FB 01

			15 00 00 00 01 00 02 75 00
			15 00 00 00 01 00 02 76 C8
			15 00 00 00 01 00 02 77 00
			15 00 00 00 01 00 02 78 D3
			15 00 00 00 01 00 02 79 00
			15 00 00 00 01 00 02 7A E7
			15 00 00 00 01 00 02 7B 00
			15 00 00 00 01 00 02 7C F8
			15 00 00 00 01 00 02 7D 01
			15 00 00 00 01 00 02 7E 08
			15 00 00 00 01 00 02 7F 01
			15 00 00 00 01 00 02 80 17
			15 00 00 00 01 00 02 81 01
			15 00 00 00 01 00 02 82 24
			15 00 00 00 01 00 02 83 01
			15 00 00 00 01 00 02 84 30
			15 00 00 00 01 00 02 85 01
			15 00 00 00 01 00 02 86 3C
			15 00 00 00 01 00 02 87 01
			15 00 00 00 01 00 02 88 64
			15 00 00 00 01 00 02 89 01
			15 00 00 00 01 00 02 8A 84
			15 00 00 00 01 00 02 8B 01
			15 00 00 00 01 00 02 8C B8
			15 00 00 00 01 00 02 8D 01
			15 00 00 00 01 00 02 8E E0
			15 00 00 00 01 00 02 8F 02
			15 00 00 00 01 00 02 90 1F
			15 00 00 00 01 00 02 91 02
			15 00 00 00 01 00 02 92 54
			15 00 00 00 01 00 02 93 02
			15 00 00 00 01 00 02 94 56
			15 00 00 00 01 00 02 95 02
			15 00 00 00 01 00 02 96 8A
			15 00 00 00 01 00 02 97 02
			15 00 00 00 01 00 02 98 C1
			15 00 00 00 01 00 02 99 02
			15 00 00 00 01 00 02 9A E1
			15 00 00 00 01 00 02 9B 03
			15 00 00 00 01 00 02 9C 0A
			15 00 00 00 01 00 02 9D 03
			15 00 00 00 01 00 02 9E 33
			15 00 00 00 01 00 02 9F 03
			15 00 00 00 01 00 02 A0 58
			15 00 00 00 01 00 02 A2 03
			15 00 00 00 01 00 02 A3 63
			15 00 00 00 01 00 02 A4 03
			15 00 00 00 01 00 02 A5 6F
			15 00 00 00 01 00 02 A6 03
			15 00 00 00 01 00 02 A7 7C
			15 00 00 00 01 00 02 A9 03
			15 00 00 00 01 00 02 AA 8A
			15 00 00 00 01 00 02 AB 03
			15 00 00 00 01 00 02 AC 9A
			15 00 00 00 01 00 02 AD 03
			15 00 00 00 01 00 02 AE AB
			15 00 00 00 01 00 02 AF 03
			15 00 00 00 01 00 02 B0 B6
			15 00 00 00 01 00 02 B1 03
			15 00 00 00 01 00 02 B2 FE

			15 00 00 00 01 00 02 B3 00
			15 00 00 00 01 00 02 B4 C8
			15 00 00 00 01 00 02 B5 00
			15 00 00 00 01 00 02 B6 D3
			15 00 00 00 01 00 02 B7 00
			15 00 00 00 01 00 02 B8 E7
			15 00 00 00 01 00 02 B9 00
			15 00 00 00 01 00 02 BA F8
			15 00 00 00 01 00 02 BB 01
			15 00 00 00 01 00 02 BC 08
			15 00 00 00 01 00 02 BD 01
			15 00 00 00 01 00 02 BE 17
			15 00 00 00 01 00 02 BF 01
			15 00 00 00 01 00 02 C0 24
			15 00 00 00 01 00 02 C1 01
			15 00 00 00 01 00 02 C2 30
			15 00 00 00 01 00 02 C3 01
			15 00 00 00 01 00 02 C4 3C
			15 00 00 00 01 00 02 C5 01
			15 00 00 00 01 00 02 C6 64
			15 00 00 00 01 00 02 C7 01
			15 00 00 00 01 00 02 C8 84
			15 00 00 00 01 00 02 C9 01
			15 00 00 00 01 00 02 CA B8
			15 00 00 00 01 00 02 CB 01
			15 00 00 00 01 00 02 CC E0
			15 00 00 00 01 00 02 CD 02
			15 00 00 00 01 00 02 CE 1F
			15 00 00 00 01 00 02 CF 02
			15 00 00 00 01 00 02 D0 54
			15 00 00 00 01 00 02 D1 02
			15 00 00 00 01 00 02 D2 56
			15 00 00 00 01 00 02 D3 02
			15 00 00 00 01 00 02 D4 8A
			15 00 00 00 01 00 02 D5 02
			15 00 00 00 01 00 02 D6 C1
			15 00 00 00 01 00 02 D7 02
			15 00 00 00 01 00 02 D8 E1
			15 00 00 00 01 00 02 D9 03
			15 00 00 00 01 00 02 DA 0A
			15 00 00 00 01 00 02 DB 03
			15 00 00 00 01 00 02 DC 33
			15 00 00 00 01 00 02 DD 03
			15 00 00 00 01 00 02 DE 58
			15 00 00 00 01 00 02 DF 03
			15 00 00 00 01 00 02 E0 63
			15 00 00 00 01 00 02 E1 03
			15 00 00 00 01 00 02 E2 6F
			15 00 00 00 01 00 02 E3 03
			15 00 00 00 01 00 02 E4 7C
			15 00 00 00 01 00 02 E5 03
			15 00 00 00 01 00 02 E6 8A
			15 00 00 00 01 00 02 E7 03
			15 00 00 00 01 00 02 E8 9A
			15 00 00 00 01 00 02 E9 03
			15 00 00 00 01 00 02 EA AB
			15 00 00 00 01 00 02 EB 03
			15 00 00 00 01 00 02 EC B6
			15 00 00 00 01 00 02 ED 03
			15 00 00 00 01 00 02 EE FE

			15 00 00 00 01 00 02 EF 00
			15 00 00 00 01 00 02 F0 C8
			15 00 00 00 01 00 02 F1 00
			15 00 00 00 01 00 02 F2 D3
			15 00 00 00 01 00 02 F3 00
			15 00 00 00 01 00 02 F4 E8
			15 00 00 00 01 00 02 F5 00
			15 00 00 00 01 00 02 F6 FA
			15 00 00 00 01 00 02 F7 01
			15 00 00 00 01 00 02 F8 0B
			15 00 00 00 01 00 02 F9 01
			15 00 00 00 01 00 02 FA 19

			15 00 00 00 01 00 02 FF 21
			15 00 00 00 01 00 02 FB 01

			15 00 00 00 01 00 02 00 01
			15 00 00 00 01 00 02 01 27
			15 00 00 00 01 00 02 02 01
			15 00 00 00 01 00 02 03 34
			15 00 00 00 01 00 02 04 01
			15 00 00 00 01 00 02 05 3F
			15 00 00 00 01 00 02 06 01
			15 00 00 00 01 00 02 07 67
			15 00 00 00 01 00 02 08 01
			15 00 00 00 01 00 02 09 88
			15 00 00 00 01 00 02 0A 01
			15 00 00 00 01 00 02 0B BB
			15 00 00 00 01 00 02 0C 01
			15 00 00 00 01 00 02 0D E3
			15 00 00 00 01 00 02 0E 02
			15 00 00 00 01 00 02 0F 22
			15 00 00 00 01 00 02 10 02
			15 00 00 00 01 00 02 11 57
			15 00 00 00 01 00 02 12 02
			15 00 00 00 01 00 02 13 59
			15 00 00 00 01 00 02 14 02
			15 00 00 00 01 00 02 15 8C
			15 00 00 00 01 00 02 16 02
			15 00 00 00 01 00 02 17 C3
			15 00 00 00 01 00 02 18 02
			15 00 00 00 01 00 02 19 E2
			15 00 00 00 01 00 02 1A 03
			15 00 00 00 01 00 02 1B 0C
			15 00 00 00 01 00 02 1C 03
			15 00 00 00 01 00 02 1D 35
			15 00 00 00 01 00 02 1E 03
			15 00 00 00 01 00 02 1F 5B
			15 00 00 00 01 00 02 20 03
			15 00 00 00 01 00 02 21 67
			15 00 00 00 01 00 02 22 03
			15 00 00 00 01 00 02 23 73
			15 00 00 00 01 00 02 24 03
			15 00 00 00 01 00 02 25 82
			15 00 00 00 01 00 02 26 03
			15 00 00 00 01 00 02 27 93
			15 00 00 00 01 00 02 28 03
			15 00 00 00 01 00 02 29 A7
			15 00 00 00 01 00 02 2A 03
			15 00 00 00 01 00 02 2B B8
			15 00 00 00 01 00 02 2D 03
			15 00 00 00 01 00 02 2F C3
			15 00 00 00 01 00 02 30 03
			15 00 00 00 01 00 02 31 FE

			15 00 00 00 01 00 02 32 00
			15 00 00 00 01 00 02 33 C8
			15 00 00 00 01 00 02 34 00
			15 00 00 00 01 00 02 35 D3
			15 00 00 00 01 00 02 36 00
			15 00 00 00 01 00 02 37 E8
			15 00 00 00 01 00 02 38 00
			15 00 00 00 01 00 02 39 FA
			15 00 00 00 01 00 02 3A 01
			15 00 00 00 01 00 02 3B 0B
			15 00 00 00 01 00 02 3D 01
			15 00 00 00 01 00 02 3F 19
			15 00 00 00 01 00 02 40 01
			15 00 00 00 01 00 02 41 27
			15 00 00 00 01 00 02 42 01
			15 00 00 00 01 00 02 43 34
			15 00 00 00 01 00 02 44 01
			15 00 00 00 01 00 02 45 3F
			15 00 00 00 01 00 02 46 01
			15 00 00 00 01 00 02 47 67
			15 00 00 00 01 00 02 48 01
			15 00 00 00 01 00 02 49 88
			15 00 00 00 01 00 02 4A 01
			15 00 00 00 01 00 02 4B BB
			15 00 00 00 01 00 02 4C 01
			15 00 00 00 01 00 02 4D E3
			15 00 00 00 01 00 02 4E 02
			15 00 00 00 01 00 02 4F 22
			15 00 00 00 01 00 02 50 02
			15 00 00 00 01 00 02 51 57
			15 00 00 00 01 00 02 52 02
			15 00 00 00 01 00 02 53 59
			15 00 00 00 01 00 02 54 02
			15 00 00 00 01 00 02 55 8C
			15 00 00 00 01 00 02 56 02
			15 00 00 00 01 00 02 58 C3
			15 00 00 00 01 00 02 59 02
			15 00 00 00 01 00 02 5A E2
			15 00 00 00 01 00 02 5B 03
			15 00 00 00 01 00 02 5C 0C
			15 00 00 00 01 00 02 5D 03
			15 00 00 00 01 00 02 5E 35
			15 00 00 00 01 00 02 5F 03
			15 00 00 00 01 00 02 60 5B
			15 00 00 00 01 00 02 61 03
			15 00 00 00 01 00 02 62 67
			15 00 00 00 01 00 02 63 03
			15 00 00 00 01 00 02 64 73
			15 00 00 00 01 00 02 65 03
			15 00 00 00 01 00 02 66 82
			15 00 00 00 01 00 02 67 03
			15 00 00 00 01 00 02 68 93
			15 00 00 00 01 00 02 69 03
			15 00 00 00 01 00 02 6A A7
			15 00 00 00 01 00 02 6B 03
			15 00 00 00 01 00 02 6C B8
			15 00 00 00 01 00 02 6D 03
			15 00 00 00 01 00 02 6E C3
			15 00 00 00 01 00 02 6F 03
			15 00 00 00 01 00 02 70 FE

			15 00 00 00 01 00 02 71 01
			15 00 00 00 01 00 02 72 B2
			15 00 00 00 01 00 02 73 01
			15 00 00 00 01 00 02 74 B4
			15 00 00 00 01 00 02 75 01
			15 00 00 00 01 00 02 76 B9
			15 00 00 00 01 00 02 77 01
			15 00 00 00 01 00 02 78 BE
			15 00 00 00 01 00 02 79 01
			15 00 00 00 01 00 02 7A C2
			15 00 00 00 01 00 02 7B 01
			15 00 00 00 01 00 02 7C C6
			15 00 00 00 01 00 02 7D 01
			15 00 00 00 01 00 02 7E CB
			15 00 00 00 01 00 02 7F 01
			15 00 00 00 01 00 02 80 CF
			15 00 00 00 01 00 02 81 01
			15 00 00 00 01 00 02 82 D3
			15 00 00 00 01 00 02 83 01
			15 00 00 00 01 00 02 84 E2
			15 00 00 00 01 00 02 85 01
			15 00 00 00 01 00 02 86 F0
			15 00 00 00 01 00 02 87 02
			15 00 00 00 01 00 02 88 0B
			15 00 00 00 01 00 02 89 02
			15 00 00 00 01 00 02 8A 22
			15 00 00 00 01 00 02 8B 02
			15 00 00 00 01 00 02 8C 4E
			15 00 00 00 01 00 02 8D 02
			15 00 00 00 01 00 02 8E 79
			15 00 00 00 01 00 02 8F 02
			15 00 00 00 01 00 02 90 7A
			15 00 00 00 01 00 02 91 02
			15 00 00 00 01 00 02 92 A6
			15 00 00 00 01 00 02 93 02
			15 00 00 00 01 00 02 94 D6
			15 00 00 00 01 00 02 95 02
			15 00 00 00 01 00 02 96 F4
			15 00 00 00 01 00 02 97 03
			15 00 00 00 01 00 02 98 29
			15 00 00 00 01 00 02 99 03
			15 00 00 00 01 00 02 9A 45
			15 00 00 00 01 00 02 9B 03
			15 00 00 00 01 00 02 9C 67
			15 00 00 00 01 00 02 9D 03
			15 00 00 00 01 00 02 9E 71
			15 00 00 00 01 00 02 9F 03
			15 00 00 00 01 00 02 A0 7B
			15 00 00 00 01 00 02 A2 03
			15 00 00 00 01 00 02 A3 87
			15 00 00 00 01 00 02 A4 03
			15 00 00 00 01 00 02 A5 94
			15 00 00 00 01 00 02 A6 03
			15 00 00 00 01 00 02 A7 A2
			15 00 00 00 01 00 02 A9 03
			15 00 00 00 01 00 02 AA AF
			15 00 00 00 01 00 02 AB 03
			15 00 00 00 01 00 02 AC B7
			15 00 00 00 01 00 02 AD 03
			15 00 00 00 01 00 02 AE FE

			15 00 00 00 01 00 02 AF 01
			15 00 00 00 01 00 02 B0 B2
			15 00 00 00 01 00 02 B1 01
			15 00 00 00 01 00 02 B2 B4
			15 00 00 00 01 00 02 B3 01
			15 00 00 00 01 00 02 B4 B9
			15 00 00 00 01 00 02 B5 01
			15 00 00 00 01 00 02 B6 BE
			15 00 00 00 01 00 02 B7 01
			15 00 00 00 01 00 02 B8 C2
			15 00 00 00 01 00 02 B9 01
			15 00 00 00 01 00 02 BA C6
			15 00 00 00 01 00 02 BB 01
			15 00 00 00 01 00 02 BC CB
			15 00 00 00 01 00 02 BD 01
			15 00 00 00 01 00 02 BE CF
			15 00 00 00 01 00 02 BF 01
			15 00 00 00 01 00 02 C0 D3
			15 00 00 00 01 00 02 C1 01
			15 00 00 00 01 00 02 C2 E2
			15 00 00 00 01 00 02 C3 01
			15 00 00 00 01 00 02 C4 F0
			15 00 00 00 01 00 02 C5 02
			15 00 00 00 01 00 02 C6 0B
			15 00 00 00 01 00 02 C7 02
			15 00 00 00 01 00 02 C8 22
			15 00 00 00 01 00 02 C9 02
			15 00 00 00 01 00 02 CA 4E
			15 00 00 00 01 00 02 CB 02
			15 00 00 00 01 00 02 CC 79
			15 00 00 00 01 00 02 CD 02
			15 00 00 00 01 00 02 CE 7A
			15 00 00 00 01 00 02 CF 02
			15 00 00 00 01 00 02 D0 A6
			15 00 00 00 01 00 02 D1 02
			15 00 00 00 01 00 02 D2 D6
			15 00 00 00 01 00 02 D3 02
			15 00 00 00 01 00 02 D4 F4
			15 00 00 00 01 00 02 D5 03
			15 00 00 00 01 00 02 D6 29
			15 00 00 00 01 00 02 D7 03
			15 00 00 00 01 00 02 D8 45
			15 00 00 00 01 00 02 D9 03
			15 00 00 00 01 00 02 DA 67
			15 00 00 00 01 00 02 DB 03
			15 00 00 00 01 00 02 DC 71
			15 00 00 00 01 00 02 DD 03
			15 00 00 00 01 00 02 DE 7B
			15 00 00 00 01 00 02 DF 03
			15 00 00 00 01 00 02 E0 87
			15 00 00 00 01 00 02 E1 03
			15 00 00 00 01 00 02 E2 94
			15 00 00 00 01 00 02 E3 03
			15 00 00 00 01 00 02 E4 A2
			15 00 00 00 01 00 02 E5 03
			15 00 00 00 01 00 02 E6 AF
			15 00 00 00 01 00 02 E7 03
			15 00 00 00 01 00 02 E8 B7
			15 00 00 00 01 00 02 E9 03
			15 00 00 00 01 00 02 EA FE

			15 00 00 00 01 00 02 FB 01
			15 01 00 00 01 00 02 FF 10
			];
		qcom,mdss-dsi-dispparam-papermode3-state = "dsi_hs_mode";
		qcom,mdss-dsi-dispparam-papermode4-command = [
			15 01 00 00 78 00 02 FF 20
			15 00 00 00 01 00 02 FB 01

			15 00 00 00 01 00 02 75 00
			15 00 00 00 01 00 02 76 C8
			15 00 00 00 01 00 02 77 00
			15 00 00 00 01 00 02 78 D3
			15 00 00 00 01 00 02 79 00
			15 00 00 00 01 00 02 7A E7
			15 00 00 00 01 00 02 7B 00
			15 00 00 00 01 00 02 7C F8
			15 00 00 00 01 00 02 7D 01
			15 00 00 00 01 00 02 7E 08
			15 00 00 00 01 00 02 7F 01
			15 00 00 00 01 00 02 80 17
			15 00 00 00 01 00 02 81 01
			15 00 00 00 01 00 02 82 24
			15 00 00 00 01 00 02 83 01
			15 00 00 00 01 00 02 84 30
			15 00 00 00 01 00 02 85 01
			15 00 00 00 01 00 02 86 3C
			15 00 00 00 01 00 02 87 01
			15 00 00 00 01 00 02 88 64
			15 00 00 00 01 00 02 89 01
			15 00 00 00 01 00 02 8A 84
			15 00 00 00 01 00 02 8B 01
			15 00 00 00 01 00 02 8C B8
			15 00 00 00 01 00 02 8D 01
			15 00 00 00 01 00 02 8E E0
			15 00 00 00 01 00 02 8F 02
			15 00 00 00 01 00 02 90 1F
			15 00 00 00 01 00 02 91 02
			15 00 00 00 01 00 02 92 54
			15 00 00 00 01 00 02 93 02
			15 00 00 00 01 00 02 94 56
			15 00 00 00 01 00 02 95 02
			15 00 00 00 01 00 02 96 8A
			15 00 00 00 01 00 02 97 02
			15 00 00 00 01 00 02 98 C1
			15 00 00 00 01 00 02 99 02
			15 00 00 00 01 00 02 9A E1
			15 00 00 00 01 00 02 9B 03
			15 00 00 00 01 00 02 9C 0A
			15 00 00 00 01 00 02 9D 03
			15 00 00 00 01 00 02 9E 33
			15 00 00 00 01 00 02 9F 03
			15 00 00 00 01 00 02 A0 58
			15 00 00 00 01 00 02 A2 03
			15 00 00 00 01 00 02 A3 63
			15 00 00 00 01 00 02 A4 03
			15 00 00 00 01 00 02 A5 6F
			15 00 00 00 01 00 02 A6 03
			15 00 00 00 01 00 02 A7 7C
			15 00 00 00 01 00 02 A9 03
			15 00 00 00 01 00 02 AA 8A
			15 00 00 00 01 00 02 AB 03
			15 00 00 00 01 00 02 AC 9A
			15 00 00 00 01 00 02 AD 03
			15 00 00 00 01 00 02 AE AB
			15 00 00 00 01 00 02 AF 03
			15 00 00 00 01 00 02 B0 B6
			15 00 00 00 01 00 02 B1 03
			15 00 00 00 01 00 02 B2 FE

			15 00 00 00 01 00 02 B3 00
			15 00 00 00 01 00 02 B4 C8
			15 00 00 00 01 00 02 B5 00
			15 00 00 00 01 00 02 B6 D3
			15 00 00 00 01 00 02 B7 00
			15 00 00 00 01 00 02 B8 E7
			15 00 00 00 01 00 02 B9 00
			15 00 00 00 01 00 02 BA F8
			15 00 00 00 01 00 02 BB 01
			15 00 00 00 01 00 02 BC 08
			15 00 00 00 01 00 02 BD 01
			15 00 00 00 01 00 02 BE 17
			15 00 00 00 01 00 02 BF 01
			15 00 00 00 01 00 02 C0 24
			15 00 00 00 01 00 02 C1 01
			15 00 00 00 01 00 02 C2 30
			15 00 00 00 01 00 02 C3 01
			15 00 00 00 01 00 02 C4 3C
			15 00 00 00 01 00 02 C5 01
			15 00 00 00 01 00 02 C6 64
			15 00 00 00 01 00 02 C7 01
			15 00 00 00 01 00 02 C8 84
			15 00 00 00 01 00 02 C9 01
			15 00 00 00 01 00 02 CA B8
			15 00 00 00 01 00 02 CB 01
			15 00 00 00 01 00 02 CC E0
			15 00 00 00 01 00 02 CD 02
			15 00 00 00 01 00 02 CE 1F
			15 00 00 00 01 00 02 CF 02
			15 00 00 00 01 00 02 D0 54
			15 00 00 00 01 00 02 D1 02
			15 00 00 00 01 00 02 D2 56
			15 00 00 00 01 00 02 D3 02
			15 00 00 00 01 00 02 D4 8A
			15 00 00 00 01 00 02 D5 02
			15 00 00 00 01 00 02 D6 C1
			15 00 00 00 01 00 02 D7 02
			15 00 00 00 01 00 02 D8 E1
			15 00 00 00 01 00 02 D9 03
			15 00 00 00 01 00 02 DA 0A
			15 00 00 00 01 00 02 DB 03
			15 00 00 00 01 00 02 DC 33
			15 00 00 00 01 00 02 DD 03
			15 00 00 00 01 00 02 DE 58
			15 00 00 00 01 00 02 DF 03
			15 00 00 00 01 00 02 E0 63
			15 00 00 00 01 00 02 E1 03
			15 00 00 00 01 00 02 E2 6F
			15 00 00 00 01 00 02 E3 03
			15 00 00 00 01 00 02 E4 7C
			15 00 00 00 01 00 02 E5 03
			15 00 00 00 01 00 02 E6 8A
			15 00 00 00 01 00 02 E7 03
			15 00 00 00 01 00 02 E8 9A
			15 00 00 00 01 00 02 E9 03
			15 00 00 00 01 00 02 EA AB
			15 00 00 00 01 00 02 EB 03
			15 00 00 00 01 00 02 EC B6
			15 00 00 00 01 00 02 ED 03
			15 00 00 00 01 00 02 EE FE

			15 00 00 00 01 00 02 EF 00
			15 00 00 00 01 00 02 F0 C8
			15 00 00 00 01 00 02 F1 00
			15 00 00 00 01 00 02 F2 D3
			15 00 00 00 01 00 02 F3 00
			15 00 00 00 01 00 02 F4 E8
			15 00 00 00 01 00 02 F5 00
			15 00 00 00 01 00 02 F6 FA
			15 00 00 00 01 00 02 F7 01
			15 00 00 00 01 00 02 F8 0B
			15 00 00 00 01 00 02 F9 01
			15 00 00 00 01 00 02 FA 19

			15 00 00 00 01 00 02 FF 21
			15 00 00 00 01 00 02 FB 01

			15 00 00 00 01 00 02 00 01
			15 00 00 00 01 00 02 01 27
			15 00 00 00 01 00 02 02 01
			15 00 00 00 01 00 02 03 34
			15 00 00 00 01 00 02 04 01
			15 00 00 00 01 00 02 05 3F
			15 00 00 00 01 00 02 06 01
			15 00 00 00 01 00 02 07 67
			15 00 00 00 01 00 02 08 01
			15 00 00 00 01 00 02 09 88
			15 00 00 00 01 00 02 0A 01
			15 00 00 00 01 00 02 0B BB
			15 00 00 00 01 00 02 0C 01
			15 00 00 00 01 00 02 0D E3
			15 00 00 00 01 00 02 0E 02
			15 00 00 00 01 00 02 0F 22
			15 00 00 00 01 00 02 10 02
			15 00 00 00 01 00 02 11 57
			15 00 00 00 01 00 02 12 02
			15 00 00 00 01 00 02 13 59
			15 00 00 00 01 00 02 14 02
			15 00 00 00 01 00 02 15 8C
			15 00 00 00 01 00 02 16 02
			15 00 00 00 01 00 02 17 C3
			15 00 00 00 01 00 02 18 02
			15 00 00 00 01 00 02 19 E2
			15 00 00 00 01 00 02 1A 03
			15 00 00 00 01 00 02 1B 0C
			15 00 00 00 01 00 02 1C 03
			15 00 00 00 01 00 02 1D 35
			15 00 00 00 01 00 02 1E 03
			15 00 00 00 01 00 02 1F 5B
			15 00 00 00 01 00 02 20 03
			15 00 00 00 01 00 02 21 67
			15 00 00 00 01 00 02 22 03
			15 00 00 00 01 00 02 23 73
			15 00 00 00 01 00 02 24 03
			15 00 00 00 01 00 02 25 82
			15 00 00 00 01 00 02 26 03
			15 00 00 00 01 00 02 27 93
			15 00 00 00 01 00 02 28 03
			15 00 00 00 01 00 02 29 A7
			15 00 00 00 01 00 02 2A 03
			15 00 00 00 01 00 02 2B B8
			15 00 00 00 01 00 02 2D 03
			15 00 00 00 01 00 02 2F C3
			15 00 00 00 01 00 02 30 03
			15 00 00 00 01 00 02 31 FE

			15 00 00 00 01 00 02 32 00
			15 00 00 00 01 00 02 33 C8
			15 00 00 00 01 00 02 34 00
			15 00 00 00 01 00 02 35 D3
			15 00 00 00 01 00 02 36 00
			15 00 00 00 01 00 02 37 E8
			15 00 00 00 01 00 02 38 00
			15 00 00 00 01 00 02 39 FA
			15 00 00 00 01 00 02 3A 01
			15 00 00 00 01 00 02 3B 0B
			15 00 00 00 01 00 02 3D 01
			15 00 00 00 01 00 02 3F 19
			15 00 00 00 01 00 02 40 01
			15 00 00 00 01 00 02 41 27
			15 00 00 00 01 00 02 42 01
			15 00 00 00 01 00 02 43 34
			15 00 00 00 01 00 02 44 01
			15 00 00 00 01 00 02 45 3F
			15 00 00 00 01 00 02 46 01
			15 00 00 00 01 00 02 47 67
			15 00 00 00 01 00 02 48 01
			15 00 00 00 01 00 02 49 88
			15 00 00 00 01 00 02 4A 01
			15 00 00 00 01 00 02 4B BB
			15 00 00 00 01 00 02 4C 01
			15 00 00 00 01 00 02 4D E3
			15 00 00 00 01 00 02 4E 02
			15 00 00 00 01 00 02 4F 22
			15 00 00 00 01 00 02 50 02
			15 00 00 00 01 00 02 51 57
			15 00 00 00 01 00 02 52 02
			15 00 00 00 01 00 02 53 59
			15 00 00 00 01 00 02 54 02
			15 00 00 00 01 00 02 55 8C
			15 00 00 00 01 00 02 56 02
			15 00 00 00 01 00 02 58 C3
			15 00 00 00 01 00 02 59 02
			15 00 00 00 01 00 02 5A E2
			15 00 00 00 01 00 02 5B 03
			15 00 00 00 01 00 02 5C 0C
			15 00 00 00 01 00 02 5D 03
			15 00 00 00 01 00 02 5E 35
			15 00 00 00 01 00 02 5F 03
			15 00 00 00 01 00 02 60 5B
			15 00 00 00 01 00 02 61 03
			15 00 00 00 01 00 02 62 67
			15 00 00 00 01 00 02 63 03
			15 00 00 00 01 00 02 64 73
			15 00 00 00 01 00 02 65 03
			15 00 00 00 01 00 02 66 82
			15 00 00 00 01 00 02 67 03
			15 00 00 00 01 00 02 68 93
			15 00 00 00 01 00 02 69 03
			15 00 00 00 01 00 02 6A A7
			15 00 00 00 01 00 02 6B 03
			15 00 00 00 01 00 02 6C B8
			15 00 00 00 01 00 02 6D 03
			15 00 00 00 01 00 02 6E C3
			15 00 00 00 01 00 02 6F 03
			15 00 00 00 01 00 02 70 FE

			15 00 00 00 01 00 02 71 01
			15 00 00 00 01 00 02 72 D2
			15 00 00 00 01 00 02 73 01
			15 00 00 00 01 00 02 74 D4
			15 00 00 00 01 00 02 75 01
			15 00 00 00 01 00 02 76 D8
			15 00 00 00 01 00 02 77 01
			15 00 00 00 01 00 02 78 DB
			15 00 00 00 01 00 02 79 01
			15 00 00 00 01 00 02 7A DF
			15 00 00 00 01 00 02 7B 01
			15 00 00 00 01 00 02 7C E2
			15 00 00 00 01 00 02 7D 01
			15 00 00 00 01 00 02 7E E6
			15 00 00 00 01 00 02 7F 01
			15 00 00 00 01 00 02 80 E9
			15 00 00 00 01 00 02 81 01
			15 00 00 00 01 00 02 82 EC
			15 00 00 00 01 00 02 83 01
			15 00 00 00 01 00 02 84 F9
			15 00 00 00 01 00 02 85 02
			15 00 00 00 01 00 02 86 06
			15 00 00 00 01 00 02 87 02
			15 00 00 00 01 00 02 88 1C
			15 00 00 00 01 00 02 89 02
			15 00 00 00 01 00 02 8A 32
			15 00 00 00 01 00 02 8B 02
			15 00 00 00 01 00 02 8C 5A
			15 00 00 00 01 00 02 8D 02
			15 00 00 00 01 00 02 8E 82
			15 00 00 00 01 00 02 8F 02
			15 00 00 00 01 00 02 90 84
			15 00 00 00 01 00 02 91 02
			15 00 00 00 01 00 02 92 AD
			15 00 00 00 01 00 02 93 02
			15 00 00 00 01 00 02 94 DD
			15 00 00 00 01 00 02 95 02
			15 00 00 00 01 00 02 96 FA
			15 00 00 00 01 00 02 97 03
			15 00 00 00 01 00 02 98 2F
			15 00 00 00 01 00 02 99 03
			15 00 00 00 01 00 02 9A 4A
			15 00 00 00 01 00 02 9B 03
			15 00 00 00 01 00 02 9C 6B
			15 00 00 00 01 00 02 9D 03
			15 00 00 00 01 00 02 9E 75
			15 00 00 00 01 00 02 9F 03
			15 00 00 00 01 00 02 A0 7F
			15 00 00 00 01 00 02 A2 03
			15 00 00 00 01 00 02 A3 8A
			15 00 00 00 01 00 02 A4 03
			15 00 00 00 01 00 02 A5 97
			15 00 00 00 01 00 02 A6 03
			15 00 00 00 01 00 02 A7 A4
			15 00 00 00 01 00 02 A9 03
			15 00 00 00 01 00 02 AA B0
			15 00 00 00 01 00 02 AB 03
			15 00 00 00 01 00 02 AC B7
			15 00 00 00 01 00 02 AD 03
			15 00 00 00 01 00 02 AE FE

			15 00 00 00 01 00 02 AF 01
			15 00 00 00 01 00 02 B0 D2
			15 00 00 00 01 00 02 B1 01
			15 00 00 00 01 00 02 B2 D4
			15 00 00 00 01 00 02 B3 01
			15 00 00 00 01 00 02 B4 D8
			15 00 00 00 01 00 02 B5 01
			15 00 00 00 01 00 02 B6 DB
			15 00 00 00 01 00 02 B7 01
			15 00 00 00 01 00 02 B8 DF
			15 00 00 00 01 00 02 B9 01
			15 00 00 00 01 00 02 BA E2
			15 00 00 00 01 00 02 BB 01
			15 00 00 00 01 00 02 BC E6
			15 00 00 00 01 00 02 BD 01
			15 00 00 00 01 00 02 BE E9
			15 00 00 00 01 00 02 BF 01
			15 00 00 00 01 00 02 C0 EC
			15 00 00 00 01 00 02 C1 01
			15 00 00 00 01 00 02 C2 F9
			15 00 00 00 01 00 02 C3 02
			15 00 00 00 01 00 02 C4 06
			15 00 00 00 01 00 02 C5 02
			15 00 00 00 01 00 02 C6 1C
			15 00 00 00 01 00 02 C7 02
			15 00 00 00 01 00 02 C8 32
			15 00 00 00 01 00 02 C9 02
			15 00 00 00 01 00 02 CA 5A
			15 00 00 00 01 00 02 CB 02
			15 00 00 00 01 00 02 CC 82
			15 00 00 00 01 00 02 CD 02
			15 00 00 00 01 00 02 CE 84
			15 00 00 00 01 00 02 CF 02
			15 00 00 00 01 00 02 D0 AD
			15 00 00 00 01 00 02 D1 02
			15 00 00 00 01 00 02 D2 DD
			15 00 00 00 01 00 02 D3 02
			15 00 00 00 01 00 02 D4 FA
			15 00 00 00 01 00 02 D5 03
			15 00 00 00 01 00 02 D6 2F
			15 00 00 00 01 00 02 D7 03
			15 00 00 00 01 00 02 D8 4A
			15 00 00 00 01 00 02 D9 03
			15 00 00 00 01 00 02 DA 6B
			15 00 00 00 01 00 02 DB 03
			15 00 00 00 01 00 02 DC 75
			15 00 00 00 01 00 02 DD 03
			15 00 00 00 01 00 02 DE 7F
			15 00 00 00 01 00 02 DF 03
			15 00 00 00 01 00 02 E0 8A
			15 00 00 00 01 00 02 E1 03
			15 00 00 00 01 00 02 E2 97
			15 00 00 00 01 00 02 E3 03
			15 00 00 00 01 00 02 E4 A4
			15 00 00 00 01 00 02 E5 03
			15 00 00 00 01 00 02 E6 B0
			15 00 00 00 01 00 02 E7 03
			15 00 00 00 01 00 02 E8 B7
			15 00 00 00 01 00 02 E9 03
			15 00 00 00 01 00 02 EA FE

			15 00 00 00 01 00 02 FB 01
			15 01 00 00 01 00 02 FF 10
			];
		qcom,mdss-dsi-dispparam-papermode4-state = "dsi_hs_mode";
		qcom,mdss-dsi-dispparam-papermode5-command = [
			15 01 00 00 78 00 02 FF 20
			15 00 00 00 01 00 02 FB 01

			15 00 00 00 01 00 02 75 00
			15 00 00 00 01 00 02 76 C8
			15 00 00 00 01 00 02 77 00
			15 00 00 00 01 00 02 78 D3
			15 00 00 00 01 00 02 79 00
			15 00 00 00 01 00 02 7A E7
			15 00 00 00 01 00 02 7B 00
			15 00 00 00 01 00 02 7C F8
			15 00 00 00 01 00 02 7D 01
			15 00 00 00 01 00 02 7E 08
			15 00 00 00 01 00 02 7F 01
			15 00 00 00 01 00 02 80 17
			15 00 00 00 01 00 02 81 01
			15 00 00 00 01 00 02 82 24
			15 00 00 00 01 00 02 83 01
			15 00 00 00 01 00 02 84 30
			15 00 00 00 01 00 02 85 01
			15 00 00 00 01 00 02 86 3C
			15 00 00 00 01 00 02 87 01
			15 00 00 00 01 00 02 88 64
			15 00 00 00 01 00 02 89 01
			15 00 00 00 01 00 02 8A 84
			15 00 00 00 01 00 02 8B 01
			15 00 00 00 01 00 02 8C B8
			15 00 00 00 01 00 02 8D 01
			15 00 00 00 01 00 02 8E E0
			15 00 00 00 01 00 02 8F 02
			15 00 00 00 01 00 02 90 1F
			15 00 00 00 01 00 02 91 02
			15 00 00 00 01 00 02 92 54
			15 00 00 00 01 00 02 93 02
			15 00 00 00 01 00 02 94 56
			15 00 00 00 01 00 02 95 02
			15 00 00 00 01 00 02 96 8A
			15 00 00 00 01 00 02 97 02
			15 00 00 00 01 00 02 98 C1
			15 00 00 00 01 00 02 99 02
			15 00 00 00 01 00 02 9A E1
			15 00 00 00 01 00 02 9B 03
			15 00 00 00 01 00 02 9C 0A
			15 00 00 00 01 00 02 9D 03
			15 00 00 00 01 00 02 9E 33
			15 00 00 00 01 00 02 9F 03
			15 00 00 00 01 00 02 A0 58
			15 00 00 00 01 00 02 A2 03
			15 00 00 00 01 00 02 A3 63
			15 00 00 00 01 00 02 A4 03
			15 00 00 00 01 00 02 A5 6F
			15 00 00 00 01 00 02 A6 03
			15 00 00 00 01 00 02 A7 7C
			15 00 00 00 01 00 02 A9 03
			15 00 00 00 01 00 02 AA 8A
			15 00 00 00 01 00 02 AB 03
			15 00 00 00 01 00 02 AC 9A
			15 00 00 00 01 00 02 AD 03
			15 00 00 00 01 00 02 AE AB
			15 00 00 00 01 00 02 AF 03
			15 00 00 00 01 00 02 B0 B6
			15 00 00 00 01 00 02 B1 03
			15 00 00 00 01 00 02 B2 FE

			15 00 00 00 01 00 02 B3 00
			15 00 00 00 01 00 02 B4 C8
			15 00 00 00 01 00 02 B5 00
			15 00 00 00 01 00 02 B6 D3
			15 00 00 00 01 00 02 B7 00
			15 00 00 00 01 00 02 B8 E7
			15 00 00 00 01 00 02 B9 00
			15 00 00 00 01 00 02 BA F8
			15 00 00 00 01 00 02 BB 01
			15 00 00 00 01 00 02 BC 08
			15 00 00 00 01 00 02 BD 01
			15 00 00 00 01 00 02 BE 17
			15 00 00 00 01 00 02 BF 01
			15 00 00 00 01 00 02 C0 24
			15 00 00 00 01 00 02 C1 01
			15 00 00 00 01 00 02 C2 30
			15 00 00 00 01 00 02 C3 01
			15 00 00 00 01 00 02 C4 3C
			15 00 00 00 01 00 02 C5 01
			15 00 00 00 01 00 02 C6 64
			15 00 00 00 01 00 02 C7 01
			15 00 00 00 01 00 02 C8 84
			15 00 00 00 01 00 02 C9 01
			15 00 00 00 01 00 02 CA B8
			15 00 00 00 01 00 02 CB 01
			15 00 00 00 01 00 02 CC E0
			15 00 00 00 01 00 02 CD 02
			15 00 00 00 01 00 02 CE 1F
			15 00 00 00 01 00 02 CF 02
			15 00 00 00 01 00 02 D0 54
			15 00 00 00 01 00 02 D1 02
			15 00 00 00 01 00 02 D2 56
			15 00 00 00 01 00 02 D3 02
			15 00 00 00 01 00 02 D4 8A
			15 00 00 00 01 00 02 D5 02
			15 00 00 00 01 00 02 D6 C1
			15 00 00 00 01 00 02 D7 02
			15 00 00 00 01 00 02 D8 E1
			15 00 00 00 01 00 02 D9 03
			15 00 00 00 01 00 02 DA 0A
			15 00 00 00 01 00 02 DB 03
			15 00 00 00 01 00 02 DC 33
			15 00 00 00 01 00 02 DD 03
			15 00 00 00 01 00 02 DE 58
			15 00 00 00 01 00 02 DF 03
			15 00 00 00 01 00 02 E0 63
			15 00 00 00 01 00 02 E1 03
			15 00 00 00 01 00 02 E2 6F
			15 00 00 00 01 00 02 E3 03
			15 00 00 00 01 00 02 E4 7C
			15 00 00 00 01 00 02 E5 03
			15 00 00 00 01 00 02 E6 8A
			15 00 00 00 01 00 02 E7 03
			15 00 00 00 01 00 02 E8 9A
			15 00 00 00 01 00 02 E9 03
			15 00 00 00 01 00 02 EA AB
			15 00 00 00 01 00 02 EB 03
			15 00 00 00 01 00 02 EC B6
			15 00 00 00 01 00 02 ED 03
			15 00 00 00 01 00 02 EE FE
			15 00 00 00 01 00 02 EF 00
			15 00 00 00 01 00 02 F0 C8
			15 00 00 00 01 00 02 F1 00
			15 00 00 00 01 00 02 F2 D3
			15 00 00 00 01 00 02 F3 00
			15 00 00 00 01 00 02 F4 E8
			15 00 00 00 01 00 02 F5 00
			15 00 00 00 01 00 02 F6 FA
			15 00 00 00 01 00 02 F7 01
			15 00 00 00 01 00 02 F8 0B
			15 00 00 00 01 00 02 F9 01
			15 00 00 00 01 00 02 FA 19

			15 00 00 00 01 00 02 FF 21
			15 00 00 00 01 00 02 FB 01

			15 00 00 00 01 00 02 00 01
			15 00 00 00 01 00 02 01 27
			15 00 00 00 01 00 02 02 01
			15 00 00 00 01 00 02 03 34
			15 00 00 00 01 00 02 04 01
			15 00 00 00 01 00 02 05 3F
			15 00 00 00 01 00 02 06 01
			15 00 00 00 01 00 02 07 67
			15 00 00 00 01 00 02 08 01
			15 00 00 00 01 00 02 09 88
			15 00 00 00 01 00 02 0A 01
			15 00 00 00 01 00 02 0B BB
			15 00 00 00 01 00 02 0C 01
			15 00 00 00 01 00 02 0D E3
			15 00 00 00 01 00 02 0E 02
			15 00 00 00 01 00 02 0F 22
			15 00 00 00 01 00 02 10 02
			15 00 00 00 01 00 02 11 57
			15 00 00 00 01 00 02 12 02
			15 00 00 00 01 00 02 13 59
			15 00 00 00 01 00 02 14 02
			15 00 00 00 01 00 02 15 8C
			15 00 00 00 01 00 02 16 02
			15 00 00 00 01 00 02 17 C3
			15 00 00 00 01 00 02 18 02
			15 00 00 00 01 00 02 19 E2
			15 00 00 00 01 00 02 1A 03
			15 00 00 00 01 00 02 1B 0C
			15 00 00 00 01 00 02 1C 03
			15 00 00 00 01 00 02 1D 35
			15 00 00 00 01 00 02 1E 03
			15 00 00 00 01 00 02 1F 5B
			15 00 00 00 01 00 02 20 03
			15 00 00 00 01 00 02 21 67
			15 00 00 00 01 00 02 22 03
			15 00 00 00 01 00 02 23 73
			15 00 00 00 01 00 02 24 03
			15 00 00 00 01 00 02 25 82
			15 00 00 00 01 00 02 26 03
			15 00 00 00 01 00 02 27 93
			15 00 00 00 01 00 02 28 03
			15 00 00 00 01 00 02 29 A7
			15 00 00 00 01 00 02 2A 03
			15 00 00 00 01 00 02 2B B8
			15 00 00 00 01 00 02 2D 03
			15 00 00 00 01 00 02 2F C3
			15 00 00 00 01 00 02 30 03
			15 00 00 00 01 00 02 31 FE

			15 00 00 00 01 00 02 32 00
			15 00 00 00 01 00 02 33 C8
			15 00 00 00 01 00 02 34 00
			15 00 00 00 01 00 02 35 D3
			15 00 00 00 01 00 02 36 00
			15 00 00 00 01 00 02 37 E8
			15 00 00 00 01 00 02 38 00
			15 00 00 00 01 00 02 39 FA
			15 00 00 00 01 00 02 3A 01
			15 00 00 00 01 00 02 3B 0B
			15 00 00 00 01 00 02 3D 01
			15 00 00 00 01 00 02 3F 19
			15 00 00 00 01 00 02 40 01
			15 00 00 00 01 00 02 41 27
			15 00 00 00 01 00 02 42 01
			15 00 00 00 01 00 02 43 34
			15 00 00 00 01 00 02 44 01
			15 00 00 00 01 00 02 45 3F
			15 00 00 00 01 00 02 46 01
			15 00 00 00 01 00 02 47 67
			15 00 00 00 01 00 02 48 01
			15 00 00 00 01 00 02 49 88
			15 00 00 00 01 00 02 4A 01
			15 00 00 00 01 00 02 4B BB
			15 00 00 00 01 00 02 4C 01
			15 00 00 00 01 00 02 4D E3
			15 00 00 00 01 00 02 4E 02
			15 00 00 00 01 00 02 4F 22
			15 00 00 00 01 00 02 50 02
			15 00 00 00 01 00 02 51 57
			15 00 00 00 01 00 02 52 02
			15 00 00 00 01 00 02 53 59
			15 00 00 00 01 00 02 54 02
			15 00 00 00 01 00 02 55 8C
			15 00 00 00 01 00 02 56 02
			15 00 00 00 01 00 02 58 C3
			15 00 00 00 01 00 02 59 02
			15 00 00 00 01 00 02 5A E2
			15 00 00 00 01 00 02 5B 03
			15 00 00 00 01 00 02 5C 0C
			15 00 00 00 01 00 02 5D 03
			15 00 00 00 01 00 02 5E 35
			15 00 00 00 01 00 02 5F 03
			15 00 00 00 01 00 02 60 5B
			15 00 00 00 01 00 02 61 03
			15 00 00 00 01 00 02 62 67
			15 00 00 00 01 00 02 63 03
			15 00 00 00 01 00 02 64 73
			15 00 00 00 01 00 02 65 03
			15 00 00 00 01 00 02 66 82
			15 00 00 00 01 00 02 67 03
			15 00 00 00 01 00 02 68 93
			15 00 00 00 01 00 02 69 03
			15 00 00 00 01 00 02 6A A7
			15 00 00 00 01 00 02 6B 03
			15 00 00 00 01 00 02 6C B8
			15 00 00 00 01 00 02 6D 03
			15 00 00 00 01 00 02 6E C3
			15 00 00 00 01 00 02 6F 03
			15 00 00 00 01 00 02 70 FE

			15 00 00 00 01 00 02 71 01
			15 00 00 00 01 00 02 72 F2
			15 00 00 00 01 00 02 73 01
			15 00 00 00 01 00 02 74 F4
			15 00 00 00 01 00 02 75 01
			15 00 00 00 01 00 02 76 F7
			15 00 00 00 01 00 02 77 01
			15 00 00 00 01 00 02 78 FA
			15 00 00 00 01 00 02 79 01
			15 00 00 00 01 00 02 7A FD
			15 00 00 00 01 00 02 7B 01
			15 00 00 00 01 00 02 7C FF
			15 00 00 00 01 00 02 7D 02
			15 00 00 00 01 00 02 7E 02
			15 00 00 00 01 00 02 7F 02
			15 00 00 00 01 00 02 80 05
			15 00 00 00 01 00 02 81 02
			15 00 00 00 01 00 02 82 08
			15 00 00 00 01 00 02 83 02
			15 00 00 00 01 00 02 84 12
			15 00 00 00 01 00 02 85 02
			15 00 00 00 01 00 02 86 1D
			15 00 00 00 01 00 02 87 02
			15 00 00 00 01 00 02 88 31
			15 00 00 00 01 00 02 89 02
			15 00 00 00 01 00 02 8A 44
			15 00 00 00 01 00 02 8B 02
			15 00 00 00 01 00 02 8C 69
			15 00 00 00 01 00 02 8D 02
			15 00 00 00 01 00 02 8E 8E
			15 00 00 00 01 00 02 8F 02
			15 00 00 00 01 00 02 90 8F
			15 00 00 00 01 00 02 91 02
			15 00 00 00 01 00 02 92 B7
			15 00 00 00 01 00 02 93 02
			15 00 00 00 01 00 02 94 E4
			15 00 00 00 01 00 02 95 03
			15 00 00 00 01 00 02 96 01
			15 00 00 00 01 00 02 97 03
			15 00 00 00 01 00 02 98 36
			15 00 00 00 01 00 02 99 03
			15 00 00 00 01 00 02 9A 50
			15 00 00 00 01 00 02 9B 03
			15 00 00 00 01 00 02 9C 70
			15 00 00 00 01 00 02 9D 03
			15 00 00 00 01 00 02 9E 79
			15 00 00 00 01 00 02 9F 03
			15 00 00 00 01 00 02 A0 83
			15 00 00 00 01 00 02 A2 03
			15 00 00 00 01 00 02 A3 8E
			15 00 00 00 01 00 02 A4 03
			15 00 00 00 01 00 02 A5 9A
			15 00 00 00 01 00 02 A6 03
			15 00 00 00 01 00 02 A7 A6
			15 00 00 00 01 00 02 A9 03
			15 00 00 00 01 00 02 AA B1
			15 00 00 00 01 00 02 AB 03
			15 00 00 00 01 00 02 AC B7
			15 00 00 00 01 00 02 AD 03
			15 00 00 00 01 00 02 AE FE

			15 00 00 00 01 00 02 AF 01
			15 00 00 00 01 00 02 B0 F2
			15 00 00 00 01 00 02 B1 01
			15 00 00 00 01 00 02 B2 F4
			15 00 00 00 01 00 02 B3 01
			15 00 00 00 01 00 02 B4 F7
			15 00 00 00 01 00 02 B5 01
			15 00 00 00 01 00 02 B6 FA
			15 00 00 00 01 00 02 B7 01
			15 00 00 00 01 00 02 B8 FD
			15 00 00 00 01 00 02 B9 01
			15 00 00 00 01 00 02 BA FF
			15 00 00 00 01 00 02 BB 02
			15 00 00 00 01 00 02 BC 02
			15 00 00 00 01 00 02 BD 02
			15 00 00 00 01 00 02 BE 05
			15 00 00 00 01 00 02 BF 02
			15 00 00 00 01 00 02 C0 08
			15 00 00 00 01 00 02 C1 02
			15 00 00 00 01 00 02 C2 12
			15 00 00 00 01 00 02 C3 02
			15 00 00 00 01 00 02 C4 1D
			15 00 00 00 01 00 02 C5 02
			15 00 00 00 01 00 02 C6 31
			15 00 00 00 01 00 02 C7 02
			15 00 00 00 01 00 02 C8 44
			15 00 00 00 01 00 02 C9 02
			15 00 00 00 01 00 02 CA 69
			15 00 00 00 01 00 02 CB 02
			15 00 00 00 01 00 02 CC 8E
			15 00 00 00 01 00 02 CD 02
			15 00 00 00 01 00 02 CE 8F
			15 00 00 00 01 00 02 CF 02
			15 00 00 00 01 00 02 D0 B7
			15 00 00 00 01 00 02 D1 02
			15 00 00 00 01 00 02 D2 E4
			15 00 00 00 01 00 02 D3 03
			15 00 00 00 01 00 02 D4 01
			15 00 00 00 01 00 02 D5 03
			15 00 00 00 01 00 02 D6 36
			15 00 00 00 01 00 02 D7 03
			15 00 00 00 01 00 02 D8 50
			15 00 00 00 01 00 02 D9 03
			15 00 00 00 01 00 02 DA 70
			15 00 00 00 01 00 02 DB 03
			15 00 00 00 01 00 02 DC 79
			15 00 00 00 01 00 02 DD 03
			15 00 00 00 01 00 02 DE 83
			15 00 00 00 01 00 02 DF 03
			15 00 00 00 01 00 02 E0 8E
			15 00 00 00 01 00 02 E1 03
			15 00 00 00 01 00 02 E2 9A
			15 00 00 00 01 00 02 E3 03
			15 00 00 00 01 00 02 E4 A6
			15 00 00 00 01 00 02 E5 03
			15 00 00 00 01 00 02 E6 B1
			15 00 00 00 01 00 02 E7 03
			15 00 00 00 01 00 02 E8 B7
			15 00 00 00 01 00 02 E9 03
			15 00 00 00 01 00 02 EA FE

			15 00 00 00 01 00 02 FB 01
			15 01 00 00 01 00 02 FF 10
			];
		qcom,mdss-dsi-dispparam-papermode5-state = "dsi_hs_mode";
		qcom,mdss-dsi-dispparam-papermode6-command = [
			15 01 00 00 78 00 02 FF 20
			15 00 00 00 01 00 02 FB 01

			15 00 00 00 01 00 02 75 00
			15 00 00 00 01 00 02 76 C8
			15 00 00 00 01 00 02 77 00
			15 00 00 00 01 00 02 78 D3
			15 00 00 00 01 00 02 79 00
			15 00 00 00 01 00 02 7A E7
			15 00 00 00 01 00 02 7B 00
			15 00 00 00 01 00 02 7C F8
			15 00 00 00 01 00 02 7D 01
			15 00 00 00 01 00 02 7E 08
			15 00 00 00 01 00 02 7F 01
			15 00 00 00 01 00 02 80 17
			15 00 00 00 01 00 02 81 01
			15 00 00 00 01 00 02 82 24
			15 00 00 00 01 00 02 83 01
			15 00 00 00 01 00 02 84 30
			15 00 00 00 01 00 02 85 01
			15 00 00 00 01 00 02 86 3C
			15 00 00 00 01 00 02 87 01
			15 00 00 00 01 00 02 88 64
			15 00 00 00 01 00 02 89 01
			15 00 00 00 01 00 02 8A 84
			15 00 00 00 01 00 02 8B 01
			15 00 00 00 01 00 02 8C B8
			15 00 00 00 01 00 02 8D 01
			15 00 00 00 01 00 02 8E E0
			15 00 00 00 01 00 02 8F 02
			15 00 00 00 01 00 02 90 1F
			15 00 00 00 01 00 02 91 02
			15 00 00 00 01 00 02 92 54
			15 00 00 00 01 00 02 93 02
			15 00 00 00 01 00 02 94 56
			15 00 00 00 01 00 02 95 02
			15 00 00 00 01 00 02 96 8A
			15 00 00 00 01 00 02 97 02
			15 00 00 00 01 00 02 98 C1
			15 00 00 00 01 00 02 99 02
			15 00 00 00 01 00 02 9A E1
			15 00 00 00 01 00 02 9B 03
			15 00 00 00 01 00 02 9C 0A
			15 00 00 00 01 00 02 9D 03
			15 00 00 00 01 00 02 9E 33
			15 00 00 00 01 00 02 9F 03
			15 00 00 00 01 00 02 A0 58
			15 00 00 00 01 00 02 A2 03
			15 00 00 00 01 00 02 A3 63
			15 00 00 00 01 00 02 A4 03
			15 00 00 00 01 00 02 A5 6F
			15 00 00 00 01 00 02 A6 03
			15 00 00 00 01 00 02 A7 7C
			15 00 00 00 01 00 02 A9 03
			15 00 00 00 01 00 02 AA 8A
			15 00 00 00 01 00 02 AB 03
			15 00 00 00 01 00 02 AC 9A
			15 00 00 00 01 00 02 AD 03
			15 00 00 00 01 00 02 AE AB
			15 00 00 00 01 00 02 AF 03
			15 00 00 00 01 00 02 B0 B6
			15 00 00 00 01 00 02 B1 03
			15 00 00 00 01 00 02 B2 FE

			15 00 00 00 01 00 02 B3 00
			15 00 00 00 01 00 02 B4 C8
			15 00 00 00 01 00 02 B5 00
			15 00 00 00 01 00 02 B6 D3
			15 00 00 00 01 00 02 B7 00
			15 00 00 00 01 00 02 B8 E7
			15 00 00 00 01 00 02 B9 00
			15 00 00 00 01 00 02 BA F8
			15 00 00 00 01 00 02 BB 01
			15 00 00 00 01 00 02 BC 08
			15 00 00 00 01 00 02 BD 01
			15 00 00 00 01 00 02 BE 17
			15 00 00 00 01 00 02 BF 01
			15 00 00 00 01 00 02 C0 24
			15 00 00 00 01 00 02 C1 01
			15 00 00 00 01 00 02 C2 30
			15 00 00 00 01 00 02 C3 01
			15 00 00 00 01 00 02 C4 3C
			15 00 00 00 01 00 02 C5 01
			15 00 00 00 01 00 02 C6 64
			15 00 00 00 01 00 02 C7 01
			15 00 00 00 01 00 02 C8 84
			15 00 00 00 01 00 02 C9 01
			15 00 00 00 01 00 02 CA B8
			15 00 00 00 01 00 02 CB 01
			15 00 00 00 01 00 02 CC E0
			15 00 00 00 01 00 02 CD 02
			15 00 00 00 01 00 02 CE 1F
			15 00 00 00 01 00 02 CF 02
			15 00 00 00 01 00 02 D0 54
			15 00 00 00 01 00 02 D1 02
			15 00 00 00 01 00 02 D2 56
			15 00 00 00 01 00 02 D3 02
			15 00 00 00 01 00 02 D4 8A
			15 00 00 00 01 00 02 D5 02
			15 00 00 00 01 00 02 D6 C1
			15 00 00 00 01 00 02 D7 02
			15 00 00 00 01 00 02 D8 E1
			15 00 00 00 01 00 02 D9 03
			15 00 00 00 01 00 02 DA 0A
			15 00 00 00 01 00 02 DB 03
			15 00 00 00 01 00 02 DC 33
			15 00 00 00 01 00 02 DD 03
			15 00 00 00 01 00 02 DE 58
			15 00 00 00 01 00 02 DF 03
			15 00 00 00 01 00 02 E0 63
			15 00 00 00 01 00 02 E1 03
			15 00 00 00 01 00 02 E2 6F
			15 00 00 00 01 00 02 E3 03
			15 00 00 00 01 00 02 E4 7C
			15 00 00 00 01 00 02 E5 03
			15 00 00 00 01 00 02 E6 8A
			15 00 00 00 01 00 02 E7 03
			15 00 00 00 01 00 02 E8 9A
			15 00 00 00 01 00 02 E9 03
			15 00 00 00 01 00 02 EA AB
			15 00 00 00 01 00 02 EB 03
			15 00 00 00 01 00 02 EC B6
			15 00 00 00 01 00 02 ED 03
			15 00 00 00 01 00 02 EE FE

			15 00 00 00 01 00 02 EF 00
			15 00 00 00 01 00 02 F0 C8
			15 00 00 00 01 00 02 F1 00
			15 00 00 00 01 00 02 F2 D3
			15 00 00 00 01 00 02 F3 00
			15 00 00 00 01 00 02 F4 E8
			15 00 00 00 01 00 02 F5 00
			15 00 00 00 01 00 02 F6 FA
			15 00 00 00 01 00 02 F7 01
			15 00 00 00 01 00 02 F8 0B
			15 00 00 00 01 00 02 F9 01
			15 00 00 00 01 00 02 FA 19

			15 00 00 00 01 00 02 FF 21
			15 00 00 00 01 00 02 FB 01

			15 00 00 00 01 00 02 00 01
			15 00 00 00 01 00 02 01 27
			15 00 00 00 01 00 02 02 01
			15 00 00 00 01 00 02 03 34
			15 00 00 00 01 00 02 04 01
			15 00 00 00 01 00 02 05 3F
			15 00 00 00 01 00 02 06 01
			15 00 00 00 01 00 02 07 67
			15 00 00 00 01 00 02 08 01
			15 00 00 00 01 00 02 09 88
			15 00 00 00 01 00 02 0A 01
			15 00 00 00 01 00 02 0B BB
			15 00 00 00 01 00 02 0C 01
			15 00 00 00 01 00 02 0D E3
			15 00 00 00 01 00 02 0E 02
			15 00 00 00 01 00 02 0F 22
			15 00 00 00 01 00 02 10 02
			15 00 00 00 01 00 02 11 57
			15 00 00 00 01 00 02 12 02
			15 00 00 00 01 00 02 13 59
			15 00 00 00 01 00 02 14 02
			15 00 00 00 01 00 02 15 8C
			15 00 00 00 01 00 02 16 02
			15 00 00 00 01 00 02 17 C3
			15 00 00 00 01 00 02 18 02
			15 00 00 00 01 00 02 19 E2
			15 00 00 00 01 00 02 1A 03
			15 00 00 00 01 00 02 1B 0C
			15 00 00 00 01 00 02 1C 03
			15 00 00 00 01 00 02 1D 35
			15 00 00 00 01 00 02 1E 03
			15 00 00 00 01 00 02 1F 5B
			15 00 00 00 01 00 02 20 03
			15 00 00 00 01 00 02 21 67
			15 00 00 00 01 00 02 22 03
			15 00 00 00 01 00 02 23 73
			15 00 00 00 01 00 02 24 03
			15 00 00 00 01 00 02 25 82
			15 00 00 00 01 00 02 26 03
			15 00 00 00 01 00 02 27 93
			15 00 00 00 01 00 02 28 03
			15 00 00 00 01 00 02 29 A7
			15 00 00 00 01 00 02 2A 03
			15 00 00 00 01 00 02 2B B8
			15 00 00 00 01 00 02 2D 03
			15 00 00 00 01 00 02 2F C3
			15 00 00 00 01 00 02 30 03
			15 00 00 00 01 00 02 31 FE

			15 00 00 00 01 00 02 32 00
			15 00 00 00 01 00 02 33 C8
			15 00 00 00 01 00 02 34 00
			15 00 00 00 01 00 02 35 D3
			15 00 00 00 01 00 02 36 00
			15 00 00 00 01 00 02 37 E8
			15 00 00 00 01 00 02 38 00
			15 00 00 00 01 00 02 39 FA
			15 00 00 00 01 00 02 3A 01
			15 00 00 00 01 00 02 3B 0B
			15 00 00 00 01 00 02 3D 01
			15 00 00 00 01 00 02 3F 19
			15 00 00 00 01 00 02 40 01
			15 00 00 00 01 00 02 41 27
			15 00 00 00 01 00 02 42 01
			15 00 00 00 01 00 02 43 34
			15 00 00 00 01 00 02 44 01
			15 00 00 00 01 00 02 45 3F
			15 00 00 00 01 00 02 46 01
			15 00 00 00 01 00 02 47 67
			15 00 00 00 01 00 02 48 01
			15 00 00 00 01 00 02 49 88
			15 00 00 00 01 00 02 4A 01
			15 00 00 00 01 00 02 4B BB
			15 00 00 00 01 00 02 4C 01
			15 00 00 00 01 00 02 4D E3
			15 00 00 00 01 00 02 4E 02
			15 00 00 00 01 00 02 4F 22
			15 00 00 00 01 00 02 50 02
			15 00 00 00 01 00 02 51 57
			15 00 00 00 01 00 02 52 02
			15 00 00 00 01 00 02 53 59
			15 00 00 00 01 00 02 54 02
			15 00 00 00 01 00 02 55 8C
			15 00 00 00 01 00 02 56 02
			15 00 00 00 01 00 02 58 C3
			15 00 00 00 01 00 02 59 02
			15 00 00 00 01 00 02 5A E2
			15 00 00 00 01 00 02 5B 03
			15 00 00 00 01 00 02 5C 0C
			15 00 00 00 01 00 02 5D 03
			15 00 00 00 01 00 02 5E 35
			15 00 00 00 01 00 02 5F 03
			15 00 00 00 01 00 02 60 5B
			15 00 00 00 01 00 02 61 03
			15 00 00 00 01 00 02 62 67
			15 00 00 00 01 00 02 63 03
			15 00 00 00 01 00 02 64 73
			15 00 00 00 01 00 02 65 03
			15 00 00 00 01 00 02 66 82
			15 00 00 00 01 00 02 67 03
			15 00 00 00 01 00 02 68 93
			15 00 00 00 01 00 02 69 03
			15 00 00 00 01 00 02 6A A7
			15 00 00 00 01 00 02 6B 03
			15 00 00 00 01 00 02 6C B8
			15 00 00 00 01 00 02 6D 03
			15 00 00 00 01 00 02 6E C3
			15 00 00 00 01 00 02 6F 03
			15 00 00 00 01 00 02 70 FE

			15 00 00 00 01 00 02 71 02
			15 00 00 00 01 00 02 72 07
			15 00 00 00 01 00 02 73 02
			15 00 00 00 01 00 02 74 08
			15 00 00 00 01 00 02 75 02
			15 00 00 00 01 00 02 76 0B
			15 00 00 00 01 00 02 77 02
			15 00 00 00 01 00 02 78 0D
			15 00 00 00 01 00 02 79 02
			15 00 00 00 01 00 02 7A 10
			15 00 00 00 01 00 02 7B 02
			15 00 00 00 01 00 02 7C 12
			15 00 00 00 01 00 02 7D 02
			15 00 00 00 01 00 02 7E 15
			15 00 00 00 01 00 02 7F 02
			15 00 00 00 01 00 02 80 17
			15 00 00 00 01 00 02 81 02
			15 00 00 00 01 00 02 82 1A
			15 00 00 00 01 00 02 83 02
			15 00 00 00 01 00 02 84 23
			15 00 00 00 01 00 02 85 02
			15 00 00 00 01 00 02 86 2D
			15 00 00 00 01 00 02 87 02
			15 00 00 00 01 00 02 88 3F
			15 00 00 00 01 00 02 89 02
			15 00 00 00 01 00 02 8A 50
			15 00 00 00 01 00 02 8B 02
			15 00 00 00 01 00 02 8C 73
			15 00 00 00 01 00 02 8D 02
			15 00 00 00 01 00 02 8E 97
			15 00 00 00 01 00 02 8F 02
			15 00 00 00 01 00 02 90 98
			15 00 00 00 01 00 02 91 02
			15 00 00 00 01 00 02 92 BE
			15 00 00 00 01 00 02 93 02
			15 00 00 00 01 00 02 94 EA
			15 00 00 00 01 00 02 95 03
			15 00 00 00 01 00 02 96 07
			15 00 00 00 01 00 02 97 03
			15 00 00 00 01 00 02 98 3C
			15 00 00 00 01 00 02 99 03
			15 00 00 00 01 00 02 9A 55
			15 00 00 00 01 00 02 9B 03
			15 00 00 00 01 00 02 9C 74
			15 00 00 00 01 00 02 9D 03
			15 00 00 00 01 00 02 9E 7D
			15 00 00 00 01 00 02 9F 03
			15 00 00 00 01 00 02 A0 87
			15 00 00 00 01 00 02 A2 03
			15 00 00 00 01 00 02 A3 91
			15 00 00 00 01 00 02 A4 03
			15 00 00 00 01 00 02 A5 9D
			15 00 00 00 01 00 02 A6 03
			15 00 00 00 01 00 02 A7 A8
			15 00 00 00 01 00 02 A9 03
			15 00 00 00 01 00 02 AA B2
			15 00 00 00 01 00 02 AB 03
			15 00 00 00 01 00 02 AC B7
			15 00 00 00 01 00 02 AD 03
			15 00 00 00 01 00 02 AE FE

			15 00 00 00 01 00 02 AF 02
			15 00 00 00 01 00 02 B0 07
			15 00 00 00 01 00 02 B1 02
			15 00 00 00 01 00 02 B2 08
			15 00 00 00 01 00 02 B3 02
			15 00 00 00 01 00 02 B4 0B
			15 00 00 00 01 00 02 B5 02
			15 00 00 00 01 00 02 B6 0D
			15 00 00 00 01 00 02 B7 02
			15 00 00 00 01 00 02 B8 10
			15 00 00 00 01 00 02 B9 02
			15 00 00 00 01 00 02 BA 12
			15 00 00 00 01 00 02 BB 02
			15 00 00 00 01 00 02 BC 15
			15 00 00 00 01 00 02 BD 02
			15 00 00 00 01 00 02 BE 17
			15 00 00 00 01 00 02 BF 02
			15 00 00 00 01 00 02 C0 1A
			15 00 00 00 01 00 02 C1 02
			15 00 00 00 01 00 02 C2 23
			15 00 00 00 01 00 02 C3 02
			15 00 00 00 01 00 02 C4 2D
			15 00 00 00 01 00 02 C5 02
			15 00 00 00 01 00 02 C6 3F
			15 00 00 00 01 00 02 C7 02
			15 00 00 00 01 00 02 C8 50
			15 00 00 00 01 00 02 C9 02
			15 00 00 00 01 00 02 CA 73
			15 00 00 00 01 00 02 CB 02
			15 00 00 00 01 00 02 CC 97
			15 00 00 00 01 00 02 CD 02
			15 00 00 00 01 00 02 CE 98
			15 00 00 00 01 00 02 CF 02
			15 00 00 00 01 00 02 D0 BE
			15 00 00 00 01 00 02 D1 02
			15 00 00 00 01 00 02 D2 EA
			15 00 00 00 01 00 02 D3 03
			15 00 00 00 01 00 02 D4 07
			15 00 00 00 01 00 02 D5 03
			15 00 00 00 01 00 02 D6 3C
			15 00 00 00 01 00 02 D7 03
			15 00 00 00 01 00 02 D8 55
			15 00 00 00 01 00 02 D9 03
			15 00 00 00 01 00 02 DA 74
			15 00 00 00 01 00 02 DB 03
			15 00 00 00 01 00 02 DC 7D
			15 00 00 00 01 00 02 DD 03
			15 00 00 00 01 00 02 DE 87
			15 00 00 00 01 00 02 DF 03
			15 00 00 00 01 00 02 E0 91
			15 00 00 00 01 00 02 E1 03
			15 00 00 00 01 00 02 E2 9D
			15 00 00 00 01 00 02 E3 03
			15 00 00 00 01 00 02 E4 A8
			15 00 00 00 01 00 02 E5 03
			15 00 00 00 01 00 02 E6 B2
			15 00 00 00 01 00 02 E7 03
			15 00 00 00 01 00 02 E8 B7
			15 00 00 00 01 00 02 E9 03
			15 00 00 00 01 00 02 EA FE

			15 00 00 00 01 00 02 FB 01
			15 01 00 00 01 00 02 FF 10
			];
		qcom,mdss-dsi-dispparam-papermode6-state = "dsi_hs_mode";
		qcom,mdss-dsi-dispparam-papermode7-command = [
			15 01 00 00 78 00 02 FF 20
			15 00 00 00 01 00 02 FB 01

			15 00 00 00 01 00 02 75 00
			15 00 00 00 01 00 02 76 C8
			15 00 00 00 01 00 02 77 00
			15 00 00 00 01 00 02 78 D3
			15 00 00 00 01 00 02 79 00
			15 00 00 00 01 00 02 7A E7
			15 00 00 00 01 00 02 7B 00
			15 00 00 00 01 00 02 7C F8
			15 00 00 00 01 00 02 7D 01
			15 00 00 00 01 00 02 7E 08
			15 00 00 00 01 00 02 7F 01
			15 00 00 00 01 00 02 80 17
			15 00 00 00 01 00 02 81 01
			15 00 00 00 01 00 02 82 24
			15 00 00 00 01 00 02 83 01
			15 00 00 00 01 00 02 84 30
			15 00 00 00 01 00 02 85 01
			15 00 00 00 01 00 02 86 3C
			15 00 00 00 01 00 02 87 01
			15 00 00 00 01 00 02 88 64
			15 00 00 00 01 00 02 89 01
			15 00 00 00 01 00 02 8A 84
			15 00 00 00 01 00 02 8B 01
			15 00 00 00 01 00 02 8C B8
			15 00 00 00 01 00 02 8D 01
			15 00 00 00 01 00 02 8E E0
			15 00 00 00 01 00 02 8F 02
			15 00 00 00 01 00 02 90 1F
			15 00 00 00 01 00 02 91 02
			15 00 00 00 01 00 02 92 54
			15 00 00 00 01 00 02 93 02
			15 00 00 00 01 00 02 94 56
			15 00 00 00 01 00 02 95 02
			15 00 00 00 01 00 02 96 8A
			15 00 00 00 01 00 02 97 02
			15 00 00 00 01 00 02 98 C1
			15 00 00 00 01 00 02 99 02
			15 00 00 00 01 00 02 9A E1
			15 00 00 00 01 00 02 9B 03
			15 00 00 00 01 00 02 9C 0A
			15 00 00 00 01 00 02 9D 03
			15 00 00 00 01 00 02 9E 33
			15 00 00 00 01 00 02 9F 03
			15 00 00 00 01 00 02 A0 58
			15 00 00 00 01 00 02 A2 03
			15 00 00 00 01 00 02 A3 63
			15 00 00 00 01 00 02 A4 03
			15 00 00 00 01 00 02 A5 6F
			15 00 00 00 01 00 02 A6 03
			15 00 00 00 01 00 02 A7 7C
			15 00 00 00 01 00 02 A9 03
			15 00 00 00 01 00 02 AA 8A
			15 00 00 00 01 00 02 AB 03
			15 00 00 00 01 00 02 AC 9A
			15 00 00 00 01 00 02 AD 03
			15 00 00 00 01 00 02 AE AB
			15 00 00 00 01 00 02 AF 03
			15 00 00 00 01 00 02 B0 B6
			15 00 00 00 01 00 02 B1 03
			15 00 00 00 01 00 02 B2 FE

			15 00 00 00 01 00 02 B3 00
			15 00 00 00 01 00 02 B4 C8
			15 00 00 00 01 00 02 B5 00
			15 00 00 00 01 00 02 B6 D3
			15 00 00 00 01 00 02 B7 00
			15 00 00 00 01 00 02 B8 E7
			15 00 00 00 01 00 02 B9 00
			15 00 00 00 01 00 02 BA F8
			15 00 00 00 01 00 02 BB 01
			15 00 00 00 01 00 02 BC 08
			15 00 00 00 01 00 02 BD 01
			15 00 00 00 01 00 02 BE 17
			15 00 00 00 01 00 02 BF 01
			15 00 00 00 01 00 02 C0 24
			15 00 00 00 01 00 02 C1 01
			15 00 00 00 01 00 02 C2 30
			15 00 00 00 01 00 02 C3 01
			15 00 00 00 01 00 02 C4 3C
			15 00 00 00 01 00 02 C5 01
			15 00 00 00 01 00 02 C6 64
			15 00 00 00 01 00 02 C7 01
			15 00 00 00 01 00 02 C8 84
			15 00 00 00 01 00 02 C9 01
			15 00 00 00 01 00 02 CA B8
			15 00 00 00 01 00 02 CB 01
			15 00 00 00 01 00 02 CC E0
			15 00 00 00 01 00 02 CD 02
			15 00 00 00 01 00 02 CE 1F
			15 00 00 00 01 00 02 CF 02
			15 00 00 00 01 00 02 D0 54
			15 00 00 00 01 00 02 D1 02
			15 00 00 00 01 00 02 D2 56
			15 00 00 00 01 00 02 D3 02
			15 00 00 00 01 00 02 D4 8A
			15 00 00 00 01 00 02 D5 02
			15 00 00 00 01 00 02 D6 C1
			15 00 00 00 01 00 02 D7 02
			15 00 00 00 01 00 02 D8 E1
			15 00 00 00 01 00 02 D9 03
			15 00 00 00 01 00 02 DA 0A
			15 00 00 00 01 00 02 DB 03
			15 00 00 00 01 00 02 DC 33
			15 00 00 00 01 00 02 DD 03
			15 00 00 00 01 00 02 DE 58
			15 00 00 00 01 00 02 DF 03
			15 00 00 00 01 00 02 E0 63
			15 00 00 00 01 00 02 E1 03
			15 00 00 00 01 00 02 E2 6F
			15 00 00 00 01 00 02 E3 03
			15 00 00 00 01 00 02 E4 7C
			15 00 00 00 01 00 02 E5 03
			15 00 00 00 01 00 02 E6 8A
			15 00 00 00 01 00 02 E7 03
			15 00 00 00 01 00 02 E8 9A
			15 00 00 00 01 00 02 E9 03
			15 00 00 00 01 00 02 EA AB
			15 00 00 00 01 00 02 EB 03
			15 00 00 00 01 00 02 EC B6
			15 00 00 00 01 00 02 ED 03
			15 00 00 00 01 00 02 EE FE

			15 00 00 00 01 00 02 EF 00
			15 00 00 00 01 00 02 F0 C8
			15 00 00 00 01 00 02 F1 00
			15 00 00 00 01 00 02 F2 D3
			15 00 00 00 01 00 02 F3 00
			15 00 00 00 01 00 02 F4 E8
			15 00 00 00 01 00 02 F5 00
			15 00 00 00 01 00 02 F6 FA
			15 00 00 00 01 00 02 F7 01
			15 00 00 00 01 00 02 F8 0B
			15 00 00 00 01 00 02 F9 01
			15 00 00 00 01 00 02 FA 19

			15 00 00 00 01 00 02 FF 21
			15 00 00 00 01 00 02 FB 01

			15 00 00 00 01 00 02 00 01
			15 00 00 00 01 00 02 01 27
			15 00 00 00 01 00 02 02 01
			15 00 00 00 01 00 02 03 34
			15 00 00 00 01 00 02 04 01
			15 00 00 00 01 00 02 05 3F
			15 00 00 00 01 00 02 06 01
			15 00 00 00 01 00 02 07 67
			15 00 00 00 01 00 02 08 01
			15 00 00 00 01 00 02 09 88
			15 00 00 00 01 00 02 0A 01
			15 00 00 00 01 00 02 0B BB
			15 00 00 00 01 00 02 0C 01
			15 00 00 00 01 00 02 0D E3
			15 00 00 00 01 00 02 0E 02
			15 00 00 00 01 00 02 0F 22
			15 00 00 00 01 00 02 10 02
			15 00 00 00 01 00 02 11 57
			15 00 00 00 01 00 02 12 02
			15 00 00 00 01 00 02 13 59
			15 00 00 00 01 00 02 14 02
			15 00 00 00 01 00 02 15 8C
			15 00 00 00 01 00 02 16 02
			15 00 00 00 01 00 02 17 C3
			15 00 00 00 01 00 02 18 02
			15 00 00 00 01 00 02 19 E2
			15 00 00 00 01 00 02 1A 03
			15 00 00 00 01 00 02 1B 0C
			15 00 00 00 01 00 02 1C 03
			15 00 00 00 01 00 02 1D 35
			15 00 00 00 01 00 02 1E 03
			15 00 00 00 01 00 02 1F 5B
			15 00 00 00 01 00 02 20 03
			15 00 00 00 01 00 02 21 67
			15 00 00 00 01 00 02 22 03
			15 00 00 00 01 00 02 23 73
			15 00 00 00 01 00 02 24 03
			15 00 00 00 01 00 02 25 82
			15 00 00 00 01 00 02 26 03
			15 00 00 00 01 00 02 27 93
			15 00 00 00 01 00 02 28 03
			15 00 00 00 01 00 02 29 A7
			15 00 00 00 01 00 02 2A 03
			15 00 00 00 01 00 02 2B B8
			15 00 00 00 01 00 02 2D 03
			15 00 00 00 01 00 02 2F C3
			15 00 00 00 01 00 02 30 03
			15 00 00 00 01 00 02 31 FE

			15 00 00 00 01 00 02 32 00
			15 00 00 00 01 00 02 33 C8
			15 00 00 00 01 00 02 34 00
			15 00 00 00 01 00 02 35 D3
			15 00 00 00 01 00 02 36 00
			15 00 00 00 01 00 02 37 E8
			15 00 00 00 01 00 02 38 00
			15 00 00 00 01 00 02 39 FA
			15 00 00 00 01 00 02 3A 01
			15 00 00 00 01 00 02 3B 0B
			15 00 00 00 01 00 02 3D 01
			15 00 00 00 01 00 02 3F 19
			15 00 00 00 01 00 02 40 01
			15 00 00 00 01 00 02 41 27
			15 00 00 00 01 00 02 42 01
			15 00 00 00 01 00 02 43 34
			15 00 00 00 01 00 02 44 01
			15 00 00 00 01 00 02 45 3F
			15 00 00 00 01 00 02 46 01
			15 00 00 00 01 00 02 47 67
			15 00 00 00 01 00 02 48 01
			15 00 00 00 01 00 02 49 88
			15 00 00 00 01 00 02 4A 01
			15 00 00 00 01 00 02 4B BB
			15 00 00 00 01 00 02 4C 01
			15 00 00 00 01 00 02 4D E3
			15 00 00 00 01 00 02 4E 02
			15 00 00 00 01 00 02 4F 22
			15 00 00 00 01 00 02 50 02
			15 00 00 00 01 00 02 51 57
			15 00 00 00 01 00 02 52 02
			15 00 00 00 01 00 02 53 59
			15 00 00 00 01 00 02 54 02
			15 00 00 00 01 00 02 55 8C
			15 00 00 00 01 00 02 56 02
			15 00 00 00 01 00 02 58 C3
			15 00 00 00 01 00 02 59 02
			15 00 00 00 01 00 02 5A E2
			15 00 00 00 01 00 02 5B 03
			15 00 00 00 01 00 02 5C 0C
			15 00 00 00 01 00 02 5D 03
			15 00 00 00 01 00 02 5E 35
			15 00 00 00 01 00 02 5F 03
			15 00 00 00 01 00 02 60 5B
			15 00 00 00 01 00 02 61 03
			15 00 00 00 01 00 02 62 67
			15 00 00 00 01 00 02 63 03
			15 00 00 00 01 00 02 64 73
			15 00 00 00 01 00 02 65 03
			15 00 00 00 01 00 02 66 82
			15 00 00 00 01 00 02 67 03
			15 00 00 00 01 00 02 68 93
			15 00 00 00 01 00 02 69 03
			15 00 00 00 01 00 02 6A A7
			15 00 00 00 01 00 02 6B 03
			15 00 00 00 01 00 02 6C B8
			15 00 00 00 01 00 02 6D 03
			15 00 00 00 01 00 02 6E C3
			15 00 00 00 01 00 02 6F 03
			15 00 00 00 01 00 02 70 FE

			15 00 00 00 01 00 02 71 02
			15 00 00 00 01 00 02 72 19
			15 00 00 00 01 00 02 73 02
			15 00 00 00 01 00 02 74 1A
			15 00 00 00 01 00 02 75 02
			15 00 00 00 01 00 02 76 1C
			15 00 00 00 01 00 02 77 02
			15 00 00 00 01 00 02 78 1F
			15 00 00 00 01 00 02 79 02
			15 00 00 00 01 00 02 7A 21
			15 00 00 00 01 00 02 7B 02
			15 00 00 00 01 00 02 7C 23
			15 00 00 00 01 00 02 7D 02
			15 00 00 00 01 00 02 7E 25
			15 00 00 00 01 00 02 7F 02
			15 00 00 00 01 00 02 80 28
			15 00 00 00 01 00 02 81 02
			15 00 00 00 01 00 02 82 2A
			15 00 00 00 01 00 02 83 02
			15 00 00 00 01 00 02 84 32
			15 00 00 00 01 00 02 85 02
			15 00 00 00 01 00 02 86 3B
			15 00 00 00 01 00 02 87 02
			15 00 00 00 01 00 02 88 4C
			15 00 00 00 01 00 02 89 02
			15 00 00 00 01 00 02 8A 5C
			15 00 00 00 01 00 02 8B 02
			15 00 00 00 01 00 02 8C 7D
			15 00 00 00 01 00 02 8D 02
			15 00 00 00 01 00 02 8E 9F
			15 00 00 00 01 00 02 8F 02
			15 00 00 00 01 00 02 90 A0
			15 00 00 00 01 00 02 91 02
			15 00 00 00 01 00 02 92 C5
			15 00 00 00 01 00 02 93 02
			15 00 00 00 01 00 02 94 F0
			15 00 00 00 01 00 02 95 03
			15 00 00 00 01 00 02 96 0D
			15 00 00 00 01 00 02 97 03
			15 00 00 00 01 00 02 98 41
			15 00 00 00 01 00 02 99 03
			15 00 00 00 01 00 02 9A 5A
			15 00 00 00 01 00 02 9B 03
			15 00 00 00 01 00 02 9C 78
			15 00 00 00 01 00 02 9D 03
			15 00 00 00 01 00 02 9E 80
			15 00 00 00 01 00 02 9F 03
			15 00 00 00 01 00 02 A0 8A
			15 00 00 00 01 00 02 A2 03
			15 00 00 00 01 00 02 A3 94
			15 00 00 00 01 00 02 A4 03
			15 00 00 00 01 00 02 A5 9F
			15 00 00 00 01 00 02 A6 03
			15 00 00 00 01 00 02 A7 A9
			15 00 00 00 01 00 02 A9 03
			15 00 00 00 01 00 02 AA B2
			15 00 00 00 01 00 02 AB 03
			15 00 00 00 01 00 02 AC B7
			15 00 00 00 01 00 02 AD 03
			15 00 00 00 01 00 02 AE FE

			15 00 00 00 01 00 02 AF 02
			15 00 00 00 01 00 02 B0 19
			15 00 00 00 01 00 02 B1 02
			15 00 00 00 01 00 02 B2 1A
			15 00 00 00 01 00 02 B3 02
			15 00 00 00 01 00 02 B4 1C
			15 00 00 00 01 00 02 B5 02
			15 00 00 00 01 00 02 B6 1F
			15 00 00 00 01 00 02 B7 02
			15 00 00 00 01 00 02 B8 21
			15 00 00 00 01 00 02 B9 02
			15 00 00 00 01 00 02 BA 23
			15 00 00 00 01 00 02 BB 02
			15 00 00 00 01 00 02 BC 25
			15 00 00 00 01 00 02 BD 02
			15 00 00 00 01 00 02 BE 28
			15 00 00 00 01 00 02 BF 02
			15 00 00 00 01 00 02 C0 2A
			15 00 00 00 01 00 02 C1 02
			15 00 00 00 01 00 02 C2 32
			15 00 00 00 01 00 02 C3 02
			15 00 00 00 01 00 02 C4 3B
			15 00 00 00 01 00 02 C5 02
			15 00 00 00 01 00 02 C6 4C
			15 00 00 00 01 00 02 C7 02
			15 00 00 00 01 00 02 C8 5C
			15 00 00 00 01 00 02 C9 02
			15 00 00 00 01 00 02 CA 7D
			15 00 00 00 01 00 02 CB 02
			15 00 00 00 01 00 02 CC 9F
			15 00 00 00 01 00 02 CD 02
			15 00 00 00 01 00 02 CE A0
			15 00 00 00 01 00 02 CF 02
			15 00 00 00 01 00 02 D0 C5
			15 00 00 00 01 00 02 D1 02
			15 00 00 00 01 00 02 D2 F0
			15 00 00 00 01 00 02 D3 03
			15 00 00 00 01 00 02 D4 0D
			15 00 00 00 01 00 02 D5 03
			15 00 00 00 01 00 02 D6 41
			15 00 00 00 01 00 02 D7 03
			15 00 00 00 01 00 02 D8 5A
			15 00 00 00 01 00 02 D9 03
			15 00 00 00 01 00 02 DA 78
			15 00 00 00 01 00 02 DB 03
			15 00 00 00 01 00 02 DC 80
			15 00 00 00 01 00 02 DD 03
			15 00 00 00 01 00 02 DE 8A
			15 00 00 00 01 00 02 DF 03
			15 00 00 00 01 00 02 E0 94
			15 00 00 00 01 00 02 E1 03
			15 00 00 00 01 00 02 E2 9F
			15 00 00 00 01 00 02 E3 03
			15 00 00 00 01 00 02 E4 A9
			15 00 00 00 01 00 02 E5 03
			15 00 00 00 01 00 02 E6 B2
			15 00 00 00 01 00 02 E7 03
			15 00 00 00 01 00 02 E8 B7
			15 00 00 00 01 00 02 E9 03
			15 00 00 00 01 00 02 EA FE

			15 00 00 00 01 00 02 FB 01
			15 01 00 00 01 00 02 FF 10
			];
		qcom,mdss-dsi-dispparam-papermode7-state = "dsi_hs_mode";
	};
};
