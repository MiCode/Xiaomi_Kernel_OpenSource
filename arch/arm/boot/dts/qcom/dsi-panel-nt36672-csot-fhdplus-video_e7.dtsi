/* Copyright (c) 2012-2015, The Linux Foundation. All rights reserved.
 * Copyright (C) 2018 XiaoMi, Inc.
 *
 * This program is free software; you can redistribute it and/or modify
 * it under the terms of the GNU General Public License version 2 and
 * only version 2 as published by the Free Software Foundation.
 *
 * This program is distributed in the hope that it will be useful,
 * but WITHOUT ANY WARRANTY; without even the implied warranty of
 * MERCHANTABILITY or FITNESS FOR A PARTICULAR PURPOSE.  See the
 * GNU General Public License for more details.
 */

&mdss_mdp {
	dsi_nt36672_csot_fhdplus_e7_vid: qcom,mdss_dsi_nt36672_csot_fhdplus_video_e7 {
		qcom,mdss-dsi-panel-name = "nt36672 csot e7 fhdplus video mode dsi panel";
		qcom,mdss-dsi-panel-type = "dsi_video_mode";
		qcom,mdss-dsi-panel-framerate = <60>;
		qcom,mdss-dsi-virtual-channel-id = <0>;
		qcom,mdss-dsi-stream = <0>;
		qcom,mdss-dsi-panel-width = <1080>;
		qcom,mdss-dsi-panel-height = <2160>;
		qcom,mdss-dsi-h-front-porch = <108>;
		qcom,mdss-dsi-h-back-porch = <62>;
		qcom,mdss-dsi-h-pulse-width = <20>;
		qcom,mdss-dsi-h-sync-skew = <0>;
		qcom,mdss-dsi-v-back-porch = <8>;
		qcom,mdss-dsi-v-front-porch = <10>;
		qcom,mdss-dsi-v-pulse-width = <2>;
		qcom,mdss-dsi-h-left-border = <0>;
		qcom,mdss-dsi-h-right-border = <0>;
		qcom,mdss-dsi-v-top-border = <0>;
		qcom,mdss-dsi-v-bottom-border = <0>;
		qcom,mdss-dsi-bpp = <24>;
		qcom,mdss-dsi-underflow-color = <0xff>;
		qcom,mdss-dsi-border-color = <0>;
		qcom,mdss-white-command-00 = [
		39 01 00 00 00 00 02 FF 20             //Enter CMD2_P0
		39 00 00 00 00 00 02 AF 00             //R G B Gamma independent
		39 00 00 00 00 00 11 B0 00 00 00 11 00 30 00 4A 00 62 00 77 00 8B 00 9D
		39 00 00 00 00 00 11 B1 00 AD 00 E4 01 10 01 52 01 85 01 D2 02 10 02 12
		39 00 00 00 00 00 11 B2 02 4D 02 91 02 BD 02 F4 03 18 03 46 03 54 03 62
		39 00 00 00 00 00 0D B3 03 73 03 84 03 99 03 C1 03 D5 03 D9
		39 00 00 00 00 00 11 B4 00 00 00 11 00 30 00 4A 00 62 00 77 00 8B 00 9D
		39 00 00 00 00 00 11 B5 00 AD 00 E4 01 10 01 52 01 85 01 D2 02 10 02 12
		39 00 00 00 00 00 11 B6 02 4D 02 91 02 BD 02 F4 03 18 03 46 03 54 03 62
		39 00 00 00 00 00 0D B7 03 73 03 84 03 99 03 C1 03 D5 03 D9
		39 00 00 00 00 00 11 B8 00 00 00 11 00 30 00 4A 00 62 00 77 00 8B 00 9D
		39 00 00 00 00 00 11 B9 00 AD 00 E4 01 10 01 52 01 85 01 D2 02 10 02 12
		39 00 00 00 00 00 11 BA 02 4D 02 91 02 BD 02 F4 03 18 03 46 03 54 03 62
		39 00 00 00 00 00 0D BB 03 73 03 84 03 99 03 C1 03 D5 03 D9
		39 01 00 00 00 00 02 FB 01
		39 01 00 00 00 00 02 FF 21             //Enter CMD2_P1
		39 00 00 00 00 00 11 B0 00 00 00 11 00 30 00 4A 00 62 00 77 00 8B 00 9D
		39 00 00 00 00 00 11 B1 00 AD 00 E4 01 10 01 52 01 85 01 D2 02 10 02 12
		39 00 00 00 00 00 11 B2 02 4D 02 91 02 BD 02 F4 03 18 03 46 03 54 03 62
		39 00 00 00 00 00 0D B3 03 73 03 84 03 99 03 C1 03 D5 03 D9
		39 00 00 00 00 00 11 B4 00 00 00 11 00 30 00 4A 00 62 00 77 00 8B 00 9D
		39 00 00 00 00 00 11 B5 00 AD 00 E4 01 10 01 52 01 85 01 D2 02 10 02 12
		39 00 00 00 00 00 11 B6 02 4D 02 91 02 BD 02 F4 03 18 03 46 03 54 03 62
		39 00 00 00 00 00 0D B7 03 73 03 84 03 99 03 C1 03 D5 03 D9
		39 00 00 00 00 00 11 B8 00 00 00 11 00 30 00 4A 00 62 00 77 00 8B 00 9D
		39 00 00 00 00 00 11 B9 00 AD 00 E4 01 10 01 52 01 85 01 D2 02 10 02 12
		39 00 00 00 00 00 11 BA 02 4D 02 91 02 BD 02 F4 03 18 03 46 03 54 03 62
		39 00 00 00 00 00 0D BB 03 73 03 84 03 99 03 C1 03 D5 03 D9
		39 01 00 00 00 00 02 FB 01
		39 01 00 00 00 00 02 FF 10
		];
		qcom,mdss-dsi-on-command =
		[
		39 01 00 00 00 00 02 FF 25
		39 01 00 00 00 00 02 FB 01
		39 01 00 00 00 00 02 8D 04
		39 01 00 00 00 00 02 FF 20
		39 01 00 00 00 00 02 FB 01
		39 01 00 00 00 00 02 30 10
		39 01 00 00 00 00 02 31 50
		39 01 00 00 00 00 02 32 2F
		39 01 00 00 00 00 02 94 00
		39 01 00 00 00 00 02 95 E1
		39 01 00 00 00 00 02 96 E1
 		39 01 00 00 00 00 02 FF 20             //Enter CMD2_P0
 		39 01 00 00 00 00 02 FB 01
 		39 01 00 00 00 00 02 AF 00             //R G B Gamma independent
 		39 01 00 00 00 00 11 B0 00 00 00 11 00 30 00 4A 00 62 00 77 00 8B 00 9D
 		39 01 00 00 00 00 11 B1 00 AD 00 E4 01 10 01 52 01 85 01 D2 02 10 02 12
 		39 01 00 00 00 00 11 B2 02 4D 02 91 02 BD 02 F4 03 18 03 46 03 54 03 62
 		39 01 00 00 00 00 0D B3 03 73 03 84 03 99 03 C1 03 D5 03 D9
 		39 01 00 00 00 00 11 B4 00 00 00 11 00 30 00 4A 00 62 00 77 00 8B 00 9D
 		39 01 00 00 00 00 11 B5 00 AD 00 E4 01 10 01 52 01 85 01 D2 02 10 02 12
 		39 01 00 00 00 00 11 B6 02 4D 02 91 02 BD 02 F4 03 18 03 46 03 54 03 62
 		39 01 00 00 00 00 0D B7 03 73 03 84 03 99 03 C1 03 D5 03 D9
 		39 01 00 00 00 00 11 B8 00 00 00 11 00 30 00 4A 00 62 00 77 00 8B 00 9D
 		39 01 00 00 00 00 11 B9 00 AD 00 E4 01 10 01 52 01 85 01 D2 02 10 02 12
 		39 01 00 00 00 00 11 BA 02 4D 02 91 02 BD 02 F4 03 18 03 46 03 54 03 62
 		39 01 00 00 00 00 0D BB 03 73 03 84 03 99 03 C1 03 D5 03 D9
 		39 01 00 00 00 00 02 FF 21             //Enter CMD2_P1
 		39 01 00 00 00 00 02 FB 01
 		39 01 00 00 00 00 11 B0 00 00 00 11 00 30 00 4A 00 62 00 77 00 8B 00 9D
 		39 01 00 00 00 00 11 B1 00 AD 00 E4 01 10 01 52 01 85 01 D2 02 10 02 12
 		39 01 00 00 00 00 11 B2 02 4D 02 91 02 BD 02 F4 03 18 03 46 03 54 03 62
 		39 01 00 00 00 00 0D B3 03 73 03 84 03 99 03 C1 03 D5 03 D9
 		39 01 00 00 00 00 11 B4 00 00 00 11 00 30 00 4A 00 62 00 77 00 8B 00 9D
 		39 01 00 00 00 00 11 B5 00 AD 00 E4 01 10 01 52 01 85 01 D2 02 10 02 12
 		39 01 00 00 00 00 11 B6 02 4D 02 91 02 BD 02 F4 03 18 03 46 03 54 03 62
 		39 01 00 00 00 00 0D B7 03 73 03 84 03 99 03 C1 03 D5 03 D9
 		39 01 00 00 00 00 11 B8 00 00 00 11 00 30 00 4A 00 62 00 77 00 8B 00 9D
 		39 01 00 00 00 00 11 B9 00 AD 00 E4 01 10 01 52 01 85 01 D2 02 10 02 12
 		39 01 00 00 00 00 11 BA 02 4D 02 91 02 BD 02 F4 03 18 03 46 03 54 03 62
 		39 01 00 00 00 00 0D BB 03 73 03 84 03 99 03 C1 03 D5 03 D9
		39 01 00 00 00 00 02 FF 10
		39 01 00 00 00 00 02 FB 01
		39 01 00 00 00 00 02 51 FF
		39 01 00 00 00 00 02 53 24
		39 01 00 00 00 00 02 55 00
		39 01 00 00 00 00 02 FF F0
		39 01 00 00 00 00 02 5A 02
		39 01 00 00 00 00 02 FF 10
		39 01 00 00 00 00 02 36 00
		39 01 00 00 00 00 02 35 00
		05 01 00 00 78 00 02 11 00
		05 01 00 00 14 00 02 29 00
		];
		qcom,mdss-white-command-01 = [
		39 01 00 00 00 00 02 FF 20       //Enter CMD2_P0
		39 00 00 00 00 00 02 AF 00       //R G B Gamma independent
		39 00 00 00 00 00 11 B0 00 C0 00 C6 00 D3 00 DE 00 E9 00 F3 00 FD 01 07
		39 00 00 00 00 00 11 B1 01 10 01 30 01 4D 01 7D 01 A5 01 E5 02 1B 02 1D
		39 00 00 00 00 00 11 B2 02 56 02 99 02 C5 02 FA 03 1E 03 4C 03 58 03 66
		39 00 00 00 00 00 0D B3 03 75 03 87 03 9C 03 B6 03 D2 03 D7
		39 00 00 00 00 00 11 B4 00 09 00 19 00 35 00 4D 00 64 00 78 00 8A 00 9B
		39 00 00 00 00 00 11 B5 00 AA 00 DF 01 0B 01 4B 01 7D 01 CB 02 06 02 08
		39 00 00 00 00 00 11 B6 02 45 02 8A 02 B7 02 EF 03 10 03 42 03 4F 03 5E
		39 00 00 00 00 00 0D B7 03 6E 03 81 03 97 03 B2 03 D1 03 D7
		39 00 00 00 00 00 11 B8 00 DF 00 E4 00 EF 00 F9 01 03 01 0C 01 15 01 1D
		39 00 00 00 00 00 11 B9 01 25 01 42 01 5D 01 88 01 AD 01 EA 02 1E 02 20
		39 00 00 00 00 00 11 BA 02 59 02 9C 02 C9 03 00 03 2B 03 66 03 7A 03 89
		39 00 00 00 00 00 0D BB 03 8B 03 8F 03 A4 03 BC 03 D2 03 D7
		39 01 00 00 00 00 02 FB 01
		39 01 00 00 00 00 02 FF 21       //Enter CMD2_P1
		39 00 00 00 00 00 11 B0 00 C0 00 C6 00 D3 00 DE 00 E9 00 F3 00 FD 01 07
		39 00 00 00 00 00 11 B1 01 10 01 30 01 4D 01 7D 01 A5 01 E5 02 1B 02 1D
		39 00 00 00 00 00 11 B2 02 56 02 99 02 C5 02 FA 03 1E 03 4C 03 58 03 66
		39 00 00 00 00 00 0D B3 03 75 03 87 03 9C 03 B6 03 D2 03 D7
		39 00 00 00 00 00 11 B4 00 09 00 19 00 35 00 4D 00 64 00 78 00 8A 00 9B
		39 00 00 00 00 00 11 B5 00 AA 00 DF 01 0B 01 4B 01 7D 01 CB 02 06 02 08
		39 00 00 00 00 00 11 B6 02 45 02 8A 02 B7 02 EF 03 10 03 42 03 4F 03 5E
		39 00 00 00 00 00 0D B7 03 6E 03 81 03 97 03 B2 03 D1 03 D7
		39 00 00 00 00 00 11 B8 00 DF 00 E4 00 EF 00 F9 01 03 01 0C 01 15 01 1D
		39 00 00 00 00 00 11 B9 01 25 01 42 01 5D 01 88 01 AD 01 EA 02 1E 02 20
		39 00 00 00 00 00 11 BA 02 59 02 9C 02 C9 03 00 03 2B 03 66 03 7A 03 89
		39 00 00 00 00 00 0D BB 03 8B 03 8F 03 A4 03 BC 03 D2 03 D7
		39 01 00 00 00 00 02 FB 01
		39 01 00 00 00 00 02 FF 10
		];
		qcom,mdss-dsi-on-command-01 =
		[
		39 01 00 00 00 00 02 FF 25
		39 01 00 00 00 00 02 FB 01
		39 01 00 00 00 00 02 8D 04
		39 01 00 00 00 00 02 FF 20
		39 01 00 00 00 00 02 FB 01
		39 01 00 00 00 00 02 30 10
		39 01 00 00 00 00 02 31 50
		39 01 00 00 00 00 02 32 2F
		39 01 00 00 00 00 02 94 00
		39 01 00 00 00 00 02 95 E1
		39 01 00 00 00 00 02 96 E1
 		39 01 00 00 00 00 02 FF 20       //Enter CMD2_P0
 		39 01 00 00 00 00 02 FB 01
 		39 01 00 00 00 00 02 AF 00       //R G B Gamma independent
 		39 01 00 00 00 00 11 B0 00 C0 00 C6 00 D3 00 DE 00 E9 00 F3 00 FD 01 07
 		39 01 00 00 00 00 11 B1 01 10 01 30 01 4D 01 7D 01 A5 01 E5 02 1B 02 1D
 		39 01 00 00 00 00 11 B2 02 56 02 99 02 C5 02 FA 03 1E 03 4C 03 58 03 66
 		39 01 00 00 00 00 0D B3 03 75 03 87 03 9C 03 B6 03 D2 03 D7
 		39 01 00 00 00 00 11 B4 00 09 00 19 00 35 00 4D 00 64 00 78 00 8A 00 9B
 		39 01 00 00 00 00 11 B5 00 AA 00 DF 01 0B 01 4B 01 7D 01 CB 02 06 02 08
 		39 01 00 00 00 00 11 B6 02 45 02 8A 02 B7 02 EF 03 10 03 42 03 4F 03 5E
 		39 01 00 00 00 00 0D B7 03 6E 03 81 03 97 03 B2 03 D1 03 D7
 		39 01 00 00 00 00 11 B8 00 DF 00 E4 00 EF 00 F9 01 03 01 0C 01 15 01 1D
 		39 01 00 00 00 00 11 B9 01 25 01 42 01 5D 01 88 01 AD 01 EA 02 1E 02 20
 		39 01 00 00 00 00 11 BA 02 59 02 9C 02 C9 03 00 03 2B 03 66 03 7A 03 89
 		39 01 00 00 00 00 0D BB 03 8B 03 8F 03 A4 03 BC 03 D2 03 D7
 		39 01 00 00 00 00 02 FF 21       //Enter CMD2_P1
 		39 01 00 00 00 00 02 FB 01
 		39 01 00 00 00 00 11 B0 00 C0 00 C6 00 D3 00 DE 00 E9 00 F3 00 FD 01 07
 		39 01 00 00 00 00 11 B1 01 10 01 30 01 4D 01 7D 01 A5 01 E5 02 1B 02 1D
 		39 01 00 00 00 00 11 B2 02 56 02 99 02 C5 02 FA 03 1E 03 4C 03 58 03 66
 		39 01 00 00 00 00 0D B3 03 75 03 87 03 9C 03 B6 03 D2 03 D7
 		39 01 00 00 00 00 11 B4 00 09 00 19 00 35 00 4D 00 64 00 78 00 8A 00 9B
 		39 01 00 00 00 00 11 B5 00 AA 00 DF 01 0B 01 4B 01 7D 01 CB 02 06 02 08
 		39 01 00 00 00 00 11 B6 02 45 02 8A 02 B7 02 EF 03 10 03 42 03 4F 03 5E
 		39 01 00 00 00 00 0D B7 03 6E 03 81 03 97 03 B2 03 D1 03 D7
 		39 01 00 00 00 00 11 B8 00 DF 00 E4 00 EF 00 F9 01 03 01 0C 01 15 01 1D
 		39 01 00 00 00 00 11 B9 01 25 01 42 01 5D 01 88 01 AD 01 EA 02 1E 02 20
 		39 01 00 00 00 00 11 BA 02 59 02 9C 02 C9 03 00 03 2B 03 66 03 7A 03 89
 		39 01 00 00 00 00 0D BB 03 8B 03 8F 03 A4 03 BC 03 D2 03 D7
		39 01 00 00 00 00 02 FF 10
		39 01 00 00 00 00 02 FB 01
		39 01 00 00 00 00 02 51 FF
		39 01 00 00 00 00 02 53 24
		39 01 00 00 00 00 02 55 00
		39 01 00 00 00 00 02 FF F0
		39 01 00 00 00 00 02 5A 02
		39 01 00 00 00 00 02 FF 10
		39 01 00 00 00 00 02 36 00
		39 01 00 00 00 00 02 35 00
		05 01 00 00 78 00 02 11 00
		05 01 00 00 14 00 02 29 00
		];
		qcom,mdss-white-command-02 = [
		39 01 00 00 00 00 02 FF 20       //Enter CMD2_P0
		39 00 00 00 00 00 02 AF 00       //R G B Gamma independent
		39 00 00 00 00 00 11 B0 00 39 00 46 00 5D 00 72 00 86 00 97 00 A8 00 B7
		39 00 00 00 00 00 11 B1 00 C6 00 F8 01 20 01 5E 01 8E 01 D8 02 14 02 15
		39 00 00 00 00 00 11 B2 02 50 02 93 02 BF 02 F5 03 16 03 46 03 54 03 62
		39 00 00 00 00 00 0D B3 03 72 03 84 03 9A 03 B4 03 D1 03 D7
		39 00 00 00 00 00 11 B4 00 09 00 1A 00 35 00 50 00 66 00 7A 00 8B 00 9D
		39 00 00 00 00 00 11 B5 00 AF 00 E3 01 11 01 50 01 82 01 D1 02 0D 02 0E
		39 00 00 00 00 00 11 B6 02 4A 02 8D 02 BA 02 F1 03 11 03 44 03 51 03 5F
		39 00 00 00 00 00 0D B7 03 6F 03 82 03 98 03 B3 03 D1 03 D7
		39 00 00 00 00 00 11 B8 00 81 00 8B 00 9C 00 AE 00 BD 00 CB 00 D7 00 E4
		39 00 00 00 00 00 11 B9 00 F1 01 18 01 3C 01 70 01 9B 01 E1 02 19 02 1A
		39 00 00 00 00 00 11 BA 02 54 02 97 02 C4 02 FC 03 26 03 61 03 75 03 81
		39 00 00 00 00 00 0D BB 03 84 03 86 03 97 03 AB 03 CE 03 D7
		39 01 00 00 00 00 02 FB 01
		39 01 00 00 00 00 02 FF 21       //Enter CMD2_P1
		39 00 00 00 00 00 11 B0 00 39 00 46 00 5D 00 72 00 86 00 97 00 A8 00 B7
		39 00 00 00 00 00 11 B1 00 C6 00 F8 01 20 01 5E 01 8E 01 D8 02 14 02 15
		39 00 00 00 00 00 11 B2 02 50 02 93 02 BF 02 F5 03 16 03 46 03 54 03 62
		39 00 00 00 00 00 0D B3 03 72 03 84 03 9A 03 B4 03 D1 03 D7
		39 00 00 00 00 00 11 B4 00 09 00 1A 00 35 00 50 00 66 00 7A 00 8B 00 9D
		39 00 00 00 00 00 11 B5 00 AF 00 E3 01 11 01 50 01 82 01 D1 02 0D 02 0E
		39 00 00 00 00 00 11 B6 02 4A 02 8D 02 BA 02 F1 03 11 03 44 03 51 03 5F
		39 00 00 00 00 00 0D B7 03 6F 03 82 03 98 03 B3 03 D1 03 D7
		39 00 00 00 00 00 11 B8 00 81 00 8B 00 9C 00 AE 00 BD 00 CB 00 D7 00 E4
		39 00 00 00 00 00 11 B9 00 F1 01 18 01 3C 01 70 01 9B 01 E1 02 19 02 1A
		39 00 00 00 00 00 11 BA 02 54 02 97 02 C4 02 FC 03 26 03 61 03 75 03 81
		39 00 00 00 00 00 0D BB 03 84 03 86 03 97 03 AB 03 CE 03 D7
		39 01 00 00 00 00 02 FB 01
		39 01 00 00 00 00 02 FF 10
		];
		qcom,mdss-dsi-on-command-02 =
		[
		39 01 00 00 00 00 02 FF 25
		39 01 00 00 00 00 02 FB 01
		39 01 00 00 00 00 02 8D 04
		39 01 00 00 00 00 02 FF 20
		39 01 00 00 00 00 02 FB 01
		39 01 00 00 00 00 02 30 10
		39 01 00 00 00 00 02 31 50
		39 01 00 00 00 00 02 32 2F
		39 01 00 00 00 00 02 94 00
		39 01 00 00 00 00 02 95 E1
		39 01 00 00 00 00 02 96 E1
 		39 01 00 00 00 00 02 FF 20       //Enter CMD2_P0
 		39 01 00 00 00 00 02 FB 01
 		39 01 00 00 00 00 02 AF 00       //R G B Gamma independent
 		39 01 00 00 00 00 11 B0 00 39 00 46 00 5D 00 72 00 86 00 97 00 A8 00 B7
 		39 01 00 00 00 00 11 B1 00 C6 00 F8 01 20 01 5E 01 8E 01 D8 02 14 02 15
 		39 01 00 00 00 00 11 B2 02 50 02 93 02 BF 02 F5 03 16 03 46 03 54 03 62
 		39 01 00 00 00 00 0D B3 03 72 03 84 03 9A 03 B4 03 D1 03 D7
 		39 01 00 00 00 00 11 B4 00 09 00 1A 00 35 00 50 00 66 00 7A 00 8B 00 9D
 		39 01 00 00 00 00 11 B5 00 AF 00 E3 01 11 01 50 01 82 01 D1 02 0D 02 0E
 		39 01 00 00 00 00 11 B6 02 4A 02 8D 02 BA 02 F1 03 11 03 44 03 51 03 5F
 		39 01 00 00 00 00 0D B7 03 6F 03 82 03 98 03 B3 03 D1 03 D7
 		39 01 00 00 00 00 11 B8 00 81 00 8B 00 9C 00 AE 00 BD 00 CB 00 D7 00 E4
 		39 01 00 00 00 00 11 B9 00 F1 01 18 01 3C 01 70 01 9B 01 E1 02 19 02 1A
 		39 01 00 00 00 00 11 BA 02 54 02 97 02 C4 02 FC 03 26 03 61 03 75 03 81
 		39 01 00 00 00 00 0D BB 03 84 03 86 03 97 03 AB 03 CE 03 D7
 		39 01 00 00 00 00 02 FF 21       //Enter CMD2_P1
 		39 01 00 00 00 00 02 FB 01
 		39 01 00 00 00 00 11 B0 00 39 00 46 00 5D 00 72 00 86 00 97 00 A8 00 B7
 		39 01 00 00 00 00 11 B1 00 C6 00 F8 01 20 01 5E 01 8E 01 D8 02 14 02 15
 		39 01 00 00 00 00 11 B2 02 50 02 93 02 BF 02 F5 03 16 03 46 03 54 03 62
 		39 01 00 00 00 00 0D B3 03 72 03 84 03 9A 03 B4 03 D1 03 D7
 		39 01 00 00 00 00 11 B4 00 09 00 1A 00 35 00 50 00 66 00 7A 00 8B 00 9D
 		39 01 00 00 00 00 11 B5 00 AF 00 E3 01 11 01 50 01 82 01 D1 02 0D 02 0E
 		39 01 00 00 00 00 11 B6 02 4A 02 8D 02 BA 02 F1 03 11 03 44 03 51 03 5F
 		39 01 00 00 00 00 0D B7 03 6F 03 82 03 98 03 B3 03 D1 03 D7
 		39 01 00 00 00 00 11 B8 00 81 00 8B 00 9C 00 AE 00 BD 00 CB 00 D7 00 E4
 		39 01 00 00 00 00 11 B9 00 F1 01 18 01 3C 01 70 01 9B 01 E1 02 19 02 1A
 		39 01 00 00 00 00 11 BA 02 54 02 97 02 C4 02 FC 03 26 03 61 03 75 03 81
 		39 01 00 00 00 00 0D BB 03 84 03 86 03 97 03 AB 03 CE 03 D7
		39 01 00 00 00 00 02 FF 10
		39 01 00 00 00 00 02 FB 01
		39 01 00 00 00 00 02 51 FF
		39 01 00 00 00 00 02 53 24
		39 01 00 00 00 00 02 55 00
		39 01 00 00 00 00 02 FF F0
		39 01 00 00 00 00 02 5A 02
		39 01 00 00 00 00 02 FF 10
		39 01 00 00 00 00 02 36 00
		39 01 00 00 00 00 02 35 00
		05 01 00 00 78 00 02 11 00
		05 01 00 00 14 00 02 29 00
		];
		qcom,mdss-white-command-03 = [
		39 01 00 00 00 00 02 FF 20       //Enter CMD2_P0
		39 00 00 00 00 00 02 AF 00       //R G B Gamma independent
		39 00 00 00 00 00 11 B0 00 0B 00 1C 00 38 00 50 00 66 00 79 00 8C 00 9D
		39 00 00 00 00 00 11 B1 00 AD 00 E3 01 0E 01 51 01 83 01 D0 02 0B 02 0E
		39 00 00 00 00 00 11 B2 02 49 02 8E 02 BB 02 F0 03 11 03 41 03 4D 03 61
		39 00 00 00 00 00 0D B3 03 71 03 84 03 9A 03 B5 03 D2 03 D7
		39 00 00 00 00 00 11 B4 00 75 00 7F 00 91 00 A1 00 B1 00 BF 00 CC 00 D9
		39 00 00 00 00 00 11 B5 00 E5 01 0E 01 30 01 68 01 94 01 DA 02 12 02 14
		39 00 00 00 00 00 11 B6 02 4E 02 92 02 BE 02 F3 03 15 03 46 03 53 03 62
		39 00 00 00 00 00 0D B7 03 72 03 84 03 9B 03 B7 03 D2 03 D7
		39 00 00 00 00 00 11 B8 00 0B 00 1B 00 39 00 54 00 6C 00 81 00 95 00 A6
		39 00 00 00 00 00 11 B9 00 B6 00 EC 01 16 01 57 01 88 01 D3 02 0D 02 10
		39 00 00 00 00 00 11 BA 02 4A 02 90 02 BD 02 F4 03 1B 03 53 03 66 03 86
		39 00 00 00 00 00 0D BB 03 9B 03 9D 03 9F 03 B8 03 D2 03 D7
		39 01 00 00 00 00 02 FB 01
		39 01 00 00 00 00 02 FF 21       //Enter CMD2_P1
		39 00 00 00 00 00 11 B0 00 0B 00 1C 00 38 00 50 00 66 00 79 00 8C 00 9D
		39 00 00 00 00 00 11 B1 00 AD 00 E3 01 0E 01 51 01 83 01 D0 02 0B 02 0E
		39 00 00 00 00 00 11 B2 02 49 02 8E 02 BB 02 F0 03 11 03 41 03 4D 03 61
		39 00 00 00 00 00 0D B3 03 71 03 84 03 9A 03 B5 03 D2 03 D7
		39 00 00 00 00 00 11 B4 00 75 00 7F 00 91 00 A1 00 B1 00 BF 00 CC 00 D9
		39 00 00 00 00 00 11 B5 00 E5 01 0E 01 30 01 68 01 94 01 DA 02 12 02 14
		39 00 00 00 00 00 11 B6 02 4E 02 92 02 BE 02 F3 03 15 03 46 03 53 03 62
		39 00 00 00 00 00 0D B7 03 72 03 84 03 9B 03 B7 03 D2 03 D7
		39 00 00 00 00 00 11 B8 00 0B 00 1B 00 39 00 54 00 6C 00 81 00 95 00 A6
		39 00 00 00 00 00 11 B9 00 B6 00 EC 01 16 01 57 01 88 01 D3 02 0D 02 10
		39 00 00 00 00 00 11 BA 02 4A 02 90 02 BD 02 F4 03 1B 03 53 03 66 03 86
		39 00 00 00 00 00 0D BB 03 9B 03 9D 03 9F 03 B8 03 D2 03 D7
		39 01 00 00 00 00 02 FB 01
		39 01 00 00 00 00 02 FF 10
		];
		qcom,mdss-dsi-on-command-03 =
		[
		39 01 00 00 00 00 02 FF 25
		39 01 00 00 00 00 02 FB 01
		39 01 00 00 00 00 02 8D 04
		39 01 00 00 00 00 02 FF 20
		39 01 00 00 00 00 02 FB 01
		39 01 00 00 00 00 02 30 10
		39 01 00 00 00 00 02 31 50
		39 01 00 00 00 00 02 32 2F
		39 01 00 00 00 00 02 94 00
		39 01 00 00 00 00 02 95 E1
		39 01 00 00 00 00 02 96 E1
 		39 01 00 00 00 00 02 FF 20       //Enter CMD2_P0
 		39 01 00 00 00 00 02 FB 01
 		39 01 00 00 00 00 02 AF 00       //R G B Gamma independent
 		39 01 00 00 00 00 11 B0 00 0B 00 1C 00 38 00 50 00 66 00 79 00 8C 00 9D
 		39 01 00 00 00 00 11 B1 00 AD 00 E3 01 0E 01 51 01 83 01 D0 02 0B 02 0E
 		39 01 00 00 00 00 11 B2 02 49 02 8E 02 BB 02 F0 03 11 03 41 03 4D 03 61
 		39 01 00 00 00 00 0D B3 03 71 03 84 03 9A 03 B5 03 D2 03 D7
 		39 01 00 00 00 00 11 B4 00 75 00 7F 00 91 00 A1 00 B1 00 BF 00 CC 00 D9
 		39 01 00 00 00 00 11 B5 00 E5 01 0E 01 30 01 68 01 94 01 DA 02 12 02 14
 		39 01 00 00 00 00 11 B6 02 4E 02 92 02 BE 02 F3 03 15 03 46 03 53 03 62
 		39 01 00 00 00 00 0D B7 03 72 03 84 03 9B 03 B7 03 D2 03 D7
 		39 01 00 00 00 00 11 B8 00 0B 00 1B 00 39 00 54 00 6C 00 81 00 95 00 A6
 		39 01 00 00 00 00 11 B9 00 B6 00 EC 01 16 01 57 01 88 01 D3 02 0D 02 10
 		39 01 00 00 00 00 11 BA 02 4A 02 90 02 BD 02 F4 03 1B 03 53 03 66 03 86
 		39 01 00 00 00 00 0D BB 03 9B 03 9D 03 9F 03 B8 03 D2 03 D7
 		39 01 00 00 00 00 02 FF 21       //Enter CMD2_P1
 		39 01 00 00 00 00 02 FB 01
 		39 01 00 00 00 00 11 B0 00 0B 00 1C 00 38 00 50 00 66 00 79 00 8C 00 9D
 		39 01 00 00 00 00 11 B1 00 AD 00 E3 01 0E 01 51 01 83 01 D0 02 0B 02 0E
 		39 01 00 00 00 00 11 B2 02 49 02 8E 02 BB 02 F0 03 11 03 41 03 4D 03 61
 		39 01 00 00 00 00 0D B3 03 71 03 84 03 9A 03 B5 03 D2 03 D7
 		39 01 00 00 00 00 11 B4 00 75 00 7F 00 91 00 A1 00 B1 00 BF 00 CC 00 D9
 		39 01 00 00 00 00 11 B5 00 E5 01 0E 01 30 01 68 01 94 01 DA 02 12 02 14
 		39 01 00 00 00 00 11 B6 02 4E 02 92 02 BE 02 F3 03 15 03 46 03 53 03 62
 		39 01 00 00 00 00 0D B7 03 72 03 84 03 9B 03 B7 03 D2 03 D7
 		39 01 00 00 00 00 11 B8 00 0B 00 1B 00 39 00 54 00 6C 00 81 00 95 00 A6
 		39 01 00 00 00 00 11 B9 00 B6 00 EC 01 16 01 57 01 88 01 D3 02 0D 02 10
 		39 01 00 00 00 00 11 BA 02 4A 02 90 02 BD 02 F4 03 1B 03 53 03 66 03 86
 		39 01 00 00 00 00 0D BB 03 9B 03 9D 03 9F 03 B8 03 D2 03 D7
		39 01 00 00 00 00 02 FF 10
		39 01 00 00 00 00 02 FB 01
		39 01 00 00 00 00 02 51 FF
		39 01 00 00 00 00 02 53 24
		39 01 00 00 00 00 02 55 00
		39 01 00 00 00 00 02 FF F0
		39 01 00 00 00 00 02 5A 02
		39 01 00 00 00 00 02 FF 10
		39 01 00 00 00 00 02 36 00
		39 01 00 00 00 00 02 35 00
		05 01 00 00 78 00 02 11 00
		05 01 00 00 14 00 02 29 00
		];
		qcom,mdss-white-command-04 = [
		39 01 00 00 00 00 02 FF 20       //Enter CMD2_P0
		39 00 00 00 00 00 02 AF 00       //R G B Gamma independent
		39 00 00 00 00 00 11 B0 00 09 00 19 00 35 00 4E 00 65 00 79 00 8C 00 9D
		39 00 00 00 00 00 11 B1 00 AD 00 E5 01 11 01 56 01 88 01 D5 02 11 02 12
		39 00 00 00 00 00 11 B2 02 4F 02 93 02 BE 02 F5 03 17 03 42 03 4E 03 61
		39 00 00 00 00 00 0D B3 03 72 03 87 03 9E 03 BA 03 D3 03 D7
		39 00 00 00 00 00 11 B4 00 C6 00 CD 00 D9 00 E5 00 F0 00 FB 01 05 01 0E
		39 00 00 00 00 00 11 B5 01 17 01 38 01 54 01 84 01 AB 01 EA 02 20 02 21
		39 00 00 00 00 00 11 B6 02 5A 02 9C 02 C7 02 FD 03 21 03 4C 03 59 03 67
		39 00 00 00 00 00 0D B7 03 76 03 88 03 9E 03 B8 03 D2 03 D7
		39 00 00 00 00 00 11 B8 00 11 00 23 00 41 00 5B 00 73 00 88 00 9B 00 AC
		39 00 00 00 00 00 11 B9 00 BC 00 F3 01 1D 01 5F 01 8F 01 D9 02 14 02 15
		39 00 00 00 00 00 11 BA 02 51 02 95 02 C1 02 FA 03 23 03 59 03 6D 03 95
		39 00 00 00 00 00 0D BB 03 B8 03 BA 03 BC 03 BE 03 D2 03 D7
		39 01 00 00 00 00 02 FB 01
		39 01 00 00 00 00 02 FF 21       //Enter CMD2_P1
		39 00 00 00 00 00 11 B0 00 09 00 19 00 35 00 4E 00 65 00 79 00 8C 00 9D
		39 00 00 00 00 00 11 B1 00 AD 00 E5 01 11 01 56 01 88 01 D5 02 11 02 12
		39 00 00 00 00 00 11 B2 02 4F 02 93 02 BE 02 F5 03 17 03 42 03 4E 03 61
		39 00 00 00 00 00 0D B3 03 72 03 87 03 9E 03 BA 03 D3 03 D7
		39 00 00 00 00 00 11 B4 00 C6 00 CD 00 D9 00 E5 00 F0 00 FB 01 05 01 0E
		39 00 00 00 00 00 11 B5 01 17 01 38 01 54 01 84 01 AB 01 EA 02 20 02 21
		39 00 00 00 00 00 11 B6 02 5A 02 9C 02 C7 02 FD 03 21 03 4C 03 59 03 67
		39 00 00 00 00 00 0D B7 03 76 03 88 03 9E 03 B8 03 D2 03 D7
		39 00 00 00 00 00 11 B8 00 11 00 23 00 41 00 5B 00 73 00 88 00 9B 00 AC
		39 00 00 00 00 00 11 B9 00 BC 00 F3 01 1D 01 5F 01 8F 01 D9 02 14 02 15
		39 00 00 00 00 00 11 BA 02 51 02 95 02 C1 02 FA 03 23 03 59 03 6D 03 95
		39 00 00 00 00 00 0D BB 03 B8 03 BA 03 BC 03 BE 03 D2 03 D7
		39 01 00 00 00 00 02 FB 01
		39 01 00 00 00 00 02 FF 10
		];
		qcom,mdss-dsi-on-command-04 =
		[
		39 01 00 00 00 00 02 FF 25
		39 01 00 00 00 00 02 FB 01
		39 01 00 00 00 00 02 8D 04
		39 01 00 00 00 00 02 FF 20
		39 01 00 00 00 00 02 FB 01
		39 01 00 00 00 00 02 30 10
		39 01 00 00 00 00 02 31 50
		39 01 00 00 00 00 02 32 2F
		39 01 00 00 00 00 02 94 00
		39 01 00 00 00 00 02 95 E1
		39 01 00 00 00 00 02 96 E1
 		39 01 00 00 00 00 02 FF 20       //Enter CMD2_P0
 		39 01 00 00 00 00 02 FB 01
 		39 01 00 00 00 00 02 AF 00       //R G B Gamma independent
 		39 01 00 00 00 00 11 B0 00 09 00 19 00 35 00 4E 00 65 00 79 00 8C 00 9D
 		39 01 00 00 00 00 11 B1 00 AD 00 E5 01 11 01 56 01 88 01 D5 02 11 02 12
 		39 01 00 00 00 00 11 B2 02 4F 02 93 02 BE 02 F5 03 17 03 42 03 4E 03 61
 		39 01 00 00 00 00 0D B3 03 72 03 87 03 9E 03 BA 03 D3 03 D7
 		39 01 00 00 00 00 11 B4 00 C6 00 CD 00 D9 00 E5 00 F0 00 FB 01 05 01 0E
 		39 01 00 00 00 00 11 B5 01 17 01 38 01 54 01 84 01 AB 01 EA 02 20 02 21
 		39 01 00 00 00 00 11 B6 02 5A 02 9C 02 C7 02 FD 03 21 03 4C 03 59 03 67
 		39 01 00 00 00 00 0D B7 03 76 03 88 03 9E 03 B8 03 D2 03 D7
 		39 01 00 00 00 00 11 B8 00 11 00 23 00 41 00 5B 00 73 00 88 00 9B 00 AC
 		39 01 00 00 00 00 11 B9 00 BC 00 F3 01 1D 01 5F 01 8F 01 D9 02 14 02 15
 		39 01 00 00 00 00 11 BA 02 51 02 95 02 C1 02 FA 03 23 03 59 03 6D 03 95
 		39 01 00 00 00 00 0D BB 03 B8 03 BA 03 BC 03 BE 03 D2 03 D7
 		39 01 00 00 00 00 02 FF 21       //Enter CMD2_P1
 		39 01 00 00 00 00 02 FB 01
 		39 01 00 00 00 00 11 B0 00 09 00 19 00 35 00 4E 00 65 00 79 00 8C 00 9D
 		39 01 00 00 00 00 11 B1 00 AD 00 E5 01 11 01 56 01 88 01 D5 02 11 02 12
 		39 01 00 00 00 00 11 B2 02 4F 02 93 02 BE 02 F5 03 17 03 42 03 4E 03 61
 		39 01 00 00 00 00 0D B3 03 72 03 87 03 9E 03 BA 03 D3 03 D7
 		39 01 00 00 00 00 11 B4 00 C6 00 CD 00 D9 00 E5 00 F0 00 FB 01 05 01 0E
 		39 01 00 00 00 00 11 B5 01 17 01 38 01 54 01 84 01 AB 01 EA 02 20 02 21
 		39 01 00 00 00 00 11 B6 02 5A 02 9C 02 C7 02 FD 03 21 03 4C 03 59 03 67
 		39 01 00 00 00 00 0D B7 03 76 03 88 03 9E 03 B8 03 D2 03 D7
 		39 01 00 00 00 00 11 B8 00 11 00 23 00 41 00 5B 00 73 00 88 00 9B 00 AC
 		39 01 00 00 00 00 11 B9 00 BC 00 F3 01 1D 01 5F 01 8F 01 D9 02 14 02 15
 		39 01 00 00 00 00 11 BA 02 51 02 95 02 C1 02 FA 03 23 03 59 03 6D 03 95
 		39 01 00 00 00 00 0D BB 03 B8 03 BA 03 BC 03 BE 03 D2 03 D7
		39 01 00 00 00 00 02 FF 10
		39 01 00 00 00 00 02 FB 01
		39 01 00 00 00 00 02 51 FF
		39 01 00 00 00 00 02 53 24
		39 01 00 00 00 00 02 55 00
		39 01 00 00 00 00 02 FF F0
		39 01 00 00 00 00 02 5A 02
		39 01 00 00 00 00 02 FF 10
		39 01 00 00 00 00 02 36 00
		39 01 00 00 00 00 02 35 00
		05 01 00 00 78 00 02 11 00
		05 01 00 00 14 00 02 29 00
		];
		qcom,mdss-white-command-05 = [
		39 01 00 00 00 00 02 FF 20       //Enter CMD2_P0
		39 00 00 00 00 00 02 AF 00       //R G B Gamma independent
		39 00 00 00 00 00 11 B0 00 0A 00 1A 00 37 00 4E 00 66 00 79 00 8B 00 9D
		39 00 00 00 00 00 11 B1 00 AC 00 E2 01 0D 01 4E 01 82 01 CD 02 0A 02 0C
		39 00 00 00 00 00 11 B2 02 47 02 8C 02 B8 02 EF 03 0F 03 3D 03 4E 03 5D
		39 00 00 00 00 00 0D B3 03 6F 03 82 03 98 03 B4 03 D2 03 D7
		39 00 00 00 00 00 11 B4 01 07 01 0B 01 14 01 1C 01 24 01 2B 01 32 01 39
		39 00 00 00 00 00 11 B5 01 40 01 59 01 6F 01 96 01 B8 01 F1 02 24 02 26
		39 00 00 00 00 00 11 B6 02 5C 02 9E 02 C9 02 FD 03 22 03 4D 03 5A 03 68
		39 00 00 00 00 00 0D B7 03 78 03 8A 03 A0 03 BB 03 D3 03 D7
		39 00 00 00 00 00 11 B8 01 0F 01 13 01 1C 01 23 01 2B 01 32 01 39 01 40
		39 00 00 00 00 00 11 B9 01 46 01 5F 01 75 01 9B 01 BD 01 F3 02 27 02 29
		39 00 00 00 00 00 11 BA 02 5F 02 A1 02 CD 03 03 03 2C 03 64 03 80 03 92
		39 00 00 00 00 00 0D BB 03 96 03 98 03 A4 03 BF 03 D4 03 D7
		39 01 00 00 00 00 02 FB 01
		39 01 00 00 00 00 02 FF 21       //Enter CMD2_P1
		39 00 00 00 00 00 11 B0 00 0A 00 1A 00 37 00 4E 00 66 00 79 00 8B 00 9D
		39 00 00 00 00 00 11 B1 00 AC 00 E2 01 0D 01 4E 01 82 01 CD 02 0A 02 0C
		39 00 00 00 00 00 11 B2 02 47 02 8C 02 B8 02 EF 03 0F 03 3D 03 4E 03 5D
		39 00 00 00 00 00 0D B3 03 6F 03 82 03 98 03 B4 03 D2 03 D7
		39 00 00 00 00 00 11 B4 01 07 01 0B 01 14 01 1C 01 24 01 2B 01 32 01 39
		39 00 00 00 00 00 11 B5 01 40 01 59 01 6F 01 96 01 B8 01 F1 02 24 02 26
		39 00 00 00 00 00 11 B6 02 5C 02 9E 02 C9 02 FD 03 22 03 4D 03 5A 03 68
		39 00 00 00 00 00 0D B7 03 78 03 8A 03 A0 03 BB 03 D3 03 D7
		39 00 00 00 00 00 11 B8 01 0F 01 13 01 1C 01 23 01 2B 01 32 01 39 01 40
		39 00 00 00 00 00 11 B9 01 46 01 5F 01 75 01 9B 01 BD 01 F3 02 27 02 29
		39 00 00 00 00 00 11 BA 02 5F 02 A1 02 CD 03 03 03 2C 03 64 03 80 03 92
		39 00 00 00 00 00 0D BB 03 96 03 98 03 A4 03 BF 03 D4 03 D7
		39 01 00 00 00 00 02 FB 01
		39 01 00 00 00 00 02 FF 10
		];
		qcom,mdss-dsi-on-command-05 =
		[
		39 01 00 00 00 00 02 FF 25
		39 01 00 00 00 00 02 FB 01
		39 01 00 00 00 00 02 8D 04
		39 01 00 00 00 00 02 FF 20
		39 01 00 00 00 00 02 FB 01
		39 01 00 00 00 00 02 30 10
		39 01 00 00 00 00 02 31 50
		39 01 00 00 00 00 02 32 2F
		39 01 00 00 00 00 02 94 00
		39 01 00 00 00 00 02 95 E1
		39 01 00 00 00 00 02 96 E1
 		39 01 00 00 00 00 02 FF 20       //Enter CMD2_P0
 		39 01 00 00 00 00 02 FB 01
 		39 01 00 00 00 00 02 AF 00       //R G B Gamma independent
 		39 01 00 00 00 00 11 B0 00 0A 00 1A 00 37 00 4E 00 66 00 79 00 8B 00 9D
 		39 01 00 00 00 00 11 B1 00 AC 00 E2 01 0D 01 4E 01 82 01 CD 02 0A 02 0C
 		39 01 00 00 00 00 11 B2 02 47 02 8C 02 B8 02 EF 03 0F 03 3D 03 4E 03 5D
 		39 01 00 00 00 00 0D B3 03 6F 03 82 03 98 03 B4 03 D2 03 D7
 		39 01 00 00 00 00 11 B4 01 07 01 0B 01 14 01 1C 01 24 01 2B 01 32 01 39
 		39 01 00 00 00 00 11 B5 01 40 01 59 01 6F 01 96 01 B8 01 F1 02 24 02 26
 		39 01 00 00 00 00 11 B6 02 5C 02 9E 02 C9 02 FD 03 22 03 4D 03 5A 03 68
 		39 01 00 00 00 00 0D B7 03 78 03 8A 03 A0 03 BB 03 D3 03 D7
 		39 01 00 00 00 00 11 B8 01 0F 01 13 01 1C 01 23 01 2B 01 32 01 39 01 40
 		39 01 00 00 00 00 11 B9 01 46 01 5F 01 75 01 9B 01 BD 01 F3 02 27 02 29
 		39 01 00 00 00 00 11 BA 02 5F 02 A1 02 CD 03 03 03 2C 03 64 03 80 03 92
 		39 01 00 00 00 00 0D BB 03 96 03 98 03 A4 03 BF 03 D4 03 D7
 		39 01 00 00 00 00 02 FF 21       //Enter CMD2_P1
 		39 01 00 00 00 00 02 FB 01
 		39 01 00 00 00 00 11 B0 00 0A 00 1A 00 37 00 4E 00 66 00 79 00 8B 00 9D
 		39 01 00 00 00 00 11 B1 00 AC 00 E2 01 0D 01 4E 01 82 01 CD 02 0A 02 0C
 		39 01 00 00 00 00 11 B2 02 47 02 8C 02 B8 02 EF 03 0F 03 3D 03 4E 03 5D
 		39 01 00 00 00 00 0D B3 03 6F 03 82 03 98 03 B4 03 D2 03 D7
 		39 01 00 00 00 00 11 B4 01 07 01 0B 01 14 01 1C 01 24 01 2B 01 32 01 39
 		39 01 00 00 00 00 11 B5 01 40 01 59 01 6F 01 96 01 B8 01 F1 02 24 02 26
 		39 01 00 00 00 00 11 B6 02 5C 02 9E 02 C9 02 FD 03 22 03 4D 03 5A 03 68
 		39 01 00 00 00 00 0D B7 03 78 03 8A 03 A0 03 BB 03 D3 03 D7
 		39 01 00 00 00 00 11 B8 01 0F 01 13 01 1C 01 23 01 2B 01 32 01 39 01 40
 		39 01 00 00 00 00 11 B9 01 46 01 5F 01 75 01 9B 01 BD 01 F3 02 27 02 29
 		39 01 00 00 00 00 11 BA 02 5F 02 A1 02 CD 03 03 03 2C 03 64 03 80 03 92
 		39 01 00 00 00 00 0D BB 03 96 03 98 03 A4 03 BF 03 D4 03 D7
		39 01 00 00 00 00 02 FF 10
		39 01 00 00 00 00 02 FB 01
		39 01 00 00 00 00 02 51 FF
		39 01 00 00 00 00 02 53 24
		39 01 00 00 00 00 02 55 00
		39 01 00 00 00 00 02 FF F0
		39 01 00 00 00 00 02 5A 02
		39 01 00 00 00 00 02 FF 10
		39 01 00 00 00 00 02 36 00
		39 01 00 00 00 00 02 35 00
		05 01 00 00 78 00 02 11 00
		05 01 00 00 14 00 02 29 00
		];
		qcom,mdss-white-command-06 = [
		39 01 00 00 00 00 02 FF 20       //Enter CMD2_P0
		39 00 00 00 00 00 02 AF 00       //R G B Gamma independent
		39 00 00 00 00 00 11 B0 00 0B 00 1C 00 39 00 53 00 6A 00 7E 00 91 00 A3
		39 00 00 00 00 00 11 B1 00 B2 00 E9 01 15 01 57 01 89 01 D6 02 14 02 15
		39 00 00 00 00 00 11 B2 02 51 02 94 02 C0 02 F5 03 15 03 43 03 53 03 62
		39 00 00 00 00 00 0D B3 03 73 03 88 03 9F 03 BB 03 D3 03 D7
		39 00 00 00 00 00 11 B4 00 CF 00 D5 00 E1 00 ED 00 F7 01 02 01 0B 01 15
		39 00 00 00 00 00 11 B5 01 1D 01 3D 01 59 01 88 01 AE 01 ED 02 23 02 25
		39 00 00 00 00 00 11 B6 02 5D 02 9F 02 CA 02 FE 03 22 03 4E 03 5A 03 68
		39 00 00 00 00 00 0D B7 03 77 03 88 03 9C 03 B6 03 D2 03 D7
		39 00 00 00 00 00 11 B8 00 E2 00 E8 00 F3 00 FE 01 08 01 11 01 1A 01 23
		39 00 00 00 00 00 11 B9 01 2B 01 49 01 64 01 90 01 B5 01 F2 02 28 02 29
		39 00 00 00 00 00 11 BA 02 61 02 A3 02 CF 03 04 03 2D 03 64 03 7C 03 8C
		39 00 00 00 00 00 0D BB 03 8E 03 94 03 A0 03 C2 03 D4 03 D7
		39 01 00 00 00 00 02 FB 01
		39 01 00 00 00 00 02 FF 21       //Enter CMD2_P1
		39 00 00 00 00 00 11 B0 00 0B 00 1C 00 39 00 53 00 6A 00 7E 00 91 00 A3
		39 00 00 00 00 00 11 B1 00 B2 00 E9 01 15 01 57 01 89 01 D6 02 14 02 15
		39 00 00 00 00 00 11 B2 02 51 02 94 02 C0 02 F5 03 15 03 43 03 53 03 62
		39 00 00 00 00 00 0D B3 03 73 03 88 03 9F 03 BB 03 D3 03 D7
		39 00 00 00 00 00 11 B4 00 CF 00 D5 00 E1 00 ED 00 F7 01 02 01 0B 01 15
		39 00 00 00 00 00 11 B5 01 1D 01 3D 01 59 01 88 01 AE 01 ED 02 23 02 25
		39 00 00 00 00 00 11 B6 02 5D 02 9F 02 CA 02 FE 03 22 03 4E 03 5A 03 68
		39 00 00 00 00 00 0D B7 03 77 03 88 03 9C 03 B6 03 D2 03 D7
		39 00 00 00 00 00 11 B8 00 E2 00 E8 00 F3 00 FE 01 08 01 11 01 1A 01 23
		39 00 00 00 00 00 11 B9 01 2B 01 49 01 64 01 90 01 B5 01 F2 02 28 02 29
		39 00 00 00 00 00 11 BA 02 61 02 A3 02 CF 03 04 03 2D 03 64 03 7C 03 8C
		39 00 00 00 00 00 0D BB 03 8E 03 94 03 A0 03 C2 03 D4 03 D7
		39 01 00 00 00 00 02 FB 01
		39 01 00 00 00 00 02 FF 10
		];
		qcom,mdss-dsi-on-command-06 =
		[
		39 01 00 00 00 00 02 FF 25
		39 01 00 00 00 00 02 FB 01
		39 01 00 00 00 00 02 8D 04
		39 01 00 00 00 00 02 FF 20
		39 01 00 00 00 00 02 FB 01
		39 01 00 00 00 00 02 30 10
		39 01 00 00 00 00 02 31 50
		39 01 00 00 00 00 02 32 2F
		39 01 00 00 00 00 02 94 00
		39 01 00 00 00 00 02 95 E1
		39 01 00 00 00 00 02 96 E1
 		39 01 00 00 00 00 02 FF 20       //Enter CMD2_P0
 		39 01 00 00 00 00 02 FB 01
 		39 01 00 00 00 00 02 AF 00       //R G B Gamma independent
 		39 01 00 00 00 00 11 B0 00 0B 00 1C 00 39 00 53 00 6A 00 7E 00 91 00 A3
 		39 01 00 00 00 00 11 B1 00 B2 00 E9 01 15 01 57 01 89 01 D6 02 14 02 15
 		39 01 00 00 00 00 11 B2 02 51 02 94 02 C0 02 F5 03 15 03 43 03 53 03 62
 		39 01 00 00 00 00 0D B3 03 73 03 88 03 9F 03 BB 03 D3 03 D7
 		39 01 00 00 00 00 11 B4 00 CF 00 D5 00 E1 00 ED 00 F7 01 02 01 0B 01 15
 		39 01 00 00 00 00 11 B5 01 1D 01 3D 01 59 01 88 01 AE 01 ED 02 23 02 25
 		39 01 00 00 00 00 11 B6 02 5D 02 9F 02 CA 02 FE 03 22 03 4E 03 5A 03 68
 		39 01 00 00 00 00 0D B7 03 77 03 88 03 9C 03 B6 03 D2 03 D7
 		39 01 00 00 00 00 11 B8 00 E2 00 E8 00 F3 00 FE 01 08 01 11 01 1A 01 23
 		39 01 00 00 00 00 11 B9 01 2B 01 49 01 64 01 90 01 B5 01 F2 02 28 02 29
 		39 01 00 00 00 00 11 BA 02 61 02 A3 02 CF 03 04 03 2D 03 64 03 7C 03 8C
 		39 01 00 00 00 00 0D BB 03 8E 03 94 03 A0 03 C2 03 D4 03 D7
 		39 01 00 00 00 00 02 FF 21       //Enter CMD2_P1
 		39 01 00 00 00 00 02 FB 01
 		39 01 00 00 00 00 11 B0 00 0B 00 1C 00 39 00 53 00 6A 00 7E 00 91 00 A3
 		39 01 00 00 00 00 11 B1 00 B2 00 E9 01 15 01 57 01 89 01 D6 02 14 02 15
 		39 01 00 00 00 00 11 B2 02 51 02 94 02 C0 02 F5 03 15 03 43 03 53 03 62
 		39 01 00 00 00 00 0D B3 03 73 03 88 03 9F 03 BB 03 D3 03 D7
 		39 01 00 00 00 00 11 B4 00 CF 00 D5 00 E1 00 ED 00 F7 01 02 01 0B 01 15
 		39 01 00 00 00 00 11 B5 01 1D 01 3D 01 59 01 88 01 AE 01 ED 02 23 02 25
 		39 01 00 00 00 00 11 B6 02 5D 02 9F 02 CA 02 FE 03 22 03 4E 03 5A 03 68
 		39 01 00 00 00 00 0D B7 03 77 03 88 03 9C 03 B6 03 D2 03 D7
 		39 01 00 00 00 00 11 B8 00 E2 00 E8 00 F3 00 FE 01 08 01 11 01 1A 01 23
 		39 01 00 00 00 00 11 B9 01 2B 01 49 01 64 01 90 01 B5 01 F2 02 28 02 29
 		39 01 00 00 00 00 11 BA 02 61 02 A3 02 CF 03 04 03 2D 03 64 03 7C 03 8C
 		39 01 00 00 00 00 0D BB 03 8E 03 94 03 A0 03 C2 03 D4 03 D7
		39 01 00 00 00 00 02 FF 10
		39 01 00 00 00 00 02 FB 01
		39 01 00 00 00 00 02 51 FF
		39 01 00 00 00 00 02 53 24
		39 01 00 00 00 00 02 55 00
		39 01 00 00 00 00 02 FF F0
		39 01 00 00 00 00 02 5A 02
		39 01 00 00 00 00 02 FF 10
		39 01 00 00 00 00 02 36 00
		39 01 00 00 00 00 02 35 00
		05 01 00 00 78 00 02 11 00
		05 01 00 00 14 00 02 29 00
		];
		qcom,mdss-white-command-07 = [
		39 01 00 00 00 00 02 FF 20       //Enter CMD2_P0
		39 00 00 00 00 00 02 AF 00       //R G B Gamma independent
		39 00 00 00 00 00 11 B0 00 91 00 99 00 A9 00 B7 00 C5 00 D2 00 DE 00 E9
		39 00 00 00 00 00 11 B1 00 F4 01 1A 01 3B 01 6F 01 9A 01 DE 02 16 02 18
		39 00 00 00 00 00 11 B2 02 51 02 95 02 C1 02 F7 03 1A 03 48 03 55 03 64
		39 00 00 00 00 00 0D B3 03 74 03 87 03 9D 03 B9 03 D3 03 D7
		39 00 00 00 00 00 11 B4 00 09 00 19 00 35 00 4E 00 65 00 79 00 8B 00 9B
		39 00 00 00 00 00 11 B5 00 AA 00 DF 01 09 01 4B 01 7E 01 CB 02 07 02 09
		39 00 00 00 00 00 11 B6 02 46 02 8A 02 B7 02 EE 03 11 03 42 03 4F 03 5E
		39 00 00 00 00 00 0D B7 03 6E 03 81 03 98 03 B4 03 D2 03 D7
		39 00 00 00 00 00 11 B8 00 09 00 1A 00 37 00 51 00 68 00 7D 00 90 00 A1
		39 00 00 00 00 00 11 B9 00 B1 00 E7 01 11 01 52 01 84 01 D0 02 0B 02 0D
		39 00 00 00 00 00 11 BA 02 49 02 8E 02 BB 02 F4 03 1B 03 53 03 66 03 7D
		39 00 00 00 00 00 0D BB 03 8F 03 97 03 9C 03 B7 03 D2 03 D7
		39 01 00 00 00 00 02 FB 01
		39 01 00 00 00 00 02 FF 21       //Enter CMD2_P1
		39 00 00 00 00 00 11 B0 00 91 00 99 00 A9 00 B7 00 C5 00 D2 00 DE 00 E9
		39 00 00 00 00 00 11 B1 00 F4 01 1A 01 3B 01 6F 01 9A 01 DE 02 16 02 18
		39 00 00 00 00 00 11 B2 02 51 02 95 02 C1 02 F7 03 1A 03 48 03 55 03 64
		39 00 00 00 00 00 0D B3 03 74 03 87 03 9D 03 B9 03 D3 03 D7
		39 00 00 00 00 00 11 B4 00 09 00 19 00 35 00 4E 00 65 00 79 00 8B 00 9B
		39 00 00 00 00 00 11 B5 00 AA 00 DF 01 09 01 4B 01 7E 01 CB 02 07 02 09
		39 00 00 00 00 00 11 B6 02 46 02 8A 02 B7 02 EE 03 11 03 42 03 4F 03 5E
		39 00 00 00 00 00 0D B7 03 6E 03 81 03 98 03 B4 03 D2 03 D7
		39 00 00 00 00 00 11 B8 00 09 00 1A 00 37 00 51 00 68 00 7D 00 90 00 A1
		39 00 00 00 00 00 11 B9 00 B1 00 E7 01 11 01 52 01 84 01 D0 02 0B 02 0D
		39 00 00 00 00 00 11 BA 02 49 02 8E 02 BB 02 F4 03 1B 03 53 03 66 03 7D
		39 00 00 00 00 00 0D BB 03 8F 03 97 03 9C 03 B7 03 D2 03 D7
		39 01 00 00 00 00 02 FB 01
		39 01 00 00 00 00 02 FF 10
		];
		qcom,mdss-dsi-on-command-07 =
		[
		39 01 00 00 00 00 02 FF 25
		39 01 00 00 00 00 02 FB 01
		39 01 00 00 00 00 02 8D 04
		39 01 00 00 00 00 02 FF 20
		39 01 00 00 00 00 02 FB 01
		39 01 00 00 00 00 02 30 10
		39 01 00 00 00 00 02 31 50
		39 01 00 00 00 00 02 32 2F
		39 01 00 00 00 00 02 94 00
		39 01 00 00 00 00 02 95 E1
		39 01 00 00 00 00 02 96 E1
 		39 01 00 00 00 00 02 FF 20       //Enter CMD2_P0
 		39 01 00 00 00 00 02 FB 01
 		39 01 00 00 00 00 02 AF 00       //R G B Gamma independent
 		39 01 00 00 00 00 11 B0 00 91 00 99 00 A9 00 B7 00 C5 00 D2 00 DE 00 E9
 		39 01 00 00 00 00 11 B1 00 F4 01 1A 01 3B 01 6F 01 9A 01 DE 02 16 02 18
 		39 01 00 00 00 00 11 B2 02 51 02 95 02 C1 02 F7 03 1A 03 48 03 55 03 64
 		39 01 00 00 00 00 0D B3 03 74 03 87 03 9D 03 B9 03 D3 03 D7
 		39 01 00 00 00 00 11 B4 00 09 00 19 00 35 00 4E 00 65 00 79 00 8B 00 9B
 		39 01 00 00 00 00 11 B5 00 AA 00 DF 01 09 01 4B 01 7E 01 CB 02 07 02 09
 		39 01 00 00 00 00 11 B6 02 46 02 8A 02 B7 02 EE 03 11 03 42 03 4F 03 5E
 		39 01 00 00 00 00 0D B7 03 6E 03 81 03 98 03 B4 03 D2 03 D7
 		39 01 00 00 00 00 11 B8 00 09 00 1A 00 37 00 51 00 68 00 7D 00 90 00 A1
 		39 01 00 00 00 00 11 B9 00 B1 00 E7 01 11 01 52 01 84 01 D0 02 0B 02 0D
 		39 01 00 00 00 00 11 BA 02 49 02 8E 02 BB 02 F4 03 1B 03 53 03 66 03 7D
 		39 01 00 00 00 00 0D BB 03 8F 03 97 03 9C 03 B7 03 D2 03 D7
 		39 01 00 00 00 00 02 FF 21       //Enter CMD2_P1
 		39 01 00 00 00 00 02 FB 01
 		39 01 00 00 00 00 11 B0 00 91 00 99 00 A9 00 B7 00 C5 00 D2 00 DE 00 E9
 		39 01 00 00 00 00 11 B1 00 F4 01 1A 01 3B 01 6F 01 9A 01 DE 02 16 02 18
 		39 01 00 00 00 00 11 B2 02 51 02 95 02 C1 02 F7 03 1A 03 48 03 55 03 64
 		39 01 00 00 00 00 0D B3 03 74 03 87 03 9D 03 B9 03 D3 03 D7
 		39 01 00 00 00 00 11 B4 00 09 00 19 00 35 00 4E 00 65 00 79 00 8B 00 9B
 		39 01 00 00 00 00 11 B5 00 AA 00 DF 01 09 01 4B 01 7E 01 CB 02 07 02 09
 		39 01 00 00 00 00 11 B6 02 46 02 8A 02 B7 02 EE 03 11 03 42 03 4F 03 5E
 		39 01 00 00 00 00 0D B7 03 6E 03 81 03 98 03 B4 03 D2 03 D7
 		39 01 00 00 00 00 11 B8 00 09 00 1A 00 37 00 51 00 68 00 7D 00 90 00 A1
 		39 01 00 00 00 00 11 B9 00 B1 00 E7 01 11 01 52 01 84 01 D0 02 0B 02 0D
 		39 01 00 00 00 00 11 BA 02 49 02 8E 02 BB 02 F4 03 1B 03 53 03 66 03 7D
 		39 01 00 00 00 00 0D BB 03 8F 03 97 03 9C 03 B7 03 D2 03 D7
		39 01 00 00 00 00 02 FF 10
		39 01 00 00 00 00 02 FB 01
		39 01 00 00 00 00 02 51 FF
		39 01 00 00 00 00 02 53 24
		39 01 00 00 00 00 02 55 00
		39 01 00 00 00 00 02 FF F0
		39 01 00 00 00 00 02 5A 02
		39 01 00 00 00 00 02 FF 10
		39 01 00 00 00 00 02 36 00
		39 01 00 00 00 00 02 35 00
		05 01 00 00 78 00 02 11 00
		05 01 00 00 14 00 02 29 00
		];
		qcom,mdss-white-command-08 = [
		39 01 00 00 00 00 02 FF 20       //Enter CMD2_P0
		39 00 00 00 00 00 02 AF 00       //R G B Gamma independent
		39 00 00 00 00 00 11 B0 01 03 01 08 01 10 01 19 01 21 01 28 01 30 01 37
		39 00 00 00 00 00 11 B1 01 3E 01 58 01 6E 01 96 01 B9 01 F2 02 26 02 28
		39 00 00 00 00 00 11 B2 02 5E 02 A0 02 CB 02 FF 03 25 03 50 03 5D 03 6A
		39 00 00 00 00 00 0D B3 03 7A 03 8C 03 A2 03 BC 03 D3 03 D7
		39 00 00 00 00 00 11 B4 00 09 00 19 00 35 00 4B 00 61 00 74 00 87 00 97
		39 00 00 00 00 00 11 B5 00 A7 00 DD 01 07 01 4A 01 7D 01 CB 02 08 02 0A
		39 00 00 00 00 00 11 B6 02 45 02 8A 02 B7 02 ED 03 10 03 41 03 4F 03 5E
		39 00 00 00 00 00 0D B7 03 6E 03 81 03 98 03 B4 03 D2 03 D7
		39 00 00 00 00 00 11 B8 00 09 00 1A 00 38 00 51 00 68 00 7D 00 90 00 A1
		39 00 00 00 00 00 11 B9 00 B1 00 E7 01 11 01 52 01 84 01 D0 02 0C 02 0E
		39 00 00 00 00 00 11 BA 02 49 02 8E 02 BB 02 F3 03 1A 03 52 03 66 03 7D
		39 00 00 00 00 00 0D BB 03 8F 03 97 03 9C 03 B7 03 D2 03 D7
		39 01 00 00 00 00 02 FB 01
		39 01 00 00 00 00 02 FF 21       //Enter CMD2_P1
		39 00 00 00 00 00 11 B0 01 03 01 08 01 10 01 19 01 21 01 28 01 30 01 37
		39 00 00 00 00 00 11 B1 01 3E 01 58 01 6E 01 96 01 B9 01 F2 02 26 02 28
		39 00 00 00 00 00 11 B2 02 5E 02 A0 02 CB 02 FF 03 25 03 50 03 5D 03 6A
		39 00 00 00 00 00 0D B3 03 7A 03 8C 03 A2 03 BC 03 D3 03 D7
		39 00 00 00 00 00 11 B4 00 09 00 19 00 35 00 4B 00 61 00 74 00 87 00 97
		39 00 00 00 00 00 11 B5 00 A7 00 DD 01 07 01 4A 01 7D 01 CB 02 08 02 0A
		39 00 00 00 00 00 11 B6 02 45 02 8A 02 B7 02 ED 03 10 03 41 03 4F 03 5E
		39 00 00 00 00 00 0D B7 03 6E 03 81 03 98 03 B4 03 D2 03 D7
		39 00 00 00 00 00 11 B8 00 09 00 1A 00 38 00 51 00 68 00 7D 00 90 00 A1
		39 00 00 00 00 00 11 B9 00 B1 00 E7 01 11 01 52 01 84 01 D0 02 0C 02 0E
		39 00 00 00 00 00 11 BA 02 49 02 8E 02 BB 02 F3 03 1A 03 52 03 66 03 7D
		39 00 00 00 00 00 0D BB 03 8F 03 97 03 9C 03 B7 03 D2 03 D7
		39 01 00 00 00 00 02 FB 01
		39 01 00 00 00 00 02 FF 10
		];
		qcom,mdss-dsi-on-command-08 =
		[
		39 01 00 00 00 00 02 FF 25
		39 01 00 00 00 00 02 FB 01
		39 01 00 00 00 00 02 8D 04
		39 01 00 00 00 00 02 FF 20
		39 01 00 00 00 00 02 FB 01
		39 01 00 00 00 00 02 30 10
		39 01 00 00 00 00 02 31 50
		39 01 00 00 00 00 02 32 2F
		39 01 00 00 00 00 02 94 00
		39 01 00 00 00 00 02 95 E1
		39 01 00 00 00 00 02 96 E1
 		39 01 00 00 00 00 02 FF 20       //Enter CMD2_P0
 		39 01 00 00 00 00 02 FB 01
 		39 01 00 00 00 00 02 AF 00       //R G B Gamma independent
 		39 01 00 00 00 00 11 B0 01 03 01 08 01 10 01 19 01 21 01 28 01 30 01 37
 		39 01 00 00 00 00 11 B1 01 3E 01 58 01 6E 01 96 01 B9 01 F2 02 26 02 28
 		39 01 00 00 00 00 11 B2 02 5E 02 A0 02 CB 02 FF 03 25 03 50 03 5D 03 6A
 		39 01 00 00 00 00 0D B3 03 7A 03 8C 03 A2 03 BC 03 D3 03 D7
 		39 01 00 00 00 00 11 B4 00 09 00 19 00 35 00 4B 00 61 00 74 00 87 00 97
 		39 01 00 00 00 00 11 B5 00 A7 00 DD 01 07 01 4A 01 7D 01 CB 02 08 02 0A
 		39 01 00 00 00 00 11 B6 02 45 02 8A 02 B7 02 ED 03 10 03 41 03 4F 03 5E
 		39 01 00 00 00 00 0D B7 03 6E 03 81 03 98 03 B4 03 D2 03 D7
 		39 01 00 00 00 00 11 B8 00 09 00 1A 00 38 00 51 00 68 00 7D 00 90 00 A1
 		39 01 00 00 00 00 11 B9 00 B1 00 E7 01 11 01 52 01 84 01 D0 02 0C 02 0E
 		39 01 00 00 00 00 11 BA 02 49 02 8E 02 BB 02 F3 03 1A 03 52 03 66 03 7D
 		39 01 00 00 00 00 0D BB 03 8F 03 97 03 9C 03 B7 03 D2 03 D7
 		39 01 00 00 00 00 02 FF 21       //Enter CMD2_P1
 		39 01 00 00 00 00 02 FB 01
 		39 01 00 00 00 00 11 B0 01 03 01 08 01 10 01 19 01 21 01 28 01 30 01 37
 		39 01 00 00 00 00 11 B1 01 3E 01 58 01 6E 01 96 01 B9 01 F2 02 26 02 28
 		39 01 00 00 00 00 11 B2 02 5E 02 A0 02 CB 02 FF 03 25 03 50 03 5D 03 6A
 		39 01 00 00 00 00 0D B3 03 7A 03 8C 03 A2 03 BC 03 D3 03 D7
 		39 01 00 00 00 00 11 B4 00 09 00 19 00 35 00 4B 00 61 00 74 00 87 00 97
 		39 01 00 00 00 00 11 B5 00 A7 00 DD 01 07 01 4A 01 7D 01 CB 02 08 02 0A
 		39 01 00 00 00 00 11 B6 02 45 02 8A 02 B7 02 ED 03 10 03 41 03 4F 03 5E
 		39 01 00 00 00 00 0D B7 03 6E 03 81 03 98 03 B4 03 D2 03 D7
 		39 01 00 00 00 00 11 B8 00 09 00 1A 00 38 00 51 00 68 00 7D 00 90 00 A1
 		39 01 00 00 00 00 11 B9 00 B1 00 E7 01 11 01 52 01 84 01 D0 02 0C 02 0E
 		39 01 00 00 00 00 11 BA 02 49 02 8E 02 BB 02 F3 03 1A 03 52 03 66 03 7D
 		39 01 00 00 00 00 0D BB 03 8F 03 97 03 9C 03 B7 03 D2 03 D7
		39 01 00 00 00 00 02 FF 10
		39 01 00 00 00 00 02 FB 01
		39 01 00 00 00 00 02 51 FF
		39 01 00 00 00 00 02 53 24
		39 01 00 00 00 00 02 55 00
		39 01 00 00 00 00 02 FF F0
		39 01 00 00 00 00 02 5A 02
		39 01 00 00 00 00 02 FF 10
		39 01 00 00 00 00 02 36 00
		39 01 00 00 00 00 02 35 00
		05 01 00 00 78 00 02 11 00
		05 01 00 00 14 00 02 29 00
		];
		qcom,mdss-white-command-09 = [
		39 01 00 00 00 00 02 FF 20       //Enter CMD2_P0
		39 00 00 00 00 00 02 AF 00       //R G B Gamma independent
		39 00 00 00 00 00 11 B0 00 0A 00 1B 00 37 00 50 00 66 00 7A 00 8C 00 9E
		39 00 00 00 00 00 11 B1 00 AE 00 E3 01 0E 01 4E 01 82 01 CE 02 0A 02 0C
		39 00 00 00 00 00 11 B2 02 48 02 8C 02 B9 02 EE 03 11 03 3F 03 51 03 5F
		39 00 00 00 00 00 0D B3 03 70 03 82 03 98 03 B4 03 D2 03 D7
		39 00 00 00 00 00 11 B4 00 91 00 99 00 A9 00 B7 00 C5 00 D2 00 DE 00 E9
		39 00 00 00 00 00 11 B5 00 F4 01 1A 01 39 01 6E 01 98 01 DC 02 14 02 15
		39 00 00 00 00 00 11 B6 02 4F 02 92 02 BE 02 F4 03 16 03 46 03 53 03 62
		39 00 00 00 00 00 0D B7 03 72 03 85 03 9C 03 B7 03 D2 03 D7
		39 00 00 00 00 00 11 B8 01 12 01 16 01 1E 01 26 01 2D 01 35 01 3B 01 42
		39 00 00 00 00 00 11 B9 01 49 01 61 01 77 01 9C 01 BE 01 F4 02 28 02 29
		39 00 00 00 00 00 11 BA 02 60 02 A1 02 CE 03 03 03 2F 03 69 03 89 03 98
		39 00 00 00 00 00 0D BB 03 9A 03 9C 03 A4 03 BF 03 D4 03 D7
		39 01 00 00 00 00 02 FB 01
		39 01 00 00 00 00 02 FF 21       //Enter CMD2_P1
		39 00 00 00 00 00 11 B0 00 0A 00 1B 00 37 00 50 00 66 00 7A 00 8C 00 9E
		39 00 00 00 00 00 11 B1 00 AE 00 E3 01 0E 01 4E 01 82 01 CE 02 0A 02 0C
		39 00 00 00 00 00 11 B2 02 48 02 8C 02 B9 02 EE 03 11 03 3F 03 51 03 5F
		39 00 00 00 00 00 0D B3 03 70 03 82 03 98 03 B4 03 D2 03 D7
		39 00 00 00 00 00 11 B4 00 91 00 99 00 A9 00 B7 00 C5 00 D2 00 DE 00 E9
		39 00 00 00 00 00 11 B5 00 F4 01 1A 01 39 01 6E 01 98 01 DC 02 14 02 15
		39 00 00 00 00 00 11 B6 02 4F 02 92 02 BE 02 F4 03 16 03 46 03 53 03 62
		39 00 00 00 00 00 0D B7 03 72 03 85 03 9C 03 B7 03 D2 03 D7
		39 00 00 00 00 00 11 B8 01 12 01 16 01 1E 01 26 01 2D 01 35 01 3B 01 42
		39 00 00 00 00 00 11 B9 01 49 01 61 01 77 01 9C 01 BE 01 F4 02 28 02 29
		39 00 00 00 00 00 11 BA 02 60 02 A1 02 CE 03 03 03 2F 03 69 03 89 03 98
		39 00 00 00 00 00 0D BB 03 9A 03 9C 03 A4 03 BF 03 D4 03 D7
		39 01 00 00 00 00 02 FB 01
		39 01 00 00 00 00 02 FF 10
		];
		qcom,mdss-dsi-on-command-09 =
		[
		39 01 00 00 00 00 02 FF 25
		39 01 00 00 00 00 02 FB 01
		39 01 00 00 00 00 02 8D 04
		39 01 00 00 00 00 02 FF 20
		39 01 00 00 00 00 02 FB 01
		39 01 00 00 00 00 02 30 10
		39 01 00 00 00 00 02 31 50
		39 01 00 00 00 00 02 32 2F
		39 01 00 00 00 00 02 94 00
		39 01 00 00 00 00 02 95 E1
		39 01 00 00 00 00 02 96 E1
 		39 01 00 00 00 00 02 FF 20       //Enter CMD2_P0
 		39 01 00 00 00 00 02 FB 01
 		39 01 00 00 00 00 02 AF 00       //R G B Gamma independent
 		39 01 00 00 00 00 11 B0 00 0A 00 1B 00 37 00 50 00 66 00 7A 00 8C 00 9E
 		39 01 00 00 00 00 11 B1 00 AE 00 E3 01 0E 01 4E 01 82 01 CE 02 0A 02 0C
 		39 01 00 00 00 00 11 B2 02 48 02 8C 02 B9 02 EE 03 11 03 3F 03 51 03 5F
 		39 01 00 00 00 00 0D B3 03 70 03 82 03 98 03 B4 03 D2 03 D7
 		39 01 00 00 00 00 11 B4 00 91 00 99 00 A9 00 B7 00 C5 00 D2 00 DE 00 E9
 		39 01 00 00 00 00 11 B5 00 F4 01 1A 01 39 01 6E 01 98 01 DC 02 14 02 15
 		39 01 00 00 00 00 11 B6 02 4F 02 92 02 BE 02 F4 03 16 03 46 03 53 03 62
 		39 01 00 00 00 00 0D B7 03 72 03 85 03 9C 03 B7 03 D2 03 D7
 		39 01 00 00 00 00 11 B8 01 12 01 16 01 1E 01 26 01 2D 01 35 01 3B 01 42
 		39 01 00 00 00 00 11 B9 01 49 01 61 01 77 01 9C 01 BE 01 F4 02 28 02 29
 		39 01 00 00 00 00 11 BA 02 60 02 A1 02 CE 03 03 03 2F 03 69 03 89 03 98
 		39 01 00 00 00 00 0D BB 03 9A 03 9C 03 A4 03 BF 03 D4 03 D7
 		39 01 00 00 00 00 02 FF 21       //Enter CMD2_P1
 		39 01 00 00 00 00 02 FB 01
 		39 01 00 00 00 00 11 B0 00 0A 00 1B 00 37 00 50 00 66 00 7A 00 8C 00 9E
 		39 01 00 00 00 00 11 B1 00 AE 00 E3 01 0E 01 4E 01 82 01 CE 02 0A 02 0C
 		39 01 00 00 00 00 11 B2 02 48 02 8C 02 B9 02 EE 03 11 03 3F 03 51 03 5F
 		39 01 00 00 00 00 0D B3 03 70 03 82 03 98 03 B4 03 D2 03 D7
 		39 01 00 00 00 00 11 B4 00 91 00 99 00 A9 00 B7 00 C5 00 D2 00 DE 00 E9
 		39 01 00 00 00 00 11 B5 00 F4 01 1A 01 39 01 6E 01 98 01 DC 02 14 02 15
 		39 01 00 00 00 00 11 B6 02 4F 02 92 02 BE 02 F4 03 16 03 46 03 53 03 62
 		39 01 00 00 00 00 0D B7 03 72 03 85 03 9C 03 B7 03 D2 03 D7
 		39 01 00 00 00 00 11 B8 01 12 01 16 01 1E 01 26 01 2D 01 35 01 3B 01 42
 		39 01 00 00 00 00 11 B9 01 49 01 61 01 77 01 9C 01 BE 01 F4 02 28 02 29
 		39 01 00 00 00 00 11 BA 02 60 02 A1 02 CE 03 03 03 2F 03 69 03 89 03 98
 		39 01 00 00 00 00 0D BB 03 9A 03 9C 03 A4 03 BF 03 D4 03 D7
		39 01 00 00 00 00 02 FF 10
		39 01 00 00 00 00 02 FB 01
		39 01 00 00 00 00 02 51 FF
		39 01 00 00 00 00 02 53 24
		39 01 00 00 00 00 02 55 00
		39 01 00 00 00 00 02 FF F0
		39 01 00 00 00 00 02 5A 02
		39 01 00 00 00 00 02 FF 10
		39 01 00 00 00 00 02 36 00
		39 01 00 00 00 00 02 35 00
		05 01 00 00 78 00 02 11 00
		05 01 00 00 14 00 02 29 00
		];
		qcom,mdss-white-command-10 = [
		39 01 00 00 00 00 02 FF 20       //Enter CMD2_P0
		39 00 00 00 00 00 02 AF 00       //R G B Gamma independent
		39 00 00 00 00 00 11 B0 00 0A 00 1A 00 35 00 4E 00 66 00 79 00 8C 00 9D
		39 00 00 00 00 00 11 B1 00 AC 00 E3 01 0C 01 4F 01 80 01 CE 02 0A 02 0C
		39 00 00 00 00 00 11 B2 02 47 02 8C 02 B8 02 EF 03 0F 03 3F 03 50 03 5E
		39 00 00 00 00 00 0D B3 03 6F 03 82 03 98 03 B4 03 D2 03 D7
		39 00 00 00 00 00 11 B4 00 D5 00 DB 00 E6 00 F0 00 FA 01 04 01 0D 01 15
		39 00 00 00 00 00 11 B5 01 1E 01 3C 01 56 01 83 01 A9 01 E7 02 1C 02 1E
		39 00 00 00 00 00 11 B6 02 55 02 98 02 C3 02 F8 03 1B 03 4A 03 57 03 65
		39 00 00 00 00 00 0D B7 03 75 03 88 03 9E 03 B9 03 D3 03 D7
		39 00 00 00 00 00 11 B8 01 10 01 14 01 1C 01 24 01 2C 01 33 01 3A 01 41
		39 00 00 00 00 00 11 B9 01 47 01 60 01 75 01 9C 01 BC 01 F4 02 27 02 29
		39 00 00 00 00 00 11 BA 02 5F 02 A1 02 CD 03 03 03 2D 03 68 03 86 03 95
		39 00 00 00 00 00 0D BB 03 97 03 99 03 A4 03 BF 03 D4 03 D7
		39 01 00 00 00 00 02 FB 01
		39 01 00 00 00 00 02 FF 21       //Enter CMD2_P1
		39 00 00 00 00 00 11 B0 00 0A 00 1A 00 35 00 4E 00 66 00 79 00 8C 00 9D
		39 00 00 00 00 00 11 B1 00 AC 00 E3 01 0C 01 4F 01 80 01 CE 02 0A 02 0C
		39 00 00 00 00 00 11 B2 02 47 02 8C 02 B8 02 EF 03 0F 03 3F 03 50 03 5E
		39 00 00 00 00 00 0D B3 03 6F 03 82 03 98 03 B4 03 D2 03 D7
		39 00 00 00 00 00 11 B4 00 D5 00 DB 00 E6 00 F0 00 FA 01 04 01 0D 01 15
		39 00 00 00 00 00 11 B5 01 1E 01 3C 01 56 01 83 01 A9 01 E7 02 1C 02 1E
		39 00 00 00 00 00 11 B6 02 55 02 98 02 C3 02 F8 03 1B 03 4A 03 57 03 65
		39 00 00 00 00 00 0D B7 03 75 03 88 03 9E 03 B9 03 D3 03 D7
		39 00 00 00 00 00 11 B8 01 10 01 14 01 1C 01 24 01 2C 01 33 01 3A 01 41
		39 00 00 00 00 00 11 B9 01 47 01 60 01 75 01 9C 01 BC 01 F4 02 27 02 29
		39 00 00 00 00 00 11 BA 02 5F 02 A1 02 CD 03 03 03 2D 03 68 03 86 03 95
		39 00 00 00 00 00 0D BB 03 97 03 99 03 A4 03 BF 03 D4 03 D7
		39 01 00 00 00 00 02 FB 01
		39 01 00 00 00 00 02 FF 10
		];
		qcom,mdss-dsi-on-command-10 =
		[
		39 01 00 00 00 00 02 FF 25
		39 01 00 00 00 00 02 FB 01
		39 01 00 00 00 00 02 8D 04
		39 01 00 00 00 00 02 FF 20
		39 01 00 00 00 00 02 FB 01
		39 01 00 00 00 00 02 30 10
		39 01 00 00 00 00 02 31 50
		39 01 00 00 00 00 02 32 2F
		39 01 00 00 00 00 02 94 00
		39 01 00 00 00 00 02 95 E1
		39 01 00 00 00 00 02 96 E1
 		39 01 00 00 00 00 02 FF 20       //Enter CMD2_P0
 		39 01 00 00 00 00 02 FB 01
 		39 01 00 00 00 00 02 AF 00       //R G B Gamma independent
 		39 01 00 00 00 00 11 B0 00 0A 00 1A 00 35 00 4E 00 66 00 79 00 8C 00 9D
 		39 01 00 00 00 00 11 B1 00 AC 00 E3 01 0C 01 4F 01 80 01 CE 02 0A 02 0C
 		39 01 00 00 00 00 11 B2 02 47 02 8C 02 B8 02 EF 03 0F 03 3F 03 50 03 5E
 		39 01 00 00 00 00 0D B3 03 6F 03 82 03 98 03 B4 03 D2 03 D7
 		39 01 00 00 00 00 11 B4 00 D5 00 DB 00 E6 00 F0 00 FA 01 04 01 0D 01 15
 		39 01 00 00 00 00 11 B5 01 1E 01 3C 01 56 01 83 01 A9 01 E7 02 1C 02 1E
 		39 01 00 00 00 00 11 B6 02 55 02 98 02 C3 02 F8 03 1B 03 4A 03 57 03 65
 		39 01 00 00 00 00 0D B7 03 75 03 88 03 9E 03 B9 03 D3 03 D7
 		39 01 00 00 00 00 11 B8 01 10 01 14 01 1C 01 24 01 2C 01 33 01 3A 01 41
 		39 01 00 00 00 00 11 B9 01 47 01 60 01 75 01 9C 01 BC 01 F4 02 27 02 29
 		39 01 00 00 00 00 11 BA 02 5F 02 A1 02 CD 03 03 03 2D 03 68 03 86 03 95
 		39 01 00 00 00 00 0D BB 03 97 03 99 03 A4 03 BF 03 D4 03 D7
 		39 01 00 00 00 00 02 FF 21       //Enter CMD2_P1
 		39 01 00 00 00 00 02 FB 01
 		39 01 00 00 00 00 11 B0 00 0A 00 1A 00 35 00 4E 00 66 00 79 00 8C 00 9D
 		39 01 00 00 00 00 11 B1 00 AC 00 E3 01 0C 01 4F 01 80 01 CE 02 0A 02 0C
 		39 01 00 00 00 00 11 B2 02 47 02 8C 02 B8 02 EF 03 0F 03 3F 03 50 03 5E
 		39 01 00 00 00 00 0D B3 03 6F 03 82 03 98 03 B4 03 D2 03 D7
 		39 01 00 00 00 00 11 B4 00 D5 00 DB 00 E6 00 F0 00 FA 01 04 01 0D 01 15
 		39 01 00 00 00 00 11 B5 01 1E 01 3C 01 56 01 83 01 A9 01 E7 02 1C 02 1E
 		39 01 00 00 00 00 11 B6 02 55 02 98 02 C3 02 F8 03 1B 03 4A 03 57 03 65
 		39 01 00 00 00 00 0D B7 03 75 03 88 03 9E 03 B9 03 D3 03 D7
 		39 01 00 00 00 00 11 B8 01 10 01 14 01 1C 01 24 01 2C 01 33 01 3A 01 41
 		39 01 00 00 00 00 11 B9 01 47 01 60 01 75 01 9C 01 BC 01 F4 02 27 02 29
 		39 01 00 00 00 00 11 BA 02 5F 02 A1 02 CD 03 03 03 2D 03 68 03 86 03 95
 		39 01 00 00 00 00 0D BB 03 97 03 99 03 A4 03 BF 03 D4 03 D7
		39 01 00 00 00 00 02 FF 10
		39 01 00 00 00 00 02 FB 01
		39 01 00 00 00 00 02 51 FF
		39 01 00 00 00 00 02 53 24
		39 01 00 00 00 00 02 55 00
		39 01 00 00 00 00 02 FF F0
		39 01 00 00 00 00 02 5A 02
		39 01 00 00 00 00 02 FF 10
		39 01 00 00 00 00 02 36 00
		39 01 00 00 00 00 02 35 00
		05 01 00 00 78 00 02 11 00
		05 01 00 00 14 00 02 29 00
		];
		qcom,mdss-white-command-11 = [
		39 01 00 00 00 00 02 FF 20       //Enter CMD2_P0
		39 00 00 00 00 00 02 AF 00       //R G B Gamma independent
		39 00 00 00 00 00 11 B0 00 0B 00 1C 00 38 00 51 00 67 00 7B 00 8E 00 A0
		39 00 00 00 00 00 11 B1 00 B0 00 E5 01 12 01 52 01 84 01 D0 02 0C 02 0E
		39 00 00 00 00 00 11 B2 02 49 02 8D 02 B8 02 EF 03 0E 03 3D 03 49 03 59
		39 00 00 00 00 00 0D B3 03 67 03 7C 03 9A 03 B6 03 D1 03 D7
		39 00 00 00 00 00 11 B4 01 35 01 38 01 3F 01 45 01 4B 01 51 01 57 01 5D
		39 00 00 00 00 00 11 B5 01 62 01 77 01 8B 01 AC 01 CA 01 FD 02 2F 02 30
		39 00 00 00 00 00 11 B6 02 65 02 A6 02 D0 03 02 03 29 03 53 03 5F 03 6D
		39 00 00 00 00 00 0D B7 03 7C 03 8E 03 A3 03 BD 03 D3 03 D7
		39 00 00 00 00 00 11 B8 01 1A 01 1E 01 26 01 2D 01 34 01 3B 01 42 01 49
		39 00 00 00 00 00 11 B9 01 4F 01 66 01 7C 01 A1 01 C1 01 F7 02 2A 02 2B
		39 00 00 00 00 00 11 BA 02 61 02 A3 02 CE 03 04 03 2E 03 65 03 7B 03 A9
		39 00 00 00 00 00 0D BB 03 C8 03 CB 03 CD 03 CF 03 D4 03 D7
		39 01 00 00 00 00 02 FB 01
		39 01 00 00 00 00 02 FF 21       //Enter CMD2_P1
		39 00 00 00 00 00 11 B0 00 0B 00 1C 00 38 00 51 00 67 00 7B 00 8E 00 A0
		39 00 00 00 00 00 11 B1 00 B0 00 E5 01 12 01 52 01 84 01 D0 02 0C 02 0E
		39 00 00 00 00 00 11 B2 02 49 02 8D 02 B8 02 EF 03 0E 03 3D 03 49 03 59
		39 00 00 00 00 00 0D B3 03 67 03 7C 03 9A 03 B6 03 D1 03 D7
		39 00 00 00 00 00 11 B4 01 35 01 38 01 3F 01 45 01 4B 01 51 01 57 01 5D
		39 00 00 00 00 00 11 B5 01 62 01 77 01 8B 01 AC 01 CA 01 FD 02 2F 02 30
		39 00 00 00 00 00 11 B6 02 65 02 A6 02 D0 03 02 03 29 03 53 03 5F 03 6D
		39 00 00 00 00 00 0D B7 03 7C 03 8E 03 A3 03 BD 03 D3 03 D7
		39 00 00 00 00 00 11 B8 01 1A 01 1E 01 26 01 2D 01 34 01 3B 01 42 01 49
		39 00 00 00 00 00 11 B9 01 4F 01 66 01 7C 01 A1 01 C1 01 F7 02 2A 02 2B
		39 00 00 00 00 00 11 BA 02 61 02 A3 02 CE 03 04 03 2E 03 65 03 7B 03 A9
		39 00 00 00 00 00 0D BB 03 C8 03 CB 03 CD 03 CF 03 D4 03 D7
		39 01 00 00 00 00 02 FB 01
		39 01 00 00 00 00 02 FF 10
		];
		qcom,mdss-dsi-on-command-11 =
		[
		39 01 00 00 00 00 02 FF 25
		39 01 00 00 00 00 02 FB 01
		39 01 00 00 00 00 02 8D 04
		39 01 00 00 00 00 02 FF 20
		39 01 00 00 00 00 02 FB 01
		39 01 00 00 00 00 02 30 10
		39 01 00 00 00 00 02 31 50
		39 01 00 00 00 00 02 32 2F
		39 01 00 00 00 00 02 94 00
		39 01 00 00 00 00 02 95 E1
		39 01 00 00 00 00 02 96 E1
 		39 01 00 00 00 00 02 FF 20       //Enter CMD2_P0
 		39 01 00 00 00 00 02 FB 01
 		39 01 00 00 00 00 02 AF 00       //R G B Gamma independent
 		39 01 00 00 00 00 11 B0 00 0B 00 1C 00 38 00 51 00 67 00 7B 00 8E 00 A0
 		39 01 00 00 00 00 11 B1 00 B0 00 E5 01 12 01 52 01 84 01 D0 02 0C 02 0E
 		39 01 00 00 00 00 11 B2 02 49 02 8D 02 B8 02 EF 03 0E 03 3D 03 49 03 59
 		39 01 00 00 00 00 0D B3 03 67 03 7C 03 9A 03 B6 03 D1 03 D7
 		39 01 00 00 00 00 11 B4 01 35 01 38 01 3F 01 45 01 4B 01 51 01 57 01 5D
 		39 01 00 00 00 00 11 B5 01 62 01 77 01 8B 01 AC 01 CA 01 FD 02 2F 02 30
 		39 01 00 00 00 00 11 B6 02 65 02 A6 02 D0 03 02 03 29 03 53 03 5F 03 6D
 		39 01 00 00 00 00 0D B7 03 7C 03 8E 03 A3 03 BD 03 D3 03 D7
 		39 01 00 00 00 00 11 B8 01 1A 01 1E 01 26 01 2D 01 34 01 3B 01 42 01 49
 		39 01 00 00 00 00 11 B9 01 4F 01 66 01 7C 01 A1 01 C1 01 F7 02 2A 02 2B
 		39 01 00 00 00 00 11 BA 02 61 02 A3 02 CE 03 04 03 2E 03 65 03 7B 03 A9
 		39 01 00 00 00 00 0D BB 03 C8 03 CB 03 CD 03 CF 03 D4 03 D7
 		39 01 00 00 00 00 02 FF 21       //Enter CMD2_P1
 		39 01 00 00 00 00 02 FB 01
 		39 01 00 00 00 00 11 B0 00 0B 00 1C 00 38 00 51 00 67 00 7B 00 8E 00 A0
 		39 01 00 00 00 00 11 B1 00 B0 00 E5 01 12 01 52 01 84 01 D0 02 0C 02 0E
 		39 01 00 00 00 00 11 B2 02 49 02 8D 02 B8 02 EF 03 0E 03 3D 03 49 03 59
 		39 01 00 00 00 00 0D B3 03 67 03 7C 03 9A 03 B6 03 D1 03 D7
 		39 01 00 00 00 00 11 B4 01 35 01 38 01 3F 01 45 01 4B 01 51 01 57 01 5D
 		39 01 00 00 00 00 11 B5 01 62 01 77 01 8B 01 AC 01 CA 01 FD 02 2F 02 30
 		39 01 00 00 00 00 11 B6 02 65 02 A6 02 D0 03 02 03 29 03 53 03 5F 03 6D
 		39 01 00 00 00 00 0D B7 03 7C 03 8E 03 A3 03 BD 03 D3 03 D7
 		39 01 00 00 00 00 11 B8 01 1A 01 1E 01 26 01 2D 01 34 01 3B 01 42 01 49
 		39 01 00 00 00 00 11 B9 01 4F 01 66 01 7C 01 A1 01 C1 01 F7 02 2A 02 2B
 		39 01 00 00 00 00 11 BA 02 61 02 A3 02 CE 03 04 03 2E 03 65 03 7B 03 A9
 		39 01 00 00 00 00 0D BB 03 C8 03 CB 03 CD 03 CF 03 D4 03 D7
		39 01 00 00 00 00 02 FF 10
		39 01 00 00 00 00 02 FB 01
		39 01 00 00 00 00 02 51 FF
		39 01 00 00 00 00 02 53 24
		39 01 00 00 00 00 02 55 00
		39 01 00 00 00 00 02 FF F0
		39 01 00 00 00 00 02 5A 02
		39 01 00 00 00 00 02 FF 10
		39 01 00 00 00 00 02 36 00
		39 01 00 00 00 00 02 35 00
		05 01 00 00 78 00 02 11 00
		05 01 00 00 14 00 02 29 00
		];
		qcom,mdss-white-command-12 = [
		39 01 00 00 00 00 02 FF 20       //Enter CMD2_P0
		39 00 00 00 00 00 02 AF 00       //R G B Gamma independent
		39 00 00 00 00 00 11 B0 00 09 00 1B 00 39 00 53 00 6A 00 7F 00 91 00 A3
		39 00 00 00 00 00 11 B1 00 B3 00 E9 01 14 01 56 01 89 01 D6 02 11 02 13
		39 00 00 00 00 00 11 B2 02 4F 02 91 02 BD 02 F4 03 15 03 3D 03 4D 03 5D
		39 00 00 00 00 00 0D B3 03 71 03 87 03 9E 03 BA 03 D3 03 D7
		39 00 00 00 00 00 11 B4 01 59 01 5C 01 61 01 67 01 6C 01 71 01 76 01 7B
		39 00 00 00 00 00 11 B5 01 80 01 92 01 A3 01 C1 01 DD 02 0C 02 3C 02 3D
		39 00 00 00 00 00 11 B6 02 71 02 B0 02 D9 03 0D 03 30 03 58 03 64 03 72
		39 00 00 00 00 00 0D B7 03 80 03 91 03 A6 03 BE 03 D4 03 D7
		39 00 00 00 00 00 11 B8 01 23 01 27 01 2E 01 36 01 3D 01 44 01 4A 01 51
		39 00 00 00 00 00 11 B9 01 57 01 6E 01 83 01 A8 01 C8 01 FE 02 30 02 32
		39 00 00 00 00 00 11 BA 02 68 02 A8 02 D3 03 0B 03 34 03 6B 03 8A 03 A3
		39 00 00 00 00 00 0D BB 03 A7 03 A9 03 AB 03 B7 03 D3 03 D7
		39 01 00 00 00 00 02 FB 01
		39 01 00 00 00 00 02 FF 21       //Enter CMD2_P1
		39 00 00 00 00 00 11 B0 00 09 00 1B 00 39 00 53 00 6A 00 7F 00 91 00 A3
		39 00 00 00 00 00 11 B1 00 B3 00 E9 01 14 01 56 01 89 01 D6 02 11 02 13
		39 00 00 00 00 00 11 B2 02 4F 02 91 02 BD 02 F4 03 15 03 3D 03 4D 03 5D
		39 00 00 00 00 00 0D B3 03 71 03 87 03 9E 03 BA 03 D3 03 D7
		39 00 00 00 00 00 11 B4 01 59 01 5C 01 61 01 67 01 6C 01 71 01 76 01 7B
		39 00 00 00 00 00 11 B5 01 80 01 92 01 A3 01 C1 01 DD 02 0C 02 3C 02 3D
		39 00 00 00 00 00 11 B6 02 71 02 B0 02 D9 03 0D 03 30 03 58 03 64 03 72
		39 00 00 00 00 00 0D B7 03 80 03 91 03 A6 03 BE 03 D4 03 D7
		39 00 00 00 00 00 11 B8 01 23 01 27 01 2E 01 36 01 3D 01 44 01 4A 01 51
		39 00 00 00 00 00 11 B9 01 57 01 6E 01 83 01 A8 01 C8 01 FE 02 30 02 32
		39 00 00 00 00 00 11 BA 02 68 02 A8 02 D3 03 0B 03 34 03 6B 03 8A 03 A3
		39 00 00 00 00 00 0D BB 03 A7 03 A9 03 AB 03 B7 03 D3 03 D7
		39 01 00 00 00 00 02 FB 01
		39 01 00 00 00 00 02 FF 10
		];
		qcom,mdss-dsi-on-command-12 =
		[
		39 01 00 00 00 00 02 FF 25
		39 01 00 00 00 00 02 FB 01
		39 01 00 00 00 00 02 8D 04
		39 01 00 00 00 00 02 FF 20
		39 01 00 00 00 00 02 FB 01
		39 01 00 00 00 00 02 30 10
		39 01 00 00 00 00 02 31 50
		39 01 00 00 00 00 02 32 2F
		39 01 00 00 00 00 02 94 00
		39 01 00 00 00 00 02 95 E1
		39 01 00 00 00 00 02 96 E1
 		39 01 00 00 00 00 02 FF 20       //Enter CMD2_P0
 		39 01 00 00 00 00 02 FB 01
 		39 01 00 00 00 00 02 AF 00       //R G B Gamma independent
 		39 01 00 00 00 00 11 B0 00 09 00 1B 00 39 00 53 00 6A 00 7F 00 91 00 A3
 		39 01 00 00 00 00 11 B1 00 B3 00 E9 01 14 01 56 01 89 01 D6 02 11 02 13
 		39 01 00 00 00 00 11 B2 02 4F 02 91 02 BD 02 F4 03 15 03 3D 03 4D 03 5D
 		39 01 00 00 00 00 0D B3 03 71 03 87 03 9E 03 BA 03 D3 03 D7
 		39 01 00 00 00 00 11 B4 01 59 01 5C 01 61 01 67 01 6C 01 71 01 76 01 7B
 		39 01 00 00 00 00 11 B5 01 80 01 92 01 A3 01 C1 01 DD 02 0C 02 3C 02 3D
 		39 01 00 00 00 00 11 B6 02 71 02 B0 02 D9 03 0D 03 30 03 58 03 64 03 72
 		39 01 00 00 00 00 0D B7 03 80 03 91 03 A6 03 BE 03 D4 03 D7
 		39 01 00 00 00 00 11 B8 01 23 01 27 01 2E 01 36 01 3D 01 44 01 4A 01 51
 		39 01 00 00 00 00 11 B9 01 57 01 6E 01 83 01 A8 01 C8 01 FE 02 30 02 32
 		39 01 00 00 00 00 11 BA 02 68 02 A8 02 D3 03 0B 03 34 03 6B 03 8A 03 A3
 		39 01 00 00 00 00 0D BB 03 A7 03 A9 03 AB 03 B7 03 D3 03 D7
 		39 01 00 00 00 00 02 FF 21       //Enter CMD2_P1
 		39 01 00 00 00 00 02 FB 01
 		39 01 00 00 00 00 11 B0 00 09 00 1B 00 39 00 53 00 6A 00 7F 00 91 00 A3
 		39 01 00 00 00 00 11 B1 00 B3 00 E9 01 14 01 56 01 89 01 D6 02 11 02 13
 		39 01 00 00 00 00 11 B2 02 4F 02 91 02 BD 02 F4 03 15 03 3D 03 4D 03 5D
 		39 01 00 00 00 00 0D B3 03 71 03 87 03 9E 03 BA 03 D3 03 D7
 		39 01 00 00 00 00 11 B4 01 59 01 5C 01 61 01 67 01 6C 01 71 01 76 01 7B
 		39 01 00 00 00 00 11 B5 01 80 01 92 01 A3 01 C1 01 DD 02 0C 02 3C 02 3D
 		39 01 00 00 00 00 11 B6 02 71 02 B0 02 D9 03 0D 03 30 03 58 03 64 03 72
 		39 01 00 00 00 00 0D B7 03 80 03 91 03 A6 03 BE 03 D4 03 D7
 		39 01 00 00 00 00 11 B8 01 23 01 27 01 2E 01 36 01 3D 01 44 01 4A 01 51
 		39 01 00 00 00 00 11 B9 01 57 01 6E 01 83 01 A8 01 C8 01 FE 02 30 02 32
 		39 01 00 00 00 00 11 BA 02 68 02 A8 02 D3 03 0B 03 34 03 6B 03 8A 03 A3
 		39 01 00 00 00 00 0D BB 03 A7 03 A9 03 AB 03 B7 03 D3 03 D7
		39 01 00 00 00 00 02 FF 10
		39 01 00 00 00 00 02 FB 01
		39 01 00 00 00 00 02 51 FF
		39 01 00 00 00 00 02 53 24
		39 01 00 00 00 00 02 55 00
		39 01 00 00 00 00 02 FF F0
		39 01 00 00 00 00 02 5A 02
		39 01 00 00 00 00 02 FF 10
		39 01 00 00 00 00 02 36 00
		39 01 00 00 00 00 02 35 00
		05 01 00 00 78 00 02 11 00
		05 01 00 00 14 00 02 29 00
		];
		qcom,mdss-white-command-13 = [
		39 01 00 00 00 00 02 FF 20       //Enter CMD2_P0
		39 00 00 00 00 00 02 AF 00       //R G B Gamma independent
		39 00 00 00 00 00 11 B0 00 0C 00 1D 00 3A 00 54 00 6B 00 80 00 93 00 A5
		39 00 00 00 00 00 11 B1 00 B5 00 EC 01 17 01 5A 01 8C 01 D8 02 13 02 15
		39 00 00 00 00 00 11 B2 02 50 02 93 02 BF 02 F5 03 16 03 45 03 52 03 61
		39 00 00 00 00 00 0D B3 03 6D 03 84 03 9B 03 B7 03 D2 03 D7
		39 00 00 00 00 00 11 B4 00 0C 00 1C 00 39 00 54 00 6A 00 80 00 92 00 A5
		39 00 00 00 00 00 11 B5 00 B4 00 EA 01 16 01 57 01 89 01 D4 02 10 02 12
		39 00 00 00 00 00 11 B6 02 4D 02 90 02 BC 02 F3 03 14 03 45 03 52 03 60
		39 00 00 00 00 00 0D B7 03 6B 03 80 03 98 03 B4 03 D2 03 D7
		39 00 00 00 00 00 11 B8 00 D7 00 DD 00 E9 00 F5 00 FF 01 0A 01 13 01 1D
		39 00 00 00 00 00 11 B9 01 25 01 44 01 60 01 8D 01 B3 01 F0 02 25 02 27
		39 00 00 00 00 00 11 BA 02 5E 02 A0 02 CC 03 03 03 2D 03 6A 03 87 03 C9
		39 00 00 00 00 00 0D BB 03 CB 03 CD 03 CF 03 D1 03 D4 03 D7
		39 01 00 00 00 00 02 FB 01
		39 01 00 00 00 00 02 FF 21       //Enter CMD2_P1
		39 00 00 00 00 00 11 B0 00 0C 00 1D 00 3A 00 54 00 6B 00 80 00 93 00 A5
		39 00 00 00 00 00 11 B1 00 B5 00 EC 01 17 01 5A 01 8C 01 D8 02 13 02 15
		39 00 00 00 00 00 11 B2 02 50 02 93 02 BF 02 F5 03 16 03 45 03 52 03 61
		39 00 00 00 00 00 0D B3 03 6D 03 84 03 9B 03 B7 03 D2 03 D7
		39 00 00 00 00 00 11 B4 00 0C 00 1C 00 39 00 54 00 6A 00 80 00 92 00 A5
		39 00 00 00 00 00 11 B5 00 B4 00 EA 01 16 01 57 01 89 01 D4 02 10 02 12
		39 00 00 00 00 00 11 B6 02 4D 02 90 02 BC 02 F3 03 14 03 45 03 52 03 60
		39 00 00 00 00 00 0D B7 03 6B 03 80 03 98 03 B4 03 D2 03 D7
		39 00 00 00 00 00 11 B8 00 D7 00 DD 00 E9 00 F5 00 FF 01 0A 01 13 01 1D
		39 00 00 00 00 00 11 B9 01 25 01 44 01 60 01 8D 01 B3 01 F0 02 25 02 27
		39 00 00 00 00 00 11 BA 02 5E 02 A0 02 CC 03 03 03 2D 03 6A 03 87 03 C9
		39 00 00 00 00 00 0D BB 03 CB 03 CD 03 CF 03 D1 03 D4 03 D7
		39 01 00 00 00 00 02 FB 01
		39 01 00 00 00 00 02 FF 10
		];
		qcom,mdss-dsi-on-command-13 =
		[
		39 01 00 00 00 00 02 FF 25
		39 01 00 00 00 00 02 FB 01
		39 01 00 00 00 00 02 8D 04
		39 01 00 00 00 00 02 FF 20
		39 01 00 00 00 00 02 FB 01
		39 01 00 00 00 00 02 30 10
		39 01 00 00 00 00 02 31 50
		39 01 00 00 00 00 02 32 2F
		39 01 00 00 00 00 02 94 00
		39 01 00 00 00 00 02 95 E1
		39 01 00 00 00 00 02 96 E1
 		39 01 00 00 00 00 02 FF 20       //Enter CMD2_P0
 		39 01 00 00 00 00 02 FB 01
 		39 01 00 00 00 00 02 AF 00       //R G B Gamma independent
 		39 01 00 00 00 00 11 B0 00 0C 00 1D 00 3A 00 54 00 6B 00 80 00 93 00 A5
 		39 01 00 00 00 00 11 B1 00 B5 00 EC 01 17 01 5A 01 8C 01 D8 02 13 02 15
 		39 01 00 00 00 00 11 B2 02 50 02 93 02 BF 02 F5 03 16 03 45 03 52 03 61
 		39 01 00 00 00 00 0D B3 03 6D 03 84 03 9B 03 B7 03 D2 03 D7
 		39 01 00 00 00 00 11 B4 00 0C 00 1C 00 39 00 54 00 6A 00 80 00 92 00 A5
 		39 01 00 00 00 00 11 B5 00 B4 00 EA 01 16 01 57 01 89 01 D4 02 10 02 12
 		39 01 00 00 00 00 11 B6 02 4D 02 90 02 BC 02 F3 03 14 03 45 03 52 03 60
 		39 01 00 00 00 00 0D B7 03 6B 03 80 03 98 03 B4 03 D2 03 D7
 		39 01 00 00 00 00 11 B8 00 D7 00 DD 00 E9 00 F5 00 FF 01 0A 01 13 01 1D
 		39 01 00 00 00 00 11 B9 01 25 01 44 01 60 01 8D 01 B3 01 F0 02 25 02 27
 		39 01 00 00 00 00 11 BA 02 5E 02 A0 02 CC 03 03 03 2D 03 6A 03 87 03 C9
 		39 01 00 00 00 00 0D BB 03 CB 03 CD 03 CF 03 D1 03 D4 03 D7
 		39 01 00 00 00 00 02 FF 21       //Enter CMD2_P1
 		39 01 00 00 00 00 02 FB 01
 		39 01 00 00 00 00 11 B0 00 0C 00 1D 00 3A 00 54 00 6B 00 80 00 93 00 A5
 		39 01 00 00 00 00 11 B1 00 B5 00 EC 01 17 01 5A 01 8C 01 D8 02 13 02 15
 		39 01 00 00 00 00 11 B2 02 50 02 93 02 BF 02 F5 03 16 03 45 03 52 03 61
 		39 01 00 00 00 00 0D B3 03 6D 03 84 03 9B 03 B7 03 D2 03 D7
 		39 01 00 00 00 00 11 B4 00 0C 00 1C 00 39 00 54 00 6A 00 80 00 92 00 A5
 		39 01 00 00 00 00 11 B5 00 B4 00 EA 01 16 01 57 01 89 01 D4 02 10 02 12
 		39 01 00 00 00 00 11 B6 02 4D 02 90 02 BC 02 F3 03 14 03 45 03 52 03 60
 		39 01 00 00 00 00 0D B7 03 6B 03 80 03 98 03 B4 03 D2 03 D7
 		39 01 00 00 00 00 11 B8 00 D7 00 DD 00 E9 00 F5 00 FF 01 0A 01 13 01 1D
 		39 01 00 00 00 00 11 B9 01 25 01 44 01 60 01 8D 01 B3 01 F0 02 25 02 27
 		39 01 00 00 00 00 11 BA 02 5E 02 A0 02 CC 03 03 03 2D 03 6A 03 87 03 C9
 		39 01 00 00 00 00 0D BB 03 CB 03 CD 03 CF 03 D1 03 D4 03 D7
		39 01 00 00 00 00 02 FF 10
		39 01 00 00 00 00 02 FB 01
		39 01 00 00 00 00 02 51 FF
		39 01 00 00 00 00 02 53 24
		39 01 00 00 00 00 02 55 00
		39 01 00 00 00 00 02 FF F0
		39 01 00 00 00 00 02 5A 02
		39 01 00 00 00 00 02 FF 10
		39 01 00 00 00 00 02 36 00
		39 01 00 00 00 00 02 35 00
		05 01 00 00 78 00 02 11 00
		05 01 00 00 14 00 02 29 00
		];
		qcom,mdss-white-command-14 = [
		39 01 00 00 00 00 02 FF 20       //Enter CMD2_P0
		39 00 00 00 00 00 02 AF 00       //R G B Gamma independent
		39 00 00 00 00 00 11 B0 00 0C 00 1D 00 3B 00 54 00 6B 00 7E 00 93 00 A3
		39 00 00 00 00 00 11 B1 00 B5 00 EB 01 16 01 5A 01 8D 01 DA 02 15 02 16
		39 00 00 00 00 00 11 B2 02 51 02 94 02 BF 02 F6 03 16 03 44 03 51 03 60
		39 00 00 00 00 00 0D B3 03 71 03 86 03 9C 03 BC 03 D3 03 D7
		39 00 00 00 00 00 11 B4 00 66 00 71 00 85 00 98 00 A9 00 B9 00 C8 00 D5
		39 00 00 00 00 00 11 B5 00 E2 01 0E 01 32 01 6C 01 99 01 E0 02 19 02 1A
		39 00 00 00 00 00 11 B6 02 53 02 96 02 C1 02 F8 03 19 03 48 03 55 03 64
		39 00 00 00 00 00 0D B7 03 74 03 89 03 9D 03 B7 03 D2 03 D7
		39 00 00 00 00 00 11 B8 00 CC 00 D3 00 E0 00 EC 00 F7 01 01 01 0C 01 15
		39 00 00 00 00 00 11 B9 01 1F 01 3F 01 5B 01 8B 01 B2 01 F1 02 26 02 27
		39 00 00 00 00 00 11 BA 02 5E 02 A0 02 CB 03 04 03 2C 03 67 03 80 03 93
		39 00 00 00 00 00 0D BB 03 97 03 9A 03 9C 03 B2 03 D0 03 D7
		39 01 00 00 00 00 02 FB 01
		39 01 00 00 00 00 02 FF 21       //Enter CMD2_P1
		39 00 00 00 00 00 11 B0 00 0C 00 1D 00 3B 00 54 00 6B 00 7E 00 93 00 A3
		39 00 00 00 00 00 11 B1 00 B5 00 EB 01 16 01 5A 01 8D 01 DA 02 15 02 16
		39 00 00 00 00 00 11 B2 02 51 02 94 02 BF 02 F6 03 16 03 44 03 51 03 60
		39 00 00 00 00 00 0D B3 03 71 03 86 03 9C 03 BC 03 D3 03 D7
		39 00 00 00 00 00 11 B4 00 66 00 71 00 85 00 98 00 A9 00 B9 00 C8 00 D5
		39 00 00 00 00 00 11 B5 00 E2 01 0E 01 32 01 6C 01 99 01 E0 02 19 02 1A
		39 00 00 00 00 00 11 B6 02 53 02 96 02 C1 02 F8 03 19 03 48 03 55 03 64
		39 00 00 00 00 00 0D B7 03 74 03 89 03 9D 03 B7 03 D2 03 D7
		39 00 00 00 00 00 11 B8 00 CC 00 D3 00 E0 00 EC 00 F7 01 01 01 0C 01 15
		39 00 00 00 00 00 11 B9 01 1F 01 3F 01 5B 01 8B 01 B2 01 F1 02 26 02 27
		39 00 00 00 00 00 11 BA 02 5E 02 A0 02 CB 03 04 03 2C 03 67 03 80 03 93
		39 00 00 00 00 00 0D BB 03 97 03 9A 03 9C 03 B2 03 D0 03 D7
		39 01 00 00 00 00 02 FB 01
		39 01 00 00 00 00 02 FF 10
		];
		qcom,mdss-dsi-on-command-14 =
		[
		39 01 00 00 00 00 02 FF 25
		39 01 00 00 00 00 02 FB 01
		39 01 00 00 00 00 02 8D 04
		39 01 00 00 00 00 02 FF 20
		39 01 00 00 00 00 02 FB 01
		39 01 00 00 00 00 02 30 10
		39 01 00 00 00 00 02 31 50
		39 01 00 00 00 00 02 32 2F
		39 01 00 00 00 00 02 94 00
		39 01 00 00 00 00 02 95 E1
		39 01 00 00 00 00 02 96 E1
 		39 01 00 00 00 00 02 FF 20       //Enter CMD2_P0
 		39 01 00 00 00 00 02 FB 01
 		39 01 00 00 00 00 02 AF 00       //R G B Gamma independent
 		39 01 00 00 00 00 11 B0 00 0C 00 1D 00 3B 00 54 00 6B 00 7E 00 93 00 A3
 		39 01 00 00 00 00 11 B1 00 B5 00 EB 01 16 01 5A 01 8D 01 DA 02 15 02 16
 		39 01 00 00 00 00 11 B2 02 51 02 94 02 BF 02 F6 03 16 03 44 03 51 03 60
 		39 01 00 00 00 00 0D B3 03 71 03 86 03 9C 03 BC 03 D3 03 D7
 		39 01 00 00 00 00 11 B4 00 66 00 71 00 85 00 98 00 A9 00 B9 00 C8 00 D5
 		39 01 00 00 00 00 11 B5 00 E2 01 0E 01 32 01 6C 01 99 01 E0 02 19 02 1A
 		39 01 00 00 00 00 11 B6 02 53 02 96 02 C1 02 F8 03 19 03 48 03 55 03 64
 		39 01 00 00 00 00 0D B7 03 74 03 89 03 9D 03 B7 03 D2 03 D7
 		39 01 00 00 00 00 11 B8 00 CC 00 D3 00 E0 00 EC 00 F7 01 01 01 0C 01 15
 		39 01 00 00 00 00 11 B9 01 1F 01 3F 01 5B 01 8B 01 B2 01 F1 02 26 02 27
 		39 01 00 00 00 00 11 BA 02 5E 02 A0 02 CB 03 04 03 2C 03 67 03 80 03 93
 		39 01 00 00 00 00 0D BB 03 97 03 9A 03 9C 03 B2 03 D0 03 D7
 		39 01 00 00 00 00 02 FF 21       //Enter CMD2_P1
 		39 01 00 00 00 00 02 FB 01
 		39 01 00 00 00 00 11 B0 00 0C 00 1D 00 3B 00 54 00 6B 00 7E 00 93 00 A3
 		39 01 00 00 00 00 11 B1 00 B5 00 EB 01 16 01 5A 01 8D 01 DA 02 15 02 16
 		39 01 00 00 00 00 11 B2 02 51 02 94 02 BF 02 F6 03 16 03 44 03 51 03 60
 		39 01 00 00 00 00 0D B3 03 71 03 86 03 9C 03 BC 03 D3 03 D7
 		39 01 00 00 00 00 11 B4 00 66 00 71 00 85 00 98 00 A9 00 B9 00 C8 00 D5
 		39 01 00 00 00 00 11 B5 00 E2 01 0E 01 32 01 6C 01 99 01 E0 02 19 02 1A
 		39 01 00 00 00 00 11 B6 02 53 02 96 02 C1 02 F8 03 19 03 48 03 55 03 64
 		39 01 00 00 00 00 0D B7 03 74 03 89 03 9D 03 B7 03 D2 03 D7
 		39 01 00 00 00 00 11 B8 00 CC 00 D3 00 E0 00 EC 00 F7 01 01 01 0C 01 15
 		39 01 00 00 00 00 11 B9 01 1F 01 3F 01 5B 01 8B 01 B2 01 F1 02 26 02 27
 		39 01 00 00 00 00 11 BA 02 5E 02 A0 02 CB 03 04 03 2C 03 67 03 80 03 93
 		39 01 00 00 00 00 0D BB 03 97 03 9A 03 9C 03 B2 03 D0 03 D7
		39 01 00 00 00 00 02 FF 10
		39 01 00 00 00 00 02 FB 01
		39 01 00 00 00 00 02 51 FF
		39 01 00 00 00 00 02 53 24
		39 01 00 00 00 00 02 55 00
		39 01 00 00 00 00 02 FF F0
		39 01 00 00 00 00 02 5A 02
		39 01 00 00 00 00 02 FF 10
		39 01 00 00 00 00 02 36 00
		39 01 00 00 00 00 02 35 00
		05 01 00 00 78 00 02 11 00
		05 01 00 00 14 00 02 29 00
		];
		qcom,mdss-white-command-15 = [
		39 01 00 00 00 00 02 FF 20       //Enter CMD2_P0
		39 00 00 00 00 00 02 AF 00       //R G B Gamma independent
		39 00 00 00 00 00 11 B0 00 0B 00 1C 00 36 00 4F 00 66 00 79 00 8C 00 9E
		39 00 00 00 00 00 11 B1 00 AD 00 E3 01 0E 01 52 01 83 01 D0 02 0B 02 0D
		39 00 00 00 00 00 11 B2 02 49 02 8E 02 BA 02 EF 03 0F 03 3F 03 4C 03 5E
		39 00 00 00 00 00 0D B3 03 6C 03 81 03 9A 03 B5 03 D2 03 D7
		39 00 00 00 00 00 11 B4 00 F0 00 F5 00 FF 01 08 01 11 01 19 01 21 01 29
		39 00 00 00 00 00 11 B5 01 31 01 4C 01 65 01 8F 01 B2 01 EE 02 21 02 23
		39 00 00 00 00 00 11 B6 02 5A 02 9C 02 C7 02 FB 03 21 03 4D 03 5A 03 68
		39 00 00 00 00 00 0D B7 03 77 03 89 03 9F 03 BA 03 D3 03 D7
		39 00 00 00 00 00 11 B8 00 C6 00 CD 00 D9 00 E5 00 F0 00 FA 01 04 01 0E
		39 00 00 00 00 00 11 B9 01 16 01 36 01 52 01 82 01 A8 01 E7 02 1C 02 1E
		39 00 00 00 00 00 11 BA 02 56 02 9A 02 C6 02 FC 03 26 03 5C 03 72 03 99
		39 00 00 00 00 00 0D BB 03 AD 03 B3 03 B5 03 BF 03 D4 03 D7
		39 01 00 00 00 00 02 FB 01
		39 01 00 00 00 00 02 FF 21       //Enter CMD2_P1
		39 00 00 00 00 00 11 B0 00 0B 00 1C 00 36 00 4F 00 66 00 79 00 8C 00 9E
		39 00 00 00 00 00 11 B1 00 AD 00 E3 01 0E 01 52 01 83 01 D0 02 0B 02 0D
		39 00 00 00 00 00 11 B2 02 49 02 8E 02 BA 02 EF 03 0F 03 3F 03 4C 03 5E
		39 00 00 00 00 00 0D B3 03 6C 03 81 03 9A 03 B5 03 D2 03 D7
		39 00 00 00 00 00 11 B4 00 F0 00 F5 00 FF 01 08 01 11 01 19 01 21 01 29
		39 00 00 00 00 00 11 B5 01 31 01 4C 01 65 01 8F 01 B2 01 EE 02 21 02 23
		39 00 00 00 00 00 11 B6 02 5A 02 9C 02 C7 02 FB 03 21 03 4D 03 5A 03 68
		39 00 00 00 00 00 0D B7 03 77 03 89 03 9F 03 BA 03 D3 03 D7
		39 00 00 00 00 00 11 B8 00 C6 00 CD 00 D9 00 E5 00 F0 00 FA 01 04 01 0E
		39 00 00 00 00 00 11 B9 01 16 01 36 01 52 01 82 01 A8 01 E7 02 1C 02 1E
		39 00 00 00 00 00 11 BA 02 56 02 9A 02 C6 02 FC 03 26 03 5C 03 72 03 99
		39 00 00 00 00 00 0D BB 03 AD 03 B3 03 B5 03 BF 03 D4 03 D7
		39 01 00 00 00 00 02 FB 01
		39 01 00 00 00 00 02 FF 10
		];
		qcom,mdss-dsi-on-command-15 =
		[
		39 01 00 00 00 00 02 FF 25
		39 01 00 00 00 00 02 FB 01
		39 01 00 00 00 00 02 8D 04
		39 01 00 00 00 00 02 FF 20
		39 01 00 00 00 00 02 FB 01
		39 01 00 00 00 00 02 30 10
		39 01 00 00 00 00 02 31 50
		39 01 00 00 00 00 02 32 2F
		39 01 00 00 00 00 02 94 00
		39 01 00 00 00 00 02 95 E1
		39 01 00 00 00 00 02 96 E1
 		39 01 00 00 00 00 02 FF 20       //Enter CMD2_P0
 		39 01 00 00 00 00 02 FB 01
 		39 01 00 00 00 00 02 AF 00       //R G B Gamma independent
 		39 01 00 00 00 00 11 B0 00 0B 00 1C 00 36 00 4F 00 66 00 79 00 8C 00 9E
 		39 01 00 00 00 00 11 B1 00 AD 00 E3 01 0E 01 52 01 83 01 D0 02 0B 02 0D
 		39 01 00 00 00 00 11 B2 02 49 02 8E 02 BA 02 EF 03 0F 03 3F 03 4C 03 5E
 		39 01 00 00 00 00 0D B3 03 6C 03 81 03 9A 03 B5 03 D2 03 D7
 		39 01 00 00 00 00 11 B4 00 F0 00 F5 00 FF 01 08 01 11 01 19 01 21 01 29
 		39 01 00 00 00 00 11 B5 01 31 01 4C 01 65 01 8F 01 B2 01 EE 02 21 02 23
 		39 01 00 00 00 00 11 B6 02 5A 02 9C 02 C7 02 FB 03 21 03 4D 03 5A 03 68
 		39 01 00 00 00 00 0D B7 03 77 03 89 03 9F 03 BA 03 D3 03 D7
 		39 01 00 00 00 00 11 B8 00 C6 00 CD 00 D9 00 E5 00 F0 00 FA 01 04 01 0E
 		39 01 00 00 00 00 11 B9 01 16 01 36 01 52 01 82 01 A8 01 E7 02 1C 02 1E
 		39 01 00 00 00 00 11 BA 02 56 02 9A 02 C6 02 FC 03 26 03 5C 03 72 03 99
 		39 01 00 00 00 00 0D BB 03 AD 03 B3 03 B5 03 BF 03 D4 03 D7
 		39 01 00 00 00 00 02 FF 21       //Enter CMD2_P1
 		39 01 00 00 00 00 02 FB 01
 		39 01 00 00 00 00 11 B0 00 0B 00 1C 00 36 00 4F 00 66 00 79 00 8C 00 9E
 		39 01 00 00 00 00 11 B1 00 AD 00 E3 01 0E 01 52 01 83 01 D0 02 0B 02 0D
 		39 01 00 00 00 00 11 B2 02 49 02 8E 02 BA 02 EF 03 0F 03 3F 03 4C 03 5E
 		39 01 00 00 00 00 0D B3 03 6C 03 81 03 9A 03 B5 03 D2 03 D7
 		39 01 00 00 00 00 11 B4 00 F0 00 F5 00 FF 01 08 01 11 01 19 01 21 01 29
 		39 01 00 00 00 00 11 B5 01 31 01 4C 01 65 01 8F 01 B2 01 EE 02 21 02 23
 		39 01 00 00 00 00 11 B6 02 5A 02 9C 02 C7 02 FB 03 21 03 4D 03 5A 03 68
 		39 01 00 00 00 00 0D B7 03 77 03 89 03 9F 03 BA 03 D3 03 D7
 		39 01 00 00 00 00 11 B8 00 C6 00 CD 00 D9 00 E5 00 F0 00 FA 01 04 01 0E
 		39 01 00 00 00 00 11 B9 01 16 01 36 01 52 01 82 01 A8 01 E7 02 1C 02 1E
 		39 01 00 00 00 00 11 BA 02 56 02 9A 02 C6 02 FC 03 26 03 5C 03 72 03 99
 		39 01 00 00 00 00 0D BB 03 AD 03 B3 03 B5 03 BF 03 D4 03 D7
		39 01 00 00 00 00 02 FF 10
		39 01 00 00 00 00 02 FB 01
		39 01 00 00 00 00 02 51 FF
		39 01 00 00 00 00 02 53 24
		39 01 00 00 00 00 02 55 00
		39 01 00 00 00 00 02 FF F0
		39 01 00 00 00 00 02 5A 02
		39 01 00 00 00 00 02 FF 10
		39 01 00 00 00 00 02 36 00
		39 01 00 00 00 00 02 35 00
		05 01 00 00 78 00 02 11 00
		05 01 00 00 14 00 02 29 00
		];
		qcom,mdss-white-command-16 = [
		39 01 00 00 00 00 02 FF 20       //Enter CMD2_P0
		39 00 00 00 00 00 02 AF 00       //R G B Gamma independent
		39 00 00 00 00 00 11 B0 00 09 00 1B 00 39 00 53 00 68 00 7D 00 90 00 A1
		39 00 00 00 00 00 11 B1 00 B3 00 E9 01 15 01 55 01 88 01 D5 02 10 02 13
		39 00 00 00 00 00 11 B2 02 4F 02 93 02 BE 02 F5 03 15 03 40 03 50 03 60
		39 00 00 00 00 00 0D B3 03 73 03 87 03 9E 03 BA 03 D3 03 D7
		39 00 00 00 00 00 11 B4 01 1B 01 1F 01 27 01 2F 01 36 01 3D 01 44 01 4A
		39 00 00 00 00 00 11 B5 01 51 01 69 01 7E 01 A4 01 C4 01 FA 02 2D 02 2F
		39 00 00 00 00 00 11 B6 02 65 02 A6 02 D0 03 05 03 28 03 52 03 5E 03 6C
		39 00 00 00 00 00 0D B7 03 7B 03 8D 03 A1 03 BB 03 D3 03 D7
		39 00 00 00 00 00 11 B8 00 C5 00 CC 00 D9 00 E5 00 F0 00 FB 01 05 01 0F
		39 00 00 00 00 00 11 B9 01 19 01 3A 01 57 01 85 01 AC 01 EC 02 21 02 23
		39 00 00 00 00 00 11 BA 02 5C 02 9F 02 CA 03 03 03 2A 03 61 03 7A 03 8D
		39 00 00 00 00 00 0D BB 03 91 03 93 03 9B 03 B2 03 D1 03 D7
		39 01 00 00 00 00 02 FB 01
		39 01 00 00 00 00 02 FF 21       //Enter CMD2_P1
		39 00 00 00 00 00 11 B0 00 09 00 1B 00 39 00 53 00 68 00 7D 00 90 00 A1
		39 00 00 00 00 00 11 B1 00 B3 00 E9 01 15 01 55 01 88 01 D5 02 10 02 13
		39 00 00 00 00 00 11 B2 02 4F 02 93 02 BE 02 F5 03 15 03 40 03 50 03 60
		39 00 00 00 00 00 0D B3 03 73 03 87 03 9E 03 BA 03 D3 03 D7
		39 00 00 00 00 00 11 B4 01 1B 01 1F 01 27 01 2F 01 36 01 3D 01 44 01 4A
		39 00 00 00 00 00 11 B5 01 51 01 69 01 7E 01 A4 01 C4 01 FA 02 2D 02 2F
		39 00 00 00 00 00 11 B6 02 65 02 A6 02 D0 03 05 03 28 03 52 03 5E 03 6C
		39 00 00 00 00 00 0D B7 03 7B 03 8D 03 A1 03 BB 03 D3 03 D7
		39 00 00 00 00 00 11 B8 00 C5 00 CC 00 D9 00 E5 00 F0 00 FB 01 05 01 0F
		39 00 00 00 00 00 11 B9 01 19 01 3A 01 57 01 85 01 AC 01 EC 02 21 02 23
		39 00 00 00 00 00 11 BA 02 5C 02 9F 02 CA 03 03 03 2A 03 61 03 7A 03 8D
		39 00 00 00 00 00 0D BB 03 91 03 93 03 9B 03 B2 03 D1 03 D7
		39 01 00 00 00 00 02 FB 01
		39 01 00 00 00 00 02 FF 10
		];
		qcom,mdss-dsi-on-command-16 =
		[
		39 01 00 00 00 00 02 FF 25
		39 01 00 00 00 00 02 FB 01
		39 01 00 00 00 00 02 8D 04
		39 01 00 00 00 00 02 FF 20
		39 01 00 00 00 00 02 FB 01
		39 01 00 00 00 00 02 30 10
		39 01 00 00 00 00 02 31 50
		39 01 00 00 00 00 02 32 2F
		39 01 00 00 00 00 02 94 00
		39 01 00 00 00 00 02 95 E1
		39 01 00 00 00 00 02 96 E1
 		39 01 00 00 00 00 02 FF 20       //Enter CMD2_P0
 		39 01 00 00 00 00 02 FB 01
 		39 01 00 00 00 00 02 AF 00       //R G B Gamma independent
 		39 01 00 00 00 00 11 B0 00 09 00 1B 00 39 00 53 00 68 00 7D 00 90 00 A1
 		39 01 00 00 00 00 11 B1 00 B3 00 E9 01 15 01 55 01 88 01 D5 02 10 02 13
 		39 01 00 00 00 00 11 B2 02 4F 02 93 02 BE 02 F5 03 15 03 40 03 50 03 60
 		39 01 00 00 00 00 0D B3 03 73 03 87 03 9E 03 BA 03 D3 03 D7
 		39 01 00 00 00 00 11 B4 01 1B 01 1F 01 27 01 2F 01 36 01 3D 01 44 01 4A
 		39 01 00 00 00 00 11 B5 01 51 01 69 01 7E 01 A4 01 C4 01 FA 02 2D 02 2F
 		39 01 00 00 00 00 11 B6 02 65 02 A6 02 D0 03 05 03 28 03 52 03 5E 03 6C
 		39 01 00 00 00 00 0D B7 03 7B 03 8D 03 A1 03 BB 03 D3 03 D7
 		39 01 00 00 00 00 11 B8 00 C5 00 CC 00 D9 00 E5 00 F0 00 FB 01 05 01 0F
 		39 01 00 00 00 00 11 B9 01 19 01 3A 01 57 01 85 01 AC 01 EC 02 21 02 23
 		39 01 00 00 00 00 11 BA 02 5C 02 9F 02 CA 03 03 03 2A 03 61 03 7A 03 8D
 		39 01 00 00 00 00 0D BB 03 91 03 93 03 9B 03 B2 03 D1 03 D7
 		39 01 00 00 00 00 02 FF 21       //Enter CMD2_P1
 		39 01 00 00 00 00 02 FB 01
 		39 01 00 00 00 00 11 B0 00 09 00 1B 00 39 00 53 00 68 00 7D 00 90 00 A1
 		39 01 00 00 00 00 11 B1 00 B3 00 E9 01 15 01 55 01 88 01 D5 02 10 02 13
 		39 01 00 00 00 00 11 B2 02 4F 02 93 02 BE 02 F5 03 15 03 40 03 50 03 60
 		39 01 00 00 00 00 0D B3 03 73 03 87 03 9E 03 BA 03 D3 03 D7
 		39 01 00 00 00 00 11 B4 01 1B 01 1F 01 27 01 2F 01 36 01 3D 01 44 01 4A
 		39 01 00 00 00 00 11 B5 01 51 01 69 01 7E 01 A4 01 C4 01 FA 02 2D 02 2F
 		39 01 00 00 00 00 11 B6 02 65 02 A6 02 D0 03 05 03 28 03 52 03 5E 03 6C
 		39 01 00 00 00 00 0D B7 03 7B 03 8D 03 A1 03 BB 03 D3 03 D7
 		39 01 00 00 00 00 11 B8 00 C5 00 CC 00 D9 00 E5 00 F0 00 FB 01 05 01 0F
 		39 01 00 00 00 00 11 B9 01 19 01 3A 01 57 01 85 01 AC 01 EC 02 21 02 23
 		39 01 00 00 00 00 11 BA 02 5C 02 9F 02 CA 03 03 03 2A 03 61 03 7A 03 8D
 		39 01 00 00 00 00 0D BB 03 91 03 93 03 9B 03 B2 03 D1 03 D7
		39 01 00 00 00 00 02 FF 10
		39 01 00 00 00 00 02 FB 01
		39 01 00 00 00 00 02 51 FF
		39 01 00 00 00 00 02 53 24
		39 01 00 00 00 00 02 55 00
		39 01 00 00 00 00 02 FF F0
		39 01 00 00 00 00 02 5A 02
		39 01 00 00 00 00 02 FF 10
		39 01 00 00 00 00 02 36 00
		39 01 00 00 00 00 02 35 00
		05 01 00 00 78 00 02 11 00
		05 01 00 00 14 00 02 29 00
		];
		qcom,mdss-white-command-17 = [
		39 01 00 00 00 00 02 FF 20       //Enter CMD2_P0
		39 00 00 00 00 00 02 AF 00       //R G B Gamma independent
		39 00 00 00 00 00 11 B0 01 14 01 18 01 20 01 27 01 2F 01 36 01 3D 01 43
		39 00 00 00 00 00 11 B1 01 4A 01 62 01 78 01 9E 01 BF 01 F5 02 29 02 2B
		39 00 00 00 00 00 11 B2 02 61 02 A3 02 CE 03 01 03 27 03 54 03 5E 03 6B
		39 00 00 00 00 00 0D B3 03 7A 03 8B 03 A0 03 B9 03 D3 03 D7
		39 00 00 00 00 00 11 B4 00 09 00 19 00 35 00 4D 00 63 00 77 00 89 00 99
		39 00 00 00 00 00 11 B5 00 AB 00 E0 01 09 01 4A 01 7C 01 CA 02 06 02 08
		39 00 00 00 00 00 11 B6 02 45 02 8A 02 B6 02 EE 03 10 03 42 03 4F 03 5E
		39 00 00 00 00 00 0D B7 03 6E 03 81 03 97 03 B2 03 D1 03 D7
		39 00 00 00 00 00 11 B8 00 DB 00 E1 00 EC 00 F6 01 00 01 09 01 12 01 1A
		39 00 00 00 00 00 11 B9 01 23 01 41 01 5A 01 86 01 AB 01 E9 02 1E 02 20
		39 00 00 00 00 00 11 BA 02 58 02 9C 02 C8 02 FF 03 2A 03 65 03 79 03 89
		39 00 00 00 00 00 0D BB 03 8B 03 8F 03 A4 03 BC 03 D2 03 D7
		39 01 00 00 00 00 02 FB 01
		39 01 00 00 00 00 02 FF 21       //Enter CMD2_P1
		39 00 00 00 00 00 11 B0 01 14 01 18 01 20 01 27 01 2F 01 36 01 3D 01 43
		39 00 00 00 00 00 11 B1 01 4A 01 62 01 78 01 9E 01 BF 01 F5 02 29 02 2B
		39 00 00 00 00 00 11 B2 02 61 02 A3 02 CE 03 01 03 27 03 54 03 5E 03 6B
		39 00 00 00 00 00 0D B3 03 7A 03 8B 03 A0 03 B9 03 D3 03 D7
		39 00 00 00 00 00 11 B4 00 09 00 19 00 35 00 4D 00 63 00 77 00 89 00 99
		39 00 00 00 00 00 11 B5 00 AB 00 E0 01 09 01 4A 01 7C 01 CA 02 06 02 08
		39 00 00 00 00 00 11 B6 02 45 02 8A 02 B6 02 EE 03 10 03 42 03 4F 03 5E
		39 00 00 00 00 00 0D B7 03 6E 03 81 03 97 03 B2 03 D1 03 D7
		39 00 00 00 00 00 11 B8 00 DB 00 E1 00 EC 00 F6 01 00 01 09 01 12 01 1A
		39 00 00 00 00 00 11 B9 01 23 01 41 01 5A 01 86 01 AB 01 E9 02 1E 02 20
		39 00 00 00 00 00 11 BA 02 58 02 9C 02 C8 02 FF 03 2A 03 65 03 79 03 89
		39 00 00 00 00 00 0D BB 03 8B 03 8F 03 A4 03 BC 03 D2 03 D7
		39 01 00 00 00 00 02 FB 01
		39 01 00 00 00 00 02 FF 10
		];
		qcom,mdss-dsi-on-command-17 =
		[
		39 01 00 00 00 00 02 FF 25
		39 01 00 00 00 00 02 FB 01
		39 01 00 00 00 00 02 8D 04
		39 01 00 00 00 00 02 FF 20
		39 01 00 00 00 00 02 FB 01
		39 01 00 00 00 00 02 30 10
		39 01 00 00 00 00 02 31 50
		39 01 00 00 00 00 02 32 2F
		39 01 00 00 00 00 02 94 00
		39 01 00 00 00 00 02 95 E1
		39 01 00 00 00 00 02 96 E1
 		39 01 00 00 00 00 02 FF 20       //Enter CMD2_P0
 		39 01 00 00 00 00 02 FB 01
 		39 01 00 00 00 00 02 AF 00       //R G B Gamma independent
 		39 01 00 00 00 00 11 B0 01 14 01 18 01 20 01 27 01 2F 01 36 01 3D 01 43
 		39 01 00 00 00 00 11 B1 01 4A 01 62 01 78 01 9E 01 BF 01 F5 02 29 02 2B
 		39 01 00 00 00 00 11 B2 02 61 02 A3 02 CE 03 01 03 27 03 54 03 5E 03 6B
 		39 01 00 00 00 00 0D B3 03 7A 03 8B 03 A0 03 B9 03 D3 03 D7
 		39 01 00 00 00 00 11 B4 00 09 00 19 00 35 00 4D 00 63 00 77 00 89 00 99
 		39 01 00 00 00 00 11 B5 00 AB 00 E0 01 09 01 4A 01 7C 01 CA 02 06 02 08
 		39 01 00 00 00 00 11 B6 02 45 02 8A 02 B6 02 EE 03 10 03 42 03 4F 03 5E
 		39 01 00 00 00 00 0D B7 03 6E 03 81 03 97 03 B2 03 D1 03 D7
 		39 01 00 00 00 00 11 B8 00 DB 00 E1 00 EC 00 F6 01 00 01 09 01 12 01 1A
 		39 01 00 00 00 00 11 B9 01 23 01 41 01 5A 01 86 01 AB 01 E9 02 1E 02 20
 		39 01 00 00 00 00 11 BA 02 58 02 9C 02 C8 02 FF 03 2A 03 65 03 79 03 89
 		39 01 00 00 00 00 0D BB 03 8B 03 8F 03 A4 03 BC 03 D2 03 D7
 		39 01 00 00 00 00 02 FF 21       //Enter CMD2_P1
 		39 01 00 00 00 00 02 FB 01
 		39 01 00 00 00 00 11 B0 01 14 01 18 01 20 01 27 01 2F 01 36 01 3D 01 43
 		39 01 00 00 00 00 11 B1 01 4A 01 62 01 78 01 9E 01 BF 01 F5 02 29 02 2B
 		39 01 00 00 00 00 11 B2 02 61 02 A3 02 CE 03 01 03 27 03 54 03 5E 03 6B
 		39 01 00 00 00 00 0D B3 03 7A 03 8B 03 A0 03 B9 03 D3 03 D7
 		39 01 00 00 00 00 11 B4 00 09 00 19 00 35 00 4D 00 63 00 77 00 89 00 99
 		39 01 00 00 00 00 11 B5 00 AB 00 E0 01 09 01 4A 01 7C 01 CA 02 06 02 08
 		39 01 00 00 00 00 11 B6 02 45 02 8A 02 B6 02 EE 03 10 03 42 03 4F 03 5E
 		39 01 00 00 00 00 0D B7 03 6E 03 81 03 97 03 B2 03 D1 03 D7
 		39 01 00 00 00 00 11 B8 00 DB 00 E1 00 EC 00 F6 01 00 01 09 01 12 01 1A
 		39 01 00 00 00 00 11 B9 01 23 01 41 01 5A 01 86 01 AB 01 E9 02 1E 02 20
 		39 01 00 00 00 00 11 BA 02 58 02 9C 02 C8 02 FF 03 2A 03 65 03 79 03 89
 		39 01 00 00 00 00 0D BB 03 8B 03 8F 03 A4 03 BC 03 D2 03 D7
		39 01 00 00 00 00 02 FF 10
		39 01 00 00 00 00 02 FB 01
		39 01 00 00 00 00 02 51 FF
		39 01 00 00 00 00 02 53 24
		39 01 00 00 00 00 02 55 00
		39 01 00 00 00 00 02 FF F0
		39 01 00 00 00 00 02 5A 02
		39 01 00 00 00 00 02 FF 10
		39 01 00 00 00 00 02 36 00
		39 01 00 00 00 00 02 35 00
		05 01 00 00 78 00 02 11 00
		05 01 00 00 14 00 02 29 00
		];
		qcom,mdss-white-command-18 = [
		39 01 00 00 00 00 02 FF 20       //Enter CMD2_P0
		39 00 00 00 00 00 02 AF 00       //R G B Gamma independent
		39 00 00 00 00 00 11 B0 00 DC 00 E2 00 EC 00 F7 01 00 01 0A 01 12 01 1B
		39 00 00 00 00 00 11 B1 01 23 01 41 01 5B 01 87 01 AD 01 EA 02 20 02 22
		39 00 00 00 00 00 11 B2 02 59 02 9B 02 C7 02 FC 03 21 03 4D 03 59 03 67
		39 00 00 00 00 00 0D B3 03 77 03 8A 03 A0 03 BB 03 D3 03 D7
		39 00 00 00 00 00 11 B4 00 09 00 18 00 35 00 4C 00 61 00 77 00 8A 00 9B
		39 00 00 00 00 00 11 B5 00 A9 00 E1 01 09 01 4B 01 80 01 CA 02 07 02 0A
		39 00 00 00 00 00 11 B6 02 45 02 8A 02 B7 02 EE 03 10 03 42 03 4F 03 5E
		39 00 00 00 00 00 0D B7 03 6E 03 81 03 98 03 B4 03 D2 03 D7
		39 00 00 00 00 00 11 B8 00 84 00 8D 00 9F 00 AE 00 BC 00 CB 00 D8 00 E4
		39 00 00 00 00 00 11 B9 00 EE 01 17 01 36 01 6C 01 99 01 DB 02 14 02 17
		39 00 00 00 00 00 11 BA 02 50 02 94 02 C1 02 F9 03 22 03 5A 03 6E 03 89
		39 00 00 00 00 00 0D BB 03 A6 03 AE 03 B0 03 B9 03 D3 03 D7
		39 01 00 00 00 00 02 FB 01
		39 01 00 00 00 00 02 FF 21       //Enter CMD2_P1
		39 00 00 00 00 00 11 B0 00 DC 00 E2 00 EC 00 F7 01 00 01 0A 01 12 01 1B
		39 00 00 00 00 00 11 B1 01 23 01 41 01 5B 01 87 01 AD 01 EA 02 20 02 22
		39 00 00 00 00 00 11 B2 02 59 02 9B 02 C7 02 FC 03 21 03 4D 03 59 03 67
		39 00 00 00 00 00 0D B3 03 77 03 8A 03 A0 03 BB 03 D3 03 D7
		39 00 00 00 00 00 11 B4 00 09 00 18 00 35 00 4C 00 61 00 77 00 8A 00 9B
		39 00 00 00 00 00 11 B5 00 A9 00 E1 01 09 01 4B 01 80 01 CA 02 07 02 0A
		39 00 00 00 00 00 11 B6 02 45 02 8A 02 B7 02 EE 03 10 03 42 03 4F 03 5E
		39 00 00 00 00 00 0D B7 03 6E 03 81 03 98 03 B4 03 D2 03 D7
		39 00 00 00 00 00 11 B8 00 84 00 8D 00 9F 00 AE 00 BC 00 CB 00 D8 00 E4
		39 00 00 00 00 00 11 B9 00 EE 01 17 01 36 01 6C 01 99 01 DB 02 14 02 17
		39 00 00 00 00 00 11 BA 02 50 02 94 02 C1 02 F9 03 22 03 5A 03 6E 03 89
		39 00 00 00 00 00 0D BB 03 A6 03 AE 03 B0 03 B9 03 D3 03 D7
		39 01 00 00 00 00 02 FB 01
		39 01 00 00 00 00 02 FF 10
		];
		qcom,mdss-dsi-on-command-18 =
		[
		39 01 00 00 00 00 02 FF 25
		39 01 00 00 00 00 02 FB 01
		39 01 00 00 00 00 02 8D 04
		39 01 00 00 00 00 02 FF 20
		39 01 00 00 00 00 02 FB 01
		39 01 00 00 00 00 02 30 10
		39 01 00 00 00 00 02 31 50
		39 01 00 00 00 00 02 32 2F
		39 01 00 00 00 00 02 94 00
		39 01 00 00 00 00 02 95 E1
		39 01 00 00 00 00 02 96 E1
 		39 01 00 00 00 00 02 FF 20       //Enter CMD2_P0
 		39 01 00 00 00 00 02 FB 01
 		39 01 00 00 00 00 02 AF 00       //R G B Gamma independent
 		39 01 00 00 00 00 11 B0 00 DC 00 E2 00 EC 00 F7 01 00 01 0A 01 12 01 1B
 		39 01 00 00 00 00 11 B1 01 23 01 41 01 5B 01 87 01 AD 01 EA 02 20 02 22
 		39 01 00 00 00 00 11 B2 02 59 02 9B 02 C7 02 FC 03 21 03 4D 03 59 03 67
 		39 01 00 00 00 00 0D B3 03 77 03 8A 03 A0 03 BB 03 D3 03 D7
 		39 01 00 00 00 00 11 B4 00 09 00 18 00 35 00 4C 00 61 00 77 00 8A 00 9B
 		39 01 00 00 00 00 11 B5 00 A9 00 E1 01 09 01 4B 01 80 01 CA 02 07 02 0A
 		39 01 00 00 00 00 11 B6 02 45 02 8A 02 B7 02 EE 03 10 03 42 03 4F 03 5E
 		39 01 00 00 00 00 0D B7 03 6E 03 81 03 98 03 B4 03 D2 03 D7
 		39 01 00 00 00 00 11 B8 00 84 00 8D 00 9F 00 AE 00 BC 00 CB 00 D8 00 E4
 		39 01 00 00 00 00 11 B9 00 EE 01 17 01 36 01 6C 01 99 01 DB 02 14 02 17
 		39 01 00 00 00 00 11 BA 02 50 02 94 02 C1 02 F9 03 22 03 5A 03 6E 03 89
 		39 01 00 00 00 00 0D BB 03 A6 03 AE 03 B0 03 B9 03 D3 03 D7
 		39 01 00 00 00 00 02 FF 21       //Enter CMD2_P1
 		39 01 00 00 00 00 02 FB 01
 		39 01 00 00 00 00 11 B0 00 DC 00 E2 00 EC 00 F7 01 00 01 0A 01 12 01 1B
 		39 01 00 00 00 00 11 B1 01 23 01 41 01 5B 01 87 01 AD 01 EA 02 20 02 22
 		39 01 00 00 00 00 11 B2 02 59 02 9B 02 C7 02 FC 03 21 03 4D 03 59 03 67
 		39 01 00 00 00 00 0D B3 03 77 03 8A 03 A0 03 BB 03 D3 03 D7
 		39 01 00 00 00 00 11 B4 00 09 00 18 00 35 00 4C 00 61 00 77 00 8A 00 9B
 		39 01 00 00 00 00 11 B5 00 A9 00 E1 01 09 01 4B 01 80 01 CA 02 07 02 0A
 		39 01 00 00 00 00 11 B6 02 45 02 8A 02 B7 02 EE 03 10 03 42 03 4F 03 5E
 		39 01 00 00 00 00 0D B7 03 6E 03 81 03 98 03 B4 03 D2 03 D7
 		39 01 00 00 00 00 11 B8 00 84 00 8D 00 9F 00 AE 00 BC 00 CB 00 D8 00 E4
 		39 01 00 00 00 00 11 B9 00 EE 01 17 01 36 01 6C 01 99 01 DB 02 14 02 17
 		39 01 00 00 00 00 11 BA 02 50 02 94 02 C1 02 F9 03 22 03 5A 03 6E 03 89
 		39 01 00 00 00 00 0D BB 03 A6 03 AE 03 B0 03 B9 03 D3 03 D7
		39 01 00 00 00 00 02 FF 10
		39 01 00 00 00 00 02 FB 01
		39 01 00 00 00 00 02 51 FF
		39 01 00 00 00 00 02 53 24
		39 01 00 00 00 00 02 55 00
		39 01 00 00 00 00 02 FF F0
		39 01 00 00 00 00 02 5A 02
		39 01 00 00 00 00 02 FF 10
		39 01 00 00 00 00 02 36 00
		39 01 00 00 00 00 02 35 00
		05 01 00 00 78 00 02 11 00
		05 01 00 00 14 00 02 29 00
		];
		qcom,mdss-white-command-19 = [
		39 01 00 00 00 00 02 FF 20       //Enter CMD2_P0
		39 00 00 00 00 00 02 AF 00       //R G B Gamma independent
		39 00 00 00 00 00 11 B0 00 55 00 60 00 74 00 87 00 99 00 A9 00 B8 00 C7
		39 00 00 00 00 00 11 B1 00 D4 01 03 01 29 01 64 01 93 01 DC 02 16 02 18
		39 00 00 00 00 00 11 B2 02 53 02 96 02 C2 02 F8 03 1A 03 49 03 54 03 65
		39 00 00 00 00 00 0D B3 03 74 03 85 03 9A 03 B4 03 D1 03 D7
		39 00 00 00 00 00 11 B4 00 67 00 71 00 84 00 96 00 A7 00 B6 00 C4 00 D2
		39 00 00 00 00 00 11 B5 00 DE 01 0A 01 2E 01 67 01 94 01 DB 02 15 02 17
		39 00 00 00 00 00 11 B6 02 51 02 94 02 C0 02 F7 03 19 03 49 03 55 03 64
		39 00 00 00 00 00 0D B7 03 73 03 85 03 9B 03 B5 03 D1 03 D7
		39 00 00 00 00 00 11 B8 00 0B 00 1E 00 3C 00 55 00 6B 00 80 00 93 00 A4
		39 00 00 00 00 00 11 B9 00 B4 00 EB 01 16 01 58 01 8A 01 D6 02 12 02 14
		39 00 00 00 00 00 11 BA 02 4F 02 93 02 C0 02 FA 03 21 03 5B 03 6D 03 8D
		39 00 00 00 00 00 0D BB 03 A1 03 A3 03 A5 03 B9 03 D3 03 D7
		39 01 00 00 00 00 02 FB 01
		39 01 00 00 00 00 02 FF 21       //Enter CMD2_P1
		39 00 00 00 00 00 11 B0 00 55 00 60 00 74 00 87 00 99 00 A9 00 B8 00 C7
		39 00 00 00 00 00 11 B1 00 D4 01 03 01 29 01 64 01 93 01 DC 02 16 02 18
		39 00 00 00 00 00 11 B2 02 53 02 96 02 C2 02 F8 03 1A 03 49 03 54 03 65
		39 00 00 00 00 00 0D B3 03 74 03 85 03 9A 03 B4 03 D1 03 D7
		39 00 00 00 00 00 11 B4 00 67 00 71 00 84 00 96 00 A7 00 B6 00 C4 00 D2
		39 00 00 00 00 00 11 B5 00 DE 01 0A 01 2E 01 67 01 94 01 DB 02 15 02 17
		39 00 00 00 00 00 11 B6 02 51 02 94 02 C0 02 F7 03 19 03 49 03 55 03 64
		39 00 00 00 00 00 0D B7 03 73 03 85 03 9B 03 B5 03 D1 03 D7
		39 00 00 00 00 00 11 B8 00 0B 00 1E 00 3C 00 55 00 6B 00 80 00 93 00 A4
		39 00 00 00 00 00 11 B9 00 B4 00 EB 01 16 01 58 01 8A 01 D6 02 12 02 14
		39 00 00 00 00 00 11 BA 02 4F 02 93 02 C0 02 FA 03 21 03 5B 03 6D 03 8D
		39 00 00 00 00 00 0D BB 03 A1 03 A3 03 A5 03 B9 03 D3 03 D7
		39 01 00 00 00 00 02 FB 01
		39 01 00 00 00 00 02 FF 10
		];
		qcom,mdss-dsi-on-command-19 =
		[
		39 01 00 00 00 00 02 FF 25
		39 01 00 00 00 00 02 FB 01
		39 01 00 00 00 00 02 8D 04
		39 01 00 00 00 00 02 FF 20
		39 01 00 00 00 00 02 FB 01
		39 01 00 00 00 00 02 30 10
		39 01 00 00 00 00 02 31 50
		39 01 00 00 00 00 02 32 2F
		39 01 00 00 00 00 02 94 00
		39 01 00 00 00 00 02 95 E1
		39 01 00 00 00 00 02 96 E1
 		39 01 00 00 00 00 02 FF 20       //Enter CMD2_P0
 		39 01 00 00 00 00 02 FB 01
 		39 01 00 00 00 00 02 AF 00       //R G B Gamma independent
 		39 01 00 00 00 00 11 B0 00 55 00 60 00 74 00 87 00 99 00 A9 00 B8 00 C7
 		39 01 00 00 00 00 11 B1 00 D4 01 03 01 29 01 64 01 93 01 DC 02 16 02 18
 		39 01 00 00 00 00 11 B2 02 53 02 96 02 C2 02 F8 03 1A 03 49 03 54 03 65
 		39 01 00 00 00 00 0D B3 03 74 03 85 03 9A 03 B4 03 D1 03 D7
 		39 01 00 00 00 00 11 B4 00 67 00 71 00 84 00 96 00 A7 00 B6 00 C4 00 D2
 		39 01 00 00 00 00 11 B5 00 DE 01 0A 01 2E 01 67 01 94 01 DB 02 15 02 17
 		39 01 00 00 00 00 11 B6 02 51 02 94 02 C0 02 F7 03 19 03 49 03 55 03 64
 		39 01 00 00 00 00 0D B7 03 73 03 85 03 9B 03 B5 03 D1 03 D7
 		39 01 00 00 00 00 11 B8 00 0B 00 1E 00 3C 00 55 00 6B 00 80 00 93 00 A4
 		39 01 00 00 00 00 11 B9 00 B4 00 EB 01 16 01 58 01 8A 01 D6 02 12 02 14
 		39 01 00 00 00 00 11 BA 02 4F 02 93 02 C0 02 FA 03 21 03 5B 03 6D 03 8D
 		39 01 00 00 00 00 0D BB 03 A1 03 A3 03 A5 03 B9 03 D3 03 D7
 		39 01 00 00 00 00 02 FF 21       //Enter CMD2_P1
 		39 01 00 00 00 00 02 FB 01
 		39 01 00 00 00 00 11 B0 00 55 00 60 00 74 00 87 00 99 00 A9 00 B8 00 C7
 		39 01 00 00 00 00 11 B1 00 D4 01 03 01 29 01 64 01 93 01 DC 02 16 02 18
 		39 01 00 00 00 00 11 B2 02 53 02 96 02 C2 02 F8 03 1A 03 49 03 54 03 65
 		39 01 00 00 00 00 0D B3 03 74 03 85 03 9A 03 B4 03 D1 03 D7
 		39 01 00 00 00 00 11 B4 00 67 00 71 00 84 00 96 00 A7 00 B6 00 C4 00 D2
 		39 01 00 00 00 00 11 B5 00 DE 01 0A 01 2E 01 67 01 94 01 DB 02 15 02 17
 		39 01 00 00 00 00 11 B6 02 51 02 94 02 C0 02 F7 03 19 03 49 03 55 03 64
 		39 01 00 00 00 00 0D B7 03 73 03 85 03 9B 03 B5 03 D1 03 D7
 		39 01 00 00 00 00 11 B8 00 0B 00 1E 00 3C 00 55 00 6B 00 80 00 93 00 A4
 		39 01 00 00 00 00 11 B9 00 B4 00 EB 01 16 01 58 01 8A 01 D6 02 12 02 14
 		39 01 00 00 00 00 11 BA 02 4F 02 93 02 C0 02 FA 03 21 03 5B 03 6D 03 8D
 		39 01 00 00 00 00 0D BB 03 A1 03 A3 03 A5 03 B9 03 D3 03 D7
		39 01 00 00 00 00 02 FF 10
		39 01 00 00 00 00 02 FB 01
		39 01 00 00 00 00 02 51 FF
		39 01 00 00 00 00 02 53 24
		39 01 00 00 00 00 02 55 00
		39 01 00 00 00 00 02 FF F0
		39 01 00 00 00 00 02 5A 02
		39 01 00 00 00 00 02 FF 10
		39 01 00 00 00 00 02 36 00
		39 01 00 00 00 00 02 35 00
		05 01 00 00 78 00 02 11 00
		05 01 00 00 14 00 02 29 00
		];
		qcom,mdss-white-command-20 = [
		39 01 00 00 00 00 02 FF 20       //Enter CMD2_P0
		39 00 00 00 00 00 02 AF 00       //R G B Gamma independent
		39 00 00 00 00 00 11 B0 00 A9 00 B1 00 BF 00 CC 00 D9 00 E5 00 F0 00 FB
		39 00 00 00 00 00 11 B1 01 05 01 29 01 48 01 7B 01 A5 01 E8 02 1F 02 20
		39 00 00 00 00 00 11 B2 02 59 02 9B 02 C7 02 FC 03 20 03 4B 03 57 03 68
		39 00 00 00 00 00 0D B3 03 77 03 8A 03 A0 03 BB 03 D3 03 D7
		39 00 00 00 00 00 11 B4 00 B1 00 B8 00 C6 00 D3 00 DF 00 EA 00 F5 00 FF
		39 00 00 00 00 00 11 B5 01 09 01 2B 01 4A 01 7B 01 A5 01 E6 02 1C 02 1E
		39 00 00 00 00 00 11 B6 02 56 02 99 02 C4 02 FA 03 1D 03 4B 03 58 03 66
		39 00 00 00 00 00 0D B7 03 75 03 87 03 9D 03 B8 03 D2 03 D7
		39 00 00 00 00 00 11 B8 00 09 00 1A 00 39 00 53 00 6B 00 81 00 94 00 A6
		39 00 00 00 00 00 11 B9 00 B6 00 EC 01 17 01 58 01 8C 01 D8 02 12 02 14
		39 00 00 00 00 00 11 BA 02 4F 02 93 02 C0 02 F9 03 21 03 58 03 6B 03 88
		39 00 00 00 00 00 0D BB 03 9B 03 A4 03 AA 03 B8 03 D1 03 D7
		39 01 00 00 00 00 02 FB 01
		39 01 00 00 00 00 02 FF 21       //Enter CMD2_P1
		39 00 00 00 00 00 11 B0 00 A9 00 B1 00 BF 00 CC 00 D9 00 E5 00 F0 00 FB
		39 00 00 00 00 00 11 B1 01 05 01 29 01 48 01 7B 01 A5 01 E8 02 1F 02 20
		39 00 00 00 00 00 11 B2 02 59 02 9B 02 C7 02 FC 03 20 03 4B 03 57 03 68
		39 00 00 00 00 00 0D B3 03 77 03 8A 03 A0 03 BB 03 D3 03 D7
		39 00 00 00 00 00 11 B4 00 B1 00 B8 00 C6 00 D3 00 DF 00 EA 00 F5 00 FF
		39 00 00 00 00 00 11 B5 01 09 01 2B 01 4A 01 7B 01 A5 01 E6 02 1C 02 1E
		39 00 00 00 00 00 11 B6 02 56 02 99 02 C4 02 FA 03 1D 03 4B 03 58 03 66
		39 00 00 00 00 00 0D B7 03 75 03 87 03 9D 03 B8 03 D2 03 D7
		39 00 00 00 00 00 11 B8 00 09 00 1A 00 39 00 53 00 6B 00 81 00 94 00 A6
		39 00 00 00 00 00 11 B9 00 B6 00 EC 01 17 01 58 01 8C 01 D8 02 12 02 14
		39 00 00 00 00 00 11 BA 02 4F 02 93 02 C0 02 F9 03 21 03 58 03 6B 03 88
		39 00 00 00 00 00 0D BB 03 9B 03 A4 03 AA 03 B8 03 D1 03 D7
		39 01 00 00 00 00 02 FB 01
		39 01 00 00 00 00 02 FF 10
		];
		qcom,mdss-dsi-on-command-20 =
		[
		39 01 00 00 00 00 02 FF 25
		39 01 00 00 00 00 02 FB 01
		39 01 00 00 00 00 02 8D 04
		39 01 00 00 00 00 02 FF 20
		39 01 00 00 00 00 02 FB 01
		39 01 00 00 00 00 02 30 10
		39 01 00 00 00 00 02 31 50
		39 01 00 00 00 00 02 32 2F
		39 01 00 00 00 00 02 94 00
		39 01 00 00 00 00 02 95 E1
		39 01 00 00 00 00 02 96 E1
 		39 01 00 00 00 00 02 FF 20       //Enter CMD2_P0
 		39 01 00 00 00 00 02 FB 01
 		39 01 00 00 00 00 02 AF 00       //R G B Gamma independent
 		39 01 00 00 00 00 11 B0 00 A9 00 B1 00 BF 00 CC 00 D9 00 E5 00 F0 00 FB
 		39 01 00 00 00 00 11 B1 01 05 01 29 01 48 01 7B 01 A5 01 E8 02 1F 02 20
 		39 01 00 00 00 00 11 B2 02 59 02 9B 02 C7 02 FC 03 20 03 4B 03 57 03 68
 		39 01 00 00 00 00 0D B3 03 77 03 8A 03 A0 03 BB 03 D3 03 D7
 		39 01 00 00 00 00 11 B4 00 B1 00 B8 00 C6 00 D3 00 DF 00 EA 00 F5 00 FF
 		39 01 00 00 00 00 11 B5 01 09 01 2B 01 4A 01 7B 01 A5 01 E6 02 1C 02 1E
 		39 01 00 00 00 00 11 B6 02 56 02 99 02 C4 02 FA 03 1D 03 4B 03 58 03 66
 		39 01 00 00 00 00 0D B7 03 75 03 87 03 9D 03 B8 03 D2 03 D7
 		39 01 00 00 00 00 11 B8 00 09 00 1A 00 39 00 53 00 6B 00 81 00 94 00 A6
 		39 01 00 00 00 00 11 B9 00 B6 00 EC 01 17 01 58 01 8C 01 D8 02 12 02 14
 		39 01 00 00 00 00 11 BA 02 4F 02 93 02 C0 02 F9 03 21 03 58 03 6B 03 88
 		39 01 00 00 00 00 0D BB 03 9B 03 A4 03 AA 03 B8 03 D1 03 D7
 		39 01 00 00 00 00 02 FF 21       //Enter CMD2_P1
 		39 01 00 00 00 00 02 FB 01
 		39 01 00 00 00 00 11 B0 00 A9 00 B1 00 BF 00 CC 00 D9 00 E5 00 F0 00 FB
 		39 01 00 00 00 00 11 B1 01 05 01 29 01 48 01 7B 01 A5 01 E8 02 1F 02 20
 		39 01 00 00 00 00 11 B2 02 59 02 9B 02 C7 02 FC 03 20 03 4B 03 57 03 68
 		39 01 00 00 00 00 0D B3 03 77 03 8A 03 A0 03 BB 03 D3 03 D7
 		39 01 00 00 00 00 11 B4 00 B1 00 B8 00 C6 00 D3 00 DF 00 EA 00 F5 00 FF
 		39 01 00 00 00 00 11 B5 01 09 01 2B 01 4A 01 7B 01 A5 01 E6 02 1C 02 1E
 		39 01 00 00 00 00 11 B6 02 56 02 99 02 C4 02 FA 03 1D 03 4B 03 58 03 66
 		39 01 00 00 00 00 0D B7 03 75 03 87 03 9D 03 B8 03 D2 03 D7
 		39 01 00 00 00 00 11 B8 00 09 00 1A 00 39 00 53 00 6B 00 81 00 94 00 A6
 		39 01 00 00 00 00 11 B9 00 B6 00 EC 01 17 01 58 01 8C 01 D8 02 12 02 14
 		39 01 00 00 00 00 11 BA 02 4F 02 93 02 C0 02 F9 03 21 03 58 03 6B 03 88
 		39 01 00 00 00 00 0D BB 03 9B 03 A4 03 AA 03 B8 03 D1 03 D7
		39 01 00 00 00 00 02 FF 10
		39 01 00 00 00 00 02 FB 01
		39 01 00 00 00 00 02 51 FF
		39 01 00 00 00 00 02 53 24
		39 01 00 00 00 00 02 55 00
		39 01 00 00 00 00 02 FF F0
		39 01 00 00 00 00 02 5A 02
		39 01 00 00 00 00 02 FF 10
		39 01 00 00 00 00 02 36 00
		39 01 00 00 00 00 02 35 00
		05 01 00 00 78 00 02 11 00
		05 01 00 00 14 00 02 29 00
		];
		qcom,mdss-white-command-21 = [
		39 01 00 00 00 00 02 FF 20       //Enter CMD2_P0
		39 00 00 00 00 00 02 AF 00       //R G B Gamma independent
		39 00 00 00 00 00 11 B0 01 57 01 5A 01 5F 01 64 01 6A 01 6F 01 74 01 78
		39 00 00 00 00 00 11 B1 01 7D 01 8F 01 A0 01 BE 01 D9 02 09 02 39 02 3A
		39 00 00 00 00 00 11 B2 02 6E 02 AF 02 D9 03 0A 03 2F 03 5E 03 6B 03 74
		39 00 00 00 00 00 0D B3 03 80 03 90 03 A4 03 BC 03 D3 03 D7
		39 00 00 00 00 00 11 B4 00 09 00 19 00 33 00 4C 00 63 00 77 00 8A 00 9A
		39 00 00 00 00 00 11 B5 00 AA 00 DF 01 0A 01 4A 01 7D 01 CA 02 07 02 08
		39 00 00 00 00 00 11 B6 02 44 02 8A 02 B7 02 EE 03 0E 03 42 03 4F 03 5E
		39 00 00 00 00 00 0D B7 03 6B 03 7F 03 97 03 B2 03 D1 03 D7
		39 00 00 00 00 00 11 B8 00 E0 00 E6 00 F0 00 FA 01 04 01 0D 01 16 01 1E
		39 00 00 00 00 00 11 B9 01 26 01 43 01 5D 01 88 01 AD 01 EA 02 1F 02 20
		39 00 00 00 00 00 11 BA 02 58 02 9C 02 C9 02 FF 03 28 03 66 03 7E 03 AC
		39 00 00 00 00 00 0D BB 03 C7 03 CA 03 CC 03 CE 03 D3 03 D7
		39 01 00 00 00 00 02 FB 01
		39 01 00 00 00 00 02 FF 21       //Enter CMD2_P1
		39 00 00 00 00 00 11 B0 01 57 01 5A 01 5F 01 64 01 6A 01 6F 01 74 01 78
		39 00 00 00 00 00 11 B1 01 7D 01 8F 01 A0 01 BE 01 D9 02 09 02 39 02 3A
		39 00 00 00 00 00 11 B2 02 6E 02 AF 02 D9 03 0A 03 2F 03 5E 03 6B 03 74
		39 00 00 00 00 00 0D B3 03 80 03 90 03 A4 03 BC 03 D3 03 D7
		39 00 00 00 00 00 11 B4 00 09 00 19 00 33 00 4C 00 63 00 77 00 8A 00 9A
		39 00 00 00 00 00 11 B5 00 AA 00 DF 01 0A 01 4A 01 7D 01 CA 02 07 02 08
		39 00 00 00 00 00 11 B6 02 44 02 8A 02 B7 02 EE 03 0E 03 42 03 4F 03 5E
		39 00 00 00 00 00 0D B7 03 6B 03 7F 03 97 03 B2 03 D1 03 D7
		39 00 00 00 00 00 11 B8 00 E0 00 E6 00 F0 00 FA 01 04 01 0D 01 16 01 1E
		39 00 00 00 00 00 11 B9 01 26 01 43 01 5D 01 88 01 AD 01 EA 02 1F 02 20
		39 00 00 00 00 00 11 BA 02 58 02 9C 02 C9 02 FF 03 28 03 66 03 7E 03 AC
		39 00 00 00 00 00 0D BB 03 C7 03 CA 03 CC 03 CE 03 D3 03 D7
		39 01 00 00 00 00 02 FB 01
		39 01 00 00 00 00 02 FF 10
		];
		qcom,mdss-dsi-on-command-21 =
		[
		39 01 00 00 00 00 02 FF 25
		39 01 00 00 00 00 02 FB 01
		39 01 00 00 00 00 02 8D 04
		39 01 00 00 00 00 02 FF 20
		39 01 00 00 00 00 02 FB 01
		39 01 00 00 00 00 02 30 10
		39 01 00 00 00 00 02 31 50
		39 01 00 00 00 00 02 32 2F
		39 01 00 00 00 00 02 94 00
		39 01 00 00 00 00 02 95 E1
		39 01 00 00 00 00 02 96 E1
 		39 01 00 00 00 00 02 FF 20       //Enter CMD2_P0
 		39 01 00 00 00 00 02 FB 01
 		39 01 00 00 00 00 02 AF 00       //R G B Gamma independent
 		39 01 00 00 00 00 11 B0 01 57 01 5A 01 5F 01 64 01 6A 01 6F 01 74 01 78
 		39 01 00 00 00 00 11 B1 01 7D 01 8F 01 A0 01 BE 01 D9 02 09 02 39 02 3A
 		39 01 00 00 00 00 11 B2 02 6E 02 AF 02 D9 03 0A 03 2F 03 5E 03 6B 03 74
 		39 01 00 00 00 00 0D B3 03 80 03 90 03 A4 03 BC 03 D3 03 D7
 		39 01 00 00 00 00 11 B4 00 09 00 19 00 33 00 4C 00 63 00 77 00 8A 00 9A
 		39 01 00 00 00 00 11 B5 00 AA 00 DF 01 0A 01 4A 01 7D 01 CA 02 07 02 08
 		39 01 00 00 00 00 11 B6 02 44 02 8A 02 B7 02 EE 03 0E 03 42 03 4F 03 5E
 		39 01 00 00 00 00 0D B7 03 6B 03 7F 03 97 03 B2 03 D1 03 D7
 		39 01 00 00 00 00 11 B8 00 E0 00 E6 00 F0 00 FA 01 04 01 0D 01 16 01 1E
 		39 01 00 00 00 00 11 B9 01 26 01 43 01 5D 01 88 01 AD 01 EA 02 1F 02 20
 		39 01 00 00 00 00 11 BA 02 58 02 9C 02 C9 02 FF 03 28 03 66 03 7E 03 AC
 		39 01 00 00 00 00 0D BB 03 C7 03 CA 03 CC 03 CE 03 D3 03 D7
 		39 01 00 00 00 00 02 FF 21       //Enter CMD2_P1
 		39 01 00 00 00 00 02 FB 01
 		39 01 00 00 00 00 11 B0 01 57 01 5A 01 5F 01 64 01 6A 01 6F 01 74 01 78
 		39 01 00 00 00 00 11 B1 01 7D 01 8F 01 A0 01 BE 01 D9 02 09 02 39 02 3A
 		39 01 00 00 00 00 11 B2 02 6E 02 AF 02 D9 03 0A 03 2F 03 5E 03 6B 03 74
 		39 01 00 00 00 00 0D B3 03 80 03 90 03 A4 03 BC 03 D3 03 D7
 		39 01 00 00 00 00 11 B4 00 09 00 19 00 33 00 4C 00 63 00 77 00 8A 00 9A
 		39 01 00 00 00 00 11 B5 00 AA 00 DF 01 0A 01 4A 01 7D 01 CA 02 07 02 08
 		39 01 00 00 00 00 11 B6 02 44 02 8A 02 B7 02 EE 03 0E 03 42 03 4F 03 5E
 		39 01 00 00 00 00 0D B7 03 6B 03 7F 03 97 03 B2 03 D1 03 D7
 		39 01 00 00 00 00 11 B8 00 E0 00 E6 00 F0 00 FA 01 04 01 0D 01 16 01 1E
 		39 01 00 00 00 00 11 B9 01 26 01 43 01 5D 01 88 01 AD 01 EA 02 1F 02 20
 		39 01 00 00 00 00 11 BA 02 58 02 9C 02 C9 02 FF 03 28 03 66 03 7E 03 AC
 		39 01 00 00 00 00 0D BB 03 C7 03 CA 03 CC 03 CE 03 D3 03 D7
		39 01 00 00 00 00 02 FF 10
		39 01 00 00 00 00 02 FB 01
		39 01 00 00 00 00 02 51 FF
		39 01 00 00 00 00 02 53 24
		39 01 00 00 00 00 02 55 00
		39 01 00 00 00 00 02 FF F0
		39 01 00 00 00 00 02 5A 02
		39 01 00 00 00 00 02 FF 10
		39 01 00 00 00 00 02 36 00
		39 01 00 00 00 00 02 35 00
		05 01 00 00 78 00 02 11 00
		05 01 00 00 14 00 02 29 00
		];
		qcom,mdss-white-command-22 = [
 		39 01 00 00 00 00 02 FF 20       //Enter CMD2_P0
 		39 00 00 00 00 00 02 AF 00       //R G B Gamma independent
 		39 00 00 00 00 00 11 B0 01 3E 01 41 01 48 01 4E 01 54 01 5A 01 60 01 66
 		39 00 00 00 00 00 11 B1 01 6B 01 80 01 93 01 B4 01 D2 02 05 02 36 02 38
 		39 00 00 00 00 00 11 B2 02 6C 02 AC 02 D6 03 06 03 2C 03 58 03 65 03 6F
 		39 00 00 00 00 00 0D B3 03 7E 03 8F 03 A3 03 BB 03 D3 03 D7
 		39 00 00 00 00 00 11 B4 00 09 00 19 00 37 00 4F 00 65 00 7A 00 8C 00 9F
 		39 00 00 00 00 00 11 B5 00 AF 00 E5 01 0F 01 51 01 84 01 D0 02 0C 02 10
 		39 00 00 00 00 00 11 B6 02 4A 02 8D 02 BA 02 F0 03 10 03 43 03 51 03 5F
 		39 00 00 00 00 00 0D B7 03 6F 03 82 03 98 03 B3 03 D1 03 D7
 		39 00 00 00 00 00 11 B8 00 8F 00 97 00 A9 00 B8 00 C6 00 D4 00 E0 00 ED
 		39 00 00 00 00 00 11 B9 00 F8 01 1F 01 3F 01 74 01 9F 01 E2 02 1A 02 1D
 		39 00 00 00 00 00 11 BA 02 55 02 98 02 C5 02 FB 03 25 03 60 03 79 03 9D
 		39 00 00 00 00 00 0D BB 03 CC 03 CE 03 D0 03 D2 03 D4 03 D7
		39 01 00 00 00 00 02 FB 01
 		39 01 00 00 00 00 02 FF 21       //Enter CMD2_P1
 		39 00 00 00 00 00 11 B0 01 3E 01 41 01 48 01 4E 01 54 01 5A 01 60 01 66
 		39 00 00 00 00 00 11 B1 01 6B 01 80 01 93 01 B4 01 D2 02 05 02 36 02 38
 		39 00 00 00 00 00 11 B2 02 6C 02 AC 02 D6 03 06 03 2C 03 58 03 65 03 6F
 		39 00 00 00 00 00 0D B3 03 7E 03 8F 03 A3 03 BB 03 D3 03 D7
 		39 00 00 00 00 00 11 B4 00 09 00 19 00 37 00 4F 00 65 00 7A 00 8C 00 9F
 		39 00 00 00 00 00 11 B5 00 AF 00 E5 01 0F 01 51 01 84 01 D0 02 0C 02 10
 		39 00 00 00 00 00 11 B6 02 4A 02 8D 02 BA 02 F0 03 10 03 43 03 51 03 5F
 		39 00 00 00 00 00 0D B7 03 6F 03 82 03 98 03 B3 03 D1 03 D7
 		39 00 00 00 00 00 11 B8 00 8F 00 97 00 A9 00 B8 00 C6 00 D4 00 E0 00 ED
 		39 00 00 00 00 00 11 B9 00 F8 01 1F 01 3F 01 74 01 9F 01 E2 02 1A 02 1D
 		39 00 00 00 00 00 11 BA 02 55 02 98 02 C5 02 FB 03 25 03 60 03 79 03 9D
 		39 00 00 00 00 00 0D BB 03 CC 03 CE 03 D0 03 D2 03 D4 03 D7
		39 01 00 00 00 00 02 FB 01
		39 01 00 00 00 00 02 FF 10
		];
		qcom,mdss-dsi-on-command-22 =
		[
		39 01 00 00 00 00 02 FF 25
		39 01 00 00 00 00 02 FB 01
		39 01 00 00 00 00 02 8D 04
		39 01 00 00 00 00 02 FF 20
		39 01 00 00 00 00 02 FB 01
		39 01 00 00 00 00 02 30 10
		39 01 00 00 00 00 02 31 50
		39 01 00 00 00 00 02 32 2F
		39 01 00 00 00 00 02 94 00
		39 01 00 00 00 00 02 95 E1
		39 01 00 00 00 00 02 96 E1
 		39 01 00 00 00 00 02 FF 20       //Enter CMD2_P0
 		39 01 00 00 00 00 02 FB 01
 		39 01 00 00 00 00 02 AF 00       //R G B Gamma independent
 		39 01 00 00 00 00 11 B0 01 3E 01 41 01 48 01 4E 01 54 01 5A 01 60 01 66
 		39 01 00 00 00 00 11 B1 01 6B 01 80 01 93 01 B4 01 D2 02 05 02 36 02 38
 		39 01 00 00 00 00 11 B2 02 6C 02 AC 02 D6 03 06 03 2C 03 58 03 65 03 6F
 		39 01 00 00 00 00 0D B3 03 7E 03 8F 03 A3 03 BB 03 D3 03 D7
 		39 01 00 00 00 00 11 B4 00 09 00 19 00 37 00 4F 00 65 00 7A 00 8C 00 9F
 		39 01 00 00 00 00 11 B5 00 AF 00 E5 01 0F 01 51 01 84 01 D0 02 0C 02 10
 		39 01 00 00 00 00 11 B6 02 4A 02 8D 02 BA 02 F0 03 10 03 43 03 51 03 5F
 		39 01 00 00 00 00 0D B7 03 6F 03 82 03 98 03 B3 03 D1 03 D7
 		39 01 00 00 00 00 11 B8 00 8F 00 97 00 A9 00 B8 00 C6 00 D4 00 E0 00 ED
 		39 01 00 00 00 00 11 B9 00 F8 01 1F 01 3F 01 74 01 9F 01 E2 02 1A 02 1D
 		39 01 00 00 00 00 11 BA 02 55 02 98 02 C5 02 FB 03 25 03 60 03 79 03 9D
 		39 01 00 00 00 00 0D BB 03 CC 03 CE 03 D0 03 D2 03 D4 03 D7
 		39 01 00 00 00 00 02 FF 21       //Enter CMD2_P1
 		39 01 00 00 00 00 02 FB 01
 		39 01 00 00 00 00 11 B0 01 3E 01 41 01 48 01 4E 01 54 01 5A 01 60 01 66
 		39 01 00 00 00 00 11 B1 01 6B 01 80 01 93 01 B4 01 D2 02 05 02 36 02 38
 		39 01 00 00 00 00 11 B2 02 6C 02 AC 02 D6 03 06 03 2C 03 58 03 65 03 6F
 		39 01 00 00 00 00 0D B3 03 7E 03 8F 03 A3 03 BB 03 D3 03 D7
 		39 01 00 00 00 00 11 B4 00 09 00 19 00 37 00 4F 00 65 00 7A 00 8C 00 9F
 		39 01 00 00 00 00 11 B5 00 AF 00 E5 01 0F 01 51 01 84 01 D0 02 0C 02 10
 		39 01 00 00 00 00 11 B6 02 4A 02 8D 02 BA 02 F0 03 10 03 43 03 51 03 5F
 		39 01 00 00 00 00 0D B7 03 6F 03 82 03 98 03 B3 03 D1 03 D7
 		39 01 00 00 00 00 11 B8 00 8F 00 97 00 A9 00 B8 00 C6 00 D4 00 E0 00 ED
 		39 01 00 00 00 00 11 B9 00 F8 01 1F 01 3F 01 74 01 9F 01 E2 02 1A 02 1D
 		39 01 00 00 00 00 11 BA 02 55 02 98 02 C5 02 FB 03 25 03 60 03 79 03 9D
 		39 01 00 00 00 00 0D BB 03 CC 03 CE 03 D0 03 D2 03 D4 03 D7
		39 01 00 00 00 00 02 FF 10
		39 01 00 00 00 00 02 FB 01
		39 01 00 00 00 00 02 51 FF
		39 01 00 00 00 00 02 53 24
		39 01 00 00 00 00 02 55 00
		39 01 00 00 00 00 02 FF F0
		39 01 00 00 00 00 02 5A 02
		39 01 00 00 00 00 02 FF 10
		39 01 00 00 00 00 02 36 00
		39 01 00 00 00 00 02 35 00
		05 01 00 00 78 00 02 11 00
		05 01 00 00 14 00 02 29 00
		];
		qcom,mdss-white-command-23 = [
 		39 01 00 00 00 00 02 FF 20       //Enter CMD2_P0
 		39 00 00 00 00 00 02 AF 00       //R G B Gamma independent
 		39 00 00 00 00 00 11 B0 00 FD 01 02 01 0B 01 14 01 1D 01 25 01 2D 01 35
 		39 00 00 00 00 00 11 B1 01 3C 01 57 01 6F 01 98 01 BB 01 F5 02 2A 02 2C
 		39 00 00 00 00 00 11 B2 02 63 02 A4 02 CF 03 03 03 27 03 52 03 5E 03 6C
 		39 00 00 00 00 00 0D B3 03 7B 03 8B 03 9F 03 B7 03 D2 03 D7
 		39 00 00 00 00 00 11 B4 00 65 00 6F 00 83 00 95 00 A5 00 B5 00 C3 00 D0
 		39 00 00 00 00 00 11 B5 00 DD 01 09 01 2D 01 67 01 94 01 DB 02 15 02 17
 		39 00 00 00 00 00 11 B6 02 51 02 94 02 C0 02 F7 03 19 03 48 03 55 03 63
 		39 00 00 00 00 00 0D B7 03 73 03 85 03 9A 03 B5 03 D1 03 D7
 		39 00 00 00 00 00 11 B8 00 0B 00 1E 00 3C 00 55 00 6B 00 80 00 93 00 A4
 		39 00 00 00 00 00 11 B9 00 B4 00 EB 01 16 01 59 01 8A 01 D6 02 12 02 14
 		39 00 00 00 00 00 11 BA 02 4F 02 93 02 C0 02 FA 03 21 03 59 03 6D 03 84
 		39 00 00 00 00 00 0D BB 03 99 03 9E 03 A0 03 B9 03 D3 03 D7
		39 01 00 00 00 00 02 FB 01
 		39 01 00 00 00 00 02 FF 21       //Enter CMD2_P1
 		39 00 00 00 00 00 11 B0 00 FD 01 02 01 0B 01 14 01 1D 01 25 01 2D 01 35
 		39 00 00 00 00 00 11 B1 01 3C 01 57 01 6F 01 98 01 BB 01 F5 02 2A 02 2C
 		39 00 00 00 00 00 11 B2 02 63 02 A4 02 CF 03 03 03 27 03 52 03 5E 03 6C
 		39 00 00 00 00 00 0D B3 03 7B 03 8B 03 9F 03 B7 03 D2 03 D7
 		39 00 00 00 00 00 11 B4 00 65 00 6F 00 83 00 95 00 A5 00 B5 00 C3 00 D0
 		39 00 00 00 00 00 11 B5 00 DD 01 09 01 2D 01 67 01 94 01 DB 02 15 02 17
 		39 00 00 00 00 00 11 B6 02 51 02 94 02 C0 02 F7 03 19 03 48 03 55 03 63
 		39 00 00 00 00 00 0D B7 03 73 03 85 03 9A 03 B5 03 D1 03 D7
 		39 00 00 00 00 00 11 B8 00 0B 00 1E 00 3C 00 55 00 6B 00 80 00 93 00 A4
 		39 00 00 00 00 00 11 B9 00 B4 00 EB 01 16 01 59 01 8A 01 D6 02 12 02 14
 		39 00 00 00 00 00 11 BA 02 4F 02 93 02 C0 02 FA 03 21 03 59 03 6D 03 84
 		39 00 00 00 00 00 0D BB 03 99 03 9E 03 A0 03 B9 03 D3 03 D7
		39 01 00 00 00 00 02 FB 01
		39 01 00 00 00 00 02 FF 10
		];
		qcom,mdss-dsi-on-command-23 =
		[
		39 01 00 00 00 00 02 FF 25
		39 01 00 00 00 00 02 FB 01
		39 01 00 00 00 00 02 8D 04
		39 01 00 00 00 00 02 FF 20
		39 01 00 00 00 00 02 FB 01
		39 01 00 00 00 00 02 30 10
		39 01 00 00 00 00 02 31 50
		39 01 00 00 00 00 02 32 2F
		39 01 00 00 00 00 02 94 00
		39 01 00 00 00 00 02 95 E1
		39 01 00 00 00 00 02 96 E1
 		39 01 00 00 00 00 02 FF 20       //Enter CMD2_P0
 		39 01 00 00 00 00 02 FB 01
 		39 01 00 00 00 00 02 AF 00       //R G B Gamma independent
 		39 01 00 00 00 00 11 B0 00 FD 01 02 01 0B 01 14 01 1D 01 25 01 2D 01 35
 		39 01 00 00 00 00 11 B1 01 3C 01 57 01 6F 01 98 01 BB 01 F5 02 2A 02 2C
 		39 01 00 00 00 00 11 B2 02 63 02 A4 02 CF 03 03 03 27 03 52 03 5E 03 6C
 		39 01 00 00 00 00 0D B3 03 7B 03 8B 03 9F 03 B7 03 D2 03 D7
 		39 01 00 00 00 00 11 B4 00 65 00 6F 00 83 00 95 00 A5 00 B5 00 C3 00 D0
 		39 01 00 00 00 00 11 B5 00 DD 01 09 01 2D 01 67 01 94 01 DB 02 15 02 17
 		39 01 00 00 00 00 11 B6 02 51 02 94 02 C0 02 F7 03 19 03 48 03 55 03 63
 		39 01 00 00 00 00 0D B7 03 73 03 85 03 9A 03 B5 03 D1 03 D7
 		39 01 00 00 00 00 11 B8 00 0B 00 1E 00 3C 00 55 00 6B 00 80 00 93 00 A4
 		39 01 00 00 00 00 11 B9 00 B4 00 EB 01 16 01 59 01 8A 01 D6 02 12 02 14
 		39 01 00 00 00 00 11 BA 02 4F 02 93 02 C0 02 FA 03 21 03 59 03 6D 03 84
 		39 01 00 00 00 00 0D BB 03 99 03 9E 03 A0 03 B9 03 D3 03 D7
 		39 01 00 00 00 00 02 FF 21       //Enter CMD2_P1
 		39 01 00 00 00 00 02 FB 01
 		39 01 00 00 00 00 11 B0 00 FD 01 02 01 0B 01 14 01 1D 01 25 01 2D 01 35
 		39 01 00 00 00 00 11 B1 01 3C 01 57 01 6F 01 98 01 BB 01 F5 02 2A 02 2C
 		39 01 00 00 00 00 11 B2 02 63 02 A4 02 CF 03 03 03 27 03 52 03 5E 03 6C
 		39 01 00 00 00 00 0D B3 03 7B 03 8B 03 9F 03 B7 03 D2 03 D7
 		39 01 00 00 00 00 11 B4 00 65 00 6F 00 83 00 95 00 A5 00 B5 00 C3 00 D0
 		39 01 00 00 00 00 11 B5 00 DD 01 09 01 2D 01 67 01 94 01 DB 02 15 02 17
 		39 01 00 00 00 00 11 B6 02 51 02 94 02 C0 02 F7 03 19 03 48 03 55 03 63
 		39 01 00 00 00 00 0D B7 03 73 03 85 03 9A 03 B5 03 D1 03 D7
 		39 01 00 00 00 00 11 B8 00 0B 00 1E 00 3C 00 55 00 6B 00 80 00 93 00 A4
 		39 01 00 00 00 00 11 B9 00 B4 00 EB 01 16 01 59 01 8A 01 D6 02 12 02 14
 		39 01 00 00 00 00 11 BA 02 4F 02 93 02 C0 02 FA 03 21 03 59 03 6D 03 84
 		39 01 00 00 00 00 0D BB 03 99 03 9E 03 A0 03 B9 03 D3 03 D7
		39 01 00 00 00 00 02 FF 10
		39 01 00 00 00 00 02 FB 01
		39 01 00 00 00 00 02 51 FF
		39 01 00 00 00 00 02 53 24
		39 01 00 00 00 00 02 55 00
		39 01 00 00 00 00 02 FF F0
		39 01 00 00 00 00 02 5A 02
		39 01 00 00 00 00 02 FF 10
		39 01 00 00 00 00 02 36 00
		39 01 00 00 00 00 02 35 00
		05 01 00 00 78 00 02 11 00
		05 01 00 00 14 00 02 29 00
		];
		qcom,mdss-white-command-24 = [
		39 01 00 00 00 00 02 FF 20       //Enter CMD2_P0
		39 00 00 00 00 00 02 AF 00       //R G B Gamma independent
		39 00 00 00 00 00 11 B0 01 06 01 0B 01 14 01 1C 01 25 01 2D 01 34 01 3C
		39 00 00 00 00 00 11 B1 01 43 01 5D 01 74 01 9C 01 BE 01 F8 02 2C 02 2E
		39 00 00 00 00 00 11 B2 02 64 02 A5 02 CF 03 02 03 28 03 51 03 5E 03 6C
		39 00 00 00 00 00 0D B3 03 7B 03 8D 03 A2 03 BB 03 D3 03 D7
		39 00 00 00 00 00 11 B4 00 C2 00 C9 00 D6 00 E2 00 ED 00 F8 01 02 01 0C
		39 00 00 00 00 00 11 B5 01 15 01 36 01 53 01 82 01 A8 01 E9 02 20 02 21
		39 00 00 00 00 00 11 B6 02 59 02 9B 02 C6 02 FA 03 21 03 4C 03 59 03 67
		39 00 00 00 00 00 0D B7 03 77 03 89 03 9F 03 BA 03 D3 03 D7
		39 00 00 00 00 00 11 B8 00 0B 00 1D 00 3C 00 55 00 6C 00 81 00 94 00 A6
		39 00 00 00 00 00 11 B9 00 B7 00 EE 01 1A 01 5B 01 8B 01 D7 02 14 02 15
		39 00 00 00 00 00 11 BA 02 50 02 94 02 C0 02 F8 03 22 03 58 03 6C 03 84
		39 00 00 00 00 00 0D BB 03 98 03 9E 03 A0 03 B7 03 D1 03 D7
		39 01 00 00 00 00 02 FB 01
		39 01 00 00 00 00 02 FF 21       //Enter CMD2_P1
		39 00 00 00 00 00 11 B0 01 06 01 0B 01 14 01 1C 01 25 01 2D 01 34 01 3C
		39 00 00 00 00 00 11 B1 01 43 01 5D 01 74 01 9C 01 BE 01 F8 02 2C 02 2E
		39 00 00 00 00 00 11 B2 02 64 02 A5 02 CF 03 02 03 28 03 51 03 5E 03 6C
		39 00 00 00 00 00 0D B3 03 7B 03 8D 03 A2 03 BB 03 D3 03 D7
		39 00 00 00 00 00 11 B4 00 C2 00 C9 00 D6 00 E2 00 ED 00 F8 01 02 01 0C
		39 00 00 00 00 00 11 B5 01 15 01 36 01 53 01 82 01 A8 01 E9 02 20 02 21
		39 00 00 00 00 00 11 B6 02 59 02 9B 02 C6 02 FA 03 21 03 4C 03 59 03 67
		39 00 00 00 00 00 0D B7 03 77 03 89 03 9F 03 BA 03 D3 03 D7
		39 00 00 00 00 00 11 B8 00 0B 00 1D 00 3C 00 55 00 6C 00 81 00 94 00 A6
		39 00 00 00 00 00 11 B9 00 B7 00 EE 01 1A 01 5B 01 8B 01 D7 02 14 02 15
		39 00 00 00 00 00 11 BA 02 50 02 94 02 C0 02 F8 03 22 03 58 03 6C 03 84
		39 00 00 00 00 00 0D BB 03 98 03 9E 03 A0 03 B7 03 D1 03 D7
		39 01 00 00 00 00 02 FB 01
		39 01 00 00 00 00 02 FF 10
		];
		qcom,mdss-dsi-on-command-24 =
		[
		39 01 00 00 00 00 02 FF 25
		39 01 00 00 00 00 02 FB 01
		39 01 00 00 00 00 02 8D 04
		39 01 00 00 00 00 02 FF 20
		39 01 00 00 00 00 02 FB 01
		39 01 00 00 00 00 02 30 10
		39 01 00 00 00 00 02 31 50
		39 01 00 00 00 00 02 32 2F
		39 01 00 00 00 00 02 94 00
		39 01 00 00 00 00 02 95 E1
		39 01 00 00 00 00 02 96 E1
 		39 01 00 00 00 00 02 FF 20       //Enter CMD2_P0
 		39 01 00 00 00 00 02 FB 01
 		39 01 00 00 00 00 02 AF 00       //R G B Gamma independent
 		39 01 00 00 00 00 11 B0 01 06 01 0B 01 14 01 1C 01 25 01 2D 01 34 01 3C
 		39 01 00 00 00 00 11 B1 01 43 01 5D 01 74 01 9C 01 BE 01 F8 02 2C 02 2E
 		39 01 00 00 00 00 11 B2 02 64 02 A5 02 CF 03 02 03 28 03 51 03 5E 03 6C
 		39 01 00 00 00 00 0D B3 03 7B 03 8D 03 A2 03 BB 03 D3 03 D7
 		39 01 00 00 00 00 11 B4 00 C2 00 C9 00 D6 00 E2 00 ED 00 F8 01 02 01 0C
 		39 01 00 00 00 00 11 B5 01 15 01 36 01 53 01 82 01 A8 01 E9 02 20 02 21
 		39 01 00 00 00 00 11 B6 02 59 02 9B 02 C6 02 FA 03 21 03 4C 03 59 03 67
 		39 01 00 00 00 00 0D B7 03 77 03 89 03 9F 03 BA 03 D3 03 D7
 		39 01 00 00 00 00 11 B8 00 0B 00 1D 00 3C 00 55 00 6C 00 81 00 94 00 A6
 		39 01 00 00 00 00 11 B9 00 B7 00 EE 01 1A 01 5B 01 8B 01 D7 02 14 02 15
 		39 01 00 00 00 00 11 BA 02 50 02 94 02 C0 02 F8 03 22 03 58 03 6C 03 84
 		39 01 00 00 00 00 0D BB 03 98 03 9E 03 A0 03 B7 03 D1 03 D7
 		39 01 00 00 00 00 02 FF 21       //Enter CMD2_P1
 		39 01 00 00 00 00 02 FB 01
 		39 01 00 00 00 00 11 B0 01 06 01 0B 01 14 01 1C 01 25 01 2D 01 34 01 3C
 		39 01 00 00 00 00 11 B1 01 43 01 5D 01 74 01 9C 01 BE 01 F8 02 2C 02 2E
 		39 01 00 00 00 00 11 B2 02 64 02 A5 02 CF 03 02 03 28 03 51 03 5E 03 6C
 		39 01 00 00 00 00 0D B3 03 7B 03 8D 03 A2 03 BB 03 D3 03 D7
 		39 01 00 00 00 00 11 B4 00 C2 00 C9 00 D6 00 E2 00 ED 00 F8 01 02 01 0C
 		39 01 00 00 00 00 11 B5 01 15 01 36 01 53 01 82 01 A8 01 E9 02 20 02 21
 		39 01 00 00 00 00 11 B6 02 59 02 9B 02 C6 02 FA 03 21 03 4C 03 59 03 67
 		39 01 00 00 00 00 0D B7 03 77 03 89 03 9F 03 BA 03 D3 03 D7
 		39 01 00 00 00 00 11 B8 00 0B 00 1D 00 3C 00 55 00 6C 00 81 00 94 00 A6
 		39 01 00 00 00 00 11 B9 00 B7 00 EE 01 1A 01 5B 01 8B 01 D7 02 14 02 15
 		39 01 00 00 00 00 11 BA 02 50 02 94 02 C0 02 F8 03 22 03 58 03 6C 03 84
 		39 01 00 00 00 00 0D BB 03 98 03 9E 03 A0 03 B7 03 D1 03 D7
		39 01 00 00 00 00 02 FF 10
		39 01 00 00 00 00 02 FB 01
		39 01 00 00 00 00 02 51 FF
		39 01 00 00 00 00 02 53 24
		39 01 00 00 00 00 02 55 00
		39 01 00 00 00 00 02 FF F0
		39 01 00 00 00 00 02 5A 02
		39 01 00 00 00 00 02 FF 10
		39 01 00 00 00 00 02 36 00
		39 01 00 00 00 00 02 35 00
		05 01 00 00 78 00 02 11 00
		05 01 00 00 14 00 02 29 00
		];
		qcom,mdss-dsi-off-command =
		[
			39 01 00 00 00 00 02 FF 10
			05 01 00 00 14 00 02 28 00
			05 01 00 00 78 00 02 10 00
		];
	qcom,mdss-dsi-CABC_on-command = [
			23 01 00 00 00 00 02 FF 23
			23 00 00 00 00 00 02 07 20
			23 00 00 00 00 00 02 08 05
			23 00 00 00 00 00 02 09 00
			23 00 00 00 00 00 02 10 95
			23 00 00 00 00 00 02 30 FF
			23 00 00 00 00 00 02 31 FF
			23 00 00 00 00 00 02 32 FF
			23 00 00 00 00 00 02 33 FF
			23 00 00 00 00 00 02 34 FF
			23 00 00 00 00 00 02 35 FF
			23 00 00 00 00 00 02 36 FF
			23 00 00 00 00 00 02 37 FF
			23 00 00 00 00 00 02 38 FF
			23 00 00 00 00 00 02 39 FF
			23 00 00 00 00 00 02 3A FF
			23 00 00 00 00 00 02 3B F9
			23 00 00 00 00 00 02 3D D9
			23 00 00 00 00 00 02 3F B9
			23 00 00 00 00 00 02 40 AB
			23 00 00 00 00 00 02 41 98
			23 01 00 00 00 00 02 FB 01
			23 01 00 00 00 00 02 FF 10
			23 00 00 00 00 00 02 55 81
			23 00 00 00 00 00 02 53 2C
			23 01 00 00 00 00 02 FB 01

		];
		qcom,mdss-dsi-CABC_off-command = [
			23 01 00 00 00 00 02 FF 10
			23 00 00 00 00 00 02 53 24
			23 00 00 00 00 00 02 55 80
			23 01 00 00 00 00 02 FB 01
		];
		qcom,mdss-dsi-CE_on-command = [

			23 01 00 00 00 00 02 FF 22
			23 00 00 00 00 00 02 00 54
			23 00 00 00 00 00 02 01 54
			23 00 00 00 00 00 02 02 54
			23 00 00 00 00 00 02 03 54
			23 00 00 00 00 00 02 04 54
			23 00 00 00 00 00 02 05 54
			23 00 00 00 00 00 02 06 54
			23 00 00 00 00 00 02 07 54
			23 00 00 00 00 00 02 08 54
			23 00 00 00 00 00 02 09 54
			23 00 00 00 00 00 02 0A 54
			23 00 00 00 00 00 02 0B 54
			23 00 00 00 00 00 02 0C 54
			23 00 00 00 00 00 02 0D 54
			23 00 00 00 00 00 02 0E 54
			23 00 00 00 00 00 02 0F 54
			23 00 00 00 00 00 02 10 54
			23 00 00 00 00 00 02 11 50
			23 00 00 00 00 00 02 12 60
			23 00 00 00 00 00 02 13 70
			23 00 00 00 00 00 02 14 58
			23 00 00 00 00 00 02 15 68
			23 00 00 00 00 00 02 16 78
			23 00 00 00 00 00 02 17 00
			23 00 00 00 00 00 02 18 40
			23 00 00 00 00 00 02 19 40
			23 00 00 00 00 00 02 1A 40
			23 00 00 00 00 00 02 1B 40
			23 00 00 00 00 00 02 1C 40
			23 00 00 00 00 00 02 1D 40
			23 00 00 00 00 00 02 1E 40
			23 00 00 00 00 00 02 1F 40
			23 00 00 00 00 00 02 20 40
			23 00 00 00 00 00 02 21 3D
			23 00 00 00 00 00 02 22 39
			23 00 00 00 00 00 02 23 36
			23 00 00 00 00 00 02 24 32
			23 00 00 00 00 00 02 25 32
			23 00 00 00 00 00 02 26 31
			23 00 00 00 00 00 02 27 2F
			23 00 00 00 00 00 02 28 2D
			23 00 00 00 00 00 02 2D 00
			23 00 00 00 00 00 02 2F 40
			23 00 00 00 00 00 02 30 40
			23 00 00 00 00 00 02 31 40
			23 00 00 00 00 00 02 32 40
			23 00 00 00 00 00 02 33 40
			23 00 00 00 00 00 02 34 40
			23 00 00 00 00 00 02 35 40
			23 00 00 00 00 00 02 36 40
			23 00 00 00 00 00 02 37 40
			23 00 00 00 00 00 02 38 3E
			23 00 00 00 00 00 02 39 3B
			23 00 00 00 00 00 02 3A 39
			23 00 00 00 00 00 02 3B 36
			23 00 00 00 00 00 02 3D 36
			23 00 00 00 00 00 02 3F 36
			23 00 00 00 00 00 02 40 36
			23 00 00 00 00 00 02 41 36
			23 00 00 00 00 00 02 42 40
			23 00 00 00 00 00 02 43 40
			23 00 00 00 00 00 02 44 40
			23 00 00 00 00 00 02 45 40
			23 00 00 00 00 00 02 46 40
			23 00 00 00 00 00 02 47 46
			23 00 00 00 00 00 02 48 4C
			23 00 00 00 00 00 02 49 50
			23 00 00 00 00 00 02 4A 52
			23 00 00 00 00 00 02 4B 52
			23 00 00 00 00 00 02 4C 50
			23 00 00 00 00 00 02 4D 4E
			23 00 00 00 00 00 02 4E 4A
			23 00 00 00 00 00 02 4F 46
			23 00 00 00 00 00 02 50 42
			23 00 00 00 00 00 02 51 41
			23 00 00 00 00 00 02 52 40
			23 00 00 00 00 00 02 53 01
			23 00 00 00 00 00 02 54 01
			23 00 00 00 00 00 02 55 89
			23 00 00 00 00 00 02 56 7F
			23 00 00 00 00 00 02 58 40
			23 00 00 00 00 00 02 59 40
			23 00 00 00 00 00 02 5A C2
			23 00 00 00 00 00 02 5B 44
			23 00 00 00 00 00 02 5C 43
			23 00 00 00 00 00 02 5D 43
			23 00 00 00 00 00 02 5E 42
			23 00 00 00 00 00 02 5F 44
			23 00 00 00 00 00 02 60 44
			23 00 00 00 00 00 02 61 44
			23 00 00 00 00 00 02 62 42
			23 00 00 00 00 00 02 63 42
			23 00 00 00 00 00 02 64 41
			23 00 00 00 00 00 02 65 40
			23 00 00 00 00 00 02 66 3F
			23 00 00 00 00 00 02 67 BD
			23 00 00 00 00 00 02 68 BC
			23 00 00 00 00 00 02 69 BD
			23 00 00 00 00 00 02 6A 3F
			23 00 00 00 00 00 02 6B 40
			23 00 00 00 00 00 02 6C 40
			23 00 00 00 00 00 02 6D 3F
			23 00 00 00 00 00 02 6E 3E
			23 00 00 00 00 00 02 6F BC
			23 00 00 00 00 00 02 70 8C
			23 00 00 00 00 00 02 71 0E
			23 00 00 00 00 00 02 72 00
			23 00 00 00 00 00 02 73 16
			23 00 00 00 00 00 02 74 06
			23 00 00 00 00 00 02 75 0C
			23 00 00 00 00 00 02 76 03
			23 00 00 00 00 00 02 77 09
			23 00 00 00 00 00 02 78 0F
			23 00 00 00 00 00 02 79 68
			23 00 00 00 00 00 02 7A 88
			23 00 00 00 00 00 02 83 01
			23 00 00 00 00 00 02 84 68
			//23 00 00 00 00 00 02 85 40
			23 00 00 00 00 00 02 86 40
			//23 00 00 00 00 00 02 87 40
			//23 00 00 00 00 00 02 88 40
			23 00 00 00 00 00 02 89 CF
			23 00 00 00 00 00 02 A2 20
			23 00 00 00 00 00 02 B3 00
			23 00 00 00 00 00 02 B7 00
			23 00 00 00 00 00 02 B8 00
			23 01 00 00 00 00 02 FB 01
			23 01 00 00 00 00 02 FF 10
			23 00 00 00 00 00 02 9D 00
			23 00 00 00 00 00 02 89 00
			23 00 00 00 00 00 02 55 80
			23 01 00 00 00 00 02 FB 01


		];
		qcom,mdss-dsi-CE_off-command = [
			23 01 00 00 00 00 02 FF 10
			23 00 00 00 00 00 02 55 01
			23 01 00 00 00 00 02 FB 01

		];
		qcom,mdss-dsi-sRGB_on-command = [
			23 01 00 00 00 00 02 FF 10
			23 00 00 00 00 00 02 55 80
			23 00 00 00 00 00 02 97 00
			23 00 00 00 00 00 02 98 00
			23 00 00 00 00 00 02 99 00
			23 00 00 00 00 00 02 8E C0
			23 00 00 00 00 00 02 8F 0C
			23 00 00 00 00 00 02 90 C0
			23 00 00 00 00 00 02 91 30
			23 00 00 00 00 00 02 92 83
			23 00 00 00 00 00 02 93 00
			23 00 00 00 00 00 02 94 0F
			23 00 00 00 00 00 02 95 00
			23 00 00 00 00 00 02 96 01
			23 00 00 00 00 00 02 9A 00
			23 00 00 00 00 00 02 9B 00
			23 00 00 00 00 00 02 9C 00
			23 00 00 00 00 00 02 9D 24
			23 00 00 00 00 00 02 89 00
			23 01 00 00 00 00 02 FB 01
			23 01 00 00 00 00 02 FF 22
			23 00 00 00 00 00 02 00 40
			23 00 00 00 00 00 02 01 54
			23 00 00 00 00 00 02 02 5A
			23 00 00 00 00 00 02 03 60
			23 00 00 00 00 00 02 04 66
			23 00 00 00 00 00 02 05 6A
			23 00 00 00 00 00 02 06 6C
			23 00 00 00 00 00 02 07 6C
			23 00 00 00 00 00 02 08 68
			23 00 00 00 00 00 02 09 62
			23 00 00 00 00 00 02 0A 5B
			23 00 00 00 00 00 02 0B 53
			23 00 00 00 00 00 02 0C 4D
			23 00 00 00 00 00 02 0D 48
			23 00 00 00 00 00 02 0E 44
			23 00 00 00 00 00 02 0F 41
			23 00 00 00 00 00 02 10 40
			23 00 00 00 00 00 02 11 50
			23 00 00 00 00 00 02 12 60
			23 00 00 00 00 00 02 13 70
			23 00 00 00 00 00 02 14 58
			23 00 00 00 00 00 02 15 68
			23 00 00 00 00 00 02 16 78
			23 00 00 00 00 00 02 17 00
			23 00 00 00 00 00 02 18 40
			23 00 00 00 00 00 02 19 40
			23 00 00 00 00 00 02 1A 40
			23 00 00 00 00 00 02 1B 40
			23 00 00 00 00 00 02 1C 40
			23 00 00 00 00 00 02 1D 40
			23 00 00 00 00 00 02 1E 40
			23 00 00 00 00 00 02 1F 40
			23 00 00 00 00 00 02 20 40
			23 00 00 00 00 00 02 21 45
			23 00 00 00 00 00 02 22 49
			23 00 00 00 00 00 02 23 4C
			23 00 00 00 00 00 02 24 4B
			23 00 00 00 00 00 02 25 48
			23 00 00 00 00 00 02 26 44
			23 00 00 00 00 00 02 27 41
			23 00 00 00 00 00 02 28 40
			23 00 00 00 00 00 02 2D 00
			23 00 00 00 00 00 02 2F 40
			23 00 00 00 00 00 02 30 40
			23 00 00 00 00 00 02 31 40
			23 00 00 00 00 00 02 32 40
			23 00 00 00 00 00 02 33 40
			23 00 00 00 00 00 02 34 40
			23 00 00 00 00 00 02 35 40
			23 00 00 00 00 00 02 36 40
			23 00 00 00 00 00 02 37 40
			23 00 00 00 00 00 02 38 40
			23 00 00 00 00 00 02 39 40
			23 00 00 00 00 00 02 3A 40
			23 00 00 00 00 00 02 3B 40
			23 00 00 00 00 00 02 3D 40
			23 00 00 00 00 00 02 3F 40
			23 00 00 00 00 00 02 40 40
			23 00 00 00 00 00 02 41 40
			23 00 00 00 00 00 02 42 40
			23 00 00 00 00 00 02 43 40
			23 00 00 00 00 00 02 44 40
			23 00 00 00 00 00 02 45 40
			23 00 00 00 00 00 02 46 40
			23 00 00 00 00 00 02 47 40
			23 00 00 00 00 00 02 48 40
			23 00 00 00 00 00 02 49 40
			23 00 00 00 00 00 02 4A 40
			23 00 00 00 00 00 02 4B 40
			23 00 00 00 00 00 02 4C 40
			23 00 00 00 00 00 02 4D 40
			23 00 00 00 00 00 02 4E 40
			23 00 00 00 00 00 02 4F 40
			23 00 00 00 00 00 02 50 40
			23 00 00 00 00 00 02 51 40
			23 00 00 00 00 00 02 52 40
			23 00 00 00 00 00 02 53 01
			23 00 00 00 00 00 02 54 00
			23 00 00 00 00 00 02 55 88
			23 00 00 00 00 00 02 56 77
			23 00 00 00 00 00 02 58 32
			23 00 00 00 00 00 02 59 30
			23 00 00 00 00 00 02 5A 2D
			23 00 00 00 00 00 02 5B 2B
			23 00 00 00 00 00 02 5C 29
			23 00 00 00 00 00 02 5D 27
			23 00 00 00 00 00 02 5E 24
			23 00 00 00 00 00 02 5F 26
			23 00 00 00 00 00 02 60 2A
			23 00 00 00 00 00 02 61 2B
			23 00 00 00 00 00 02 62 2D
			23 00 00 00 00 00 02 63 30
			23 00 00 00 00 00 02 64 30
			23 00 00 00 00 00 02 65 33
			23 00 00 00 00 00 02 66 34
			23 00 00 00 00 00 02 67 34
			23 00 00 00 00 00 02 68 34
			23 00 00 00 00 00 02 69 34
			23 00 00 00 00 00 02 6A 33
			23 00 00 00 00 00 02 6B 32
			23 00 00 00 00 00 02 6C 32
			23 00 00 00 00 00 02 6D 32
			23 00 00 00 00 00 02 6E 32
			23 00 00 00 00 00 02 6F 32
			23 00 00 00 00 00 02 70 00
			23 00 00 00 00 00 02 71 00
			23 00 00 00 00 00 02 72 00
			23 00 00 00 00 00 02 73 05
			23 00 00 00 00 00 02 74 06
			23 00 00 00 00 00 02 75 0C
			23 00 00 00 00 00 02 76 03
			23 00 00 00 00 00 02 77 09
			23 00 00 00 00 00 02 78 0F
			23 00 00 00 00 00 02 79 68
			23 00 00 00 00 00 02 7A 88
			23 00 00 00 00 00 02 83 77
			23 00 00 00 00 00 02 84 3B
			23 00 00 00 00 00 02 86 20
			23 00 00 00 00 00 02 89 40
			23 00 00 00 00 00 02 A2 20
			23 00 00 00 00 00 02 B3 00
			23 00 00 00 00 00 02 B7 00
			23 00 00 00 00 00 02 B8 00
			23 01 00 00 00 00 02 FB 01
			23 01 00 00 00 00 02 FF 10
		];
		qcom,mdss-dsi-sRGB_off-command = [
			23 01 00 00 00 00 02 FF 10
			23 00 00 00 00 00 02 9D 00
			23 00 00 00 00 00 02 55 01
			23 00 00 00 00 00 02 89 00
			23 01 00 00 00 00 02 FB 01
		];
		qcom,mdss-dsi-cold_gamma-command = [
			39 01 00 00 00 00 02 FF 20
			39 01 00 00 00 00 02 FB 01
			39 01 00 00 00 00 11 B0 00 77 00 81 00 93 00 A4 00 B3 00 C2 00 D0 00 DC
			39 01 00 00 00 00 11 B1 00 E9 01 13 01 36 01 6E 01 9A 01 E0 02 19 02 1A
			39 01 00 00 00 00 11 B2 02 54 02 97 02 C2 02 F9 03 1C 03 49 03 57 03 65
			39 01 00 00 00 00 0D B3 03 75 03 87 03 9C 03 B7 03 D2 03 D7
			39 01 00 00 00 00 11 B4 00 20 00 2F 00 49 00 60 00 76 00 89 00 9B 00 AA
			39 01 00 00 00 00 11 B5 00 B9 00 EB 01 15 01 54 01 86 01 D3 02 0E 02 0F
			39 01 00 00 00 00 11 B6 02 4B 02 8F 02 BA 02 F2 03 15 03 44 03 52 03 60
			39 01 00 00 00 00 0D B7 03 70 03 83 03 99 03 B4 03 D1 03 D7
			39 01 00 00 00 00 11 B8 00 09 00 1B 00 39 00 54 00 6B 00 81 00 95 00 A6
			39 01 00 00 00 00 11 B9 00 B7 00 ED 01 18 01 59 01 8B 01 D7 02 12 02 13
			39 01 00 00 00 00 11 BA 02 4F 02 93 02 BF 02 F9 03 23 03 5E 03 78 03 9A
			39 01 00 00 00 00 0D BB 03 C0 03 C2 03 C4 03 C6 03 D2 03 D7
			39 01 00 00 00 00 02 FF 21
			39 01 00 00 00 00 02 FB 01
			39 01 00 00 00 00 11 B0 00 77 00 81 00 93 00 A4 00 B3 00 C2 00 D0 00 D3
			39 01 00 00 00 00 11 B1 00 E9 01 13 01 36 01 6E 01 9A 01 E0 02 19 02 1A
			39 01 00 00 00 00 11 B2 02 54 02 97 02 C2 02 F9 03 1C 03 49 03 57 03 65
			39 01 00 00 00 00 0D B3 03 75 03 87 03 9C 03 B7 03 D2 03 D7
			39 01 00 00 00 00 11 B4 00 20 00 2F 00 49 00 60 00 76 00 89 00 9B 00 AA
			39 01 00 00 00 00 11 B5 00 B9 00 EB 01 15 01 54 01 86 01 D3 02 0E 02 0F
			39 01 00 00 00 00 11 B6 02 4B 02 8F 02 BA 02 F2 03 15 03 44 03 52 03 60
			39 01 00 00 00 00 0D B7 03 70 03 83 03 99 03 B4 03 D1 03 D7
			39 01 00 00 00 00 11 B8 00 09 00 1B 00 39 00 54 00 6B 00 81 00 95 00 A6
			39 01 00 00 00 00 11 B9 00 B7 00 ED 01 18 01 59 01 8B 01 D7 02 12 02 13
			39 01 00 00 00 00 11 BA 02 4F 02 93 02 BF 02 F9 03 23 03 5E 03 78 03 9A
			39 01 00 00 00 00 0D BB 03 C0 03 C2 03 C4 03 C6 03 D2 03 D7
		];
		qcom,mdss-dsi-warm_gamma-command = [
			39 01 00 00 00 00 02 FF 20
			39 01 00 00 00 00 02 FB 01
			39 01 00 00 00 00 11 B0 00 09 00 19 00 37 00 4F 00 67 00 7A 00 8E 00 9E
			39 01 00 00 00 00 11 B1 00 B0 00 E6 01 12 01 53 01 86 01 D4 02 0F 02 11
			39 01 00 00 00 00 11 B2 02 4C 02 92 02 BC 02 F3 03 16 03 43 03 53 03 62
			39 01 00 00 00 00 0D B3 03 72 03 87 03 9A 03 B5 03 D2 03 D7
			39 01 00 00 00 00 11 B4 00 0E 00 1E 00 3B 00 54 00 6B 00 7F 00 92 00 A3
			39 01 00 00 00 00 11 B5 00 B4 00 E9 01 14 01 55 01 86 01 D2 02 0D 02 0F
			39 01 00 00 00 00 11 B6 02 4A 02 8F 02 BA 02 F2 03 15 03 44 03 51 03 60
			39 01 00 00 00 00 0D B7 03 70 03 84 03 9B 03 B4 03 D1 03 D7
			39 01 00 00 00 00 11 B8 00 DA 00 E0 00 EC 00 F6 01 01 01 0A 01 14 01 1C
			39 01 00 00 00 00 11 B9 01 25 01 43 01 5E 01 8A 01 B0 01 EE 02 22 02 24
			39 01 00 00 00 00 11 BA 02 5C 02 A0 02 CB 03 04 03 2F 03 6E 03 8F 03 A3
			39 01 00 00 00 00 0D BB 03 A5 03 A7 03 A9 03 BA 03 D2 03 D7
			39 01 00 00 00 00 02 FF 21
			39 01 00 00 00 00 02 FB 01
			39 01 00 00 00 00 11 B0 00 09 00 19 00 37 00 4F 00 67 00 7A 00 8E 00 9E
			39 01 00 00 00 00 11 B1 00 B0 00 E6 01 12 01 53 01 86 01 D4 02 0F 02 11
			39 01 00 00 00 00 11 B2 02 4C 02 92 02 BC 02 F3 03 16 03 43 03 53 03 62
			39 01 00 00 00 00 0D B3 03 72 03 87 03 9A 03 B5 03 D3 03 D7
			39 01 00 00 00 00 11 B4 00 0E 00 1E 00 3B 00 54 00 6B 00 7F 00 92 00 A3
			39 01 00 00 00 00 11 B5 00 B4 00 E9 01 14 01 55 01 86 01 D2 02 0D 02 0F
			39 01 00 00 00 00 11 B6 02 4A 02 8F 02 BA 02 F2 03 15 03 44 03 51 03 60
			39 01 00 00 00 00 0D B7 03 70 03 84 03 9B 03 B4 03 D1 03 D7
			39 01 00 00 00 00 11 B8 00 DA 00 E0 00 EC 00 F6 01 01 01 0A 01 14 01 1C
			39 01 00 00 00 00 11 B9 01 25 01 43 01 5E 01 8A 01 B0 01 EE 02 22 02 24
			39 01 00 00 00 00 11 BA 02 5C 02 A0 02 CB 03 04 03 2F 03 6E 03 8F 03 A3
			39 01 00 00 00 00 0D BB 03 A5 03 A7 03 A9 03 BA 03 D2 03 D7
		];
		qcom,mdss-dsi-default_gamma-command = [
  		39 01 00 00 00 00 02 FF 20             //Enter CMD2_P0
 		39 00 00 00 00 00 02 AF 00             //R G B Gamma independent
 		39 00 00 00 00 00 11 B0 00 00 00 11 00 30 00 4A 00 62 00 77 00 8B 00 9D
 		39 00 00 00 00 00 11 B1 00 AD 00 E4 01 10 01 52 01 85 01 D2 02 10 02 12
 		39 00 00 00 00 00 11 B2 02 4D 02 91 02 BD 02 F4 03 18 03 46 03 54 03 62
 		39 00 00 00 00 00 0D B3 03 73 03 84 03 99 03 C1 03 D5 03 D9
 		39 00 00 00 00 00 11 B4 00 00 00 11 00 30 00 4A 00 62 00 77 00 8B 00 9D
 		39 00 00 00 00 00 11 B5 00 AD 00 E4 01 10 01 52 01 85 01 D2 02 10 02 12
 		39 00 00 00 00 00 11 B6 02 4D 02 91 02 BD 02 F4 03 18 03 46 03 54 03 62
 		39 00 00 00 00 00 0D B7 03 73 03 84 03 99 03 C1 03 D5 03 D9
 		39 00 00 00 00 00 11 B8 00 00 00 11 00 30 00 4A 00 62 00 77 00 8B 00 9D
 		39 00 00 00 00 00 11 B9 00 AD 00 E4 01 10 01 52 01 85 01 D2 02 10 02 12
 		39 00 00 00 00 00 11 BA 02 4D 02 91 02 BD 02 F4 03 18 03 46 03 54 03 62
 		39 00 00 00 00 00 0D BB 03 73 03 84 03 99 03 C1 03 D5 03 D9
		39 01 00 00 00 00 02 FB 01
 		39 01 00 00 00 00 02 FF 21             //Enter CMD2_P1
 		39 00 00 00 00 00 11 B0 00 00 00 11 00 30 00 4A 00 62 00 77 00 8B 00 9D
 		39 00 00 00 00 00 11 B1 00 AD 00 E4 01 10 01 52 01 85 01 D2 02 10 02 12
 		39 00 00 00 00 00 11 B2 02 4D 02 91 02 BD 02 F4 03 18 03 46 03 54 03 62
 		39 00 00 00 00 00 0D B3 03 73 03 84 03 99 03 C1 03 D5 03 D9
 		39 00 00 00 00 00 11 B4 00 00 00 11 00 30 00 4A 00 62 00 77 00 8B 00 9D
 		39 00 00 00 00 00 11 B5 00 AD 00 E4 01 10 01 52 01 85 01 D2 02 10 02 12
 		39 00 00 00 00 00 11 B6 02 4D 02 91 02 BD 02 F4 03 18 03 46 03 54 03 62
 		39 00 00 00 00 00 0D B7 03 73 03 84 03 99 03 C1 03 D5 03 D9
 		39 00 00 00 00 00 11 B8 00 00 00 11 00 30 00 4A 00 62 00 77 00 8B 00 9D
 		39 00 00 00 00 00 11 B9 00 AD 00 E4 01 10 01 52 01 85 01 D2 02 10 02 12
 		39 00 00 00 00 00 11 BA 02 4D 02 91 02 BD 02 F4 03 18 03 46 03 54 03 62
 		39 00 00 00 00 00 0D BB 03 73 03 84 03 99 03 C1 03 D5 03 D9
		39 01 00 00 00 00 02 FB 01
		39 01 00 00 00 00 02 FF 10
		];
		qcom,mdss-dsi-on-command-state = "dsi_lp_mode";
		qcom,mdss-dsi-off-command-state = "dsi_hs_mode";
		qcom,mdss-dsi-CABC_on-command-state = "dsi_hs_mode";
		qcom,mdss-dsi-CABC_off-command-state = "dsi_hs_mode";
		qcom,mdss-dsi-CE_on-command-state = "dsi_hs_mode";
		qcom,mdss-dsi-CE_off-command-state = "dsi_hs_mode";
		qcom,mdss-dsi-cold_gamma-command-state = "dsi_lp_mode";
		qcom,mdss-dsi-warm_gamma-command-state = "dsi_lp_mode";
		qcom,mdss-dsi-default_gamma-command-state = "dsi_hs_mode";
		qcom,mdss-white-command-state = "dsi_hs_mode";
		qcom,mdss-dsi-sRGB_on-command-state = "dsi_hs_mode";
		qcom,mdss-dsi-sRGB_off-command-state = "dsi_hs_mode";
		qcom,mdss-dsi-h-sync-pulse = <1>;
		qcom,mdss-dsi-traffic-mode = "burst_mode";
		qcom,mdss-dsi-bllp-eof-power-mode;
		qcom,mdss-dsi-bllp-power-mode;
		qcom,mdss-dsi-lane-0-state;
		qcom,mdss-dsi-lane-1-state;
		qcom,mdss-dsi-lane-2-state;
		qcom,mdss-dsi-lane-3-state;
		qcom,mdss-dsi-t-clk-post = <0x0E>;
		qcom,mdss-dsi-t-clk-pre = <0x34>;
		qcom,mdss-dsi-bl-min-level = <1>;
		qcom,mdss-dsi-bl-max-level = <4095>;
		qcom,mdss-dsi-dma-trigger = "trigger_sw";
		qcom,mdss-dsi-mdp-trigger = "none";
		qcom,mdss-dsi-bl-pmic-control-type = "bl_ctrl_wled";
		qcom,mdss-dsi-reset-sequence = <1 10>, <0 10>, <1 10>;
		qcom,mdss-dsi-lp11-init;
                //qcom,mdss-dsi-tx-eot-append;
	    qcom,esd-check-enabled;
		qcom,mdss-dsi-panel-status-command = [06 01 00 01 05 00 01 0A];
		qcom,mdss-dsi-panel-status-command-mode = "dsi_lp_mode";
		qcom,mdss-dsi-panel-status-check-mode = "reg_read";
		qcom,mdss-dsi-panel-status-read-length = <1>;
		qcom,mdss-dsi-panel-status-value = <0x9C>;
		qcom,mdss-dsi-panel-max-error-count = <3>;
		qcom,mdss-pan-physical-width-dimension = <69>;
		qcom,mdss-pan-physical-height-dimension = <122>;
	};
};
