/* Copyright (c) 2015, The Linux Foundation. All rights reserved.
 *
 * This program is free software; you can redistribute it and/or modify
 * it under the terms of the GNU General Public License version 2 and
 * only version 2 as published by the Free Software Foundation.
 *
 * This program is distributed in the hope that it will be useful,
 * but WITHOUT ANY WARRANTY; without even the implied warranty of
 * MERCHANTABILITY or FITNESS FOR A PARTICULAR PURPOSE.  See the
 * GNU General Public License for more details.
 */

&mdss_mdp {
	dsi_hx8399a_1080p_video: qcom,mdss_dsi_hx8399a_1080p_video {
		qcom,mdss-dsi-panel-name = "hx8399a 1080p video mode dsi panel";
		qcom,mdss-dsi-panel-type = "dsi_video_mode";
		qcom,mdss-dsi-panel-framerate = <60>;
		qcom,mdss-dsi-panel-clockrate = <866400000>;
		qcom,mdss-dsi-virtual-channel-id = <0>;
		qcom,mdss-dsi-stream = <0>;
		qcom,mdss-dsi-panel-width = <1080>;
		qcom,mdss-dsi-panel-height = <1920>;
		qcom,mdss-dsi-h-front-porch = <90>;
		qcom,mdss-dsi-h-back-porch = <60>;
		qcom,mdss-dsi-h-pulse-width = <20>;
		qcom,mdss-dsi-h-sync-skew = <0>;
		qcom,mdss-dsi-v-back-porch = <3>;
		qcom,mdss-dsi-v-front-porch = <9>;
		qcom,mdss-dsi-v-pulse-width = <4>;
		qcom,mdss-dsi-h-left-border = <0>;
		qcom,mdss-dsi-h-right-border = <0>;
		qcom,mdss-dsi-v-top-border = <0>;
		qcom,mdss-dsi-v-bottom-border = <0>;
		qcom,mdss-dsi-bpp = <24>;
		qcom,mdss-dsi-underflow-color = <0xff>;
		qcom,mdss-dsi-border-color = <0>;
		qcom,mdss-dsi-on-command = [29 01 00 00 00 00 04
					B9 FF 83 99
			29 01 00 00 00 00 03
					BA 63 82
			29 01 00 00 00 00 0D
					B1 00 74 31 31
					44 09 22 22 71
					F1 63 6D
			29 01 00 00 00 00 0B
					B2 00 80 00 7F
					05 07 23 4D 02
					02
			29 01 00 00 00 00 29
					B4 00 FF 00 40
					00 3E 00 00 02
					00 00 01 00 10
					01 02 04 31 00
					01 44 00 40 00
					3E 00 00 02 00
					00 01 00 10 01
					02 04 01 00 01
					44
			29 01 00 00 00 00 02 D2 00
			29 01 00 00 00 00 20
					D3 00 01 00 00
					00 30 00 32 10
					05 00 05 00 00
					00 00 00 00 00
					00 00 00 01 07
					07 03 00 00 00
					05 08
			29 01 00 00 00 00 21
					D5 18 18 00 00
					00 00 00 00 19
					19 18 18 00 00
					00 00 00 00 00
					00 03 02 01 00
					21 20 30 30 31
					31 32 32
			29 01 00 00 00 00 21
					D6 18 18 40 40
					40 40 40 40 18
					18 19 19 40 40
					40 40 40 40 40
					40 00 01 02 03
					20 21 30 30 31
					31 32 32
			29 01 00 00 00 00 31
					D8 00 00 00 00
					00 00 00 00 00
					00 00 00 00 00
					00 00 00 00 00
					00 00 00 00 00
					00 00 00 00 00
					00 00 00 00 00
					00 00 00 00 00
					00 C0 00 0A BF
					C0 00 0A BF
			29 01 00 00 00 00 03
					B6 34 34
			29 01 00 00 00 00 02 CC 08
			29 01 00 00 00 00 2B
					E0 01 10 15 2B
					32 3E 22 3C 07
					0C 0F 12 15 13
					14 10 16 0A 17
					06 12 01 10 15
					2B 32 3E 22 3C
					07 0C 0F 12 15
					13 14 10 16 0A
					17 06 12
			29 01 00 00 00 00 04
					BF CF 00 46
			29 01 00 00 00 00 02 36 c0
			29 01 00 00 78 00 02 11 00
			29 01 00 00 0A 00 02 29 00];
		qcom,mdss-dsi-off-command = [05 01 00 00 32 00 02 28 00
					05 01 00 00 78 00 02 10 00];
		qcom,mdss-dsi-on-command-state = "dsi_lp_mode";
		qcom,mdss-dsi-off-command-state = "dsi_hs_mode";
		qcom,mdss-dsi-traffic-mode = "burst_mode";
		qcom,mdss-dsi-bllp-eof-power-mode;
		qcom,mdss-dsi-bllp-power-mode;
		qcom,mdss-dsi-lane-0-state;
		qcom,mdss-dsi-lane-1-state;
		qcom,mdss-dsi-lane-2-state;
		qcom,mdss-dsi-lane-3-state;
		qcom,mdss-dsi-panel-timings =
			[f9 3d 34 00 58 4d 36 3f 53 03 04 00];
		qcom,mdss-dsi-t-clk-post = <0x1e>;
		qcom,mdss-dsi-t-clk-pre = <0x38>;
		qcom,mdss-dsi-panel-status-check-mode = "reg_read";
		qcom,mdss-dsi-panel-status-command
			= [06 01 00 01 05 00 02 09 00];
		qcom,mdss-dsi-panel-status-command-state = "dsi_hs_mode";
		qcom,mdss-dsi-panel-status-read-length = <3>;
		qcom,mdss-dsi-panel-status-value = <0xe0 0x73 0x04>;
		qcom,mdss-dsi-bl-min-level = <1>;
		qcom,mdss-dsi-bl-max-level = <4095>;
		qcom,mdss-dsi-dma-trigger = "trigger_sw";
		qcom,mdss-dsi-mdp-trigger = "none";
		qcom,mdss-dsi-bl-pmic-control-type = "bl_ctrl_wled";
		qcom,mdss-dsi-reset-sequence = <1 20>, <0 2>, <1 20>;
		qcom,mdss-dsi-post-init-delay = <1>;
	};
};
