/* Copyright (c) 2015, The Linux Foundation. All rights reserved.
 *
 * This program is free software; you can redistribute it and/or modify
 * it under the terms of the GNU General Public License version 2 and
 * only version 2 as published by the Free Software Foundation.
 *
 * This program is distributed in the hope that it will be useful,
 * but WITHOUT ANY WARRANTY; without even the implied warranty of
 * MERCHANTABILITY or FITNESS FOR A PARTICULAR PURPOSE.  See the
 * GNU General Public License for more details.
 */

/dts-v1/;

#include "mdmcalifornium.dtsi"
#include "mdmcalifornium-pinctrl.dtsi"

/ {
	model = "Qualcomm Technologies, Inc. MDM Californium SIM";
	compatible = "qcom,mdmcalifornium-sim",
		   "qcom,mdmcalifornium", "qcom,sim";
	qcom,board-id = <16 0>;
};

&blsp1_uart1 {
	status = "ok";
};

&qnand_1 {
	status = "ok";
};
