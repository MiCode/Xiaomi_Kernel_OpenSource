/* Copyright (c) 2015, The Linux Foundation. All rights reserved.
 * Copyright (C) 2018 XiaoMi, Inc.
 *
 * This program is free software; you can redistribute it and/or modify
 * it under the terms of the GNU General Public License version 2 and
 * only version 2 as published by the Free Software Foundation.
 *
 * This program is distributed in the hope that it will be useful,
 * but WITHOUT ANY WARRANTY; without even the implied warranty of
 * MERCHANTABILITY or FITNESS FOR A PARTICULAR PURPOSE.  See the
 * GNU General Public License for more details.
 */

/*---------------------------------------------------------------------------
 * This file is autogenerated file using gcdb parser. Please do not edit it.
 * Update input XML file to add a new entry or update variable in this file
 * VERSION = "1.0"
 *---------------------------------------------------------------------------*/
&soc {
	dsi_jdi_fhd_r63452_cmd: qcom,mdss_dsi_jdi_fhd_r63452_cmd {
		qcom,mdss-dsi-panel-name = "jdi fhd cmd incell dsi panel";
		qcom,mdss-dsi-panel-id = <0>;
		qcom,mdss-dsi-panel-model = "JDI FHD R63452 CMD PANEL";
		qcom,mdss-dsi-panel-sleepwrmod = <0>;
		qcom,mdss-dsi-panel-type = "dsi_cmd_mode";
		qcom,mdss-dsi-panel-framerate = <60>;
		qcom,mdss-dsi-virtual-channel-id = <0>;
		qcom,mdss-dsi-stream = <0>;
		qcom,mdss-dsi-panel-width = <1080>;
		qcom,mdss-dsi-panel-height = <1920>;
		qcom,mdss-dsi-h-front-porch = <120>;
		qcom,mdss-dsi-h-back-porch = <40>;
		qcom,mdss-dsi-h-pulse-width = <16>;
		qcom,mdss-dsi-h-sync-skew = <0>;
		qcom,mdss-dsi-v-back-porch = <4>;
		qcom,mdss-dsi-v-front-porch = <4>;
		qcom,mdss-dsi-v-pulse-width = <2>;
		qcom,mdss-dsi-h-left-border = <0>;
		qcom,mdss-dsi-h-right-border = <0>;
		qcom,mdss-dsi-v-top-border = <0>;
		qcom,mdss-dsi-v-bottom-border = <0>;
		qcom,mdss-dsi-bpp = <24>;
		qcom,mdss-dsi-color-order = <0>;
		qcom,mdss-dsi-underflow-color = <0xff>;
		qcom,mdss-dsi-border-color = <0>;
		qcom,mdss-dsi-on-command = [
				29 00 00 00 00 00 02 b0 00
				29 00 00 00 00 00 02 d6 01
				29 00 00 00 00 00 0E EC 64 DC EC 3B 52 00 0B 0B 13 15 68 0B B5
				29 00 00 00 00 00 02 b0 03
				39 00 00 00 00 00 02 35 00
				39 00 00 00 00 00 02 36 00
				39 00 00 00 00 00 02 3A 77
				39 00 00 00 00 00 05 2A 00 00 04 37
				39 00 00 00 00 00 05 2B 00 00 07 7F
				39 00 00 00 00 00 03 44 00 00
				39 00 00 00 00 00 02 51 FF
				39 00 00 00 00 00 02 53 24
				39 00 00 00 00 00 02 55 00
				39 00 00 00 00 00 02 5E 00
				39 00 00 00 00 00 02 84 00
				05 01 00 00 14 00 02 29 00
				05 01 00 00 50 00 02 11 00
				29 00 00 00 00 00 02 B0 04
				39 00 00 00 00 00 02 84 00
				29 00 00 00 00 00 02 C8 11
				29 01 00 00 00 00 02 B0 03
];
		qcom,mdss-dsi-off-command = [
				29 00 00 00 00 00 02 b0 00
				29 00 00 00 00 00 02 d6 01
				29 00 00 00 00 00 0E EC 64 DC EC 3B 52 00 0B 0B 13 15 68 0B 95
				29 00 00 00 00 00 02 b0 03
				05 01 00 00 02 00 02 28 00
				05 01 00 00 78 00 02 10 00];
		qcom,mdss-dsi-displayoff-command = [05 01 00 00 20 00 02 28 00];
		qcom,mdss-dsi-displayon-command = [05 01 00 00 20 00 02 29 00];
		qcom,mdss-dsi-on-command-state = "dsi_lp_mode";
		qcom,mdss-dsi-off-command-state = "dsi_hs_mode";
		qcom,mdss-dsi-displayoff-command-state = "dsi_hs_mode";
		qcom,mdss-dsi-displayon-command-state = "dsi_hs_mode";
		qcom,mdss-dsi-h-sync-pulse = <0>;
		qcom,mdss-dsi-traffic-mode = "burst_mode";
		qcom,mdss-dsi-bllp-eof-power-mode;
		qcom,mdss-dsi-bllp-power-mode;
		qcom,mdss-dsi-lp11-init;
		qcom,mdss-dsi-lane-0-state;
		qcom,mdss-dsi-lane-1-state;
		qcom,mdss-dsi-lane-2-state;
		qcom,mdss-dsi-lane-3-state;
		qcom,mdss-dsi-panel-timings = [e3 50 36 00 a9 a3 3a 50 3d 03 04 00];
		qcom,mdss-dsi-t-clk-post = <0x20>;
		qcom,mdss-dsi-t-clk-pre = <0x36>;
		qcom,mdss-dsi-bl-min-level = <1>;
		qcom,mdss-dsi-bl-max-level = <4095>;
		qcom,mdss-brightness-max-level = <4095>;
		qcom,mdss-dsi-dma-trigger = "trigger_sw";
		qcom,mdss-dsi-mdp-trigger = "none";
		qcom,mdss-dsi-bl-pmic-control-type = "bl_ctrl_wled";
		qcom,mdss-dsi-reset-sequence = <1 10>, <0 1>, <1 10>;
		qcom,mdss-pan-physical-width-dimension = <64>;
		qcom,mdss-pan-physical-height-dimension = <114>;
		qcom,mdss-dsi-te-pin-select = <1>;
		qcom,mdss-dsi-wr-mem-start = <0x2c>;
		qcom,mdss-dsi-wr-mem-continue = <0x3c>;
		qcom,mdss-dsi-te-dcs-command = <1>;
		qcom,mdss-dsi-te-check-enable;
		qcom,mdss-dsi-te-using-te-pin;
		qcom,mdss-dsi-tx-eot-append;
		qcom,mdss-panel-on-dimming-delay = <120>;
		qcom,dispblnotify-enabled;
		qcom,dispccbb-enabled;
		qcom,dispparam-enabled;
		qcom,mdss-night-brightness = <7 25 43 61>;
		qcom,mdss-dsi-dispparam-cabcon-command = [
				29 01 00 00 00 00 02 B0 04
				15 01 00 00 00 00 02 55 81
				29 01 00 00 00 00 08 B8 89 51 0D 00 02 00 00
				29 01 00 00 00 00 1A CE 55 40 4C 5A 69 77 84 93 A2 B1 C1 D1 E0 F0 F1 F2 FF 04 00 04 04 42 00 69 5A
				29 01 00 00 00 00 0A F9 66 3F E0 BE 00 8D BF 80 00
				29 01 00 00 00 00 02 B0 03
		];
		qcom,mdss-dsi-dispparam-cabcguion-command = [
				29 01 00 00 00 00 02 B0 04
				15 01 00 00 00 00 02 55 81
				29 01 00 00 00 00 08 B8 89 51 0D 00 02 00 00
				29 01 00 00 00 00 1A CE 55 40 4C 5A 69 77 84 93 A2 B1 C1 D1 E0 F0 F1 F2 FF 04 00 04 04 42 00 69 5A
				29 01 00 00 00 00 0A F9 66 3F E0 BE 00 8D BF 80 00
				29 01 00 00 00 00 02 B0 03
		];
		qcom,mdss-dsi-dispparam-cabcstillon-command = [
				29 01 00 00 00 00 02 B0 04
				15 01 00 00 00 00 02 55 82
				29 01 00 00 00 00 08 B9 FF 27 37 00 04 00 00
				29 01 00 00 00 00 1A CE 55 40 4C 5A 69 77 84 93 A2 B1 C1 D1 E0 F0 F1 F2 FF 04 00 04 04 42 00 69 5A
				29 01 00 00 00 00 0A F9 66 3F E0 BE 00 8D BF 80 00
				29 01 00 00 00 00 02 B0 03
		];
		qcom,mdss-dsi-dispparam-cabcmovieon-command = [
				29 01 00 00 00 00 02 B0 04
				15 01 00 00 00 00 02 55 83
				29 01 00 00 00 00 08 BA BB 3D 22 00 03 00 00
				29 01 00 00 00 00 1A CE 55 40 4C 5A 69 77 84 93 A2 B1 C1 D1 E0 F0 F1 F2 FF 04 00 04 04 42 00 69 5A
				29 01 00 00 00 00 0A F9 66 3F E0 BE 00 8D BF 80 00
				29 01 00 00 00 00 02 B0 03
		];
		qcom,mdss-dsi-dispparam-cabcoff-command = [
				39 01 00 00 01 00 02 55 00
		];
		qcom,mdss-dsi-dispparam-dimmingon-command = [
				39 01 00 00 01 00 02 53 2C
		];
		qcom,mdss-dsi-dispparam-idleon-command = [
				39 01 00 00 01 00 02 39 00
		];
		qcom,mdss-dsi-dispparam-idleoff-command = [
				39 01 00 00 01 00 02 38 00
		];
		qcom,mdss-dsi-dispparam-warm-command = [
				29 01 00 00 00 00 02 B0 04
				39 01 00 00 00 00 02 84 80
				29 01 00 00 00 00 32 C8 01 00 FB 05 FD FC E0 00 FA 02 F6 FC F0 00 F8 FF ED FC 01 00 FA 05 F9 BC 00 FA 02 F4 EB 00 FB FE EC FC 00 FA 05 FC FC 00 F9 03 F6 DB 00 FA 00 F6 AB
				29 01 00 00 00 00 02 CA 1C
				29 01 00 00 00 00 02 B0 03
		];
		qcom,mdss-dsi-dispparam-warm-command-state = "dsi_hs_mode";
		qcom,mdss-dsi-dispparam-cold-command = [
				29 01 00 00 00 00 02 B0 04
				39 01 00 00 00 00 02 84 7F
				29 01 00 00 00 00 32 C8 01 00 FB 05 FD FC E0 00 FA 02 F6 FC F0 00 F8 FF ED FC 01 00 FA 05 F9 BC 00 FA 02 F4 EB 00 FB FE EC FC 00 FA 05 FC FC 00 F9 03 F6 DB 00 FA 00 F6 AB
				29 01 00 00 00 00 02 CA 1C
				29 01 00 00 00 00 02 B0 03
		];
		qcom,mdss-dsi-dispparam-cold-command-state = "dsi_hs_mode";
		qcom,mdss-dsi-dispparam-default-command = [
				29 01 00 00 00 00 02 B0 04
				39 01 00 00 00 00 02 84 00
				29 01 00 00 00 00 02 C8 11
				29 01 00 00 00 00 02 CA 1C
				29 01 00 00 00 00 02 B0 03
		];
		qcom,mdss-dsi-dispparam-default-command-state = "dsi_hs_mode";
		qcom,mdss-dsi-dispparam-papermode-command = [
				29 01 00 00 00 00 02 55 80
				29 01 00 00 00 00 02 B0 04
				39 01 00 00 00 00 02 84 00
				29 01 00 00 00 00 14 c8 01 00 f4 07 fc e3 f3 00 f6 04 f7 fc f2 00 fd ff 02 00 12
				29 01 00 00 00 00 2C CA 1D FC FC 48 00 00 D3 00 00 D3 00 00 D3 00 00 D3 00 00 D3 00 00 D3 00 00 00 00 00 00 00 00 00 00 00 00 00 00 00 00 00 00 00 00 00
				29 01 00 00 00 00 02 B0 03
		];
		qcom,mdss-dsi-dispparam-papermode-command-state = "dsi_hs_mode";
		qcom,mdss-dsi-dispparam-papermode1-command = [
				29 01 00 00 00 00 02 B0 04
				39 01 00 00 00 00 02 84 00
				29 01 00 00 00 00 32 C8 01 00 F8 07 FB D7 F1 00 F8 01 F7 FC F1 00 F6 01 F2 C0 02 00 F9 05 01 59 00 F8 01 F9 B1 00 F7 FE ED FC 00 F9 06 FC ED 00 F8 01 F7 FC 00 F7 01 F6 82
				29 01 00 00 00 00 02 CA 1C
				29 01 00 00 00 00 02 B0 03
		];
		qcom,mdss-dsi-dispparam-papermode1-command-state = "dsi_hs_mode";
		qcom,mdss-dsi-dispparam-papermode2-command = [
				29 01 00 00 00 00 02 B0 04
				39 01 00 00 00 00 02 84 00
				29 01 00 00 00 00 32 C8 01 00 FC 03 F8 FC 00 00 FC FF F5 BB 00 00 02 FF F9 76 00 00 FC 03 F8 FC 00 FC FF F5 BB 00 02 FF F9 76 00 FC 03 F8 FC 00 FC FF F5 BB 00 02 FF F9 76
				29 01 00 00 00 00 02 CA 1C
				29 01 00 00 00 00 02 B0 03
		];
		qcom,mdss-dsi-dispparam-papermode2-command-state = "dsi_hs_mode";
		qcom,mdss-dsi-dispparam-papermode3-command = [
				29 01 00 00 00 00 02 B0 04
				39 01 00 00 00 00 02 84 00
				29 01 00 00 00 00 32 c8 01 00 FC 03 F8 FC 00 00 FB FF F6 AA 00 00 FE 01 FA 4B 00 00 FC 03 F8 FC 00 FB FF F6 AA 00 FE 01 FA 4B 00 FC 03 F8 FC 00 FB FF F6 AA 00 FE 01 FA 4B
				29 01 00 00 00 00 02 CA 1C
				29 01 00 00 00 00 02 B0 03
		];
		qcom,mdss-dsi-dispparam-papermode3-command-state = "dsi_hs_mode";
		qcom,mdss-dsi-dispparam-papermode4-command = [
				29 01 00 00 00 00 02 B0 04
				39 01 00 00 00 00 02 84 00
				29 01 00 00 00 00 32 c8 01 00 FC 03 F8 FC 00 00 FD FF F7 9A 00 00 03 01 FC 27 00 00 FC 03 F8 FC 00 FD FF F7 9A 00 03 01 FC 27 00 FC 03 F8 FC 00 FD FF F7 9A 00 03 01 FC 27
				29 01 00 00 00 00 02 CA 1C
				29 01 00 00 00 00 02 B0 03
		];
		qcom,mdss-dsi-dispparam-papermode4-command-state = "dsi_hs_mode";
		qcom,mdss-dsi-dispparam-papermode5-command = [
				29 01 00 00 00 00 02 55 80
				29 01 00 00 00 00 02 B0 04
				39 01 00 00 00 00 02 84 00
				29 01 00 00 00 00 14 c8 01 00 f4 08 fb d5 f3 00 f5 04 f7 fc f1 00 fd ff 02 00 22
				29 01 00 00 00 00 2C CA 1D FC FC E4 00 00 FA 00 00 FA 00 00 FA 00 00 FA 00 00 FA 00 00 FA 00 00 00 00 00 00 00 00 00 00 00 00 00 00 00 00 00 00 00 00 00
				29 01 00 00 00 00 02 B0 03
		];
		qcom,mdss-dsi-dispparam-papermode5-command-state = "dsi_hs_mode";
		qcom,mdss-dsi-dispparam-papermode6-command = [
				29 01 00 00 00 00 02 55 80
				29 01 00 00 00 00 02 B0 04
				39 01 00 00 00 00 02 84 00
				29 01 00 00 00 00 14 c8 01 00 f4 08 fb db f2 00 f6 04 f7 fc f3 00 fd ff 02 00 22
				29 01 00 00 00 00 2C CA 1D FC FC B0 00 00 ED 00 00 ED 00 00 ED 00 00 ED 00 00 ED 00 00 ED 00 00 00 00 00 00 00 00 00 00 00 00 00 00 00 00 00 00 00 00 00
				29 01 00 00 00 00 02 B0 03
		];
		qcom,mdss-dsi-dispparam-papermode6-command-state = "dsi_hs_mode";
		qcom,mdss-dsi-dispparam-papermode7-command = [
				29 01 00 00 00 00 02 55 80
				29 01 00 00 00 00 02 B0 04
				39 01 00 00 00 00 02 84 00
				29 01 00 00 00 00 14 c8 01 00 f4 08 fc df f2 00 f6 04 f7 fc f1 00 fd ff 02 00 12
				29 01 00 00 00 00 2C CA 1D FC FC 7C 00 00 E0 00 00 E0 00 00 E0 00 00 E0 00 00 E0 00 00 E0 00 00 00 00 00 00 00 00 00 00 00 00 00 00 00 00 00 00 00 00 00
				29 01 00 00 00 00 02 B0 03
		];
		qcom,mdss-dsi-dispparam-papermode7-command-state = "dsi_hs_mode";
		qcom,mdss-dsi-dispparam-normal1-command = [
				29 01 00 00 00 00 02 B0 04
				39 01 00 00 00 00 02 84 00
				29 01 00 00 00 00 32 C8 01 00 FD FE FC D8 00 00 FC FE FB DC 00 00 01 F3 F0 FC 00 00 FE FD F9 99 00 FE FC FB C8 00 FF F4 EB FC 00 FE FA FD FC 00 FE FB FA E5 00 FF F6 F2 D3
				29 01 00 00 00 00 02 CA 1C
				29 01 00 00 00 00 02 B0 03
		];
		qcom,mdss-dsi-dispparam-normal1-command-state = "dsi_hs_mode";
		qcom,mdss-dsi-dispparam-normal2-command = [
				29 01 00 00 00 00 02 B0 04
				39 01 00 00 00 00 02 84 00
				29 01 00 00 00 00 02 C8 11
				29 01 00 00 00 00 02 CA 1C
				29 01 00 00 00 00 02 B0 03
		];
		qcom,mdss-dsi-dispparam-normal2-command-state = "dsi_hs_mode";
		qcom,mdss-dsi-dispparam-srgb-command = [
				05 01 00 00 10 00 02 11 00
				29 01 00 00 00 00 02 B0 00
				29 01 00 00 00 00 02 D6 01
				29 01 00 00 00 00 13 C8 01 00 FD FE FC FC 00 00 FC FE FB FC 00 00 01 F3 F0 FC
				29 01 00 00 00 00 02 CA 1D
				29 01 00 00 00 00 02 84 00
				29 01 00 00 00 00 02 B0 03
		];
		qcom,mdss-dsi-dispparam-srgb-command-state = "dsi_hs_mode";
	};
};
