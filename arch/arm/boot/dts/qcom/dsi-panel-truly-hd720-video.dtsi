/* Copyright (c) 2015, The Linux Foundation. All rights reserved.
 * Copyright (C) 2018 XiaoMi, Inc.
 *
 * This program is free software; you can redistribute it and/or modify
 * it under the terms of the GNU General Public License version 2 and
 * only version 2 as published by the Free Software Foundation.
 *
 * This program is distributed in the hope that it will be useful,
 * but WITHOUT ANY WARRANTY; without even the implied warranty of
 * MERCHANTABILITY or FITNESS FOR A PARTICULAR PURPOSE.  See the
 * GNU General Public License for more details.
 */

&mdss_mdp {
	dsi_truly_hd720_vid: qcom,mdss_dsi_truly_hd720_video {
		qcom,mdss-dsi-panel-name = "truly hx8394f hd720 video mode dsi panel";
		qcom,mdss-dsi-panel-type = "dsi_video_mode";
		qcom,mdss-dsi-panel-controller = <&mdss_dsi0>;
		qcom,mdss-dsi-panel-framerate = <60>;
		qcom,mdss-dsi-virtual-channel-id = <0>;
		qcom,mdss-dsi-stream = <0>;
		qcom,mdss-dsi-panel-width = <720>;
		qcom,mdss-dsi-panel-height = <1440>;
		qcom,mdss-dsi-h-front-porch = <96>;
		qcom,mdss-dsi-h-back-porch = <80>;
		qcom,mdss-dsi-h-pulse-width = <20>;
		qcom,mdss-dsi-h-sync-skew = <0>;
		qcom,mdss-dsi-v-back-porch = <4>;
		qcom,mdss-dsi-v-front-porch = <10>;
		qcom,mdss-dsi-v-pulse-width = <4>;
		qcom,mdss-dsi-h-left-border = <0>;
		qcom,mdss-dsi-h-right-border = <0>;
		qcom,mdss-dsi-v-top-border = <0>;
		qcom,mdss-dsi-v-bottom-border = <0>;
		qcom,mdss-dsi-bpp = <24>;
		qcom,mdss-dsi-underflow-color = <0xff>;
		qcom,mdss-dsi-border-color = <0>;
		qcom,mdss-dsi-h-sync-pulse = <0>;
		qcom,mdss-pan-physical-width-dimension = <68>;
		qcom,mdss-pan-physical-height-dimension = <136>;
		qcom,mdss-dsi-traffic-mode = "burst_mode";
		qcom,mdss-dsi-bllp-eof-power-mode;
		qcom,mdss-dsi-bllp-power-mode;
		qcom,mdss-dsi-lane-0-state;
		qcom,mdss-dsi-lane-1-state;
		qcom,mdss-dsi-lane-2-state;
		qcom,mdss-dsi-lane-3-state;
		qcom,mdss-dsi-panel-timings = [8E 1E 14 00 42 46 18 20 19 03
				04 00];
		qcom,mdss-dsi-t-clk-post = <0x0a>;
		qcom,mdss-dsi-t-clk-pre = <0x1f>;
		qcom,mdss-dsi-bl-min-level = <1>;
		qcom,mdss-dsi-bl-max-level = <4095>;
		qcom,mdss-brightness-max-level = <4095>;
		qcom,mdss-dsi-dma-trigger = "trigger_sw";
		qcom,mdss-dsi-mdp-trigger = "none";
		qcom,mdss-dsi-on-command = [
				39 01 00 00 00 00 04 B9 FF 83 94
				39 01 00 00 00 00 07 BA 63 03 68 6B B2 C0
				39 01 00 00 00 00 0B B1 48 07 67 09 31 54 71 31 50 34
				39 01 00 00 00 00 07 B2 00 80 78 06 08 22
				39 01 00 00 00 00 16 B4 71 72 29 72 29 72 01 0C 7C 33 00 3F 71 72 29 72 29 72 01 0C 7E
				39 01 00 00 00 00 3B E0 1a 1A 20 25 25 28 2B 28 52 63 72 70 77 8A 90 93 A1 A5 A0 B0 C1 61 5F 64 69 6C 72 7A 7C 1a 1A 20 24 25 28 2A 28 53 63 71 6F 77 8A 8F 94 A0 A4 A0 AF C1 60 5F 63 68 6C 73 7A 7C
				39 01 00 00 00 00 22 D3 00 00 00 00 00 00 0F 0F 32 10 01 00 01 52 15 A8 05 A8 32 10 00 00 00 67 43 05 05 37 0E 0E 27 06 40
				39 01 00 00 00 00 2D D5 19 19 18 18 24 25 06 07 04 05 02 03 00 01 18 18 18 18 18 18 18 18 18 18 18 18 18 18 18 18 20 21 18 18 18 18 18 18 18 18 18 18 18 18
				39 01 00 00 00 00 2D D6 18 18 19 19 21 20 01 00 03 02 05 04 07 06 18 18 18 18 18 18 18 18 18 18 18 18 18 18 18 18 25 24 18 18 18 18 18 18 18 18 18 18 18 18
				39 01 00 00 00 00 03 B6 25 25
				39 01 00 00 00 00 02 CC 0B
				39 01 00 00 00 00 03 C0 1F 31
				39 01 00 00 00 00 02 D4 02
				39 01 00 00 00 00 02 BD 02
				39 01 00 00 00 00 05 D3 01 04 00 01
				39 01 00 00 00 00 02 BD 00
				39 01 00 00 00 00 02 BD 01
				39 01 00 00 00 00 02 B1 00
				39 01 00 00 00 00 02 BD 00
				39 01 00 00 00 00 02 BD 02
				39 01 00 00 00 00 0D D8 FF FF FF FF FF F0 FF FF FF FF FF F0
				39 01 00 00 00 00 02 BD 00
				39 01 00 00 00 00 02 C6 ED
				15 01 00 00 00 00 02 35 00
				39 01 00 00 05 00 02 55 11
				39 01 00 00 00 00 0a ca 20 20 20 20 20 20 20 20 20
				39 01 00 00 00 00 02 51 ff
				39 01 00 00 00 00 0a c9 13 00 0a 10 b2 20 00 91 00
				39 01 00 00 00 00 02 53 2c
				05 01 00 00 78 00 02 11 00
				05 01 00 00 14 00 02 29 00
		];
		qcom,mdss-dsi-off-command = [
				05 01 00 00 24 00 02 28 00
				05 01 00 00 78 00 02 10 00];
		qcom,mdss-dsi-ce-on-command = [
				15 00 00 00 00 00 02 E4 00
				39 00 00 00 00 00 20 E5 00 00 08 06 04 00 00 00 00 00 00 05 1D 19 1F 05 ED 09 20 02 04 06 08 08 07 06 06 05 03 02 01
				39 00 00 00 00 00 16 E6 00 08 00 05 05 10 00 00 20 20 20 10 10 10 10 10 12 B0 01 0F 11
				39 01 00 00 00 00 03 E4 00 41
		];
		qcom,mdss-dsi-ce-off-command = [
				39 01 00 00 00 00 03 E4 00 00
		];
		qcom,mdss-dsi-cabc-on-command = [
				39 01 00 00 00 00 0a ca 38 38 20 20 20 20 20 20 20
		];
		qcom,mdss-dsi-cabc-off-command = [
				39 01 00 00 00 00 0a ca 20 20 20 20 20 20 20 20 20
		];
		qcom,mdss-dsi-gamma0-command = [
				15 00 00 00 00 00 02 BD 00
				15 01 00 00 00 00 02 C1 00
		];
		qcom,mdss-dsi-gamma1-command = [
				39 00 00 00 00 00 3B E0 1a 1A 20 25 25 28 2B 28 52 63 72 70 77 8A 90 93 A1 A5 A0 B0 C1 61 5F 64 69 6C 72 7A 7C 1a 1A 20 24 25 28 2A 28 53 63 71 6F 77 8A 8F 94 A0 A4 A0 AF C1 60 5F 63 68 6C 73 7A 7C
				15 00 00 00 00 00 02 BD 00
				39 00 00 00 00 00 2c C1 01 00 08 0F 17 1E 25 2C 34 3B 42 49 4F 56 5D 65 6C 74 7B 83 8A 91 99 A0 A6 AE B5 BC C3 CB D3 DA E1 E7 0F E8 53 F1 61 C3 07 4D C0
				15 00 00 00 00 00 02 BD 01
				39 00 00 00 00 00 2B C1 00 09 12 1B 23 2A 32 3A 42 4A 51 59 61 69 71 79 82 8A 92 9A A2 A9 B1 B9 C1 C9 D2 DA E2 E9 F0 F7 FF 06 2F 8E 6F 8A 3A 76 17 C0
				15 00 00 00 00 00 02 BD 02
				39 00 00 00 00 00 2b C1 00 06 0D 14 1C 24 2B 33 3B 42 49 50 57 5F 66 6D 76 7D 85 8C 94 9B A2 A9 B0 B8 BF C7 CE D6 DD E4 EA 39 DE 6A C7 26 2A C4 ED C0
				15 01 00 00 00 00 02 BD 00
		];
		qcom,mdss-dsi-gamma2-command = [
				39 00 00 00 00 00 3B E0 1a 1A 20 25 25 28 2B 28 52 63 72 70 77 8A 90 93 A1 A5 A0 B0 C1 61 5F 64 69 6C 72 7A 7C 1a 1A 20 24 25 28 2A 28 53 63 71 6F 77 8A 8F 94 A0 A4 A0 AF C1 60 5F 63 68 6C 73 7A 7C
				15 00 00 00 00 00 02 BD 00
				39 00 00 00 00 00 2c C1 01 00 08 10 19 20 27 2E 35 3D 44 4B 53 5A 62 69 72 79 81 89 91 99 A0 A7 AF B7 BE C6 CE D5 DC E3 EA F0 2C 05 1D DC 90 29 28 7D C0
				15 00 00 00 00 00 02 BD 01
				39 00 00 00 00 00 2B C1 00 08 11 19 21 28 2F 37 3F 46 4D 55 5D 64 6C 74 7C 83 8B 94 9B A3 AA B2 B9 C1 C9 D1 D8 DF E6 ED F3 27 18 1E 35 3C C9 EC 78 C0
				15 00 00 00 00 00 02 BD 02
				39 00 00 00 00 00 2b C1 00 08 10 18 21 29 31 39 41 49 51 5A 62 6A 72 7B 83 8B 94 9C A4 AC B4 BD C5 CD D5 DD E4 EB F2 F8 FF 1B 55 EC 14 67 A8 A4 53 C0
				15 01 00 00 00 00 02 BD 00
		];
		qcom,mdss-dsi-gamma3-command = [
				39 00 00 00 00 00 3B E0 1a 1A 20 25 25 28 2B 28 52 63 72 70 77 8A 90 93 A1 A5 A0 B0 C1 61 5F 64 69 6C 72 7A 7C 1a 1A 20 24 25 28 2A 28 53 63 71 6F 77 8A 8F 94 A0 A4 A0 AF C1 60 5F 63 68 6C 73 7A 7C
				15 00 00 00 00 00 02 BD 00
				39 00 00 00 00 00 2c C1 01 00 08 10 19 20 27 2F 37 3F 45 4C 54 5C 64 6C 74 7C 84 8C 94 9B A3 AA B2 BA C2 CA D2 D9 E1 E7 EE F4 2C 4F 6E 69 E4 DD 58 8D C0
				15 00 00 00 00 00 02 BD 01
				39 00 00 00 00 00 2B C1 00 08 10 19 20 27 30 38 3F 45 4D 54 5C 64 6C 74 7C 84 8B 93 9B A2 AA B1 B9 C1 C9 D1 D8 E0 E6 ED F3 2D 90 73 A9 9E 62 58 89 C0
				15 00 00 00 00 00 02 BD 02
				39 00 00 00 00 00 2b C1 00 07 0F 17 1F 27 30 39 41 47 4F 58 60 69 71 7A 82 8A 93 9B A3 AB B3 BB C4 CD D5 DD E4 EB F2 F8 FF 34 DD 3D 9C F1 5B 80 53 C0
				15 01 00 00 00 00 02 BD 00
		];
		qcom,mdss-dsi-gamma4-command = [
				39 00 00 00 00 00 3B E0 1a 1A 20 25 25 28 2B 28 52 63 72 70 77 8A 90 93 A1 A5 A0 B0 C1 61 5F 64 69 6C 72 7A 7C 1a 1A 20 24 25 28 2A 28 53 63 71 6F 77 8A 8F 94 A0 A4 A0 AF C1 60 5F 63 68 6C 73 7A 7C
				15 00 00 00 00 00 02 BD 00
				39 00 00 00 00 00 2c C1 01 00 08 11 19 21 28 30 38 40 48 50 58 60 68 71 7A 82 89 91 99 A0 A8 AF B7 BF C8 D0 D9 E0 E8 EF F7 FF 27 16 82 A8 65 8F E8 DE C0
				15 00 00 00 00 00 02 BD 01
				39 00 00 00 00 00 2B C1 00 08 0F 17 1E 25 2C 33 3A 42 48 50 57 5E 66 6D 75 7C 83 8A 91 98 9F A5 AC B3 BA C1 C9 D0 D8 DF E5 0F E6 CC A7 7E 53 AB 71 C0
				15 00 00 00 00 00 02 BD 02
				39 00 00 00 00 00 2b C1 00 08 10 18 20 28 2F 38 40 47 4F 57 5F 67 70 78 80 88 8F 97 9E A5 AD B5 BC C4 CC D4 DC E3 EA F1 F7 00 4C 2B E6 C9 B4 FF 74 C0
				15 01 00 00 00 00 02 BD 00
		];
		qcom,mdss-dsi-gamma5-command = [
				39 00 00 00 00 00 3B E0 1a 1A 20 25 25 28 2B 28 52 63 72 70 77 8A 90 93 A1 A5 A0 B0 C1 61 5F 64 69 6C 72 7A 7C 1a 1A 20 24 25 28 2A 28 53 63 71 6F 77 8A 8F 94 A0 A4 A0 AF C1 60 5F 63 68 6C 73 7A 7C
				15 00 00 00 00 00 02 BD 00
				39 00 00 00 00 00 2c C1 01 00 09 12 1C 23 2A 32 3A 41 48 50 58 61 69 71 79 81 89 90 98 9F A7 AF B7 BF C8 D0 D8 E0 E8 EF F7 FF 2C B5 FB 05 45 EE 56 99 C0
				15 00 00 00 00 00 02 BD 01
				39 00 00 00 00 00 2B C1 00 08 10 18 1F 25 2C 32 39 40 46 4C 53 5A 61 68 6E 75 7C 83 89 8F 96 9C A3 A9 B0 B7 BD C4 CB D2 DA 1B 63 42 50 F8 77 38 FF 00
				15 00 00 00 00 00 02 BD 02
				39 00 00 00 00 00 2b C1 00 07 0E 15 1D 23 2A 31 38 3F 45 4B 52 59 60 67 6E 76 7C 83 89 90 97 9D A4 AB B2 B8 BF C7 CD D5 DB 15 3A 47 FF CE E7 53 8C C0
				15 01 00 00 00 00 02 BD 00
		];
		qcom,mdss-dsi-gamma6-command = [
				39 00 00 00 00 00 3B E0 1a 1A 20 25 25 28 2B 28 52 63 72 70 77 8A 90 93 A1 A5 A0 B0 C1 61 5F 64 69 6C 72 7A 7C 1a 1A 20 24 25 28 2A 28 53 63 71 6F 77 8A 8F 94 A0 A4 A0 AF C1 60 5F 63 68 6C 73 7A 7C
				15 00 00 00 00 00 02 BD 00
				39 00 00 00 00 00 2c C1 01 00 09 12 1B 23 2A 32 3A 41 48 50 58 60 68 71 79 81 88 90 98 9F A7 AF B7 BF C8 D0 D8 E0 E7 EF F7 FF 1B 60 BB A4 64 95 01 39 C0
				15 00 00 00 00 00 02 BD 01
				39 00 00 00 00 00 2B C1 00 08 11 1A 21 27 2F 36 3D 44 4A 51 59 60 68 6F 76 7E 84 8B 92 99 A0 A7 AE B5 BC C4 CC D3 DA E1 E9 39 30 4F 62 CE A9 FD 2F 00
				15 00 00 00 00 00 02 BD 02
				39 00 00 00 00 00 2b C1 00 07 0F 17 1E 26 2D 34 3B 42 49 50 58 5F 67 6E 76 7D 84 8B 92 99 A0 A7 AE B6 BD C4 CC D3 DB E2 E8 34 C6 FA 12 14 15 C2 70 C0
				15 01 00 00 00 00 02 BD 00
		];
		qcom,mdss-dsi-gamma7-command = [
				39 00 00 00 00 00 3B E0 1a 1A 20 25 25 28 2B 28 52 63 72 70 77 8A 90 93 A1 A5 A0 B0 C1 61 5F 64 69 6C 72 7A 7C 1a 1A 20 24 25 28 2A 28 53 63 71 6F 77 8A 8F 94 A0 A4 A0 AF C1 60 5F 63 68 6C 73 7A 7C
				15 00 00 00 00 00 02 BD 00
				39 00 00 00 00 00 2c C1 01 00 09 12 1B 22 28 30 38 3F 45 4C 53 5A 61 68 6F 77 7E 85 8C 93 9A A1 A8 B0 B7 BE C5 CC D4 DB E2 E8 05 68 35 87 22 FE 12 C1 C0
				15 00 00 00 00 00 02 BD 01
				39 00 00 00 00 00 2B C1 00 0A 14 1E 25 2E 36 3E 45 4D 54 5C 64 6C 74 7C 83 8B 93 9B A2 AA B2 BA C1 C9 D1 D9 E0 E7 EE F6 FE 06 C9 DE 40 E1 E4 F8 FC 00
				15 00 00 00 00 00 02 BD 02
				39 00 00 00 00 00 2b C1 00 09 12 1C 24 2C 35 3D 45 4D 54 5C 64 6C 74 7C 84 8C 94 9C A4 AC B4 BC C4 CC D4 DC E3 EA F1 F8 FF 2C 6A 4A 9B F7 A5 A4 A6 C0
				15 01 00 00 00 00 02 BD 00
		];
		qcom,mdss-dsi-gamma8-command = [
				39 00 00 00 00 00 3B E0 1a 1A 20 25 25 28 2B 28 52 63 72 70 77 8A 90 93 A1 A5 A0 B0 C1 61 5F 64 69 6C 72 7A 7C 1a 1A 20 24 25 28 2A 28 53 63 71 6F 77 8A 8F 94 A0 A4 A0 AF C1 60 5F 63 68 6C 73 7A 7C
				15 00 00 00 00 00 02 BD 00
				39 00 00 00 00 00 2c C1 01 00 07 0D 14 1B 21 27 2E 34 3B 41 47 4D 54 5B 62 69 6F 77 7E 84 8B 92 99 A0 A6 AD B4 BB C1 C9 D0 D6 0F A9 D5 FE B0 FB 74 39 C0
				15 00 00 00 00 00 02 BD 01
				39 00 00 00 00 00 2B C1 00 08 11 19 20 27 2F 36 3E 45 4C 54 5C 64 6C 73 7B 83 8B 93 9B A2 AA B2 B9 C1 C9 D1 D8 E0 E7 EE F6 22 E3 54 53 DA 74 AD EA 00
				15 00 00 00 00 00 02 BD 02
				39 00 00 00 00 00 2b C1 00 08 10 18 20 28 30 38 40 47 4F 58 60 69 71 79 82 89 92 9B A3 AB B3 BB C3 CC D3 DB E3 EA F1 F8 FF 00 DB B8 D6 3D 01 8E 6E C0
				15 01 00 00 00 00 02 BD 00
		];
		qcom,mdss-dsi-gamma9-command = [
				39 00 00 00 00 00 3B E0 1a 1A 20 25 25 28 2B 28 52 63 72 70 77 8A 90 93 A1 A5 A0 B0 C1 61 5F 64 69 6C 72 7A 7C 1a 1A 20 24 25 28 2A 28 53 63 71 6F 77 8A 8F 94 A0 A4 A0 AF C1 60 5F 63 68 6C 73 7A 7C
				15 00 00 00 00 00 02 BD 00
				39 00 00 00 00 00 2c C1 01 00 08 11 1A 21 28 30 38 40 47 4E 56 5F 67 6F 77 80 87 8F 97 9F A7 AF B7 BF C8 D0 D9 E1 E8 EF F7 FF 39 45 0F 2B 22 6E DE 6F C0
				15 00 00 00 00 00 02 BD 01
				39 00 00 00 00 00 2B C1 00 08 10 18 1F 26 2D 34 3C 43 49 51 58 60 67 6F 76 7E 84 8C 93 9A A2 A9 B0 B8 BF C7 CF D6 DE E5 EB 06 DB 4C 88 8C 71 C9 30 C0
				15 00 00 00 00 00 02 BD 02
				39 00 00 00 00 00 2b C1 00 06 0D 13 1B 22 29 30 37 3E 44 4B 52 59 60 67 6E 75 7C 83 8A 91 98 9E A5 AC B3 BA C1 C8 CF D7 DD 37 F6 ED 6A BA 03 AA BC C0
				15 01 00 00 00 00 02 BD 00
		];
		qcom,mdss-dsi-gamma10-command = [
				39 00 00 00 00 00 3B E0 1a 1A 20 25 25 28 2B 28 52 63 72 70 77 8A 90 93 A1 A5 A0 B0 C1 61 5F 64 69 6C 72 7A 7C 1a 1A 20 24 25 28 2A 28 53 63 71 6F 77 8A 8F 94 A0 A4 A0 AF C1 60 5F 63 68 6C 73 7A 7C
				15 00 00 00 00 00 02 BD 00
				39 00 00 00 00 00 2c C1 01 00 09 11 1A 21 28 30 38 40 47 4F 57 5F 67 6F 78 80 87 8F 97 9F A7 AF B7 BF C8 D0 D9 E1 E8 EF F7 FF 0E 9A 65 68 3B AF DC 2E C0
				15 00 00 00 00 00 02 BD 01
				39 00 00 00 00 00 2B C1 00 08 0F 17 1E 24 2B 32 39 40 46 4D 54 5B 62 6A 71 78 7F 86 8C 93 9A A1 A8 AF B6 BD C5 CC D3 DB E1 0E BA AE BC 14 FE BB 1C C0
				15 00 00 00 00 00 02 BD 02
				39 00 00 00 00 00 2b C1 00 06 0D 13 1B 22 29 30 37 3E 44 4A 51 58 5F 66 6D 74 7B 82 89 8F 96 9D A4 AB B1 B8 BF C6 CE D5 DB 37 E1 5B BB BA 39 0F B0 C0
				15 01 00 00 00 00 02 BD 00
		];
		qcom,mdss-dsi-gamma11-command = [
				39 00 00 00 00 00 3B E0 1a 1A 20 25 25 28 2B 28 52 63 72 70 77 8A 90 93 A1 A5 A0 B0 C1 61 5F 64 69 6C 72 7A 7C 1a 1A 20 24 25 28 2A 28 53 63 71 6F 77 8A 8F 94 A0 A4 A0 AF C1 60 5F 63 68 6C 73 7A 7C
				15 00 00 00 00 00 02 BD 00
				39 00 00 00 00 00 2c C1 01 00 09 12 1B 22 29 31 39 41 49 51 59 61 69 71 79 82 89 92 9B A3 AA B2 BA C3 CB D3 DB E3 EA F0 F8 FF 00 6A 81 52 29 2B 65 0D C0
				15 00 00 00 00 00 02 BD 01
				39 00 00 00 00 00 2B C1 00 07 0F 16 1D 23 29 30 36 3D 43 4A 50 57 5D 64 6B 71 78 7F 86 8C 93 9A A1 A7 AD B4 BB C1 C9 CF D5 22 28 9D EE 69 3F 1D 31 C0
				15 00 00 00 00 00 02 BD 02
				39 00 00 00 00 00 2b C1 00 06 0D 14 1C 23 2A 31 38 3F 46 4D 54 5B 61 68 70 76 7E 85 8C 93 9B A2 A8 AF B6 BD C4 CB D2 D9 DF 34 10 10 0B 21 B0 95 F8 C0
				15 01 00 00 00 00 02 BD 00
		];
		qcom,mdss-dsi-gamma12-command = [
				39 00 00 00 00 00 3B E0 1a 1A 20 25 25 28 2B 28 52 63 72 70 77 8A 90 93 A1 A5 A0 B0 C1 61 5F 64 69 6C 72 7A 7C 1a 1A 20 24 25 28 2A 28 53 63 71 6F 77 8A 8F 94 A0 A4 A0 AF C1 60 5F 63 68 6C 73 7A 7C
				15 00 00 00 00 00 02 BD 00
				39 00 00 00 00 00 2c C1 01 00 09 11 1A 22 29 31 39 41 49 51 59 61 69 71 79 81 8A 92 9B A2 AA B2 BA C3 CB D3 DB E2 E9 F0 F8 FF 0F 75 95 67 DD EF 68 FD C0
				15 00 00 00 00 00 02 BD 01
				39 00 00 00 00 00 2B C1 00 07 0E 16 1C 22 28 2E 35 3B 42 48 4E 55 5B 61 68 6E 75 7B 82 88 8F 96 9C A2 A8 AF B5 BC C2 C9 CF 2C 6B 20 87 62 20 BD 8A C0
				15 00 00 00 00 00 02 BD 02
				39 00 00 00 00 00 2b C1 00 06 0D 14 1C 23 2A 31 38 3F 46 4D 54 5B 62 69 70 77 7E 86 8D 94 9B A2 A9 B0 B7 BE C5 CC D3 DA E0 39 65 79 A6 AC 2E 55 F4 C0
				15 01 00 00 00 00 02 BD 00
		];
		qcom,mdss-dsi-gamma13-command = [
				39 00 00 00 00 00 3B E0 1a 1A 20 25 25 28 2B 28 52 63 72 70 77 8A 90 93 A1 A5 A0 B0 C1 61 5F 64 69 6C 72 7A 7C 1a 1A 20 24 25 28 2A 28 53 63 71 6F 77 8A 8F 94 A0 A4 A0 AF C1 60 5F 63 68 6C 73 7A 7C
				15 00 00 00 00 00 02 BD 00
				39 00 00 00 00 00 2c C1 01 00 09 11 1A 22 29 30 38 40 47 4E 56 5E 66 6E 76 7E 85 8D 94 9C A3 AB B3 BB C3 CB D3 DB E3 EA F1 F9 0F 1E 0B A5 B7 79 06 9B 00
				15 00 00 00 00 00 02 BD 01
				39 00 00 00 00 00 2B C1 00 09 12 1C 23 2B 33 3B 42 49 51 5A 62 6A 72 7A 82 89 91 98 A0 A7 AF B7 BF C7 D0 D8 E0 E7 EF F6 FF 2D D0 BC 00 23 3E B1 37 C0
				15 00 00 00 00 00 02 BD 02
				39 00 00 00 00 00 2b C1 00 07 0F 16 1E 26 2D 34 3C 43 49 51 58 60 67 6E 76 7E 85 8B 92 9A A1 A8 AF B6 BE C5 CD D5 DC E3 E9 37 C7 0C 87 83 C0 F3 44 C0
				15 01 00 00 00 00 02 BD 00
		];
		qcom,mdss-dsi-gamma14-command = [
				39 00 00 00 00 00 3B E0 1a 1A 20 25 25 28 2B 28 52 63 72 70 77 8A 90 93 A1 A5 A0 B0 C1 61 5F 64 69 6C 72 7A 7C 1a 1A 20 24 25 28 2A 28 53 63 71 6F 77 8A 8F 94 A0 A4 A0 AF C1 60 5F 63 68 6C 73 7A 7C
				15 00 00 00 00 00 02 BD 00
				39 00 00 00 00 00 2c C1 01 00 09 12 1B 23 2A 32 39 41 48 50 58 61 68 71 79 81 88 90 98 9F A7 AF B7 BF C7 D0 D8 E0 E8 EF F7 FF 06 13 A7 31 20 E5 21 59 C0
				15 00 00 00 00 00 02 BD 01
				39 00 00 00 00 00 2B C1 00 09 12 1B 22 29 30 38 3F 46 4D 55 5D 64 6C 74 7B 82 89 91 98 9F A6 AE B5 BD C4 CC D4 DC E3 EA F2 05 5D 99 24 BC 6D CE 8A 00
				15 00 00 00 00 00 02 BD 02
				39 00 00 00 00 00 2b C1 00 07 0F 16 1E 25 2D 34 3B 42 49 50 58 5F 66 6E 75 7C 83 8A 91 98 9F A6 AE B5 BC C3 CB D2 DA E1 E7 37 B1 A1 08 7E BA 06 70 C0
				15 01 00 00 00 00 02 BD 00
		];
		qcom,mdss-dsi-gamma15-command = [
				39 00 00 00 00 00 3B E0 1a 1A 20 25 25 28 2B 28 52 63 72 70 77 8A 90 93 A1 A5 A0 B0 C1 61 5F 64 69 6C 72 7A 7C 1a 1A 20 24 25 28 2A 28 53 63 71 6F 77 8A 8F 94 A0 A4 A0 AF C1 60 5F 63 68 6C 73 7A 7C
				15 00 00 00 00 00 02 BD 00
				39 00 00 00 00 00 2c C1 01 00 09 11 1A 22 29 31 39 41 48 51 59 61 69 71 79 81 8A 92 9B A2 AA B2 BA C3 CB D3 DB E2 E9 F1 F8 FF 0E 24 71 06 C0 EA 25 F2 C0
				15 00 00 00 00 00 02 BD 01
				39 00 00 00 00 00 2B C1 00 08 10 18 1E 25 2C 33 3A 41 48 4F 56 5D 64 6B 72 79 80 87 8F 96 9D A4 AB B1 B8 C0 C7 CE D5 DC E2 00 E4 10 00 57 29 3C A4 C0
				15 00 00 00 00 00 02 BD 02
				39 00 00 00 00 00 2b C1 00 07 0E 16 1D 25 2C 33 3B 42 4A 51 58 60 67 6F 76 7E 85 8D 95 9C A3 AA B2 B9 C0 C8 CF D6 DE E4 EA 2C DB 72 C8 85 2F 1F F2 C0
				15 01 00 00 00 00 02 BD 00
		];
		qcom,mdss-dsi-gamma16-command = [
				39 00 00 00 00 00 3B E0 1a 1A 20 25 25 28 2B 28 52 63 72 70 77 8A 90 93 A1 A5 A0 B0 C1 61 5F 64 69 6C 72 7A 7C 1a 1A 20 24 25 28 2A 28 53 63 71 6F 77 8A 8F 94 A0 A4 A0 AF C1 60 5F 63 68 6C 73 7A 7C
				15 00 00 00 00 00 02 BD 00
				39 00 00 00 00 00 2c C1 01 00 09 11 1A 22 29 31 39 41 49 51 59 61 69 71 79 81 8A 92 9B A2 AA B2 BA C3 CB D3 DB E2 E9 F1 F8 FF 0F 65 86 61 DC EB 58 F1 C0
				15 00 00 00 00 00 02 BD 01
				39 00 00 00 00 00 2B C1 00 07 0F 17 1D 24 2A 30 37 3E 45 4B 52 59 5F 66 6D 74 7B 82 88 8F 97 9D A4 AA B1 B8 BE C6 CC D3 D9 24 8B E7 9E 90 F3 24 CD C0
				15 00 00 00 00 00 02 BD 02
				39 00 00 00 00 00 2b C1 00 07 0E 16 1D 25 2C 33 3B 42 4A 51 59 60 67 6E 76 7E 85 8D 95 9C A3 AA B2 B9 C1 C8 CF D6 DE E4 EA 2C DB B6 17 89 2B 13 F2 C0
				15 01 00 00 00 00 02 BD 00
		];
		qcom,mdss-dsi-gamma17-command = [
				39 00 00 00 00 00 3B E0 1a 1A 20 25 25 28 2B 28 52 63 72 70 77 8A 90 93 A1 A5 A0 B0 C1 61 5F 64 69 6C 72 7A 7C 1a 1A 20 24 25 28 2A 28 53 63 71 6F 77 8A 8F 94 A0 A4 A0 AF C1 60 5F 63 68 6C 73 7A 7C
				15 00 00 00 00 00 02 BD 00
				39 00 00 00 00 00 2c C1 01 00 07 0E 15 1C 22 28 2F 35 3C 42 48 4F 55 5B 62 68 6F 76 7D 84 8A 91 98 9E A4 AB B1 B8 BE C5 CC D2 1B 15 DF 1C FA 74 72 14 C0
				15 00 00 00 00 00 02 BD 01
				39 00 00 00 00 00 2B C1 00 09 12 1B 22 2A 32 3A 42 49 51 59 60 68 71 7A 82 8A 92 9A A1 A9 B1 B9 C1 C9 D2 DA E1 E9 F0 F7 FF 00 86 64 F8 01 E4 21 D3 C0
				15 00 00 00 00 00 02 BD 02
				39 00 00 00 00 00 2b C1 00 06 0D 14 1C 24 2B 33 3B 42 49 50 57 5E 66 6E 75 7D 85 8C 94 9B A2 A9 B0 B8 BF C7 CE D6 DD E4 EA 39 DF 6A F9 F2 2A C4 E9 C0
				15 01 00 00 00 00 02 BD 00
		];
		qcom,mdss-dsi-gamma18-command = [
				39 00 00 00 00 00 3B E0 1a 1A 20 25 25 28 2B 28 52 63 72 70 77 8A 90 93 A1 A5 A0 B0 C1 61 5F 64 69 6C 72 7A 7C 1a 1A 20 24 25 28 2A 28 53 63 71 6F 77 8A 8F 94 A0 A4 A0 AF C1 60 5F 63 68 6C 73 7A 7C
				15 00 00 00 00 00 02 BD 00
				39 00 00 00 00 00 2c C1 01 00 07 0F 17 1D 24 2B 32 38 3F 46 4C 53 5A 60 68 6F 76 7D 84 8B 92 99 A0 A6 AD B4 BB C2 C9 D0 D8 DE 24 C0 F6 4C 5B A8 A4 2E C0
				15 00 00 00 00 00 02 BD 01
				39 00 00 00 00 00 2B C1 00 09 12 1B 22 2A 32 3A 42 49 51 59 60 69 71 7A 82 8A 92 9A A1 A9 B1 B9 C1 C9 D2 DA E1 E9 F0 F7 FF 00 9A 79 C8 45 D5 61 D7 C0
				15 00 00 00 00 00 02 BD 02
				39 00 00 00 00 00 2b C1 00 07 0E 16 1E 26 2E 36 3D 45 4C 53 5B 62 6A 73 7B 82 8A 92 9A A1 A8 B0 B7 BF C7 CF D7 DE E5 EC F2 2C 40 DB 7C 39 19 D5 7D C0
				15 01 00 00 00 00 02 BD 00
		];
		qcom,mdss-dsi-gamma19-command = [
				39 00 00 00 00 00 3B E0 1a 1A 20 25 25 28 2B 28 52 63 72 70 77 8A 90 93 A1 A5 A0 B0 C1 61 5F 64 69 6C 72 7A 7C 1a 1A 20 24 25 28 2A 28 53 63 71 6F 77 8A 8F 94 A0 A4 A0 AF C1 60 5F 63 68 6C 73 7A 7C
				15 00 00 00 00 00 02 BD 00
				39 00 00 00 00 00 2c C1 01 00 08 10 19 1F 26 2D 34 3B 42 48 4F 56 5E 64 6B 72 79 80 87 8E 96 9D A4 AB B3 BA C1 C8 D0 D7 DF E5 2D D5 85 4B FD C6 C0 D8 C0
				15 00 00 00 00 00 02 BD 01
				39 00 00 00 00 00 2B C1 00 09 12 1B 23 2A 31 39 40 47 4E 56 5E 66 6D 74 7C 83 8B 92 9A A2 A9 B1 B8 C0 C8 D0 D7 DF E6 EC F4 1B 0D EF 47 71 49 D4 93 00
				15 00 00 00 00 00 02 BD 02
				39 00 00 00 00 00 2b C1 00 09 12 1B 23 2B 33 3B 43 4B 52 5B 63 6B 72 7A 82 8A 92 9A A3 AB B3 BB C3 CC D4 DC E3 EA F1 F8 FF 15 AF 8D 1F FE 1A C0 A6 C0
				15 01 00 00 00 00 02 BD 00
		];
		qcom,mdss-dsi-gamma20-command = [
				39 00 00 00 00 00 3B E0 1a 1A 20 25 25 28 2B 28 52 63 72 70 77 8A 90 93 A1 A5 A0 B0 C1 61 5F 64 69 6C 72 7A 7C 1a 1A 20 24 25 28 2A 28 53 63 71 6F 77 8A 8F 94 A0 A4 A0 AF C1 60 5F 63 68 6C 73 7A 7C
				15 00 00 00 00 00 02 BD 00
				39 00 00 00 00 00 2c C1 01 00 08 0F 17 1E 25 2C 34 3B 42 48 4F 57 5E 66 6E 76 7D 84 8C 93 9A A2 A9 B0 B7 BF C7 CF D6 DE E5 EB 0E A9 9A B9 3D A0 BA 65 C0
				15 00 00 00 00 00 02 BD 01
				39 00 00 00 00 00 2B C1 00 08 10 19 20 26 2E 36 3D 44 4A 52 5A 61 69 71 78 80 87 8F 96 9D A5 AC B3 BB C3 CB D2 DA E1 E8 EE 2C 24 4C 24 EC B1 E5 D9 C0
				15 00 00 00 00 00 02 BD 02
				39 00 00 00 00 00 2b C1 00 08 10 18 20 28 31 39 41 48 50 58 60 69 71 7A 82 8A 92 9A A2 A9 B2 BA C3 CB D3 DB E3 EA F1 F8 FF 00 81 01 C8 56 75 3A 43 C0
				15 01 00 00 00 00 02 BD 00
		];
		qcom,mdss-dsi-gamma21-command = [
				39 00 00 00 00 00 3B E0 1a 1A 20 25 25 28 2B 28 52 63 72 70 77 8A 90 93 A1 A5 A0 B0 C1 61 5F 64 69 6C 72 7A 7C 1a 1A 20 24 25 28 2A 28 53 63 71 6F 77 8A 8F 94 A0 A4 A0 AF C1 60 5F 63 68 6C 73 7A 7C
				15 00 00 00 00 00 02 BD 00
				39 00 00 00 00 00 2c C1 01 00 06 0C 12 18 1E 23 29 2F 35 3B 40 46 4B 51 56 5C 62 68 6E 74 7A 80 86 8C 92 98 9D A3 A8 AE B4 B9 1B DE 57 23 90 59 43 6D C0
				15 00 00 00 00 00 02 BD 01
				39 00 00 00 00 00 2B C1 00 09 12 1B 22 2A 32 3A 42 49 51 59 61 69 71 7A 82 8A 92 9A A2 A9 B1 B9 C1 CA D2 DA E2 E9 F0 F7 FF 00 86 79 18 51 7E 8A 17 C0
				15 00 00 00 00 00 02 BD 02
				39 00 00 00 00 00 2b C1 00 06 0D 14 1C 24 2B 33 3B 42 49 50 57 5F 66 6E 76 7D 85 8C 94 9B A2 A9 B1 B8 BF C7 CF D6 DD E4 EA 39 DF 6A C4 32 6F 1D 2D C0
				15 01 00 00 00 00 02 BD 00
		];
		qcom,mdss-dsi-gamma22-command = [
				39 00 00 00 00 00 3B E0 1a 1A 20 25 25 28 2B 28 52 63 72 70 77 8A 90 93 A1 A5 A0 B0 C1 61 5F 64 69 6C 72 7A 7C 1a 1A 20 24 25 28 2A 28 53 63 71 6F 77 8A 8F 94 A0 A4 A0 AF C1 60 5F 63 68 6C 73 7A 7C
				15 00 00 00 00 00 02 BD 00
				39 00 00 00 00 00 2c C1 01 00 06 0D 13 19 1F 25 2B 31 38 3E 43 49 4F 55 5B 61 67 6E 74 7A 81 87 8D 93 99 9F A5 AB B1 B7 BD C3 22 FA C3 55 61 D1 FE AF C0
				15 00 00 00 00 00 02 BD 01
				39 00 00 00 00 00 2B C1 00 09 12 1B 22 2A 32 3A 42 49 51 59 60 68 71 7A 82 8A 92 9A A2 A9 B1 B9 C1 CA D2 DA E2 E9 F0 F7 FF 00 85 10 F4 46 3E 86 17 C0
				15 00 00 00 00 00 02 BD 02
				39 00 00 00 00 00 2b C1 00 07 0E 15 1E 25 2D 35 3D 44 4C 53 5B 62 6A 72 7B 82 8A 92 9A A1 A9 B0 B8 BF C7 CF D7 DE E5 EC F2 1B 3F B2 2B 39 22 2A BD C0
				15 01 00 00 00 00 02 BD 00
		];
		qcom,mdss-dsi-gamma23-command = [
				39 00 00 00 00 00 3B E0 1a 1A 20 25 25 28 2B 28 52 63 72 70 77 8A 90 93 A1 A5 A0 B0 C1 61 5F 64 69 6C 72 7A 7C 1a 1A 20 24 25 28 2A 28 53 63 71 6F 77 8A 8F 94 A0 A4 A0 AF C1 60 5F 63 68 6C 73 7A 7C
				15 00 00 00 00 00 02 BD 00
				39 00 00 00 00 00 2c C1 01 00 07 0E 16 1C 23 29 30 38 3E 45 4B 53 5A 61 68 6F 76 7D 84 8B 92 9A A1 A7 AE B5 BC C3 CB D3 DA E0 2C DB 37 2B E6 F0 BA D0 C0
				15 00 00 00 00 00 02 BD 01
				39 00 00 00 00 00 2B C1 00 08 10 19 20 27 2E 36 3E 45 4C 54 5C 64 6B 73 7A 82 8A 92 9A A1 A8 B0 B7 BF C7 CF D7 DE E5 EC F2 2D 4E 6E 9D D4 1D DA A4 C0
				15 00 00 00 00 00 02 BD 02
				39 00 00 00 00 00 2b C1 00 08 0F 17 20 28 30 39 41 48 51 59 61 6A 72 7A 82 8A 93 9B A3 AB B3 BB C4 CC D5 DC E4 EA F1 F8 FF 0F 48 71 C0 66 9A 23 3F C0
				15 01 00 00 00 00 02 BD 00
		];
		qcom,mdss-dsi-gamma24-command = [
				39 00 00 00 00 00 3B E0 1a 1A 20 25 25 28 2B 28 52 63 72 70 77 8A 90 93 A1 A5 A0 B0 C1 61 5F 64 69 6C 72 7A 7C 1a 1A 20 24 25 28 2A 28 53 63 71 6F 77 8A 8F 94 A0 A4 A0 AF C1 60 5F 63 68 6C 73 7A 7C
				15 00 00 00 00 00 02 BD 00
				39 00 00 00 00 00 2c C1 01 00 07 0E 15 1C 22 28 2F 36 3D 44 4A 51 59 5F 66 6D 74 7B 81 88 90 97 9E A5 AB B2 B9 C1 C8 D0 D7 DF 06 1F F3 CA 17 D9 3F 23 00
				15 00 00 00 00 00 02 BD 01
				39 00 00 00 00 00 2B C1 00 08 10 18 1F 26 2D 35 3D 44 4B 52 5A 62 69 70 77 7F 86 8E 96 9D A4 AC B3 BB C2 CA D2 DA E1 E8 EE 06 9D 03 82 9E 7D 8F D8 C0
				15 00 00 00 00 00 02 BD 02
				39 00 00 00 00 00 2b C1 00 07 0F 17 1F 27 30 38 40 48 50 59 61 69 70 79 80 89 92 9A A2 AA B2 BA C2 CB D4 DC E3 EA F1 F8 FF 39 E6 D4 5C E2 56 E0 9A C0
				15 01 00 00 00 00 02 BD 00
		];
		qcom,mdss-dsi-on-command-state = "dsi_lp_mode";
		qcom,mdss-dsi-off-command-state = "dsi_lp_mode";
		qcom,mdss-dsi-ce-on-command-state = "dsi_hs_mode";
		qcom,mdss-dsi-ce-off-command-state = "dsi_hs_mode";
		qcom,mdss-dsi-cabc-on-command-state = "dsi_hs_mode";
		qcom,mdss-dsi-cabc-off-command-state = "dsi_hs_mode";
		qcom,mdss-dsi-gamma-command-state = "dsi_hs_mode";
		qcom,mdss-dsi-bl-pmic-control-type = "bl_ctrl_wled";
		qcom,mdss-dsi-reset-sequence = <1 10>, <0 10>, <1 10>;
		qcom,mdss-dsi-tx-eot-append;
		qcom,mdss-dsi-lp11-init;
		qcom,mdss-dsi-post-init-delay = <1>;

		qcom,esd-check-enabled;
		qcom,mdss-dsi-panel-status-command = [14 01 00 01 05 00 01 0a
				14 01 00 01 05 00 01 0c
				14 01 00 01 05 00 01 0d
				14 01 00 01 05 00 01 d9
				24 01 00 01 05 00 01 c9
				];
		qcom,mdss-dsi-panel-status-command-state = "dsi_hs_mode";
		qcom,mdss-dsi-panel-status-check-mode = "reg_read";
		qcom,mdss-dsi-panel-status-read-length = <1 1 1 1 2>;
		qcom,mdss-dsi-panel-status-valid-params = <1 1 1 1 2>;
		qcom,mdss-dsi-panel-status-value = <0x1c 0x77 0x00 0x80 0x13 0x00>;
	};
};
