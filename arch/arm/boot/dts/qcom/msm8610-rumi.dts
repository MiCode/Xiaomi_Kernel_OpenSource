/* Copyright (c) 2012-2014, The Linux Foundation. All rights reserved.
 *
 * This program is free software; you can redistribute it and/or modify
 * it under the terms of the GNU General Public License version 2 and
 * only version 2 as published by the Free Software Foundation.
 *
 * This program is distributed in the hope that it will be useful,
 * but WITHOUT ANY WARRANTY; without even the implied warranty of
 * MERCHANTABILITY or FITNESS FOR A PARTICULAR PURPOSE.  See the
 * GNU General Public License for more details.
 */

/dts-v1/;

#include "msm8610.dtsi"

/ {
	model = "Qualcomm Technologies, Inc. MSM 8610 Rumi";
	compatible = "qcom,msm8610-rumi", "qcom,msm8610", "qcom,rumi";
	qcom,board-id = <15 0>;
};

&soc {
	serial@f991f000 {
		status = "ok";
	};
};

&gfx_iommu {
	status = "disabled";
};
