/* Copyright (c) 2014, The Linux Foundation. All rights reserved.
 *
 * This program is free software; you can redistribute it and/or modify
 * it under the terms of the GNU General Public License version 2 and
 * only version 2 as published by the Free Software Foundation.
 *
 * This program is distributed in the hope that it will be useful,
 * but WITHOUT ANY WARRANTY; without even the implied warranty of
 * MERCHANTABILITY or FITNESS FOR A PARTICULAR PURPOSE.  See the
 * GNU General Public License for more details.
 */

/dts-v1/;

#include "mdm9640-mtp.dtsi"

/ {
	model = "Qualcomm Technologies, Inc. MSM 9640 MTP";
	compatible = "qcom,mdm9640-mtp", "qcom,mdm9640", "qcom,mtp";
	qcom,board-id = <8 0>;
};
