/* Copyright (c) 2013-2014, The Linux Foundation. All rights reserved.
 * Copyright (C) 2016 XiaoMi, Inc.
 *
 * This program is free software; you can redistribute it and/or modify
 * it under the terms of the GNU General Public License version 2 and
 * only version 2 as published by the Free Software Foundation.
 *
 * This program is distributed in the hope that it will be useful,
 * but WITHOUT ANY WARRANTY; without even the implied warranty of
 * MERCHANTABILITY or FITNESS FOR A PARTICULAR PURPOSE.  See the
 * GNU General Public License for more details.
 */

&mdss_mdp {
	dsi_nt35596_1080_vid: qcom,mdss_dsi_nt35596_1080p_video {
		qcom,mdss-dsi-panel-name = "nt35596_1080p_video_EBBG";
		qcom,mdss-dsi-panel-controller = <&mdss_dsi0>;
		qcom,mdss-dsi-panel-type = "dsi_video_mode";
		qcom,mdss-dsi-panel-destination = "display_1";
		qcom,mdss-dsi-panel-framerate = <60>;
		qcom,mdss-dsi-virtual-channel-id = <0>;
		qcom,mdss-dsi-stream = <0>;
		qcom,mdss-dsi-panel-width = <1080>;
		qcom,mdss-dsi-panel-height = <1920>;
		qcom,mdss-dsi-h-front-porch = <124>;
		qcom,mdss-dsi-h-back-porch = <120>;
		qcom,mdss-dsi-h-pulse-width = <4>;
		qcom,mdss-dsi-h-sync-skew = <0>;
		qcom,mdss-dsi-v-back-porch = <15>;
		qcom,mdss-dsi-v-front-porch = <8>;
		qcom,mdss-dsi-v-pulse-width = <5>;
		qcom,mdss-dsi-h-left-border = <0>;
		qcom,mdss-dsi-h-right-border = <0>;
		qcom,mdss-dsi-v-top-border = <0>;
		qcom,mdss-dsi-v-bottom-border = <0>;
		qcom,mdss-dsi-bpp = <24>;
		qcom,mdss-dsi-underflow-color = <0xff>;
		qcom,mdss-dsi-border-color = <0>;
		qcom,mdss-dsi-on-command = [29 01 00 00 00 00 02 FF EE
				29 01 00 00 0A 00 02 18 40
				29 01 00 00 0A 00 02 18 00
				29 01 00 00 00 00 02 FF 00
				29 01 00 00 00 00 02 35 00
				29 01 00 00 00 00 02 D3 14
				29 01 00 00 00 00 02 D4 08
				29 01 00 00 96 00 02 11 00
				29 01 00 00 78 00 02 29 00];
		qcom,mdss-dsi-off-command = [05 01 00 00 32 00 02 28 00
				05 01 00 00 78 00 02 10 00];
		qcom,mdss-dsi-on-command-state = "dsi_lp_mode";
		qcom,mdss-dsi-off-command-state = "dsi_hs_mode";
		qcom,mdss-dsi-h-sync-pulse = <1>;
		qcom,mdss-dsi-traffic-mode = "burst_mode";
		qcom,mdss-dsi-bllp-eof-power-mode;
		qcom,mdss-dsi-bllp-power-mode;
		qcom,mdss-dsi-lane-0-state;
		qcom,mdss-dsi-lane-1-state;
		qcom,mdss-dsi-lane-2-state;
		qcom,mdss-dsi-lane-3-state;
		qcom,mdss-dsi-panel-timings = [F2 3A 28 00 6C 6E 2C 3E 2E 03 04 00];
		qcom,mdss-dsi-t-clk-post = <0x2>;
		qcom,mdss-dsi-t-clk-pre = <0x2D>;
		qcom,mdss-dsi-bl-min-level = <1>;
		qcom,mdss-dsi-bl-max-level = <255>;
		qcom,mdss-dsi-bl-pmic-pwm-frequency = <40>;
		qcom,mdss-dsi-bl-pmic-bank-select = <0>;
		qcom,mdss-dsi-dma-trigger = "trigger_sw";
		qcom,mdss-dsi-mdp-trigger = "none";
		qcom,mdss-dsi-bl-pmic-control-type = "bl_ctrl_pwm";
		qcom,mdss-dsi-reset-sequence = <1 20>, <0 10>, <1 20>, <0 10>, <1 20>;
		qcom,mdss-dsi-panel-warm-command = [29 00 00 00 00 00 02 FF 01
				29 00 00 00 00 00 02 75 00
				29 00 00 00 00 00 02 76 4E
				29 00 00 00 00 00 02 77 00
				29 00 00 00 00 00 02 78 5A
				29 00 00 00 00 00 02 79 00
				29 00 00 00 00 00 02 7A 70
				29 00 00 00 00 00 02 7B 00
				29 00 00 00 00 00 02 7C 86
				29 00 00 00 00 00 02 7D 00
				29 00 00 00 00 00 02 7E 9A
				29 00 00 00 00 00 02 7F 00
				29 00 00 00 00 00 02 80 AC
				29 00 00 00 00 00 02 81 00
				29 00 00 00 00 00 02 82 BD
				29 00 00 00 00 00 02 83 00
				29 00 00 00 00 00 02 84 CC
				29 00 00 00 00 00 02 85 00
				29 00 00 00 00 00 02 86 D8
				29 00 00 00 00 00 02 87 01
				29 00 00 00 00 00 02 88 03
				29 00 00 00 00 00 02 89 01
				29 00 00 00 00 00 02 8A 25
				29 00 00 00 00 00 02 8B 01
				29 00 00 00 00 00 02 8C 5E
				29 00 00 00 00 00 02 8D 01
				29 00 00 00 00 00 02 8E 8F
				29 00 00 00 00 00 02 8F 01
				29 00 00 00 00 00 02 90 DA
				29 00 00 00 00 00 02 91 02
				29 00 00 00 00 00 02 92 16
				29 00 00 00 00 00 02 93 02
				29 00 00 00 00 00 02 94 18
				29 00 00 00 00 00 02 95 02
				29 00 00 00 00 00 02 96 52
				29 00 00 00 00 00 02 97 02
				29 00 00 00 00 00 02 98 90
				29 00 00 00 00 00 02 99 02
				29 00 00 00 00 00 02 9A B6
				29 00 00 00 00 00 02 9B 02
				29 00 00 00 00 00 02 9C E8
				29 00 00 00 00 00 02 9D 03
				29 00 00 00 00 00 02 9E 08
				29 00 00 00 00 00 02 9F 03
				29 00 00 00 00 00 02 A0 39
				29 00 00 00 00 00 02 A2 03
				29 00 00 00 00 00 02 A3 46
				29 00 00 00 00 00 02 A4 03
				29 00 00 00 00 00 02 A5 53
				29 00 00 00 00 00 02 A6 03
				29 00 00 00 00 00 02 A7 66
				29 00 00 00 00 00 02 A9 03
				29 00 00 00 00 00 02 AA 78
				29 00 00 00 00 00 02 AB 03
				29 00 00 00 00 00 02 AC 90
				29 00 00 00 00 00 02 AD 03
				29 00 00 00 00 00 02 AE B6
				29 00 00 00 00 00 02 AF 03
				29 00 00 00 00 00 02 B0 CC
				29 00 00 00 00 00 02 B1 03
				29 00 00 00 00 00 02 B2 CF
				29 00 00 00 00 00 02 B3 00
				29 00 00 00 00 00 02 B4 4E
				29 00 00 00 00 00 02 B5 00
				29 00 00 00 00 00 02 B6 5A
				29 00 00 00 00 00 02 B7 00
				29 00 00 00 00 00 02 B8 70
				29 00 00 00 00 00 02 B9 00
				29 00 00 00 00 00 02 BA 86
				29 00 00 00 00 00 02 BB 00
				29 00 00 00 00 00 02 BC 9A
				29 00 00 00 00 00 02 BD 00
				29 00 00 00 00 00 02 BE AC
				29 00 00 00 00 00 02 BF 00
				29 00 00 00 00 00 02 C0 BD
				29 00 00 00 00 00 02 C1 00
				29 00 00 00 00 00 02 C2 CC
				29 00 00 00 00 00 02 C3 00
				29 00 00 00 00 00 02 C4 D8
				29 00 00 00 00 00 02 C5 01
				29 00 00 00 00 00 02 C6 03
				29 00 00 00 00 00 02 C7 01
				29 00 00 00 00 00 02 C8 25
				29 00 00 00 00 00 02 C9 01
				29 00 00 00 00 00 02 CA 5E
				29 00 00 00 00 00 02 CB 01
				29 00 00 00 00 00 02 CC 8F
				29 00 00 00 00 00 02 CD 01
				29 00 00 00 00 00 02 CE DA
				29 00 00 00 00 00 02 CF 02
				29 00 00 00 00 00 02 D0 16
				29 00 00 00 00 00 02 D1 02
				29 00 00 00 00 00 02 D2 18
				29 00 00 00 00 00 02 D3 02
				29 00 00 00 00 00 02 D4 52
				29 00 00 00 00 00 02 D5 02
				29 00 00 00 00 00 02 D6 90
				29 00 00 00 00 00 02 D7 02
				29 00 00 00 00 00 02 D8 B6
				29 00 00 00 00 00 02 D9 02
				29 00 00 00 00 00 02 DA E8
				29 00 00 00 00 00 02 DB 03
				29 00 00 00 00 00 02 DC 08
				29 00 00 00 00 00 02 DD 03
				29 00 00 00 00 00 02 DE 39
				29 00 00 00 00 00 02 DF 03
				29 00 00 00 00 00 02 E0 46
				29 00 00 00 00 00 02 E1 03
				29 00 00 00 00 00 02 E2 53
				29 00 00 00 00 00 02 E3 03
				29 00 00 00 00 00 02 E4 66
				29 00 00 00 00 00 02 E5 03
				29 00 00 00 00 00 02 E6 78
				29 00 00 00 00 00 02 E7 03
				29 00 00 00 00 00 02 E8 90
				29 00 00 00 00 00 02 E9 03
				29 00 00 00 00 00 02 EA B6
				29 00 00 00 00 00 02 EB 03
				29 00 00 00 00 00 02 EC CC
				29 00 00 00 00 00 02 ED 03
				29 00 00 00 00 00 02 EE CF
				29 00 00 00 00 00 02 EF 00
				29 00 00 00 00 00 02 F0 B0
				29 00 00 00 00 00 02 F1 00
				29 00 00 00 00 00 02 F2 B6
				29 00 00 00 00 00 02 F3 00
				29 00 00 00 00 00 02 F4 C3
				29 00 00 00 00 00 02 F5 00
				29 00 00 00 00 00 02 F6 CE
				29 00 00 00 00 00 02 F7 00
				29 00 00 00 00 00 02 F8 D9
				29 00 00 00 00 00 02 F9 00
				29 00 00 00 00 00 02 FA E3
				29 00 00 00 00 00 02 FF 02
				29 00 00 00 00 00 02 00 00
				29 00 00 00 00 00 02 01 ED
				29 00 00 00 00 00 02 02 00
				29 00 00 00 00 00 02 03 F6
				29 00 00 00 00 00 02 04 01
				29 00 00 00 00 00 02 05 00
				29 00 00 00 00 00 02 06 01
				29 00 00 00 00 00 02 07 21
				29 00 00 00 00 00 02 08 01
				29 00 00 00 00 00 02 09 3F
				29 00 00 00 00 00 02 0A 01
				29 00 00 00 00 00 02 0B 71
				29 00 00 00 00 00 02 0C 01
				29 00 00 00 00 00 02 0D 9B
				29 00 00 00 00 00 02 0E 01
				29 00 00 00 00 00 02 0F E1
				29 00 00 00 00 00 02 10 02
				29 00 00 00 00 00 02 11 1C
				29 00 00 00 00 00 02 12 02
				29 00 00 00 00 00 02 13 1E
				29 00 00 00 00 00 02 14 02
				29 00 00 00 00 00 02 15 55
				29 00 00 00 00 00 02 16 02
				29 00 00 00 00 00 02 17 93
				29 00 00 00 00 00 02 18 02
				29 00 00 00 00 00 02 19 BA
				29 00 00 00 00 00 02 1A 02
				29 00 00 00 00 00 02 1B EC
				29 00 00 00 00 00 02 1C 03
				29 00 00 00 00 00 02 1D 0F
				29 00 00 00 00 00 02 1E 03
				29 00 00 00 00 00 02 1F 38
				29 00 00 00 00 00 02 20 03
				29 00 00 00 00 00 02 21 45
				29 00 00 00 00 00 02 22 03
				29 00 00 00 00 00 02 23 53
				29 00 00 00 00 00 02 24 03
				29 00 00 00 00 00 02 25 69
				29 00 00 00 00 00 02 26 03
				29 00 00 00 00 00 02 27 7B
				29 00 00 00 00 00 02 28 03
				29 00 00 00 00 00 02 29 90
				29 00 00 00 00 00 02 2A 03
				29 00 00 00 00 00 02 2B A8
				29 00 00 00 00 00 02 2D 03
				29 00 00 00 00 00 02 2F CB
				29 00 00 00 00 00 02 30 03
				29 00 00 00 00 00 02 31 CF
				29 00 00 00 00 00 02 32 00
				29 00 00 00 00 00 02 33 B0
				29 00 00 00 00 00 02 34 00
				29 00 00 00 00 00 02 35 B6
				29 00 00 00 00 00 02 36 00
				29 00 00 00 00 00 02 37 C3
				29 00 00 00 00 00 02 38 00
				29 00 00 00 00 00 02 39 CE
				29 00 00 00 00 00 02 3A 00
				29 00 00 00 00 00 02 3B D9
				29 00 00 00 00 00 02 3D 00
				29 00 00 00 00 00 02 3F E3
				29 00 00 00 00 00 02 40 00
				29 00 00 00 00 00 02 41 ED
				29 00 00 00 00 00 02 42 00
				29 00 00 00 00 00 02 43 F6
				29 00 00 00 00 00 02 44 01
				29 00 00 00 00 00 02 45 00
				29 00 00 00 00 00 02 46 01
				29 00 00 00 00 00 02 47 21
				29 00 00 00 00 00 02 48 01
				29 00 00 00 00 00 02 49 3F
				29 00 00 00 00 00 02 4A 01
				29 00 00 00 00 00 02 4B 71
				29 00 00 00 00 00 02 4C 01
				29 00 00 00 00 00 02 4D 9B
				29 00 00 00 00 00 02 4E 01
				29 00 00 00 00 00 02 4F E1
				29 00 00 00 00 00 02 50 02
				29 00 00 00 00 00 02 51 1C
				29 00 00 00 00 00 02 52 02
				29 00 00 00 00 00 02 53 1E
				29 00 00 00 00 00 02 54 02
				29 00 00 00 00 00 02 55 55
				29 00 00 00 00 00 02 56 02
				29 00 00 00 00 00 02 58 93
				29 00 00 00 00 00 02 59 02
				29 00 00 00 00 00 02 5A BA
				29 00 00 00 00 00 02 5B 02
				29 00 00 00 00 00 02 5C EC
				29 00 00 00 00 00 02 5D 03
				29 00 00 00 00 00 02 5E 0F
				29 00 00 00 00 00 02 5F 03
				29 00 00 00 00 00 02 60 38
				29 00 00 00 00 00 02 61 03
				29 00 00 00 00 00 02 62 45
				29 00 00 00 00 00 02 63 03
				29 00 00 00 00 00 02 64 53
				29 00 00 00 00 00 02 65 03
				29 00 00 00 00 00 02 66 69
				29 00 00 00 00 00 02 67 03
				29 00 00 00 00 00 02 68 7B
				29 00 00 00 00 00 02 69 03
				29 00 00 00 00 00 02 6A 90
				29 00 00 00 00 00 02 6B 03
				29 00 00 00 00 00 02 6C A8
				29 00 00 00 00 00 02 6D 03
				29 00 00 00 00 00 02 6E CB
				29 00 00 00 00 00 02 6F 03
				29 00 00 00 00 00 02 70 CF
				29 00 00 00 00 00 02 71 01
				29 00 00 00 00 00 02 72 1F
				29 00 00 00 00 00 02 73 01
				29 00 00 00 00 00 02 74 22
				29 00 00 00 00 00 02 75 01
				29 00 00 00 00 00 02 76 29
				29 00 00 00 00 00 02 77 01
				29 00 00 00 00 00 02 78 30
				29 00 00 00 00 00 02 79 01
				29 00 00 00 00 00 02 7A 37
				29 00 00 00 00 00 02 7B 01
				29 00 00 00 00 00 02 7C 3C
				29 00 00 00 00 00 02 7D 01
				29 00 00 00 00 00 02 7E 42
				29 00 00 00 00 00 02 7F 01
				29 00 00 00 00 00 02 80 48
				29 00 00 00 00 00 02 81 01
				29 00 00 00 00 00 02 82 4E
				29 00 00 00 00 00 02 83 01
				29 00 00 00 00 00 02 84 63
				29 00 00 00 00 00 02 85 01
				29 00 00 00 00 00 02 86 76
				29 00 00 00 00 00 02 87 01
				29 00 00 00 00 00 02 88 9E
				29 00 00 00 00 00 02 89 01
				29 00 00 00 00 00 02 8A BF
				29 00 00 00 00 00 02 8B 01
				29 00 00 00 00 00 02 8C F9
				29 00 00 00 00 00 02 8D 02
				29 00 00 00 00 00 02 8E 2D
				29 00 00 00 00 00 02 8F 02
				29 00 00 00 00 00 02 90 2F
				29 00 00 00 00 00 02 91 02
				29 00 00 00 00 00 02 92 63
				29 00 00 00 00 00 02 93 02
				29 00 00 00 00 00 02 94 9F
				29 00 00 00 00 00 02 95 02
				29 00 00 00 00 00 02 96 C6
				29 00 00 00 00 00 02 97 02
				29 00 00 00 00 00 02 98 FC
				29 00 00 00 00 00 02 99 03
				29 00 00 00 00 00 02 9A 1E
				29 00 00 00 00 00 02 9B 03
				29 00 00 00 00 00 02 9C 41
				29 00 00 00 00 00 02 9D 03
				29 00 00 00 00 00 02 9E 4C
				29 00 00 00 00 00 02 9F 03
				29 00 00 00 00 00 02 A0 57
				29 00 00 00 00 00 02 A2 03
				29 00 00 00 00 00 02 A3 63
				29 00 00 00 00 00 02 A4 03
				29 00 00 00 00 00 02 A5 76
				29 00 00 00 00 00 02 A6 03
				29 00 00 00 00 00 02 A7 91
				29 00 00 00 00 00 02 A9 03
				29 00 00 00 00 00 02 AA B1
				29 00 00 00 00 00 02 AB 03
				29 00 00 00 00 00 02 AC CC
				29 00 00 00 00 00 02 AD 03
				29 00 00 00 00 00 02 AE CF
				29 00 00 00 00 00 02 AF 01
				29 00 00 00 00 00 02 B0 1F
				29 00 00 00 00 00 02 B1 01
				29 00 00 00 00 00 02 B2 22
				29 00 00 00 00 00 02 B3 01
				29 00 00 00 00 00 02 B4 29
				29 00 00 00 00 00 02 B5 01
				29 00 00 00 00 00 02 B6 30
				29 00 00 00 00 00 02 B7 01
				29 00 00 00 00 00 02 B8 37
				29 00 00 00 00 00 02 B9 01
				29 00 00 00 00 00 02 BA 3C
				29 00 00 00 00 00 02 BB 01
				29 00 00 00 00 00 02 BC 42
				29 00 00 00 00 00 02 BD 01
				29 00 00 00 00 00 02 BE 48
				29 00 00 00 00 00 02 BF 01
				29 00 00 00 00 00 02 C0 4E
				29 00 00 00 00 00 02 C1 01
				29 00 00 00 00 00 02 C2 63
				29 00 00 00 00 00 02 C3 01
				29 00 00 00 00 00 02 C4 76
				29 00 00 00 00 00 02 C5 01
				29 00 00 00 00 00 02 C6 9E
				29 00 00 00 00 00 02 C7 01
				29 00 00 00 00 00 02 C8 BF
				29 00 00 00 00 00 02 C9 01
				29 00 00 00 00 00 02 CA F9
				29 00 00 00 00 00 02 CB 02
				29 00 00 00 00 00 02 CC 2D
				29 00 00 00 00 00 02 CD 02
				29 00 00 00 00 00 02 CE 2F
				29 00 00 00 00 00 02 CF 02
				29 00 00 00 00 00 02 D0 63
				29 00 00 00 00 00 02 D1 02
				29 00 00 00 00 00 02 D2 9F
				29 00 00 00 00 00 02 D3 02
				29 00 00 00 00 00 02 D4 C6
				29 00 00 00 00 00 02 D5 02
				29 00 00 00 00 00 02 D6 FC
				29 00 00 00 00 00 02 D7 03
				29 00 00 00 00 00 02 D8 1E
				29 00 00 00 00 00 02 D9 03
				29 00 00 00 00 00 02 DA 41
				29 00 00 00 00 00 02 DB 03
				29 00 00 00 00 00 02 DC 4C
				29 00 00 00 00 00 02 DD 03
				29 00 00 00 00 00 02 DE 57
				29 00 00 00 00 00 02 DF 03
				29 00 00 00 00 00 02 E0 63
				29 00 00 00 00 00 02 E1 03
				29 00 00 00 00 00 02 E2 76
				29 00 00 00 00 00 02 E3 03
				29 00 00 00 00 00 02 E4 91
				29 00 00 00 00 00 02 E5 03
				29 00 00 00 00 00 02 E6 B1
				29 00 00 00 00 00 02 E7 03
				29 00 00 00 00 00 02 E8 CC
				29 00 00 00 00 00 02 E9 03
				29 01 00 00 00 00 02 EA CF];
		qcom,mdss-dsi-panel-cool-command = [29 00 00 00 00 00 02 FF 01
				29 00 00 00 00 00 02 75 00
				29 00 00 00 00 00 02 76 F3
				29 00 00 00 00 00 02 77 00
				29 00 00 00 00 00 02 78 FE
				29 00 00 00 00 00 02 79 01
				29 00 00 00 00 00 02 7A 06
				29 00 00 00 00 00 02 7B 01
				29 00 00 00 00 00 02 7C 0E
				29 00 00 00 00 00 02 7D 01
				29 00 00 00 00 00 02 7E 16
				29 00 00 00 00 00 02 7F 01
				29 00 00 00 00 00 02 80 1E
				29 00 00 00 00 00 02 81 01
				29 00 00 00 00 00 02 82 26
				29 00 00 00 00 00 02 83 01
				29 00 00 00 00 00 02 84 2D
				29 00 00 00 00 00 02 85 01
				29 00 00 00 00 00 02 86 35
				29 00 00 00 00 00 02 87 01
				29 00 00 00 00 00 02 88 51
				29 00 00 00 00 00 02 89 01
				29 00 00 00 00 00 02 8A 6C
				29 00 00 00 00 00 02 8B 01
				29 00 00 00 00 00 02 8C 9A
				29 00 00 00 00 00 02 8D 01
				29 00 00 00 00 00 02 8E BF
				29 00 00 00 00 00 02 8F 01
				29 00 00 00 00 00 02 90 FF
				29 00 00 00 00 00 02 91 02
				29 00 00 00 00 00 02 92 35
				29 00 00 00 00 00 02 93 02
				29 00 00 00 00 00 02 94 37
				29 00 00 00 00 00 02 95 02
				29 00 00 00 00 00 02 96 6D
				29 00 00 00 00 00 02 97 02
				29 00 00 00 00 00 02 98 AC
				29 00 00 00 00 00 02 99 02
				29 00 00 00 00 00 02 9A D3
				29 00 00 00 00 00 02 9B 03
				29 00 00 00 00 00 02 9C 09
				29 00 00 00 00 00 02 9D 03
				29 00 00 00 00 00 02 9E 2F
				29 00 00 00 00 00 02 9F 03
				29 00 00 00 00 00 02 A0 54
				29 00 00 00 00 00 02 A2 03
				29 00 00 00 00 00 02 A3 62
				29 00 00 00 00 00 02 A4 03
				29 00 00 00 00 00 02 A5 6E
				29 00 00 00 00 00 02 A6 03
				29 00 00 00 00 00 02 A7 7E
				29 00 00 00 00 00 02 A9 03
				29 00 00 00 00 00 02 AA 8E
				29 00 00 00 00 00 02 AB 03
				29 00 00 00 00 00 02 AC A0
				29 00 00 00 00 00 02 AD 03
				29 00 00 00 00 00 02 AE BA
				29 00 00 00 00 00 02 AF 03
				29 00 00 00 00 00 02 B0 C8
				29 00 00 00 00 00 02 B1 03
				29 00 00 00 00 00 02 B2 CF
				29 00 00 00 00 00 02 B3 00
				29 00 00 00 00 00 02 B4 F3
				29 00 00 00 00 00 02 B5 00
				29 00 00 00 00 00 02 B6 FE
				29 00 00 00 00 00 02 B7 01
				29 00 00 00 00 00 02 B8 06
				29 00 00 00 00 00 02 B9 01
				29 00 00 00 00 00 02 BA 0E
				29 00 00 00 00 00 02 BB 01
				29 00 00 00 00 00 02 BC 16
				29 00 00 00 00 00 02 BD 01
				29 00 00 00 00 00 02 BE 1E
				29 00 00 00 00 00 02 BF 01
				29 00 00 00 00 00 02 C0 26
				29 00 00 00 00 00 02 C1 01
				29 00 00 00 00 00 02 C2 2D
				29 00 00 00 00 00 02 C3 01
				29 00 00 00 00 00 02 C4 35
				29 00 00 00 00 00 02 C5 01
				29 00 00 00 00 00 02 C6 51
				29 00 00 00 00 00 02 C7 01
				29 00 00 00 00 00 02 C8 6C
				29 00 00 00 00 00 02 C9 01
				29 00 00 00 00 00 02 CA 9A
				29 00 00 00 00 00 02 CB 01
				29 00 00 00 00 00 02 CC BF
				29 00 00 00 00 00 02 CD 01
				29 00 00 00 00 00 02 CE FF
				29 00 00 00 00 00 02 CF 02
				29 00 00 00 00 00 02 D0 35
				29 00 00 00 00 00 02 D1 02
				29 00 00 00 00 00 02 D2 37
				29 00 00 00 00 00 02 D3 02
				29 00 00 00 00 00 02 D4 6D
				29 00 00 00 00 00 02 D5 02
				29 00 00 00 00 00 02 D6 AC
				29 00 00 00 00 00 02 D7 02
				29 00 00 00 00 00 02 D8 D3
				29 00 00 00 00 00 02 D9 03
				29 00 00 00 00 00 02 DA 09
				29 00 00 00 00 00 02 DB 03
				29 00 00 00 00 00 02 DC 2F
				29 00 00 00 00 00 02 DD 03
				29 00 00 00 00 00 02 DE 54
				29 00 00 00 00 00 02 DF 03
				29 00 00 00 00 00 02 E0 62
				29 00 00 00 00 00 02 E1 03
				29 00 00 00 00 00 02 E2 6E
				29 00 00 00 00 00 02 E3 03
				29 00 00 00 00 00 02 E4 7E
				29 00 00 00 00 00 02 E5 03
				29 00 00 00 00 00 02 E6 8E
				29 00 00 00 00 00 02 E7 03
				29 00 00 00 00 00 02 E8 A0
				29 00 00 00 00 00 02 E9 03
				29 00 00 00 00 00 02 EA BA
				29 00 00 00 00 00 02 EB 03
				29 00 00 00 00 00 02 EC C8
				29 00 00 00 00 00 02 ED 03
				29 00 00 00 00 00 02 EE CF
				29 00 00 00 00 00 02 EF 00
				29 00 00 00 00 00 02 F0 E4
				29 00 00 00 00 00 02 F1 00
				29 00 00 00 00 00 02 F2 E8
				29 00 00 00 00 00 02 F3 00
				29 00 00 00 00 00 02 F4 F2
				29 00 00 00 00 00 02 F5 00
				29 00 00 00 00 00 02 F6 FD
				29 00 00 00 00 00 02 F7 01
				29 00 00 00 00 00 02 F8 07
				29 00 00 00 00 00 02 F9 01
				29 00 00 00 00 00 02 FA 10
				29 00 00 00 00 00 02 FF 02
				29 00 00 00 00 00 02 00 01
				29 00 00 00 00 00 02 01 19
				29 00 00 00 00 00 02 02 01
				29 00 00 00 00 00 02 03 22
				29 00 00 00 00 00 02 04 01
				29 00 00 00 00 00 02 05 2A
				29 00 00 00 00 00 02 06 01
				29 00 00 00 00 00 02 07 48
				29 00 00 00 00 00 02 08 01
				29 00 00 00 00 00 02 09 62
				29 00 00 00 00 00 02 0A 01
				29 00 00 00 00 00 02 0B 90
				29 00 00 00 00 00 02 0C 01
				29 00 00 00 00 00 02 0D B7
				29 00 00 00 00 00 02 0E 01
				29 00 00 00 00 00 02 0F F9
				29 00 00 00 00 00 02 10 02
				29 00 00 00 00 00 02 11 31
				29 00 00 00 00 00 02 12 02
				29 00 00 00 00 00 02 13 33
				29 00 00 00 00 00 02 14 02
				29 00 00 00 00 00 02 15 6A
				29 00 00 00 00 00 02 16 02
				29 00 00 00 00 00 02 17 A9
				29 00 00 00 00 00 02 18 02
				29 00 00 00 00 00 02 19 D1
				29 00 00 00 00 00 02 1A 03
				29 00 00 00 00 00 02 1B 05
				29 00 00 00 00 00 02 1C 03
				29 00 00 00 00 00 02 1D 26
				29 00 00 00 00 00 02 1E 03
				29 00 00 00 00 00 02 1F 53
				29 00 00 00 00 00 02 20 03
				29 00 00 00 00 00 02 21 62
				29 00 00 00 00 00 02 22 03
				29 00 00 00 00 00 02 23 6F
				29 00 00 00 00 00 02 24 03
				29 00 00 00 00 00 02 25 80
				29 00 00 00 00 00 02 26 03
				29 00 00 00 00 00 02 27 8F
				29 00 00 00 00 00 02 28 03
				29 00 00 00 00 00 02 29 9F
				29 00 00 00 00 00 02 2A 03
				29 00 00 00 00 00 02 2B B6
				29 00 00 00 00 00 02 2D 03
				29 00 00 00 00 00 02 2F C6
				29 00 00 00 00 00 02 30 03
				29 00 00 00 00 00 02 31 CF
				29 00 00 00 00 00 02 32 00
				29 00 00 00 00 00 02 33 E4
				29 00 00 00 00 00 02 34 00
				29 00 00 00 00 00 02 35 E8
				29 00 00 00 00 00 02 36 00
				29 00 00 00 00 00 02 37 F2
				29 00 00 00 00 00 02 38 00
				29 00 00 00 00 00 02 39 FD
				29 00 00 00 00 00 02 3A 01
				29 00 00 00 00 00 02 3B 07
				29 00 00 00 00 00 02 3D 01
				29 00 00 00 00 00 02 3F 10
				29 00 00 00 00 00 02 40 01
				29 00 00 00 00 00 02 41 19
				29 00 00 00 00 00 02 42 01
				29 00 00 00 00 00 02 43 22
				29 00 00 00 00 00 02 44 01
				29 00 00 00 00 00 02 45 2A
				29 00 00 00 00 00 02 46 01
				29 00 00 00 00 00 02 47 48
				29 00 00 00 00 00 02 48 01
				29 00 00 00 00 00 02 49 62
				29 00 00 00 00 00 02 4A 01
				29 00 00 00 00 00 02 4B 90
				29 00 00 00 00 00 02 4C 01
				29 00 00 00 00 00 02 4D B7
				29 00 00 00 00 00 02 4E 01
				29 00 00 00 00 00 02 4F F9
				29 00 00 00 00 00 02 50 02
				29 00 00 00 00 00 02 51 31
				29 00 00 00 00 00 02 52 02
				29 00 00 00 00 00 02 53 33
				29 00 00 00 00 00 02 54 02
				29 00 00 00 00 00 02 55 6A
				29 00 00 00 00 00 02 56 02
				29 00 00 00 00 00 02 58 A9
				29 00 00 00 00 00 02 59 02
				29 00 00 00 00 00 02 5A D1
				29 00 00 00 00 00 02 5B 03
				29 00 00 00 00 00 02 5C 05
				29 00 00 00 00 00 02 5D 03
				29 00 00 00 00 00 02 5E 26
				29 00 00 00 00 00 02 5F 03
				29 00 00 00 00 00 02 60 53
				29 00 00 00 00 00 02 61 03
				29 00 00 00 00 00 02 62 62
				29 00 00 00 00 00 02 63 03
				29 00 00 00 00 00 02 64 6F
				29 00 00 00 00 00 02 65 03
				29 00 00 00 00 00 02 66 80
				29 00 00 00 00 00 02 67 03
				29 00 00 00 00 00 02 68 8F
				29 00 00 00 00 00 02 69 03
				29 00 00 00 00 00 02 6A 9F
				29 00 00 00 00 00 02 6B 03
				29 00 00 00 00 00 02 6C B6
				29 00 00 00 00 00 02 6D 03
				29 00 00 00 00 00 02 6E C6
				29 00 00 00 00 00 02 6F 03
				29 00 00 00 00 00 02 70 CF
				29 00 00 00 00 00 02 71 00
				29 00 00 00 00 00 02 72 E8
				29 00 00 00 00 00 02 73 00
				29 00 00 00 00 00 02 74 ED
				29 00 00 00 00 00 02 75 00
				29 00 00 00 00 00 02 76 F8
				29 00 00 00 00 00 02 77 01
				29 00 00 00 00 00 02 78 00
				29 00 00 00 00 00 02 79 01
				29 00 00 00 00 00 02 7A 09
				29 00 00 00 00 00 02 7B 01
				29 00 00 00 00 00 02 7C 13
				29 00 00 00 00 00 02 7D 01
				29 00 00 00 00 00 02 7E 1C
				29 00 00 00 00 00 02 7F 01
				29 00 00 00 00 00 02 80 23
				29 00 00 00 00 00 02 81 01
				29 00 00 00 00 00 02 82 2B
				29 00 00 00 00 00 02 83 01
				29 00 00 00 00 00 02 84 47
				29 00 00 00 00 00 02 85 01
				29 00 00 00 00 00 02 86 62
				29 00 00 00 00 00 02 87 01
				29 00 00 00 00 00 02 88 8F
				29 00 00 00 00 00 02 89 01
				29 00 00 00 00 00 02 8A B5
				29 00 00 00 00 00 02 8B 01
				29 00 00 00 00 00 02 8C F7
				29 00 00 00 00 00 02 8D 02
				29 00 00 00 00 00 02 8E 30
				29 00 00 00 00 00 02 8F 02
				29 00 00 00 00 00 02 90 32
				29 00 00 00 00 00 02 91 02
				29 00 00 00 00 00 02 92 69
				29 00 00 00 00 00 02 93 02
				29 00 00 00 00 00 02 94 A9
				29 00 00 00 00 00 02 95 02
				29 00 00 00 00 00 02 96 D3
				29 00 00 00 00 00 02 97 03
				29 00 00 00 00 00 02 98 0D
				29 00 00 00 00 00 02 99 03
				29 00 00 00 00 00 02 9A 37
				29 00 00 00 00 00 02 9B 03
				29 00 00 00 00 00 02 9C 56
				29 00 00 00 00 00 02 9D 03
				29 00 00 00 00 00 02 9E 63
				29 00 00 00 00 00 02 9F 03
				29 00 00 00 00 00 02 A0 70
				29 00 00 00 00 00 02 A2 03
				29 00 00 00 00 00 02 A3 84
				29 00 00 00 00 00 02 A4 03
				29 00 00 00 00 00 02 A5 96
				29 00 00 00 00 00 02 A6 03
				29 00 00 00 00 00 02 A7 A7
				29 00 00 00 00 00 02 A9 03
				29 00 00 00 00 00 02 AA BF
				29 00 00 00 00 00 02 AB 03
				29 00 00 00 00 00 02 AC C9
				29 00 00 00 00 00 02 AD 03
				29 00 00 00 00 00 02 AE CF
				29 00 00 00 00 00 02 AF 00
				29 00 00 00 00 00 02 B0 E8
				29 00 00 00 00 00 02 B1 00
				29 00 00 00 00 00 02 B2 ED
				29 00 00 00 00 00 02 B3 00
				29 00 00 00 00 00 02 B4 F8
				29 00 00 00 00 00 02 B5 01
				29 00 00 00 00 00 02 B6 00
				29 00 00 00 00 00 02 B7 01
				29 00 00 00 00 00 02 B8 09
				29 00 00 00 00 00 02 B9 01
				29 00 00 00 00 00 02 BA 13
				29 00 00 00 00 00 02 BB 01
				29 00 00 00 00 00 02 BC 1C
				29 00 00 00 00 00 02 BD 01
				29 00 00 00 00 00 02 BE 23
				29 00 00 00 00 00 02 BF 01
				29 00 00 00 00 00 02 C0 2B
				29 00 00 00 00 00 02 C1 01
				29 00 00 00 00 00 02 C2 47
				29 00 00 00 00 00 02 C3 01
				29 00 00 00 00 00 02 C4 62
				29 00 00 00 00 00 02 C5 01
				29 00 00 00 00 00 02 C6 8F
				29 00 00 00 00 00 02 C7 01
				29 00 00 00 00 00 02 C8 B5
				29 00 00 00 00 00 02 C9 01
				29 00 00 00 00 00 02 CA F7
				29 00 00 00 00 00 02 CB 02
				29 00 00 00 00 00 02 CC 30
				29 00 00 00 00 00 02 CD 02
				29 00 00 00 00 00 02 CE 32
				29 00 00 00 00 00 02 CF 02
				29 00 00 00 00 00 02 D0 69
				29 00 00 00 00 00 02 D1 02
				29 00 00 00 00 00 02 D2 A9
				29 00 00 00 00 00 02 D3 02
				29 00 00 00 00 00 02 D4 D3
				29 00 00 00 00 00 02 D5 03
				29 00 00 00 00 00 02 D6 0D
				29 00 00 00 00 00 02 D7 03
				29 00 00 00 00 00 02 D8 37
				29 00 00 00 00 00 02 D9 03
				29 00 00 00 00 00 02 DA 56
				29 00 00 00 00 00 02 DB 03
				29 00 00 00 00 00 02 DC 63
				29 00 00 00 00 00 02 DD 03
				29 00 00 00 00 00 02 DE 70
				29 00 00 00 00 00 02 DF 03
				29 00 00 00 00 00 02 E0 84
				29 00 00 00 00 00 02 E1 03
				29 00 00 00 00 00 02 E2 96
				29 00 00 00 00 00 02 E3 03
				29 00 00 00 00 00 02 E4 A7
				29 00 00 00 00 00 02 E5 03
				29 00 00 00 00 00 02 E6 BF
				29 00 00 00 00 00 02 E7 03
				29 00 00 00 00 00 02 E8 C9
				29 00 00 00 00 00 02 E9 03
				29 01 00 00 00 00 02 EA CF];
		qcom,mdss-dsi-panel-nature-command = [29 00 00 00 00 00 02 FF 00
				29 01 00 00 00 00 02 11 00];
		qcom,mdss-dsi-panel-ce-std-command = [29 00 00 00 00 00 02 FF 00
				29 01 00 00 00 00 02 55 00];
		qcom,mdss-dsi-panel-ce-bright-command = [29 00 00 00 00 00 02 FF 00
				29 01 00 00 00 00 02 55 80];
		qcom,mdss-dsi-panel-ce-vivid-command = [29 00 00 00 00 00 02 FF 00
				29 01 00 00 00 00 02 55 B0];
		qcom,mdss-dsi-panel-gamma-command-state = "dsi_hs_mode";
		qcom,mdss-dsi-panel-ce-command-state = "dsi_hs_mode";
		qcom,mdss-dsi-lp11-init;
		qcom,mdss-dsi-init-delay-us = <50000>;
		qcom,mdss-pan-physical-width-dimension = <62>;
		qcom,mdss-pan-physical-height-dimension = <110>;

	};
};
