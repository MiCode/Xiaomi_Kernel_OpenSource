/* Copyright (c) 2015, The Linux Foundation. All rights reserved.
 * Copyright (C) 2018 XiaoMi, Inc.
 *
 * This program is free software; you can redistribute it and/or modify
 * it under the terms of the GNU General Public License version 2 and
 * only version 2 as published by the Free Software Foundation.
 *
 * This program is distributed in the hope that it will be useful,
 * but WITHOUT ANY WARRANTY; without even the implied warranty of
 * MERCHANTABILITY or FITNESS FOR A PARTICULAR PURPOSE.  See the
 * GNU General Public License for more details.
 */
&mdss_mdp {
	dsi_gx_rm67198_amoled_1080_video: qcom,mdss_dsi_gx_rm67198_amoled_1080p_video {
		qcom,mdss-dsi-panel-name = "guoxian rm67198 amoled 1080p cmd mode dsi panel";
		qcom,mdss-dsi-panel-type = "dsi_cmd_mode";
		qcom,mdss-dsi-panel-framerate = <60>;
		qcom,mdss-dsi-virtual-channel-id = <0>;
		qcom,mdss-dsi-stream = <0>;
		qcom,mdss-dsi-panel-width = <1080>;
		qcom,mdss-dsi-panel-height = <1920>;
		qcom,mdss-dsi-h-front-porch = <26>;
		qcom,mdss-dsi-h-back-porch = <36>;
		qcom,mdss-dsi-h-pulse-width = <2>;
		qcom,mdss-dsi-h-sync-skew = <0>;
		qcom,mdss-dsi-v-back-porch = <4>;
		qcom,mdss-dsi-v-front-porch = <8>;
		qcom,mdss-dsi-v-pulse-width = <4>;
		qcom,mdss-dsi-h-left-border = <0>;
		qcom,mdss-dsi-h-right-border = <0>;
		qcom,mdss-dsi-v-top-border = <0>;
		qcom,mdss-dsi-v-bottom-border = <0>;
		qcom,mdss-dsi-bpp = <24>;
		qcom,mdss-pan-physical-width-dimension = <68>;
		qcom,mdss-pan-physical-height-dimension = <121>;
		qcom,mdss-dsi-underflow-color = <0xff>;
		qcom,mdss-dsi-border-color = <0>;
		qcom,mdss-dsi-reset-sequence = <1 10>, <0 20>, <1 10>;
		qcom,mdss-dsi-on-command = [
				15 01 00 00 00 00 02 40 02
				15 01 00 00 00 00 02 4B 4C
				15 01 00 00 00 00 02 49 01
				15 01 00 00 00 00 02 FE 40
				15 01 00 00 00 00 02 C7 85
				15 01 00 00 00 00 02 C8 32
				15 01 00 00 00 00 02 C9 18
				15 01 00 00 00 00 02 CA 09
				15 01 00 00 00 00 02 CB 22
				15 01 00 00 00 00 02 CC 44
				15 01 00 00 00 00 02 CD 11
				15 01 00 00 00 00 02 05 0F
				15 01 00 00 00 00 02 06 09
				15 01 00 00 00 00 02 08 0F
				15 01 00 00 00 00 02 09 09
				15 01 00 00 00 00 02 0A E6
				15 01 00 00 00 00 02 0B 88
				15 01 00 00 00 00 02 20 93
				15 01 00 00 00 00 02 21 93
				15 01 00 00 00 00 02 24 02
				15 01 00 00 00 00 02 26 02
				15 01 00 00 00 00 02 28 05
				15 01 00 00 00 00 02 2A 05
				15 01 00 00 00 00 02 2D 23
				15 01 00 00 00 00 02 2F 23
				15 01 00 00 00 00 02 30 23
				15 01 00 00 00 00 02 31 23
				15 01 00 00 00 00 02 37 80
				15 01 00 00 00 00 02 38 50
				15 01 00 00 00 00 02 39 00
				15 01 00 00 00 00 02 46 1D
				15 01 00 00 00 00 02 6F 00
				15 01 00 00 00 00 02 74 2F
				15 01 00 00 00 00 02 75 19
				15 01 00 00 00 00 02 AD 00
				15 01 00 00 00 00 02 FE 60
				15 01 00 00 00 00 02 00 C4
				15 01 00 00 00 00 02 01 00
				15 01 00 00 00 00 02 02 02
				15 01 00 00 00 00 02 03 00
				15 01 00 00 00 00 02 04 00
				15 01 00 00 00 00 02 05 07
				15 01 00 00 00 00 02 06 00
				15 01 00 00 00 00 02 07 83
				15 01 00 00 00 00 02 09 C4
				15 01 00 00 00 00 02 0A 00
				15 01 00 00 00 00 02 0B 02
				15 01 00 00 00 00 02 0C 00
				15 01 00 00 00 00 02 0D 00
				15 01 00 00 00 00 02 0E 08
				15 01 00 00 00 00 02 0F 00
				15 01 00 00 00 00 02 10 83
				15 01 00 00 00 00 02 12 CC
				15 01 00 00 00 00 02 13 0F
				15 01 00 00 00 00 02 14 FF
				15 01 00 00 00 00 02 15 01
				15 01 00 00 00 00 02 16 00
				15 01 00 00 00 00 02 17 02
				15 01 00 00 00 00 02 18 00
				15 01 00 00 00 00 02 19 C0
				15 01 00 00 00 00 02 1B C4
				15 01 00 00 00 00 02 1C 00
				15 01 00 00 00 00 02 1D 02
				15 01 00 00 00 00 02 1E 00
				15 01 00 00 00 00 02 1F 00
				15 01 00 00 00 00 02 20 07
				15 01 00 00 00 00 02 21 00
				15 01 00 00 00 00 02 22 83
				15 01 00 00 00 00 02 24 C4
				15 01 00 00 00 00 02 25 00
				15 01 00 00 00 00 02 26 02
				15 01 00 00 00 00 02 27 00
				15 01 00 00 00 00 02 28 00
				15 01 00 00 00 00 02 29 08
				15 01 00 00 00 00 02 2A 00
				15 01 00 00 00 00 02 2B 83
				15 01 00 00 00 00 02 2F C4
				15 01 00 00 00 00 02 30 00
				15 01 00 00 00 00 02 31 02
				15 01 00 00 00 00 02 32 00
				15 01 00 00 00 00 02 33 00
				15 01 00 00 00 00 02 34 07
				15 01 00 00 00 00 02 35 00
				15 01 00 00 00 00 02 36 83
				15 01 00 00 00 00 02 38 C4
				15 01 00 00 00 00 02 39 00
				15 01 00 00 00 00 02 3A 02
				15 01 00 00 00 00 02 3B 00
				15 01 00 00 00 00 02 3D 00
				15 01 00 00 00 00 02 3F 08
				15 01 00 00 00 00 02 40 00
				15 01 00 00 00 00 02 41 83
				15 01 00 00 00 00 02 4C C4
				15 01 00 00 00 00 02 4D 00
				15 01 00 00 00 00 02 4E 04
				15 01 00 00 00 00 02 4F 01
				15 01 00 00 00 00 02 50 00
				15 01 00 00 00 00 02 51 08
				15 01 00 00 00 00 02 52 00
				15 01 00 00 00 00 02 53 64
				15 01 00 00 00 00 02 55 C4
				15 01 00 00 00 00 02 56 00
				15 01 00 00 00 00 02 58 04
				15 01 00 00 00 00 02 59 01
				15 01 00 00 00 00 02 5A 00
				15 01 00 00 00 00 02 5B 06
				15 01 00 00 00 00 02 5C 00
				15 01 00 00 00 00 02 5D 64
				15 01 00 00 00 00 02 5F CA
				15 01 00 00 00 00 02 60 00
				15 01 00 00 00 00 02 61 07
				15 01 00 00 00 00 02 62 05
				15 01 00 00 00 00 02 63 00
				15 01 00 00 00 00 02 64 04
				15 01 00 00 00 00 02 65 00
				15 01 00 00 00 00 02 66 BB
				15 01 00 00 00 00 02 67 80
				15 01 00 00 00 00 02 9B 03
				15 01 00 00 00 00 02 A9 10
				15 01 00 00 00 00 02 AA 10
				15 01 00 00 00 00 02 AB 03
				15 01 00 00 00 00 02 AC 04
				15 01 00 00 00 00 02 AD 00
				15 01 00 00 00 00 02 AE 01
				15 01 00 00 00 00 02 AF 10
				15 01 00 00 00 00 02 B0 10
				15 01 00 00 00 00 02 B1 10
				15 01 00 00 00 00 02 B2 10
				15 01 00 00 00 00 02 B3 10
				15 01 00 00 00 00 02 B4 10
				15 01 00 00 00 00 02 B5 10
				15 01 00 00 00 00 02 B6 10
				15 01 00 00 00 00 02 B7 10
				15 01 00 00 00 00 02 B8 10
				15 01 00 00 00 00 02 B9 02
				15 01 00 00 00 00 02 BA 0A
				15 01 00 00 00 00 02 BB 08
				15 01 00 00 00 00 02 BC 09
				15 01 00 00 00 00 02 BD 06
				15 01 00 00 00 00 02 BE 05
				15 01 00 00 00 00 02 BF 10
				15 01 00 00 00 00 02 C0 10
				15 01 00 00 00 00 02 C4 80
				15 01 00 00 00 00 02 FE 70
				15 01 00 00 00 00 02 48 05
				15 01 00 00 00 00 02 52 00
				15 01 00 00 00 00 02 5A FF
				15 01 00 00 00 00 02 5C F6
				15 01 00 00 00 00 02 5D 07
				15 01 00 00 00 00 02 7D 35
				15 01 00 00 00 00 02 86 07
				15 01 00 00 00 00 02 A7 02
				15 01 00 00 00 00 02 A9 2C
				15 01 00 00 00 00 02 FE A0
				15 01 00 00 00 00 02 2B 18
				15 01 00 00 00 00 02 FE 90
				15 01 00 00 00 00 02 26 10
				15 01 00 00 00 00 02 28 20
				15 01 00 00 00 00 02 2A 40
				15 01 00 00 00 00 02 2D 60
				15 01 00 00 00 00 02 30 70
				15 01 00 00 00 00 02 32 80
				15 01 00 00 00 00 02 34 90
				15 01 00 00 00 00 02 36 98
				15 01 00 00 00 00 02 38 A0
				15 01 00 00 00 00 02 3A C0
				15 01 00 00 00 00 02 3D E0
				15 01 00 00 00 00 02 40 F0
				15 01 00 00 00 00 02 42 00
				15 01 00 00 00 00 02 43 01
				15 01 00 00 00 00 02 44 40
				15 01 00 00 00 00 02 45 01
				15 01 00 00 00 00 02 46 80
				15 01 00 00 00 00 02 47 01
				15 01 00 00 00 00 02 48 C0
				15 01 00 00 00 00 02 49 01
				15 01 00 00 00 00 02 4A 00
				15 01 00 00 00 00 02 4B 02
				15 01 00 00 00 00 02 4C 40
				15 01 00 00 00 00 02 4D 02
				15 01 00 00 00 00 02 4E 80
				15 01 00 00 00 00 02 4F 02
				15 01 00 00 00 00 02 50 00
				15 01 00 00 00 00 02 51 03
				15 01 00 00 00 00 02 52 80
				15 01 00 00 00 00 02 53 03
				15 01 00 00 00 00 02 54 00
				15 01 00 00 00 00 02 55 04
				15 01 00 00 00 00 02 56 8D
				15 01 00 00 00 00 02 58 04
				15 01 00 00 00 00 02 59 20
				15 01 00 00 00 00 02 5A 05
				15 01 00 00 00 00 02 5B BD
				15 01 00 00 00 00 02 5C 05
				15 01 00 00 00 00 02 5D 63
				15 01 00 00 00 00 02 5E 06
				15 01 00 00 00 00 02 5F 13
				15 01 00 00 00 00 02 60 07
				15 01 00 00 00 00 02 61 CD
				15 01 00 00 00 00 02 62 07
				15 01 00 00 00 00 02 63 91
				15 01 00 00 00 00 02 64 08
				15 01 00 00 00 00 02 65 60
				15 01 00 00 00 00 02 66 09
				15 01 00 00 00 00 02 67 38
				15 01 00 00 00 00 02 68 0A
				15 01 00 00 00 00 02 69 1A
				15 01 00 00 00 00 02 6A 0B
				15 01 00 00 00 00 02 6B 07
				15 01 00 00 00 00 02 6C 0C
				15 01 00 00 00 00 02 6D FE
				15 01 00 00 00 00 02 6E 0C
				15 01 00 00 00 00 02 6F 00
				15 01 00 00 00 00 02 70 0E
				15 01 00 00 00 00 02 71 0C
				15 01 00 00 00 00 02 72 0F
				15 01 00 00 00 00 02 73 96
				15 01 00 00 00 00 02 74 0F
				15 01 00 00 00 00 02 75 DC
				15 01 00 00 00 00 02 76 0F
				15 01 00 00 00 00 02 77 FF
				15 01 00 00 00 00 02 78 0F
				15 01 00 00 00 00 02 79 00
				15 01 00 00 00 00 02 7A 00
				15 01 00 00 00 00 02 7B 00
				15 01 00 00 00 00 02 7C 01
				15 01 00 00 00 00 02 7D 02
				15 01 00 00 00 00 02 7E 04
				15 01 00 00 00 00 02 7F 08
				15 01 00 00 00 00 02 80 10
				15 01 00 00 00 00 02 81 20
				15 01 00 00 00 00 02 82 30
				15 01 00 00 00 00 02 83 40
				15 01 00 00 00 00 02 84 50
				15 01 00 00 00 00 02 85 60
				15 01 00 00 00 00 02 86 70
				15 01 00 00 00 00 02 87 78
				15 01 00 00 00 00 02 88 88
				15 01 00 00 00 00 02 89 96
				15 01 00 00 00 00 02 8A A3
				15 01 00 00 00 00 02 8B AF
				15 01 00 00 00 00 02 8C BA
				15 01 00 00 00 00 02 8D C4
				15 01 00 00 00 00 02 8E CE
				15 01 00 00 00 00 02 8F D7
				15 01 00 00 00 00 02 90 E0
				15 01 00 00 00 00 02 91 E8
				15 01 00 00 00 00 02 92 F0
				15 01 00 00 00 00 02 93 F8
				15 01 00 00 00 00 02 94 FF
				15 01 00 00 00 00 02 99 20
				15 01 00 00 00 00 02 FE 00
				15 01 00 00 00 00 02 C2 09
				15 01 00 00 00 00 02 35 00
				15 01 00 00 00 00 02 53 28
				15 01 00 00 00 00 02 51 28
				15 01 00 00 78 00 02 11 00
				15 01 00 00 3a 00 02 29 00];
		qcom,mdss-dsi-off-command = [
			05 01 00 00 10 00 01 28
			05 01 00 00 40 00 01 10];
		qcom,mdss-dsi-on-command-state = "dsi_lp_mode";
		qcom,mdss-dsi-off-command-state = "dsi_hs_mode";
		qcom,mdss-dsi-h-sync-pulse = <0>;
		qcom,mdss-dsi-traffic-mode = "burst_mode";
		qcom,mdss-dsi-bllp-eof-power-mode;
		qcom,mdss-dsi-bllp-power-mode;
		qcom,mdss-dsi-lane-0-state;
		qcom,mdss-dsi-lane-1-state;
		qcom,mdss-dsi-lane-2-state;
		qcom,mdss-dsi-lane-3-state;
		qcom,mdss-dsi-panel-timings = [e7 36 24 00 66 6a 2a 3a 2d 03 04
			00];
		qcom,cont-splash-enabled;
		qcom,mdss-dsi-t-clk-post = <0x0d>;
		qcom,mdss-dsi-t-clk-pre = <0x2e>;
		qcom,mdss-dsi-dma-trigger = "trigger_sw";
		qcom,mdss-dsi-mdp-trigger = "none";
		qcom,mdss-dsi-bl-pmic-control-type = "bl_ctrl_dcs";
		qcom,mdss-dsi-te-pin-select = <1>;
		qcom,mdss-dsi-wr-mem-start = <0x2c>;
		qcom,mdss-dsi-wr-mem-continue = <0x3c>;
		qcom,mdss-dsi-bl-min-level = <2>;
		qcom,mdss-dsi-te-dcs-command = <1>;
		qcom,panel-supply-entries = <&dsi_panel_pwr_supply>;
		qcom,mdss-dsi-te-check-enable;
		qcom,mdss-dsi-te-using-te-pin;
		qcom,esd-check-enabled;
		qcom,mdss-dsi-panel-status-check-mode = "te_signal_check";
	};
};
