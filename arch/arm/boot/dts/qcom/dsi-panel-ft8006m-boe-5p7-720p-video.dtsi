/* Copyright (c) 2013, The Linux Foundation. All rights reserved.
 *
 * This program is free software; you can redistribute it and/or modify
 * it under the terms of the GNU General Public License version 2 and
 * only version 2 as published by the Free Software Foundation.
 *
 * This program is distributed in the hope that it will be useful,
 * but WITHOUT ANY WARRANTY; without even the implied warranty of
 * MERCHANTABILITY or FITNESS FOR A PARTICULAR PURPOSE.  See the
 * GNU General Public License for more details.
 */

/*---------------------------------------------------------------------------
 * This file is autogenerated file using gcdb parser. Please do not edit it.
 * Update input XML file to add a new entry or update variable in this file
 * VERSION = "1.0"
 *---------------------------------------------------------------------------*/
&mdss_mdp {
	dsi_ft8006m_boe_5p7_720p_video: qcom,mdss_dsi_ft8006m_boe_5p7_720p_video {
		qcom,mdss-dsi-panel-name = "ft8006m_boe_5p7_720p_video";
		qcom,mdss-dsi-panel-controller = <&mdss_dsi0>;
		qcom,mdss-dsi-panel-type = "dsi_video_mode";
		qcom,mdss-dsi-panel-destination = "display_1";
		qcom,mdss-dsi-panel-framerate = <60>;
		qcom,mdss-dsi-pan-fps-update = "dfps_immediate_porch_mode_vfp";
		qcom,min-refresh-rate = <48>;
		qcom,max-refresh-rate = <60>;
		qcom,mdss-dsi-virtual-channel-id = <0>;
		qcom,mdss-dsi-stream = <0>;
		qcom,mdss-dsi-panel-width = <720>;
		qcom,mdss-dsi-panel-height = <1440>;
		qcom,mdss-pan-physical-width-dimension = <65>;
		qcom,mdss-pan-physical-height-dimension = <129>;
		qcom,mdss-dsi-h-front-porch = <45>;
		qcom,mdss-dsi-h-back-porch = <25>;
		qcom,mdss-dsi-h-pulse-width = <14>;
		qcom,mdss-dsi-h-sync-skew = <0>;
		qcom,mdss-dsi-v-back-porch = <37>;
		qcom,mdss-dsi-v-front-porch = <65>;
		qcom,mdss-dsi-v-pulse-width = <8>;
		qcom,mdss-dsi-h-left-border = <0>;
		qcom,mdss-dsi-h-right-border = <0>;
		qcom,mdss-dsi-v-top-border = <0>;
		qcom,mdss-dsi-v-bottom-border = <0>;
		qcom,mdss-dsi-bpp = <24>;
		qcom,mdss-dsi-underflow-color = <0x00>;
		qcom,mdss-dsi-border-color = <0>;
		qcom,mdss-dsi-on-command = [39 01 00 00 78 00 02 11 00
				39 00 00 00 00 00 03 50 5A 0E
				39 00 00 00 00 00 04 83 AC B4 6D
				39 00 00 00 00 00 03 50 5A 19
				39 00 00 00 00 00 08 90 fc 6f f6 ef cf af 0f
				39 00 00 00 00 00 03 A1 00 44
				39 00 00 00 00 00 11 80 ea d3 c6 b8 af a6 9e 98 92 8e 8a 85 00 60 f6 cf
				39 00 00 00 00 00 03 50 5A 23
				39 00 00 00 00 00 07 90 ff 0f 00 00 2C 00
				39 01 00 00 00 00 02 50 00
				39 01 00 00 02 00 02 29 00
			];
		qcom,mdss-dsi-off-command = [
				05 01 00 00 14 00 02 28 00
				05 01 00 00 78 00 02 10 00
				39 01 00 00 00 00 02 04 5A
				39 01 00 00 00 00 02 05 5A];
		qcom,mdss-dsi-on-command-state = "dsi_lp_mode";
		qcom,mdss-dsi-off-command-state = "dsi_lp_mode";

		qcom,mdss-dsi-panel-cabc-off-command = [39 01 00 00 00 00 03 50 5A 23
				39 01 00 00 00 00 02 95 00
				39 01 00 00 00 00 02 50 00];
		qcom,mdss-dsi-panel-cabc-on-command = [39 01 00 00 00 00 03 50 5A 23
				39 01 00 00 00 00 02 95 01
				39 01 00 00 00 00 02 50 00];
		qcom,mdss-dsi-panel-cabc-command-state = "dsi_hs_mode";
		qcom,mdss-dsi-h-sync-pulse = <1>;
		qcom,mdss-dsi-traffic-mode = "burst_mode";
		qcom,mdss-dsi-bllp-eof-power-mode;
		qcom,mdss-dsi-bllp-power-mode;
		qcom,mdss-dsi-lane-0-state;
		qcom,mdss-dsi-lane-1-state;
		qcom,mdss-dsi-lane-2-state;
		qcom,mdss-dsi-lane-3-state;

		qcom,mdss-dsi-panel-timings = [8B 1E 14 00 44 48 18 30 19 03 04 00];
		qcom,mdss-dsi-panel-timings-phy-v2 = [1E 1B 04 06 02 03 04 A0
				1E 1B 04 06 02 03 04 A0
				1E 1B 04 06 02 03 04 A0
				1E 1B 04 06 02 03 04 A0
				1E 0E 04 05 02 03 04 A0];
		qcom,mdss-dsi-t-clk-post = <0x0A>;
		qcom,mdss-dsi-t-clk-pre = <0x1E>;
		qcom,mdss-dsi-bl-min-level = <7>;
		qcom,mdss-dsi-bl-max-level = <4095>;
		qcom,mdss-brightness-max-level = <4095>;
		qcom,mdss-dsi-dma-trigger = "trigger_sw";
		qcom,mdss-dsi-mdp-trigger = "none";
		qcom,mdss-dsi-bl-pmic-control-type = "bl_ctrl_wled";
		qcom,mdss-dsi-lp11-init;
		qcom,mdss-dsi-init-delay-us = <5000>;
		qcom,mdss-dsi-reset-sequence = <1 35>, <0 5>, <1 10>;
		qcom,mdss-dsi-pwr-off-rst-pull-high = <1>;

		qcom,mdss-dsi-panel-status-command = [06 01 00 01 05 00 02 0A 9c];
		qcom,mdss-dsi-panel-status-command-state = "dsi_hs_mode";
		qcom,mdss-dsi-panel-status-check-mode = "reg_read";
		qcom,mdss-dsi-panel-status-valid-params = <1>;
		qcom,mdss-dsi-panel-status-value = <0x9c>;
		qcom,mdss-dsi-panel-status-read-length = <1>;
	};
};
