qcom,a7_atl {
	qcom,max-voltage-uv = <4400000>;
	qcom,nom-batt-capacity-mah = <3200>;
	qcom,batt-id-kohm = <68>;
	qcom,battery-beta = <3435>;
	qcom,battery-type = "a7_atl";
	qcom,chg-rslow-comp-c1 = <3194303>;
	qcom,chg-rslow-comp-c2 = <4632960>;
	qcom,chg-rs-to-rslow = <1076226>;
	qcom,chg-rslow-comp-thr = <0xA8>;
	qcom,fg-cc-cv-threshold-mv = <4390>;
	qcom,checksum = <0xE033>;
	qcom,gui-version = "PMI8996GUI - 1.1.0.4";
	qcom,fg-profile-data = [
			03 88 03 7E
			E4 81 4C 7C
			3D 83 83 72
			78 7E AF 7B
			F4 81 7B 9B
			DF BE 4D D0
			81 11 04 88
			F8 7D 10 82
			AB 7C 31 83
			FA 79 15 8C
			7B 88 23 82
			9E 9B 2B C4
			51 D2 6B 0E
			4C 0C CD 5A
			14 70 8B FD
			F9 3D E1 3E
			2E 39 00 00
			1A 4D 78 38
			AA 42 00 00
			00 00 00 00
			00 00 00 00
			22 71 D1 6B
			59 86 3C 72
			1B 77 A5 70
			A0 56 9F 7A
			86 6F D1 63
			70 5C 99 9B
			32 54 61 5A
			5E A0 71 0C
			28 00 FF 36
			F0 11 30 03
			00 00 00 0C
	];
};
