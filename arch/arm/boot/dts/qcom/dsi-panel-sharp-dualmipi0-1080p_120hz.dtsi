/* Copyright (c) 2014-2015, The Linux Foundation. All rights reserved.
 *
 * This program is free software; you can redistribute it and/or modify
 * it under the terms of the GNU General Public License version 2 and
 * only version 2 as published by the Free Software Foundation.
 *
 * This program is distributed in the hope that it will be useful,
 * but WITHOUT ANY WARRANTY; without even the implied warranty of
 * MERCHANTABILITY or FITNESS FOR A PARTICULAR PURPOSE.  See the
 * GNU General Public License for more details.
 */

&mdss_mdp {
	dsi_dual_sharp_1080_cmd_0: qcom,mdss_dsi_sharp_1080p_cmd_0 {
		qcom,mdss-dsi-panel-name = "Dual 0 SHARP 1080p cmd mode dsi panel";
		qcom,mdss-dsi-panel-controller = <&mdss_dsi0>;
		qcom,mdss-dsi-panel-type = "dsi_cmd_mode";
		qcom,mdss-dsi-panel-destination = "display_1";
		qcom,mdss-dsi-panel-framerate = <120>;
		qcom,mdss-dsi-panel-clockrate = <975000000>;
		qcom,mdss-dsi-virtual-channel-id = <0>;
		qcom,mdss-dsi-stream = <0>;
		qcom,mdss-dsi-panel-width = <540>;
		qcom,mdss-dsi-panel-height = <1920>;
		qcom,mdss-dsi-h-front-porch = <28>;
		qcom,mdss-dsi-h-back-porch = <4>;
		qcom,mdss-dsi-h-pulse-width = <4>;
		qcom,mdss-dsi-h-sync-skew = <0>;
		qcom,mdss-dsi-v-back-porch = <12>;
		qcom,mdss-dsi-v-front-porch = <12>;
		qcom,mdss-dsi-v-pulse-width = <2>;
		qcom,mdss-dsi-h-left-border = <0>;
		qcom,mdss-dsi-h-right-border = <0>;
		qcom,mdss-dsi-v-top-border = <0>;
		qcom,mdss-dsi-v-bottom-border = <0>;
		qcom,mdss-dsi-bpp = <24>;
		qcom,mdss-dsi-underflow-color = <0xff>;
		qcom,mdss-dsi-border-color = <0>;
		qcom,mdss-dsi-reset-sequence = <1 20>, <0 1>, <1 10>;
		qcom,mdss-dsi-on-command = [15 01 00 00 00 00 02 FF 10
			15 01 00 00 00 00 02 FB 01
			15 01 00 00 00 00 02 BA 07
			15 01 00 00 00 00 02 C0 00
			15 01 00 00 00 00 02 BB 10
			15 01 00 00 00 00 02 D9 00
			15 01 00 00 00 00 02 EF 70
			15 01 00 00 00 00 02 F7 80
			39 01 00 00 00 00 06 3B 03 0E 0C 08 1C
			15 01 00 00 00 00 02 E9 0E
			15 01 00 00 00 00 02 EA 0C
			15 01 00 00 00 00 02 35 00
			15 01 00 00 00 00 02 C0 00
			15 01 00 00 00 00 02 FF 20
			15 01 00 00 00 00 02 FB 01
			15 01 00 00 00 00 02 59 6A
			15 01 00 00 00 00 02 0B 1B
			15 01 00 00 00 00 02 61 F7
			15 01 00 00 00 00 02 62 6C
			15 01 00 00 00 00 02 00 01
			15 01 00 00 00 00 02 01 55
			15 01 00 00 00 00 02 04 C8
			15 01 00 00 00 00 02 05 1A
			15 01 00 00 00 00 02 0D 93
			15 01 00 00 00 00 02 0E 93
			15 01 00 00 00 00 02 0F 7E
			15 01 00 00 00 00 02 06 69
			15 01 00 00 00 00 02 07 BC
			15 01 00 00 00 00 02 10 03
			15 01 00 00 00 00 02 11 64
			15 01 00 00 00 00 02 12 5A
			15 01 00 00 00 00 02 13 40
			15 01 00 00 00 00 02 14 40
			15 01 00 00 00 00 02 15 00
			15 01 00 00 00 00 02 33 13
			15 01 00 00 00 00 02 5A 40
			15 01 00 00 00 00 02 5B 40
			15 01 00 00 00 00 02 5E 80
			15 01 00 00 00 00 02 FF 24
			15 01 00 00 00 00 02 FB 01
			15 01 00 00 00 00 02 00 80
			15 01 00 00 00 00 02 14 80
			15 01 00 00 00 00 02 01 80
			15 01 00 00 00 00 02 15 80
			15 01 00 00 00 00 02 02 80
			15 01 00 00 00 00 02 16 80
			15 01 00 00 00 00 02 03 0A
			15 01 00 00 00 00 02 17 0C
			15 01 00 00 00 00 02 04 06
			15 01 00 00 00 00 02 18 08
			15 01 00 00 00 00 02 05 80
			15 01 00 00 00 00 02 19 80
			15 01 00 00 00 00 02 06 80
			15 01 00 00 00 00 02 1A 80
			15 01 00 00 00 00 02 07 80
			15 01 00 00 00 00 02 1B 80
			15 01 00 00 00 00 02 08 80
			15 01 00 00 00 00 02 1C 80
			15 01 00 00 00 00 02 09 80
			15 01 00 00 00 00 02 1D 80
			15 01 00 00 00 00 02 0A 80
			15 01 00 00 00 00 02 1E 80
			15 01 00 00 00 00 02 0B 1A
			15 01 00 00 00 00 02 1F 1B
			15 01 00 00 00 00 02 0C 16
			15 01 00 00 00 00 02 20 17
			15 01 00 00 00 00 02 0D 1C
			15 01 00 00 00 00 02 21 1D
			15 01 00 00 00 00 02 0E 18
			15 01 00 00 00 00 02 22 19
			15 01 00 00 00 00 02 0F 0E
			15 01 00 00 00 00 02 23 10
			15 01 00 00 00 00 02 10 80
			15 01 00 00 00 00 02 24 80
			15 01 00 00 00 00 02 11 80
			15 01 00 00 00 00 02 25 80
			15 01 00 00 00 00 02 12 80
			15 01 00 00 00 00 02 26 80
			15 01 00 00 00 00 02 13 80
			15 01 00 00 00 00 02 27 80
			15 01 00 00 00 00 02 74 FF
			15 01 00 00 00 00 02 75 FF
			15 01 00 00 00 00 02 8D 00
			15 01 00 00 00 00 02 8E 00
			15 01 00 00 00 00 02 8F 9C
			15 01 00 00 00 00 02 90 0C
			15 01 00 00 00 00 02 91 0E
			15 01 00 00 00 00 02 D6 00
			15 01 00 00 00 00 02 D7 20
			15 01 00 00 00 00 02 D8 00
			15 01 00 00 00 00 02 D9 88
			15 01 00 00 00 00 02 E5 05
			15 01 00 00 00 00 02 E6 10
			15 01 00 00 00 00 02 54 06
			15 01 00 00 00 00 02 55 05
			15 01 00 00 00 00 02 56 04
			15 01 00 00 00 00 02 58 03
			15 01 00 00 00 00 02 59 33
			15 01 00 00 00 00 02 5A 33
			15 01 00 00 00 00 02 5B 01
			15 01 00 00 00 00 02 5C 00
			15 01 00 00 00 00 02 5D 01
			15 01 00 00 00 00 02 5E 0A
			15 01 00 00 00 00 02 5F 0A
			15 01 00 00 00 00 02 60 0A
			15 01 00 00 00 00 02 61 0A
			15 01 00 00 00 00 02 62 10
			15 01 00 00 00 00 02 63 01
			15 01 00 00 00 00 02 64 00
			15 01 00 00 00 00 02 65 00
			15 01 00 00 00 00 02 EF 00
			15 01 00 00 00 00 02 F0 00
			15 01 00 00 00 00 02 6D 20
			15 01 00 00 00 00 02 66 44
			15 01 00 00 00 00 02 68 01
			15 01 00 00 00 00 02 69 00
			15 01 00 00 00 00 02 67 11
			15 01 00 00 00 00 02 6A 06
			15 01 00 00 00 00 02 6B 31
			15 01 00 00 00 00 02 6C 90
			15 01 00 00 00 00 02 AB C3
			15 01 00 00 00 00 02 B1 49
			15 01 00 00 00 00 02 AA 80
			15 01 00 00 00 00 02 B0 90
			15 01 00 00 00 00 02 B2 A4
			15 01 00 00 00 00 02 B3 00
			15 01 00 00 00 00 02 B4 23
			15 01 00 00 00 00 02 B5 00
			15 01 00 00 00 00 02 B6 00
			15 01 00 00 00 00 02 B7 00
			15 01 00 00 00 00 02 B8 00
			15 01 00 00 00 00 02 B9 00
			15 01 00 00 00 00 02 BA 00
			15 01 00 00 00 00 02 BB 00
			15 01 00 00 00 00 02 BC 00
			15 01 00 00 00 00 02 BD 00
			15 01 00 00 00 00 02 BE 00
			15 01 00 00 00 00 02 BF 00
			15 01 00 00 00 00 02 C0 00
			15 01 00 00 00 00 02 C7 40
			15 01 00 00 00 00 02 C9 00
			15 01 00 00 00 00 02 C1 2A
			15 01 00 00 00 00 02 C2 2A
			15 01 00 00 00 00 02 C3 00
			15 01 00 00 00 00 02 C4 00
			15 01 00 00 00 00 02 C5 00
			15 01 00 00 00 00 02 C6 00
			15 01 00 00 00 00 02 C8 AB
			15 01 00 00 00 00 02 CA 00
			15 01 00 00 00 00 02 CB 00
			15 01 00 00 00 00 02 CC 20
			15 01 00 00 00 00 02 CD 40
			15 01 00 00 00 00 02 CE A8
			15 01 00 00 00 00 02 CF A8
			15 01 00 00 00 00 02 D0 00
			15 01 00 00 00 00 02 D1 00
			15 01 00 00 00 00 02 D2 00
			15 01 00 00 00 00 02 D3 00
			15 01 00 00 00 00 02 AF 01
			15 01 00 00 00 00 02 A4 1E
			15 01 00 00 00 00 02 95 41
			15 01 00 00 00 00 02 96 03
			15 01 00 00 00 00 02 98 00
			15 01 00 00 00 00 02 9A 9A
			15 01 00 00 00 00 02 9B 03
			15 01 00 00 00 00 02 9D 80
			15 01 00 00 00 00 02 FF 26
			15 01 00 00 00 00 02 FB 01
			15 01 00 00 00 00 02 FA D0
			15 01 00 00 00 00 02 6B 80
			15 01 00 00 00 00 02 6C 5C
			15 01 00 00 00 00 02 6D 0C
			15 01 00 00 00 00 02 6E 0E
			15 01 00 00 00 00 02 58 01
			15 01 00 00 00 00 02 59 15
			15 01 00 00 00 00 02 5A 01
			15 01 00 00 00 00 02 5B 00
			15 01 00 00 00 00 02 5C 01
			15 01 00 00 00 00 02 5D 2B
			15 01 00 00 00 00 02 74 00
			15 01 00 00 00 00 02 75 BA
			15 01 00 00 00 00 02 81 0A
			15 01 00 00 00 00 02 4E 81
			15 01 00 00 00 00 02 4F 83
			15 01 00 00 00 00 02 51 00
			15 01 00 00 00 00 02 53 4D
			15 01 00 00 00 00 02 54 03
			15 01 00 00 00 00 02 FF E0
			15 01 00 00 00 00 02 FB 01
			15 01 00 00 00 00 02 B2 81
			15 01 00 00 00 00 02 62 28
			15 01 00 00 00 00 02 A2 09
			15 01 00 00 00 00 02 B3 01
			15 01 00 00 00 00 02 ED 00
			15 01 00 00 00 00 02 FF 10
			05 01 00 00 78 00 01 11
			15 01 00 00 00 00 02 FF 20
			15 01 00 00 00 00 02 75 00
			15 01 00 00 00 00 02 76 71
			15 01 00 00 00 00 02 77 00
			15 01 00 00 00 00 02 78 84
			15 01 00 00 00 00 02 79 00
			15 01 00 00 00 00 02 7A A5
			15 01 00 00 00 00 02 7B 00
			15 01 00 00 00 00 02 7C BB
			15 01 00 00 00 00 02 7D 00
			15 01 00 00 00 00 02 7E CE
			15 01 00 00 00 00 02 7F 00
			15 01 00 00 00 00 02 80 E0
			15 01 00 00 00 00 02 81 00
			15 01 00 00 00 00 02 82 EF
			15 01 00 00 00 00 02 83 00
			15 01 00 00 00 00 02 84 FF
			15 01 00 00 00 00 02 85 01
			15 01 00 00 00 00 02 86 0B
			15 01 00 00 00 00 02 87 01
			15 01 00 00 00 00 02 88 38
			15 01 00 00 00 00 02 89 01
			15 01 00 00 00 00 02 8A 5B
			15 01 00 00 00 00 02 8B 01
			15 01 00 00 00 00 02 8C 95
			15 01 00 00 00 00 02 8D 01
			15 01 00 00 00 00 02 8E C4
			15 01 00 00 00 00 02 8F 02
			15 01 00 00 00 00 02 90 0D
			15 01 00 00 00 00 02 91 02
			15 01 00 00 00 00 02 92 4A
			15 01 00 00 00 00 02 93 02
			15 01 00 00 00 00 02 94 4C
			15 01 00 00 00 00 02 95 02
			15 01 00 00 00 00 02 96 85
			15 01 00 00 00 00 02 97 02
			15 01 00 00 00 00 02 98 C3
			15 01 00 00 00 00 02 99 02
			15 01 00 00 00 00 02 9A E9
			15 01 00 00 00 00 02 9B 03
			15 01 00 00 00 00 02 9C 16
			15 01 00 00 00 00 02 9D 03
			15 01 00 00 00 00 02 9E 34
			15 01 00 00 00 00 02 9F 03
			15 01 00 00 00 00 02 A0 56
			15 01 00 00 00 00 02 A2 03
			15 01 00 00 00 00 02 A3 62
			15 01 00 00 00 00 02 A4 03
			15 01 00 00 00 00 02 A5 6C
			15 01 00 00 00 00 02 A6 03
			15 01 00 00 00 00 02 A7 74
			15 01 00 00 00 00 02 A9 03
			15 01 00 00 00 00 02 AA 80
			15 01 00 00 00 00 02 AB 03
			15 01 00 00 00 00 02 AC 89
			15 01 00 00 00 00 02 AD 03
			15 01 00 00 00 00 02 AE 8B
			15 01 00 00 00 00 02 AF 03
			15 01 00 00 00 00 02 B0 8D
			15 01 00 00 00 00 02 B1 03
			15 01 00 00 00 00 02 B2 8E
			15 01 00 00 00 00 02 B3 00
			15 01 00 00 00 00 02 B4 71
			15 01 00 00 00 00 02 B5 00
			15 01 00 00 00 00 02 B6 84
			15 01 00 00 00 00 02 B7 00
			15 01 00 00 00 00 02 B8 A5
			15 01 00 00 00 00 02 B9 00
			15 01 00 00 00 00 02 BA BB
			15 01 00 00 00 00 02 BB 00
			15 01 00 00 00 00 02 BC CE
			15 01 00 00 00 00 02 BD 00
			15 01 00 00 00 00 02 BE E0
			15 01 00 00 00 00 02 BF 00
			15 01 00 00 00 00 02 C0 EF
			15 01 00 00 00 00 02 C1 00
			15 01 00 00 00 00 02 C2 FF
			15 01 00 00 00 00 02 C3 01
			15 01 00 00 00 00 02 C4 0B
			15 01 00 00 00 00 02 C5 01
			15 01 00 00 00 00 02 C6 38
			15 01 00 00 00 00 02 C7 01
			15 01 00 00 00 00 02 C8 5B
			15 01 00 00 00 00 02 C9 01
			15 01 00 00 00 00 02 CA 95
			15 01 00 00 00 00 02 CB 01
			15 01 00 00 00 00 02 CC C4
			15 01 00 00 00 00 02 CD 02
			15 01 00 00 00 00 02 CE 0D
			15 01 00 00 00 00 02 CF 02
			15 01 00 00 00 00 02 D0 4A
			15 01 00 00 00 00 02 D1 02
			15 01 00 00 00 00 02 D2 4C
			15 01 00 00 00 00 02 D3 02
			15 01 00 00 00 00 02 D4 85
			15 01 00 00 00 00 02 D5 02
			15 01 00 00 00 00 02 D6 C3
			15 01 00 00 00 00 02 D7 02
			15 01 00 00 00 00 02 D8 E9
			15 01 00 00 00 00 02 D9 03
			15 01 00 00 00 00 02 DA 16
			15 01 00 00 00 00 02 DB 03
			15 01 00 00 00 00 02 DC 34
			15 01 00 00 00 00 02 DD 03
			15 01 00 00 00 00 02 DE 56
			15 01 00 00 00 00 02 DF 03
			15 01 00 00 00 00 02 E0 62
			15 01 00 00 00 00 02 E1 03
			15 01 00 00 00 00 02 E2 6C
			15 01 00 00 00 00 02 E3 03
			15 01 00 00 00 00 02 E4 74
			15 01 00 00 00 00 02 E5 03
			15 01 00 00 00 00 02 E6 80
			15 01 00 00 00 00 02 E7 03
			15 01 00 00 00 00 02 E8 89
			15 01 00 00 00 00 02 E9 03
			15 01 00 00 00 00 02 EA 8B
			15 01 00 00 00 00 02 EB 03
			15 01 00 00 00 00 02 EC 8D
			15 01 00 00 00 00 02 ED 03
			15 01 00 00 00 00 02 EE 8E
			15 01 00 00 00 00 02 EF 00
			15 01 00 00 00 00 02 F0 71
			15 01 00 00 00 00 02 F1 00
			15 01 00 00 00 00 02 F2 84
			15 01 00 00 00 00 02 F3 00
			15 01 00 00 00 00 02 F4 A5
			15 01 00 00 00 00 02 F5 00
			15 01 00 00 00 00 02 F6 BB
			15 01 00 00 00 00 02 F7 00
			15 01 00 00 00 00 02 F8 CE
			15 01 00 00 00 00 02 F9 00
			15 01 00 00 00 00 02 FA E0
			15 01 00 00 00 00 02 FF 21
			15 01 00 00 00 00 02 FB 01
			15 01 00 00 00 00 02 00 00
			15 01 00 00 00 00 02 01 EF
			15 01 00 00 00 00 02 02 00
			15 01 00 00 00 00 02 03 FF
			15 01 00 00 00 00 02 04 01
			15 01 00 00 00 00 02 05 0B
			15 01 00 00 00 00 02 06 01
			15 01 00 00 00 00 02 07 38
			15 01 00 00 00 00 02 08 01
			15 01 00 00 00 00 02 09 5B
			15 01 00 00 00 00 02 0A 01
			15 01 00 00 00 00 02 0B 95
			15 01 00 00 00 00 02 0C 01
			15 01 00 00 00 00 02 0D C4
			15 01 00 00 00 00 02 0E 02
			15 01 00 00 00 00 02 0F 0D
			15 01 00 00 00 00 02 10 02
			15 01 00 00 00 00 02 11 4A
			15 01 00 00 00 00 02 12 02
			15 01 00 00 00 00 02 13 4C
			15 01 00 00 00 00 02 14 02
			15 01 00 00 00 00 02 15 85
			15 01 00 00 00 00 02 16 02
			15 01 00 00 00 00 02 17 C3
			15 01 00 00 00 00 02 18 02
			15 01 00 00 00 00 02 19 E9
			15 01 00 00 00 00 02 1A 03
			15 01 00 00 00 00 02 1B 16
			15 01 00 00 00 00 02 1C 03
			15 01 00 00 00 00 02 1D 34
			15 01 00 00 00 00 02 1E 03
			15 01 00 00 00 00 02 1F 56
			15 01 00 00 00 00 02 20 03
			15 01 00 00 00 00 02 21 62
			15 01 00 00 00 00 02 22 03
			15 01 00 00 00 00 02 23 6C
			15 01 00 00 00 00 02 24 03
			15 01 00 00 00 00 02 25 74
			15 01 00 00 00 00 02 26 03
			15 01 00 00 00 00 02 27 80
			15 01 00 00 00 00 02 28 03
			15 01 00 00 00 00 02 29 89
			15 01 00 00 00 00 02 2A 03
			15 01 00 00 00 00 02 2B 8B
			15 01 00 00 00 00 02 2D 03
			15 01 00 00 00 00 02 2F 8D
			15 01 00 00 00 00 02 30 03
			15 01 00 00 00 00 02 31 8E
			15 01 00 00 00 00 02 32 00
			15 01 00 00 00 00 02 33 71
			15 01 00 00 00 00 02 34 00
			15 01 00 00 00 00 02 35 84
			15 01 00 00 00 00 02 36 00
			15 01 00 00 00 00 02 37 A5
			15 01 00 00 00 00 02 38 00
			15 01 00 00 00 00 02 39 BB
			15 01 00 00 00 00 02 3A 00
			15 01 00 00 00 00 02 3B CE
			15 01 00 00 00 00 02 3D 00
			15 01 00 00 00 00 02 3F E0
			15 01 00 00 00 00 02 40 00
			15 01 00 00 00 00 02 41 EF
			15 01 00 00 00 00 02 42 00
			15 01 00 00 00 00 02 43 FF
			15 01 00 00 00 00 02 44 01
			15 01 00 00 00 00 02 45 0B
			15 01 00 00 00 00 02 46 01
			15 01 00 00 00 00 02 47 38
			15 01 00 00 00 00 02 48 01
			15 01 00 00 00 00 02 49 5B
			15 01 00 00 00 00 02 4A 01
			15 01 00 00 00 00 02 4B 95
			15 01 00 00 00 00 02 4C 01
			15 01 00 00 00 00 02 4D C4
			15 01 00 00 00 00 02 4E 02
			15 01 00 00 00 00 02 4F 0D
			15 01 00 00 00 00 02 50 02
			15 01 00 00 00 00 02 51 4A
			15 01 00 00 00 00 02 52 02
			15 01 00 00 00 00 02 53 4C
			15 01 00 00 00 00 02 54 02
			15 01 00 00 00 00 02 55 85
			15 01 00 00 00 00 02 56 02
			15 01 00 00 00 00 02 58 C3
			15 01 00 00 00 00 02 59 02
			15 01 00 00 00 00 02 5A E9
			15 01 00 00 00 00 02 5B 03
			15 01 00 00 00 00 02 5C 16
			15 01 00 00 00 00 02 5D 03
			15 01 00 00 00 00 02 5E 34
			15 01 00 00 00 00 02 5F 03
			15 01 00 00 00 00 02 60 56
			15 01 00 00 00 00 02 61 03
			15 01 00 00 00 00 02 62 62
			15 01 00 00 00 00 02 63 03
			15 01 00 00 00 00 02 64 6C
			15 01 00 00 00 00 02 65 03
			15 01 00 00 00 00 02 66 74
			15 01 00 00 00 00 02 67 03
			15 01 00 00 00 00 02 68 80
			15 01 00 00 00 00 02 69 03
			15 01 00 00 00 00 02 6A 89
			15 01 00 00 00 00 02 6B 03
			15 01 00 00 00 00 02 6C 8B
			15 01 00 00 00 00 02 6D 03
			15 01 00 00 00 00 02 6E 8D
			15 01 00 00 00 00 02 6F 03
			15 01 00 00 00 00 02 70 8E
			15 01 00 00 00 00 02 71 00
			15 01 00 00 00 00 02 72 71
			15 01 00 00 00 00 02 73 00
			15 01 00 00 00 00 02 74 84
			15 01 00 00 00 00 02 75 00
			15 01 00 00 00 00 02 76 A5
			15 01 00 00 00 00 02 77 00
			15 01 00 00 00 00 02 78 BB
			15 01 00 00 00 00 02 79 00
			15 01 00 00 00 00 02 7A CE
			15 01 00 00 00 00 02 7B 00
			15 01 00 00 00 00 02 7C E0
			15 01 00 00 00 00 02 7D 00
			15 01 00 00 00 00 02 7E EF
			15 01 00 00 00 00 02 7F 00
			15 01 00 00 00 00 02 80 FF
			15 01 00 00 00 00 02 81 01
			15 01 00 00 00 00 02 82 0B
			15 01 00 00 00 00 02 83 01
			15 01 00 00 00 00 02 84 38
			15 01 00 00 00 00 02 85 01
			15 01 00 00 00 00 02 86 5B
			15 01 00 00 00 00 02 87 01
			15 01 00 00 00 00 02 88 95
			15 01 00 00 00 00 02 89 01
			15 01 00 00 00 00 02 8A C4
			15 01 00 00 00 00 02 8B 02
			15 01 00 00 00 00 02 8C 0D
			15 01 00 00 00 00 02 8D 02
			15 01 00 00 00 00 02 8E 4A
			15 01 00 00 00 00 02 8F 02
			15 01 00 00 00 00 02 90 4C
			15 01 00 00 00 00 02 91 02
			15 01 00 00 00 00 02 92 85
			15 01 00 00 00 00 02 93 02
			15 01 00 00 00 00 02 94 C3
			15 01 00 00 00 00 02 95 02
			15 01 00 00 00 00 02 96 E9
			15 01 00 00 00 00 02 97 03
			15 01 00 00 00 00 02 98 16
			15 01 00 00 00 00 02 99 03
			15 01 00 00 00 00 02 9A 34
			15 01 00 00 00 00 02 9B 03
			15 01 00 00 00 00 02 9C 56
			15 01 00 00 00 00 02 9D 03
			15 01 00 00 00 00 02 9E 62
			15 01 00 00 00 00 02 9F 03
			15 01 00 00 00 00 02 A0 6C
			15 01 00 00 00 00 02 A2 03
			15 01 00 00 00 00 02 A3 74
			15 01 00 00 00 00 02 A4 03
			15 01 00 00 00 00 02 A5 80
			15 01 00 00 00 00 02 A6 03
			15 01 00 00 00 00 02 A7 89
			15 01 00 00 00 00 02 A9 03
			15 01 00 00 00 00 02 AA 8B
			15 01 00 00 00 00 02 AB 03
			15 01 00 00 00 00 02 AC 8D
			15 01 00 00 00 00 02 AD 03
			15 01 00 00 00 00 02 AE 8E
			15 01 00 00 00 00 02 AF 00
			15 01 00 00 00 00 02 B0 71
			15 01 00 00 00 00 02 B1 00
			15 01 00 00 00 00 02 B2 84
			15 01 00 00 00 00 02 B3 00
			15 01 00 00 00 00 02 B4 A5
			15 01 00 00 00 00 02 B5 00
			15 01 00 00 00 00 02 B6 BB
			15 01 00 00 00 00 02 B7 00
			15 01 00 00 00 00 02 B8 CE
			15 01 00 00 00 00 02 B9 00
			15 01 00 00 00 00 02 BA E0
			15 01 00 00 00 00 02 BB 00
			15 01 00 00 00 00 02 BC EF
			15 01 00 00 00 00 02 BD 00
			15 01 00 00 00 00 02 BE FF
			15 01 00 00 00 00 02 BF 01
			15 01 00 00 00 00 02 C0 0B
			15 01 00 00 00 00 02 C1 01
			15 01 00 00 00 00 02 C2 38
			15 01 00 00 00 00 02 C3 01
			15 01 00 00 00 00 02 C4 5B
			15 01 00 00 00 00 02 C5 01
			15 01 00 00 00 00 02 C6 95
			15 01 00 00 00 00 02 C7 01
			15 01 00 00 00 00 02 C8 C4
			15 01 00 00 00 00 02 C9 02
			15 01 00 00 00 00 02 CA 0D
			15 01 00 00 00 00 02 CB 02
			15 01 00 00 00 00 02 CC 4A
			15 01 00 00 00 00 02 CD 02
			15 01 00 00 00 00 02 CE 4C
			15 01 00 00 00 00 02 CF 02
			15 01 00 00 00 00 02 D0 85
			15 01 00 00 00 00 02 D1 02
			15 01 00 00 00 00 02 D2 C3
			15 01 00 00 00 00 02 D3 02
			15 01 00 00 00 00 02 D4 E9
			15 01 00 00 00 00 02 D5 03
			15 01 00 00 00 00 02 D6 16
			15 01 00 00 00 00 02 D7 03
			15 01 00 00 00 00 02 D8 34
			15 01 00 00 00 00 02 D9 03
			15 01 00 00 00 00 02 DA 56
			15 01 00 00 00 00 02 DB 03
			15 01 00 00 00 00 02 DC 62
			15 01 00 00 00 00 02 DD 03
			15 01 00 00 00 00 02 DE 6C
			15 01 00 00 00 00 02 DF 03
			15 01 00 00 00 00 02 E0 74
			15 01 00 00 00 00 02 E1 03
			15 01 00 00 00 00 02 E2 80
			15 01 00 00 00 00 02 E3 03
			15 01 00 00 00 00 02 E4 89
			15 01 00 00 00 00 02 E5 03
			15 01 00 00 00 00 02 E6 8B
			15 01 00 00 00 00 02 E7 03
			15 01 00 00 00 00 02 E8 8D
			15 01 00 00 00 00 02 E9 03
			15 01 00 00 00 00 02 EA 8E
			15 01 00 00 00 00 02 ff 10
			05 01 00 00 00 00 01 29];
		qcom,mdss-dsi-off-command = [15 01 00 00 00 00 02 ff 10
			05 01 00 00 10 00 01 28
			15 01 00 00 00 00 02 b0 00
			05 01 00 00 40 00 01 10
			15 01 00 00 00 00 02 4f 01];
		qcom,mdss-dsi-on-command-state = "dsi_lp_mode";
		qcom,mdss-dsi-off-command-state = "dsi_hs_mode";
		qcom,mdss-dsi-h-sync-pulse = <0>;
		qcom,mdss-dsi-traffic-mode = "burst_mode";
		qcom,mdss-dsi-bllp-eof-power-mode;
		qcom,mdss-dsi-bllp-power-mode;
		qcom,cmd-sync-wait-broadcast;
		qcom,cmd-sync-wait-trigger;
		qcom,mdss-tear-check-frame-rate = <12000>;
		qcom,mdss-dsi-lane-0-state;
		qcom,mdss-dsi-lane-1-state;
		qcom,mdss-dsi-lane-2-state;
		qcom,mdss-dsi-lane-3-state;
		qcom,mdss-dsi-panel-timings = [d6 32 22 00 60 66 26 36 28 03 04
			00];
		qcom,mdss-dsi-t-clk-post = <0x04>;
		qcom,mdss-dsi-t-clk-pre = <0x1b>;
		qcom,mdss-dsi-dma-trigger = "trigger_sw";
		qcom,mdss-dsi-mdp-trigger = "none";
		qcom,mdss-dsi-te-pin-select = <1>;
		qcom,mdss-dsi-wr-mem-start = <0x2c>;
		qcom,mdss-dsi-wr-mem-continue = <0x3c>;
		qcom,mdss-dsi-te-dcs-command = <1>;
		qcom,mdss-dsi-te-check-enable;
		qcom,mdss-dsi-te-using-te-pin;
	};
};
