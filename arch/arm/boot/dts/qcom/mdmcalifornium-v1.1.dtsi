/* Copyright (c) 2016, The Linux Foundation. All rights reserved.
 *
 * This program is free software; you can redistribute it and/or modify
 * it under the terms of the GNU General Public License version 2 and
 * only version 2 as published by the Free Software Foundation.
 *
 * This program is distributed in the hope that it will be useful,
 * but WITHOUT ANY WARRANTY; without even the implied warranty of
 * MERCHANTABILITY or FITNESS FOR A PARTICULAR PURPOSE.  See the
 * GNU General Public License for more details.
 */

#include "mdmcalifornium.dtsi"

/ {
	model = "Qualcomm Technologies, Inc. MDM CALIFORNIUM v1.1";
	compatible = "qcom,mdmcalifornium";
	qcom,msm-id = <279 0x10001>, <284 0x10001>, <285 0x10001>,
		      <286 0x10001>, <283 0x10001>;
};
