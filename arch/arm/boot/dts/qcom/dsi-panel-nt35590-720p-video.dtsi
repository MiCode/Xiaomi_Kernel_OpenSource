/* Copyright (c) 2013-2014, The Linux Foundation. All rights reserved.
 *
 * This program is free software; you can redistribute it and/or modify
 * it under the terms of the GNU General Public License version 2 and
 * only version 2 as published by the Free Software Foundation.
 *
 * This program is distributed in the hope that it will be useful,
 * but WITHOUT ANY WARRANTY; without even the implied warranty of
 * MERCHANTABILITY or FITNESS FOR A PARTICULAR PURPOSE.  See the
 * GNU General Public License for more details.
 */

/*---------------------------------------------------------------------------
 * This file is autogenerated file using gcdb parser. Please do not edit it.
 * Update input XML file to add a new entry or update variable in this file
 * VERSION = "1.0"
 *---------------------------------------------------------------------------*/
&mdss_mdp {
	dsi_nt35590_720_vid: qcom,mdss_dsi_nt35590_720p_video {
		qcom,mdss-dsi-panel-name = "nt35590 720p video mode dsi panel";
		qcom,mdss-dsi-panel-controller = <&mdss_dsi0>;
		qcom,mdss-dsi-panel-type = "dsi_video_mode";
		qcom,mdss-dsi-panel-destination = "display_1";
		qcom,mdss-dsi-panel-framerate = <60>;
		qcom,mdss-dsi-virtual-channel-id = <0>;
		qcom,mdss-dsi-stream = <0>;
		qcom,mdss-dsi-panel-width = <720>;
		qcom,mdss-dsi-panel-height = <1280>;
		qcom,mdss-dsi-h-front-porch = <140>;
		qcom,mdss-dsi-h-back-porch = <164>;
		qcom,mdss-dsi-h-pulse-width = <8>;
		qcom,mdss-dsi-h-sync-skew = <0>;
		qcom,mdss-dsi-v-back-porch = <11>;
		qcom,mdss-dsi-v-front-porch = <6>;
		qcom,mdss-dsi-v-pulse-width = <1>;
		qcom,mdss-dsi-h-left-border = <0>;
		qcom,mdss-dsi-h-right-border = <0>;
		qcom,mdss-dsi-v-top-border = <0>;
		qcom,mdss-dsi-v-bottom-border = <0>;
		qcom,mdss-dsi-bpp = <24>;
		qcom,mdss-dsi-underflow-color = <0xff>;
		qcom,mdss-dsi-border-color = <0>;
		qcom,mdss-dsi-on-command = [29 01 00 00 00 00 02 FF EE
					29 01 00 00 00 00 02 26 08
					29 01 00 00 00 00 02 26 00
					29 01 00 00 10 00 02 FF 00
					29 01 00 00 00 00 02 BA 03
					29 01 00 00 00 00 02 C2 03
					29 01 00 00 00 00 02 FF 01
					29 01 00 00 00 00 02 FB 01
					29 01 00 00 00 00 02 00 4A
					29 01 00 00 00 00 02 01 33
					29 01 00 00 00 00 02 02 53
					29 01 00 00 00 00 02 03 55
					29 01 00 00 00 00 02 04 55
					29 01 00 00 00 00 02 05 33
					29 01 00 00 00 00 02 06 22
					29 01 00 00 00 00 02 08 56
					29 01 00 00 00 00 02 09 8F
					29 01 00 00 00 00 02 36 73
					29 01 00 00 00 00 02 0B 9F
					29 01 00 00 00 00 02 0C 9F
					29 01 00 00 00 00 02 0D 2F
					29 01 00 00 00 00 02 0E 24
					29 01 00 00 00 00 02 11 83
					29 01 00 00 00 00 02 12 03
					29 01 00 00 00 00 02 71 2C
					29 01 00 00 00 00 02 6F 03
					29 01 00 00 00 00 02 0F 0A
					29 01 00 00 00 00 02 FF 05
					29 01 00 00 00 00 02 FB 01
					29 01 00 00 00 00 02 01 00
					29 01 00 00 00 00 02 02 8B
					29 01 00 00 00 00 02 03 82
					29 01 00 00 00 00 02 04 82
					29 01 00 00 00 00 02 05 30
					29 01 00 00 00 00 02 06 33
					29 01 00 00 00 00 02 07 01
					29 01 00 00 00 00 02 08 00
					29 01 00 00 00 00 02 09 46
					29 01 00 00 00 00 02 0A 46
					29 01 00 00 00 00 02 0D 0B
					29 01 00 00 00 00 02 0E 1D
					29 01 00 00 00 00 02 0F 08
					29 01 00 00 00 00 02 10 53
					29 01 00 00 00 00 02 11 00
					29 01 00 00 00 00 02 12 00
					29 01 00 00 00 00 02 14 01
					29 01 00 00 00 00 02 15 00
					29 01 00 00 00 00 02 16 05
					29 01 00 00 00 00 02 17 00
					29 01 00 00 00 00 02 19 7F
					29 01 00 00 00 00 02 1A FF
					29 01 00 00 00 00 02 1B 0F
					29 01 00 00 00 00 02 1C 00
					29 01 00 00 00 00 02 1D 00
					29 01 00 00 00 00 02 1E 00
					29 01 00 00 00 00 02 1F 07
					29 01 00 00 00 00 02 20 00
					29 01 00 00 00 00 02 21 06
					29 01 00 00 00 00 02 22 55
					29 01 00 00 00 00 02 23 4D
					29 01 00 00 00 00 02 2D 02
					29 01 00 00 00 00 02 28 01
					29 01 00 00 00 00 02 2F 02
					29 01 00 00 00 00 02 83 01
					29 01 00 00 00 00 02 9E 58
					29 01 00 00 00 00 02 9F 6A
					29 01 00 00 00 00 02 A0 01
					29 01 00 00 00 00 02 A2 10
					29 01 00 00 00 00 02 BB 0A
					29 01 00 00 00 00 02 BC 0A
					29 01 00 00 00 00 02 32 08
					29 01 00 00 00 00 02 33 B8
					29 01 00 00 00 00 02 36 01
					29 01 00 00 00 00 02 37 00
					29 01 00 00 00 00 02 43 00
					29 01 00 00 00 00 02 4B 21
					29 01 00 00 00 00 02 4C 03
					29 01 00 00 00 00 02 50 21
					29 01 00 00 00 00 02 51 03
					29 01 00 00 00 00 02 58 21
					29 01 00 00 00 00 02 59 03
					29 01 00 00 00 00 02 5D 21
					29 01 00 00 00 00 02 5E 03
					29 01 00 00 00 00 02 6C 00
					29 01 00 00 00 00 02 6D 00
					29 01 00 00 00 00 02 FB 01
					29 01 00 00 00 00 02 FF 01
					29 01 00 00 00 00 02 FB 01
					29 01 00 00 00 00 02 75 00
					29 01 00 00 00 00 02 76 7D
					29 01 00 00 00 00 02 77 00
					29 01 00 00 00 00 02 78 8A
					29 01 00 00 00 00 02 79 00
					29 01 00 00 00 00 02 7A 9C
					29 01 00 00 00 00 02 7B 00
					29 01 00 00 00 00 02 7C B1
					29 01 00 00 00 00 02 7D 00
					29 01 00 00 00 00 02 7E BF
					29 01 00 00 00 00 02 7F 00
					29 01 00 00 00 00 02 80 CF
					29 01 00 00 00 00 02 81 00
					29 01 00 00 00 00 02 82 DD
					29 01 00 00 00 00 02 83 00
					29 01 00 00 00 00 02 84 E8
					29 01 00 00 00 00 02 85 00
					29 01 00 00 00 00 02 86 F2
					29 01 00 00 00 00 02 87 01
					29 01 00 00 00 00 02 88 1F
					29 01 00 00 00 00 02 89 01
					29 01 00 00 00 00 02 8A 41
					29 01 00 00 00 00 02 8B 01
					29 01 00 00 00 00 02 8C 78
					29 01 00 00 00 00 02 8D 01
					29 01 00 00 00 00 02 8E A5
					29 01 00 00 00 00 02 8F 01
					29 01 00 00 00 00 02 90 EE
					29 01 00 00 00 00 02 91 02
					29 01 00 00 00 00 02 92 29
					29 01 00 00 00 00 02 93 02
					29 01 00 00 00 00 02 94 2A
					29 01 00 00 00 00 02 95 02
					29 01 00 00 00 00 02 96 5D
					29 01 00 00 00 00 02 97 02
					29 01 00 00 00 00 02 98 93
					29 01 00 00 00 00 02 99 02
					29 01 00 00 00 00 02 9A B8
					29 01 00 00 00 00 02 9B 02
					29 01 00 00 00 00 02 9C E7
					29 01 00 00 00 00 02 9D 03
					29 01 00 00 00 00 02 9E 07
					29 01 00 00 00 00 02 9F 03
					29 01 00 00 00 00 02 A0 37
					29 01 00 00 00 00 02 A2 03
					29 01 00 00 00 00 02 A3 46
					29 01 00 00 00 00 02 A4 03
					29 01 00 00 00 00 02 A5 56
					29 01 00 00 00 00 02 A6 03
					29 01 00 00 00 00 02 A7 66
					29 01 00 00 00 00 02 A9 03
					29 01 00 00 00 00 02 AA 7A
					29 01 00 00 00 00 02 AB 03
					29 01 00 00 00 00 02 AC 93
					29 01 00 00 00 00 02 AD 03
					29 01 00 00 00 00 02 AE A3
					29 01 00 00 00 00 02 AF 03
					29 01 00 00 00 00 02 B0 B4
					29 01 00 00 00 00 02 B1 03
					29 01 00 00 00 00 02 B2 CB
					29 01 00 00 00 00 02 B3 00
					29 01 00 00 00 00 02 B4 7D
					29 01 00 00 00 00 02 B5 00
					29 01 00 00 00 00 02 B6 8A
					29 01 00 00 00 00 02 B7 00
					29 01 00 00 00 00 02 B8 9C
					29 01 00 00 00 00 02 B9 00
					29 01 00 00 00 00 02 BA B1
					29 01 00 00 00 00 02 BB 00
					29 01 00 00 00 00 02 BC BF
					29 01 00 00 00 00 02 BD 00
					29 01 00 00 00 00 02 BE CF
					29 01 00 00 00 00 02 BF 00
					29 01 00 00 00 00 02 C0 DD
					29 01 00 00 00 00 02 C1 00
					29 01 00 00 00 00 02 C2 E8
					29 01 00 00 00 00 02 C3 00
					29 01 00 00 00 00 02 C4 F2
					29 01 00 00 00 00 02 C5 01
					29 01 00 00 00 00 02 C6 1F
					29 01 00 00 00 00 02 C7 01
					29 01 00 00 00 00 02 C8 41
					29 01 00 00 00 00 02 C9 01
					29 01 00 00 00 00 02 CA 78
					29 01 00 00 00 00 02 CB 01
					29 01 00 00 00 00 02 CC A5
					29 01 00 00 00 00 02 CD 01
					29 01 00 00 00 00 02 CE EE
					29 01 00 00 00 00 02 CF 02
					29 01 00 00 00 00 02 D0 29
					29 01 00 00 00 00 02 D1 02
					29 01 00 00 00 00 02 D2 2A
					29 01 00 00 00 00 02 D3 02
					29 01 00 00 00 00 02 D4 5D
					29 01 00 00 00 00 02 D5 02
					29 01 00 00 00 00 02 D6 93
					29 01 00 00 00 00 02 D7 02
					29 01 00 00 00 00 02 D8 B8
					29 01 00 00 00 00 02 D9 02
					29 01 00 00 00 00 02 DA E7
					29 01 00 00 00 00 02 DB 03
					29 01 00 00 00 00 02 DC 07
					29 01 00 00 00 00 02 DD 03
					29 01 00 00 00 00 02 DE 37
					29 01 00 00 00 00 02 DF 03
					29 01 00 00 00 00 02 E0 46
					29 01 00 00 00 00 02 E1 03
					29 01 00 00 00 00 02 E2 56
					29 01 00 00 00 00 02 E3 03
					29 01 00 00 00 00 02 E4 66
					29 01 00 00 00 00 02 E5 03
					29 01 00 00 00 00 02 E6 7A
					29 01 00 00 00 00 02 E7 03
					29 01 00 00 00 00 02 E8 93
					29 01 00 00 00 00 02 E9 03
					29 01 00 00 00 00 02 EA A3
					29 01 00 00 00 00 02 EB 03
					29 01 00 00 00 00 02 EC B4
					29 01 00 00 00 00 02 ED 03
					29 01 00 00 00 00 02 EE CB
					29 01 00 00 00 00 02 EF 00
					29 01 00 00 00 00 02 F0 ED
					29 01 00 00 00 00 02 F1 00
					29 01 00 00 00 00 02 F2 F3
					29 01 00 00 00 00 02 F3 00
					29 01 00 00 00 00 02 F4 FE
					29 01 00 00 00 00 02 F5 01
					29 01 00 00 00 00 02 F6 09
					29 01 00 00 00 00 02 F7 01
					29 01 00 00 00 00 02 F8 13
					29 01 00 00 00 00 02 F9 01
					29 01 00 00 00 00 02 FA 1D
					29 01 00 00 00 00 02 FF 02
					29 01 00 00 00 00 02 FB 01
					29 01 00 00 00 00 02 00 01
					29 01 00 00 00 00 02 01 26
					29 01 00 00 00 00 02 02 01
					29 01 00 00 00 00 02 03 2F
					29 01 00 00 00 00 02 04 01
					29 01 00 00 00 00 02 05 37
					29 01 00 00 00 00 02 06 01
					29 01 00 00 00 00 02 07 56
					29 01 00 00 00 00 02 08 01
					29 01 00 00 00 00 02 09 70
					29 01 00 00 00 00 02 0A 01
					29 01 00 00 00 00 02 0B 9D
					29 01 00 00 00 00 02 0C 01
					29 01 00 00 00 00 02 0D C2
					29 01 00 00 00 00 02 0E 01
					29 01 00 00 00 00 02 0F FF
					29 01 00 00 00 00 02 10 02
					29 01 00 00 00 00 02 11 31
					29 01 00 00 00 00 02 12 02
					29 01 00 00 00 00 02 13 32
					29 01 00 00 00 00 02 14 02
					29 01 00 00 00 00 02 15 60
					29 01 00 00 00 00 02 16 02
					29 01 00 00 00 00 02 17 94
					29 01 00 00 00 00 02 18 02
					29 01 00 00 00 00 02 19 B5
					29 01 00 00 00 00 02 1A 02
					29 01 00 00 00 00 02 1B E3
					29 01 00 00 00 00 02 1C 03
					29 01 00 00 00 00 02 1D 03
					29 01 00 00 00 00 02 1E 03
					29 01 00 00 00 00 02 1F 2D
					29 01 00 00 00 00 02 20 03
					29 01 00 00 00 00 02 21 3A
					29 01 00 00 00 00 02 22 03
					29 01 00 00 00 00 02 23 48
					29 01 00 00 00 00 02 24 03
					29 01 00 00 00 00 02 25 57
					29 01 00 00 00 00 02 26 03
					29 01 00 00 00 00 02 27 68
					29 01 00 00 00 00 02 28 03
					29 01 00 00 00 00 02 29 7B
					29 01 00 00 00 00 02 2A 03
					29 01 00 00 00 00 02 2B 90
					29 01 00 00 00 00 02 2D 03
					29 01 00 00 00 00 02 2F A0
					29 01 00 00 00 00 02 30 03
					29 01 00 00 00 00 02 31 CB
					29 01 00 00 00 00 02 32 00
					29 01 00 00 00 00 02 33 ED
					29 01 00 00 00 00 02 34 00
					29 01 00 00 00 00 02 35 F3
					29 01 00 00 00 00 02 36 00
					29 01 00 00 00 00 02 37 FE
					29 01 00 00 00 00 02 38 01
					29 01 00 00 00 00 02 39 09
					29 01 00 00 00 00 02 3A 01
					29 01 00 00 00 00 02 3B 13
					29 01 00 00 00 00 02 3D 01
					29 01 00 00 00 00 02 3F 1D
					29 01 00 00 00 00 02 40 01
					29 01 00 00 00 00 02 41 26
					29 01 00 00 00 00 02 42 01
					29 01 00 00 00 00 02 43 2F
					29 01 00 00 00 00 02 44 01
					29 01 00 00 00 00 02 45 37
					29 01 00 00 00 00 02 46 01
					29 01 00 00 00 00 02 47 56
					29 01 00 00 00 00 02 48 01
					29 01 00 00 00 00 02 49 70
					29 01 00 00 00 00 02 4A 01
					29 01 00 00 00 00 02 4B 9D
					29 01 00 00 00 00 02 4C 01
					29 01 00 00 00 00 02 4D C2
					29 01 00 00 00 00 02 4E 01
					29 01 00 00 00 00 02 4F FF
					29 01 00 00 00 00 02 50 02
					29 01 00 00 00 00 02 51 31
					29 01 00 00 00 00 02 52 02
					29 01 00 00 00 00 02 53 32
					29 01 00 00 00 00 02 54 02
					29 01 00 00 00 00 02 55 60
					29 01 00 00 00 00 02 56 02
					29 01 00 00 00 00 02 58 94
					29 01 00 00 00 00 02 59 02
					29 01 00 00 00 00 02 5A B5
					29 01 00 00 00 00 02 5B 02
					29 01 00 00 00 00 02 5C E3
					29 01 00 00 00 00 02 5D 03
					29 01 00 00 00 00 02 5E 03
					29 01 00 00 00 00 02 5F 03
					29 01 00 00 00 00 02 60 2D
					29 01 00 00 00 00 02 61 03
					29 01 00 00 00 00 02 62 3A
					29 01 00 00 00 00 02 63 03
					29 01 00 00 00 00 02 64 48
					29 01 00 00 00 00 02 65 03
					29 01 00 00 00 00 02 66 57
					29 01 00 00 00 00 02 67 03
					29 01 00 00 00 00 02 68 68
					29 01 00 00 00 00 02 69 03
					29 01 00 00 00 00 02 6A 7B
					29 01 00 00 00 00 02 6B 03
					29 01 00 00 00 00 02 6C 90
					29 01 00 00 00 00 02 6D 03
					29 01 00 00 00 00 02 6E A0
					29 01 00 00 00 00 02 6F 03
					29 01 00 00 00 00 02 70 CB
					29 01 00 00 00 00 02 71 00
					29 01 00 00 00 00 02 72 19
					29 01 00 00 00 00 02 73 00
					29 01 00 00 00 00 02 74 36
					29 01 00 00 00 00 02 75 00
					29 01 00 00 00 00 02 76 55
					29 01 00 00 00 00 02 77 00
					29 01 00 00 00 00 02 78 70
					29 01 00 00 00 00 02 79 00
					29 01 00 00 00 00 02 7A 83
					29 01 00 00 00 00 02 7B 00
					29 01 00 00 00 00 02 7C 99
					29 01 00 00 00 00 02 7D 00
					29 01 00 00 00 00 02 7E A8
					29 01 00 00 00 00 02 7F 00
					29 01 00 00 00 00 02 80 B7
					29 01 00 00 00 00 02 81 00
					29 01 00 00 00 00 02 82 C5
					29 01 00 00 00 00 02 83 00
					29 01 00 00 00 00 02 84 F7
					29 01 00 00 00 00 02 85 01
					29 01 00 00 00 00 02 86 1E
					29 01 00 00 00 00 02 87 01
					29 01 00 00 00 00 02 88 60
					29 01 00 00 00 00 02 89 01
					29 01 00 00 00 00 02 8A 95
					29 01 00 00 00 00 02 8B 01
					29 01 00 00 00 00 02 8C E1
					29 01 00 00 00 00 02 8D 02
					29 01 00 00 00 00 02 8E 20
					29 01 00 00 00 00 02 8F 02
					29 01 00 00 00 00 02 90 23
					29 01 00 00 00 00 02 91 02
					29 01 00 00 00 00 02 92 59
					29 01 00 00 00 00 02 93 02
					29 01 00 00 00 00 02 94 94
					29 01 00 00 00 00 02 95 02
					29 01 00 00 00 00 02 96 B4
					29 01 00 00 00 00 02 97 02
					29 01 00 00 00 00 02 98 E1
					29 01 00 00 00 00 02 99 03
					29 01 00 00 00 00 02 9A 01
					29 01 00 00 00 00 02 9B 03
					29 01 00 00 00 00 02 9C 28
					29 01 00 00 00 00 02 9D 03
					29 01 00 00 00 00 02 9E 30
					29 01 00 00 00 00 02 9F 03
					29 01 00 00 00 00 02 A0 37
					29 01 00 00 00 00 02 A2 03
					29 01 00 00 00 00 02 A3 3B
					29 01 00 00 00 00 02 A4 03
					29 01 00 00 00 00 02 A5 40
					29 01 00 00 00 00 02 A6 03
					29 01 00 00 00 00 02 A7 50
					29 01 00 00 00 00 02 A9 03
					29 01 00 00 00 00 02 AA 6D
					29 01 00 00 00 00 02 AB 03
					29 01 00 00 00 00 02 AC 80
					29 01 00 00 00 00 02 AD 03
					29 01 00 00 00 00 02 AE CB
					29 01 00 00 00 00 02 AF 00
					29 01 00 00 00 00 02 B0 19
					29 01 00 00 00 00 02 B1 00
					29 01 00 00 00 00 02 B2 36
					29 01 00 00 00 00 02 B3 00
					29 01 00 00 00 00 02 B4 55
					29 01 00 00 00 00 02 B5 00
					29 01 00 00 00 00 02 B6 70
					29 01 00 00 00 00 02 B7 00
					29 01 00 00 00 00 02 B8 83
					29 01 00 00 00 00 02 B9 00
					29 01 00 00 00 00 02 BA 99
					29 01 00 00 00 00 02 BB 00
					29 01 00 00 00 00 02 BC A8
					29 01 00 00 00 00 02 BD 00
					29 01 00 00 00 00 02 BE B7
					29 01 00 00 00 00 02 BF 00
					29 01 00 00 00 00 02 C0 C5
					29 01 00 00 00 00 02 C1 00
					29 01 00 00 00 00 02 C2 F7
					29 01 00 00 00 00 02 C3 01
					29 01 00 00 00 00 02 C4 1E
					29 01 00 00 00 00 02 C5 01
					29 01 00 00 00 00 02 C6 60
					29 01 00 00 00 00 02 C7 01
					29 01 00 00 00 00 02 C8 95
					29 01 00 00 00 00 02 C9 01
					29 01 00 00 00 00 02 CA E1
					29 01 00 00 00 00 02 CB 02
					29 01 00 00 00 00 02 CC 20
					29 01 00 00 00 00 02 CD 02
					29 01 00 00 00 00 02 CE 23
					29 01 00 00 00 00 02 CF 02
					29 01 00 00 00 00 02 D0 59
					29 01 00 00 00 00 02 D1 02
					29 01 00 00 00 00 02 D2 94
					29 01 00 00 00 00 02 D3 02
					29 01 00 00 00 00 02 D4 B4
					29 01 00 00 00 00 02 D5 02
					29 01 00 00 00 00 02 D6 E1
					29 01 00 00 00 00 02 D7 03
					29 01 00 00 00 00 02 D8 01
					29 01 00 00 00 00 02 D9 03
					29 01 00 00 00 00 02 DA 28
					29 01 00 00 00 00 02 DB 03
					29 01 00 00 00 00 02 DC 30
					29 01 00 00 00 00 02 DD 03
					29 01 00 00 00 00 02 DE 37
					29 01 00 00 00 00 02 DF 03
					29 01 00 00 00 00 02 E0 3B
					29 01 00 00 00 00 02 E1 03
					29 01 00 00 00 00 02 E2 40
					29 01 00 00 00 00 02 E3 03
					29 01 00 00 00 00 02 E4 50
					29 01 00 00 00 00 02 E5 03
					29 01 00 00 00 00 02 E6 6D
					29 01 00 00 00 00 02 E7 03
					29 01 00 00 00 00 02 E8 80
					29 01 00 00 00 00 02 E9 03
					29 01 00 00 00 00 02 EA CB
					29 01 00 00 00 00 02 FF 01
					29 01 00 00 00 00 02 FB 01
					29 01 00 00 00 00 02 FF 02
					29 01 00 00 00 00 02 FB 01
					29 01 00 00 00 00 02 FF 04
					29 01 00 00 00 00 02 FB 01
					29 01 00 00 00 00 02 FF 00
					29 01 00 00 64 00 02 11 00
					29 01 00 00 00 00 02 FF EE
					29 01 00 00 00 00 02 12 50
					29 01 00 00 00 00 02 13 02
					29 01 00 00 00 00 02 6A 60
					29 01 00 00 00 00 02 FF 00
					29 01 00 00 78 00 02 29 00
					29 01 00 00 78 00 02 53 2C
					29 01 00 00 00 00 02 FF 00
					29 01 00 00 00 00 06 3B 03 06 03 02 02];
		qcom,mdss-dsi-off-command = [05 01 00 00 32 00 02 28 00
					05 01 00 00 78 00 02 10 00];
		qcom,mdss-dsi-on-command-state = "dsi_lp_mode";
		qcom,mdss-dsi-off-command-state = "dsi_hs_mode";
		qcom,mdss-dsi-panel-status-check-mode = "bta_check";
		qcom,dynamic-mode-switch-enabled;
		qcom,video-to-cmd-mode-switch-commands = [15 01 00 00 14 00 02 C2 0B
					15 01 00 00 00 00 02 C2 08];
		qcom,cmd-to-video-mode-switch-commands = [15 01 00 00 00 00 02 C2 03];
		qcom,mdss-dsi-h-sync-pulse = <1>;
		qcom,mdss-dsi-traffic-mode = "burst_mode";
		qcom,mdss-dsi-bllp-eof-power-mode;
		qcom,mdss-dsi-bllp-power-mode;
		qcom,mdss-dsi-lane-0-state;
		qcom,mdss-dsi-lane-1-state;
		qcom,mdss-dsi-lane-2-state;
		qcom,mdss-dsi-lane-3-state;
		qcom,mdss-dsi-panel-timings = [7d 25 1d 00 37 33 22 27 1e 03 04 00];
		qcom,mdss-dsi-t-clk-post = <0x20>;
		qcom,mdss-dsi-t-clk-pre = <0x2c>;
		qcom,mdss-dsi-bl-min-level = <1>;
		qcom,mdss-dsi-bl-max-level = <4095>;
		qcom,mdss-dsi-dma-trigger = "trigger_sw";
		qcom,mdss-dsi-mdp-trigger = "none";
		qcom,mdss-dsi-bl-pmic-control-type = "bl_ctrl_wled";
		qcom,mdss-dsi-reset-sequence = <1 20>, <0 1>, <1 20>;
		qcom,mdss-pan-physical-width-dimension = <59>;
		qcom,mdss-pan-physical-height-dimension = <104>;

	};
};
