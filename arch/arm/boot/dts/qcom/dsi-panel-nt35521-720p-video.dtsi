/* Copyright (c) 2013, The Linux Foundation. All rights reserved.
 * Copyright (C) 2016 XiaoMi, Inc.
 *
 * This program is free software; you can redistribute it and/or modify
 * it under the terms of the GNU General Public License version 2 and
 * only version 2 as published by the Free Software Foundation.
 *
 * This program is distributed in the hope that it will be useful,
 * but WITHOUT ANY WARRANTY; without even the implied warranty of
 * MERCHANTABILITY or FITNESS FOR A PARTICULAR PURPOSE.  See the
 * GNU General Public License for more details.
 */

&mdss_mdp {
	dsi_nt35521_720_vid: qcom,mdss_dsi_nt35521_720p_video {
		qcom,mdss-dsi-panel-name = "nt35521_HD720p_video_AUO5";
		qcom,mdss-dsi-panel-controller = <&mdss_dsi0>;
		qcom,mdss-dsi-panel-type = "dsi_video_mode";
		qcom,mdss-dsi-panel-destination = "display_1";
		qcom,mdss-dsi-panel-framerate = <60>;
		qcom,mdss-dsi-virtual-channel-id = <0>;
		qcom,mdss-dsi-stream = <0>;
		qcom,mdss-dsi-panel-width = <720>;
		qcom,mdss-dsi-panel-height = <1280>;
		qcom,mdss-pan-physical-width-dimension = <58>;
		qcom,mdss-pan-physical-height-dimension = <103>;
		qcom,mdss-dsi-h-front-porch = <160>;
		qcom,mdss-dsi-h-back-porch = <160>;
		qcom,mdss-dsi-h-pulse-width = <20>;
		qcom,mdss-dsi-h-sync-skew = <0>;
		qcom,mdss-dsi-v-back-porch = <16>;
		qcom,mdss-dsi-v-front-porch = <16>;
		qcom,mdss-dsi-v-pulse-width = <2>;
		qcom,mdss-dsi-h-left-border = <0>;
		qcom,mdss-dsi-h-right-border = <0>;
		qcom,mdss-dsi-v-top-border = <0>;
		qcom,mdss-dsi-v-bottom-border = <20>;
		qcom,mdss-dsi-bpp = <24>;
		qcom,mdss-dsi-underflow-color = <0xff>;
		qcom,mdss-dsi-border-color = <0>;
		qcom,mdss-dsi-pixel-packing = "tight";
		qcom,mdss-dsi-on-command = [39 01 00 00 00 00 06 F0 55 AA 52 08 00
				39 01 00 00 00 00 02 C8 00
				39 01 00 00 00 00 06 F0 55 AA 52 08 02
				39 01 00 00 00 00 05 EF 11 08 16 19
				39 01 00 00 00 00 06 F0 55 AA 52 08 01
				39 01 00 00 00 00 03 B5 04 04
				39 01 00 00 00 00 03 B9 35 35
				39 01 00 00 00 00 03 BA 25 25
				05 01 00 00 78 00 02 11 00
				05 01 00 00 00 00 02 29 00];
		qcom,mdss-dsi-off-command = [05 01 00 00 00 00 02 28 00
				05 01 00 00 00 00 02 10 00];
		qcom,mdss-dsi-on-command-state = "dsi_lp_mode";
		qcom,mdss-dsi-off-command-state = "dsi_hs_mode";
		qcom,mdss-dsi-panel-warm-command = [29 00 00 00 00 00 06 F0 55 AA 52 08 02
				29 01 00 00 00 00 02 EE 03
				29 00 00 00 00 00 11 B0 00 29 00 41 00 50 00 66 00 75 00 7E 00 8C 00 D0
				29 01 00 00 00 00 11 B1 00 F9 01 3F 01 7F 01 D7 02 24 02 25 02 68 02 B0
				29 00 00 00 00 00 11 B2 02 DD 03 19 03 40 03 6F 03 86 03 8C 03 9E 03 B6
				29 01 00 00 00 00 05 B3 03 C6 03 D5
				29 00 00 00 00 00 11 B4 00 E3 00 E8 00 F4 00 FC 01 05 01 18 01 29 01 45
				29 01 00 00 00 00 11 B5 01 61 01 91 01 B9 02 01 02 3F 02 41 02 7D 02 C1
				29 00 00 00 00 00 11 B6 02 EE 03 29 03 50 03 82 03 95 03 99 03 A9 03 BB
				29 01 00 00 00 00 05 B7 03 CA 03 DA
				29 00 00 00 00 00 11 B8 01 2D 01 2F 01 34 01 3E 01 44 01 52 01 5E 01 74
				29 01 00 00 00 00 11 B9 01 89 01 B1 01 D4 02 14 02 4E 02 50 02 89 02 CC
				29 00 00 00 00 00 11 BA 02 FA 03 38 03 65 03 9D 03 AC 03 E8 03 EA 03 EC
				29 01 00 00 00 00 05 BB 03 EE 03 EF];
		qcom,mdss-dsi-panel-cool-command = [29 00 00 00 00 00 06 F0 55 AA 52 08 02
				29 01 00 00 00 00 02 EE 03
				29 00 00 00 00 00 11 B0 00 26 00 37 00 41 00 57 00 5F 00 7B 00 A3 00 D5
				29 01 00 00 00 00 11 B1 00 FF 01 51 01 8B 01 E9 02 35 02 36 02 79 02 C3
				29 00 00 00 00 00 11 B2 02 F5 03 33 03 5A 03 89 03 9A 03 AD 03 BE 03 CE
				29 01 00 00 00 00 05 B3 03 E5 03 F9
				29 00 00 00 00 00 11 B4 00 89 00 8D 00 A0 00 B1 00 C1 00 DA 00 ED 01 19
				29 01 00 00 00 00 11 B5 01 3E 01 78 01 AA 01 FB 02 40 02 42 02 83 02 CC
				29 00 00 00 00 00 11 B6 02 FC 03 3B 03 64 03 94 03 A2 03 B3 03 C3 03 D0
				29 01 00 00 00 00 05 B7 03 DF 03 E4
				29 00 00 00 00 00 11 B8 00 82 00 85 00 89 00 8F 00 A1 00 BE 00 DD 01 05
				29 01 00 00 00 00 11 B9 01 2A 01 6D 01 A0 01 F4 02 3C 02 3E 02 80 02 CA
				29 00 00 00 00 00 11 BA 02 FB 03 3E 03 6D 03 A3 03 E5 03 E8 03 EF 03 F1
				29 01 00 00 00 00 05 BB 03 F9 03 FC];
		qcom,mdss-dsi-panel-nature-command = [29 00 00 00 00 00 06 F0 55 AA 52 08 02
				29 01 00 00 00 00 02 EE 03
				29 00 00 00 00 00 11 B0 00 29 00 2B 00 50 00 6A 00 6C 00 80 00 98 00 D2
				29 01 00 00 00 00 11 B1 01 00 01 56 01 8B 01 E8 02 33 02 34 02 79 02 C4
				29 00 00 00 00 00 11 B2 02 F4 03 33 03 5A 03 89 03 9B 03 AE 03 BF 03 CF
				29 01 00 00 00 00 05 B3 03 D9 03 DA
				29 00 00 00 00 00 11 B4 00 BB 00 C3 00 D1 00 DB 00 EA 01 00 01 13 01 37
				29 01 00 00 00 00 11 B5 01 57 01 8A 01 B9 02 06 02 48 02 4A 02 88 02 D0
				29 00 00 00 00 00 11 B6 03 00 03 3F 03 67 03 95 03 A5 03 B6 03 C6 03 D1
				29 01 00 00 00 00 05 B7 03 DF 03 E4
				29 00 00 00 00 00 11 B8 00 E4 00 E7 00 F2 00 FC 01 04 01 18 01 27 01 49
				29 01 00 00 00 00 11 B9 01 64 01 98 01 C3 02 0C 02 4C 02 4E 02 8C 02 D5
				29 00 00 00 00 00 11 BA 03 06 03 49 03 79 03 AE 03 BA 03 C6 03 D0 03 DD
				29 01 00 00 00 00 05 BB 03 E8 03 F1];
		qcom,mdss-dsi-panel-ce-std-command = [29 00 00 00 00 00 06 F0 55 AA 52 08 00
				29 01 00 00 00 00 02 55 01];
	 	qcom,mdss-dsi-panel-ce-bright-command = [29 00 00 00 00 00 06 F0 55 AA 52 08 00
				29 01 00 00 00 00 02 55 80
				29 00 00 00 00 00 11 CC 40 36 87 00 00 00 00 00 00 00 00 00 40 08 A5 05
				29 01 00 00 00 00 11 D1 00 02 04 08 10 12 14 16 18 18 16 14 12 0E 08 00
				29 00 00 00 00 00 0D D7 26 28 25 23 23 00 00 00 00 00 00 00
				29 01 00 00 00 00 0E D8 00 00 00 00 00 00 00 00 00 00 23 25 00];
		qcom,mdss-dsi-panel-ce-vivid-command = [29 00 00 00 00 00 06 F0 55 AA 52 08 00
				29 01 00 00 00 00 02 55 80
				29 00 00 00 00 00 11 CC 40 36 87 00 00 00 00 00 00 00 00 00 40 08 A5 05
				29 01 00 00 00 00 11 D1 00 02 0A 0E 12 16 18 18 18 18 16 14 12 0E 08 00
				29 00 00 00 00 00 0D D7 28 30 27 23 23 00 00 00 00 00 00 00
				29 01 00 00 00 00 0E D8 00 00 00 00 00 00 00 00 00 00 23 25 00];
		qcom,mdss-dsi-panel-gamma-command-state = "dsi_lp_mode";
		qcom,mdss-dsi-panel-ce-command-state = "dsi_lp_mode";
		qcom,mdss-dsi-h-sync-pulse = <1>;
		qcom,mdss-dsi-traffic-mode = "burst_mode";
		qcom,mdss-dsi-bllp-eof-power-mode;
		qcom,mdss-dsi-bllp-power-mode;
		qcom,mdss-dsi-hfp-power-mode;
		qcom,mdss-dsi-hbp-power-mode;
		qcom,mdss-dsi-hsa-power-mode;
		qcom,mdss-dsi-lane-0-state;
		qcom,mdss-dsi-lane-1-state;
		qcom,mdss-dsi-lane-2-state;
		qcom,mdss-dsi-panel-timings = [B4 2A 1C 00 54 58 20 2E 20 03 04 00];
		qcom,mdss-dsi-t-clk-post = <0x03>;
		qcom,mdss-dsi-t-clk-pre = <0x23>;
		qcom,mdss-dsi-bl-min-level = <10>;
		qcom,mdss-dsi-bl-max-level = <255>;
		qcom,mdss-dsi-bl-pmic-pwm-frequency = <100>;
		qcom,mdss-dsi-bl-pmic-bank-select = <0>;
		qcom,mdss-dsi-dma-trigger = "trigger_sw";
		qcom,mdss-dsi-mdp-trigger = "none";
		qcom,mdss-dsi-bl-pmic-control-type = "bl_ctrl_pwm";
		qcom,mdss-dsi-reset-sequence = <1 5>, <0 10>, <1 30>;

	};
};
