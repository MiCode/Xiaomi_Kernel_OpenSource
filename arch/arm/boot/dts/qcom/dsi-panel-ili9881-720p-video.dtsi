/* Copyright (c) 2013, The Linux Foundation. All rights reserved.
 * Copyright (C) 2015 XiaoMi, Inc.
 *
 * This program is free software; you can redistribute it and/or modify
 * it under the terms of the GNU General Public License version 2 and
 * only version 2 as published by the Free Software Foundation.
 *
 * This program is distributed in the hope that it will be useful,
 * but WITHOUT ANY WARRANTY; without even the implied warranty of
 * MERCHANTABILITY or FITNESS FOR A PARTICULAR PURPOSE.  See the
 * GNU General Public License for more details.
 */

/*---------------------------------------------------------------------------
 * This file is autogenerated file using gcdb parser. Please do not edit it.
 * Update input XML file to add a new entry or update variable in this file
 * VERSION = "1.0"
 *---------------------------------------------------------------------------*/
&mdss_mdp {
	dsi_ili9881_720p_video: qcom,mdss_dsi_ili9881_720p_video {
		qcom,mdss-dsi-panel-name = "otm1285a 720p video mode dsi panel";
		qcom,mdss-dsi-panel-controller = <&mdss_dsi0>;
		qcom,mdss-dsi-panel-type = "dsi_video_mode";
		qcom,mdss-dsi-panel-destination = "display_1";
		qcom,mdss-dsi-panel-framerate = <60>;
		qcom,mdss-dsi-virtual-channel-id = <0>;
		qcom,mdss-dsi-stream = <0>;
		qcom,mdss-dsi-panel-width = <720>;
		qcom,mdss-dsi-panel-height = <1280>;
		qcom,mdss-dsi-h-front-porch = <140>;
		qcom,mdss-dsi-h-back-porch = <20>;
		qcom,mdss-dsi-h-pulse-width = <10>;
		qcom,mdss-dsi-h-sync-skew = <0>;
		qcom,mdss-dsi-v-back-porch = <11>;
		qcom,mdss-dsi-v-front-porch = <13>;
		qcom,mdss-dsi-v-pulse-width = <1>;
		qcom,mdss-dsi-h-left-border = <0>;
		qcom,mdss-dsi-h-right-border = <0>;
		qcom,mdss-dsi-v-top-border = <0>;
		qcom,mdss-dsi-v-bottom-border = <0>;
		qcom,mdss-dsi-bpp = <24>;
		qcom,mdss-dsi-color-order = "rgb_swap_bgr";
		qcom,mdss-dsi-underflow-color = <0xff>;
		qcom,mdss-dsi-border-color = <0>;
		qcom,mdss-dsi-on-command = [29 01 00 00 00 00 04 FF 98 81 07
				13 01 00 00 00 00 02 03 20
				13 01 00 00 00 00 02 04 06
				13 01 00 00 00 00 02 05 00
				13 01 00 00 00 00 02 06 01
				13 01 00 00 00 00 02 07 00
				13 01 00 00 00 00 02 08 00
				13 01 00 00 00 00 02 09 00
				13 01 00 00 00 00 02 0A 01
				13 01 00 00 00 00 02 0B 2F
				13 01 00 00 00 00 02 0C 00
				13 01 00 00 00 00 02 0D 00
				13 01 00 00 00 00 02 0E 00
				13 01 00 00 00 00 02 0F 00
				13 01 00 00 00 00 02 10 44
				13 01 00 00 00 00 02 11 02
				13 01 00 00 00 00 02 12 03
				13 01 00 00 00 00 02 13 00
				13 01 00 00 00 00 02 14 00
				13 01 00 00 00 00 02 15 00
				13 01 00 00 00 00 02 16 2F
				13 01 00 00 00 00 02 17 2F
				13 01 00 00 00 00 02 18 00
				13 01 00 00 00 00 02 19 00
				13 01 00 00 00 00 02 1A 00
				13 01 00 00 00 00 02 1B 50
				13 01 00 00 00 00 02 1C BB
				13 01 00 00 00 00 02 1D 0C
				13 01 00 00 00 00 02 1E 00
				13 01 00 00 00 00 02 1F 00
				13 01 00 00 00 00 02 20 00
				13 01 00 00 00 00 02 21 00
				13 01 00 00 00 00 02 22 00
				13 01 00 00 00 00 02 23 C0
				13 01 00 00 00 00 02 24 30
				13 01 00 00 00 00 02 26 00
				13 01 00 00 00 00 02 27 03
				13 01 00 00 00 00 02 30 01
				13 01 00 00 00 00 02 31 23
				13 01 00 00 00 00 02 25 00
				13 01 00 00 00 00 02 32 45
				13 01 00 00 00 00 02 33 67
				13 01 00 00 00 00 02 34 89
				13 01 00 00 00 00 02 35 ab
				13 01 00 00 00 00 02 36 01
				13 01 00 00 00 00 02 37 23
				13 01 00 00 00 00 02 38 45
				13 01 00 00 00 00 02 39 67
				13 01 00 00 00 00 02 3A 89
				13 01 00 00 00 00 02 3B ab
				13 01 00 00 00 00 02 3C cd
				13 01 00 00 00 00 02 3D ef
				13 01 00 00 00 00 02 50 11
				13 01 00 00 00 00 02 51 06
				13 01 00 00 00 00 02 52 0c
				13 01 00 00 00 00 02 53 0d
				13 01 00 00 00 00 02 54 0e
				13 01 00 00 00 00 02 55 0f
				13 01 00 00 00 00 02 56 02
				13 01 00 00 00 00 02 57 02
				13 01 00 00 00 00 02 58 02
				13 01 00 00 00 00 02 59 02
				13 01 00 00 00 00 02 5A 02
				13 01 00 00 00 00 02 5B 02
				13 01 00 00 00 00 02 5C 02
				13 01 00 00 00 00 02 5D 02
				13 01 00 00 00 00 02 5E 02
				13 01 00 00 00 00 02 5F 02
				13 01 00 00 00 00 02 60 05
				13 01 00 00 00 00 02 61 05
				13 01 00 00 00 00 02 62 05
				13 01 00 00 00 00 02 63 02
				13 01 00 00 00 00 02 64 01
				13 01 00 00 00 00 02 65 00
				13 01 00 00 00 00 02 66 08
				13 01 00 00 00 00 02 67 08
				13 01 00 00 00 00 02 68 0c
				13 01 00 00 00 00 02 69 0d
				13 01 00 00 00 00 02 6A 0e
				13 01 00 00 00 00 02 6B 0f
				13 01 00 00 00 00 02 6C 02
				13 01 00 00 00 00 02 6D 02
				13 01 00 00 00 00 02 6E 02
				13 01 00 00 00 00 02 6F 02
				13 01 00 00 00 00 02 70 02
				13 01 00 00 00 00 02 71 02
				13 01 00 00 00 00 02 72 02
				13 01 00 00 00 00 02 73 02
				13 01 00 00 00 00 02 74 02
				13 01 00 00 00 00 02 75 02
				13 01 00 00 00 00 02 76 05
				13 01 00 00 00 00 02 77 05
				13 01 00 00 00 00 02 78 05
				13 01 00 00 00 00 02 79 02
				13 01 00 00 00 00 02 7A 01
				13 01 00 00 00 00 02 7B 00
				13 01 00 00 00 00 02 7C 06
				29 01 00 00 00 00 04 FF 98 81 08
				13 01 00 00 00 00 02 76 B4
				13 01 00 00 00 00 02 78 02
				13 01 00 00 00 00 02 74 2B
				13 01 00 00 00 00 02 8E 15
				13 01 00 00 00 00 02 40 01
				13 01 00 00 00 00 02 7B 04
				13 01 00 00 00 00 02 72 25
				13 01 00 00 00 00 02 87 3A
				13 01 00 00 00 00 02 7E 4C
				13 01 00 00 00 00 02 6C 05
				13 01 00 00 00 00 02 49 10
				13 01 00 00 00 00 02 2D 80
				13 01 00 00 00 00 02 50 65
				13 01 00 00 00 00 02 53 29
				13 01 00 00 00 00 02 54 65
				13 01 00 00 00 00 02 55 38
				13 01 00 00 00 00 02 57 47
				13 01 00 00 00 00 02 58 47
				29 01 00 00 00 00 04 FF 98 81 01
				13 01 00 00 00 00 02 22 0A
				13 01 00 00 00 00 02 53 86
				13 01 00 00 00 00 02 55 75
				13 01 00 00 00 00 02 50 82
				13 01 00 00 00 00 02 51 82
				13 01 00 00 00 00 02 31 00
				13 01 00 00 00 00 02 A0 08
				13 01 00 00 00 00 02 A1 22
				13 01 00 00 00 00 02 A2 30
				13 01 00 00 00 00 02 A3 10
				13 01 00 00 00 00 02 A4 12
				13 01 00 00 00 00 02 A5 24
				13 01 00 00 00 00 02 A6 18
				13 01 00 00 00 00 02 A7 1B
				13 01 00 00 00 00 02 A8 99
				13 01 00 00 00 00 02 A9 1C
				13 01 00 00 00 00 02 AA 29
				13 01 00 00 00 00 02 AB 92
				13 01 00 00 00 00 02 AC 1C
				13 01 00 00 00 00 02 AD 1A
				13 01 00 00 00 00 02 AE 4F
				13 01 00 00 00 00 02 AF 22
				13 01 00 00 00 00 02 B0 27
				13 01 00 00 00 00 02 B1 56
				13 01 00 00 00 00 02 B2 64
				13 01 00 00 00 00 02 B3 39
				13 01 00 00 00 00 02 C0 08
				13 01 00 00 00 00 02 C1 22
				13 01 00 00 00 00 02 C2 30
				13 01 00 00 00 00 02 C3 10
				13 01 00 00 00 00 02 C4 12
				13 01 00 00 00 00 02 C5 24
				13 01 00 00 00 00 02 C6 18
				13 01 00 00 00 00 02 C7 1B
				13 01 00 00 00 00 02 C8 99
				13 01 00 00 00 00 02 C9 1C
				13 01 00 00 00 00 02 CA 29
				13 01 00 00 00 00 02 CB 92
				13 01 00 00 00 00 02 CC 1C
				13 01 00 00 00 00 02 CD 1A
				13 01 00 00 00 00 02 CE 4F
				13 01 00 00 00 00 02 CF 22
				13 01 00 00 00 00 02 D0 27
				13 01 00 00 00 00 02 D1 56
				13 01 00 00 00 00 02 D2 64
				13 01 00 00 00 00 02 D3 39
				29 01 00 00 00 00 04 FF 98 81 00
				05 01 00 00 78 00 01 11
				05 01 00 00 00 00 01 29
				13 01 00 00 00 00 02 35 00
				13 01 00 00 00 00 02 51 fa
				13 01 00 00 00 00 02 53 2c
				13 01 00 00 00 00 02 55 02];
		qcom,mdss-dsi-off-command = [05 01 00 00 00 00 02 28 00
				05 01 00 00 78 00 02 10 00];
		qcom,mdss-dsi-on-command-state = "dsi_lp_mode";
		qcom,mdss-dsi-off-command-state = "dsi_hs_mode";
		qcom,mdss-dsi-h-sync-pulse = <10>;
		qcom,mdss-dsi-traffic-mode = "non_burst_sync_pulse";
		qcom,mdss-dsi-bllp-eof-power-mode;
		qcom,mdss-dsi-bllp-power-mode;
		qcom,mdss-dsi-lane-0-state;
		qcom,mdss-dsi-lane-1-state;
		qcom,mdss-dsi-lane-2-state;
		qcom,mdss-dsi-panel-timings = [9b 22 18 00 4a 4c 1c 26 1d 03 04 00];
		qcom,mdss-dsi-t-clk-post = <0x04>;
		qcom,mdss-dsi-t-clk-pre = <0x1f>;
		qcom,mdss-dsi-bl-min-level = <1>;
		qcom,mdss-dsi-bl-max-level = <255>;
		qcom,mdss-dsi-bl-pmic-pwm-frequency = <100>;
		qcom,mdss-dsi-bl-pmic-bank-select = <0>;
		qcom,mdss-dsi-dma-trigger = "trigger_sw";
		qcom,mdss-dsi-mdp-trigger = "none";
		qcom,mdss-dsi-bl-pmic-control-type = "bl_ctrl_pwm";
		qcom,mdss-dsi-reset-sequence = <1 50>, <0 20>, <1 5>;
	};
};
