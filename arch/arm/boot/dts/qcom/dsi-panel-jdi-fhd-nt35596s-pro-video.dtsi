/* Copyright (c) 2015, The Linux Foundation. All rights reserved.
 * Copyright (C) 2018 XiaoMi, Inc.
 *
 * This program is free software; you can redistribute it and/or modify
 * it under the terms of the GNU General Public License version 2 and
 * only version 2 as published by the Free Software Foundation.
 *
 * This program is distributed in the hope that it will be useful,
 * but WITHOUT ANY WARRANTY; without even the implied warranty of
 * MERCHANTABILITY or FITNESS FOR A PARTICULAR PURPOSE.  See the
 * GNU General Public License for more details.
 */

/*---------------------------------------------------------------------------
 * This file is autogenerated file using gcdb parser. Please do not edit it.
 * Update input XML file to add a new entry or update variable in this file
 * VERSION = "1.0"
 *---------------------------------------------------------------------------*/
&soc {
	dsi_jdi_fhd_nt35596s_pro_video: qcom,mdss_dsi_jdi_fhd_nt35596s_pro_video {
		qcom,mdss-dsi-panel-name = "jdi fhd video dsi panel";
		qcom,mdss-dsi-panel-id = <0>;
		qcom,mdss-dsi-panel-model = "JDI FHD NT35596S VIDEO PANEL";
		qcom,mdss-dsi-panel-sleepwrmod = <0>;
		qcom,mdss-dsi-panel-type = "dsi_video_mode";
		qcom,mdss-dsi-panel-framerate = <60>;
		qcom,mdss-dsi-virtual-channel-id = <0>;
		qcom,mdss-dsi-stream = <0>;
		qcom,mdss-dsi-panel-width = <1080>;
		qcom,mdss-dsi-panel-height = <2160>;
		qcom,mdss-dsi-h-front-porch = <12>;
		qcom,mdss-dsi-h-back-porch = <40>;
		qcom,mdss-dsi-h-pulse-width = <24>;
		qcom,mdss-dsi-h-sync-skew = <0>;
		qcom,mdss-dsi-v-back-porch = <24>;
		qcom,mdss-dsi-v-front-porch = <6>;
		qcom,mdss-dsi-v-pulse-width = <4>;
		qcom,mdss-dsi-h-left-border = <0>;
		qcom,mdss-dsi-h-right-border = <0>;
		qcom,mdss-dsi-v-top-border = <0>;
		qcom,mdss-dsi-v-bottom-border = <0>;
		qcom,mdss-dsi-bpp = <24>;
		qcom,mdss-dsi-color-order = <0>;
		qcom,mdss-dsi-underflow-color = <0x0>;
		qcom,mdss-dsi-border-color = <0>;
		qcom,mdss-dsi-on-command = [
				15 01 00 00 00 00 02 FF 24
				15 00 00 00 00 00 02 9D 34
				15 00 00 00 00 00 02 FB 01
				15 00 00 00 00 00 02 C4 25
				15 00 00 00 00 00 02 D1 08
				15 00 00 00 00 00 02 D2 84
				15 01 00 00 00 00 02 FF 26
				15 00 00 00 00 00 02 FB 01
				15 00 00 00 00 00 02 03 1C
				15 00 00 00 00 00 02 3B 08
				15 00 00 00 00 00 02 6B 08
				15 00 00 00 00 00 02 97 08
				15 00 00 00 00 00 02 C5 08
				15 00 00 00 00 00 02 FB 01
				15 01 00 00 00 00 02 FF 23
				15 00 00 00 00 00 02 FB 01
				15 00 00 00 00 00 02 01 84
				15 00 00 00 00 00 02 05 2D
				15 00 00 00 00 00 02 06 00
				15 00 00 00 00 00 02 33 07
				15 00 00 00 00 00 02 21 EE
				15 00 00 00 00 00 02 22 ED
				15 00 00 00 00 00 02 23 EA
				15 00 00 00 00 00 02 24 E8
				15 00 00 00 00 00 02 25 E5
				15 00 00 00 00 00 02 26 E2
				15 00 00 00 00 00 02 27 DE
				15 00 00 00 00 00 02 28 BB
				15 00 00 00 00 00 02 29 87
				15 00 00 00 00 00 02 2A 77
				15 01 00 00 00 00 02 32 0C
				15 00 00 00 00 00 02 13 3F
				15 00 00 00 00 00 02 14 34
				15 00 00 00 00 00 02 15 2A
				15 00 00 00 00 00 02 16 25
				15 00 00 00 00 00 02 17 9D
				15 00 00 00 00 00 02 18 9A
				15 00 00 00 00 00 02 19 97
				15 00 00 00 00 00 02 1A 94
				15 00 00 00 00 00 02 1B 91
				15 00 00 00 00 00 02 1C 8E
				15 00 00 00 00 00 02 1D 8B
				15 00 00 00 00 00 02 1E 89
				15 00 00 00 00 00 02 1F 86
				15 00 00 00 00 00 02 20 83
				15 01 00 00 00 00 02 FF 22
				15 00 00 00 00 00 02 00 0A
				15 00 00 00 00 00 02 01 43
				15 00 00 00 00 00 02 02 5B
				15 00 00 00 00 00 02 03 6A
				15 00 00 00 00 00 02 04 7A
				15 00 00 00 00 00 02 05 82
				15 00 00 00 00 00 02 06 85
				15 00 00 00 00 00 02 07 80
				15 00 00 00 00 00 02 08 7C
				15 00 00 00 00 00 02 09 7C
				15 00 00 00 00 00 02 0A 74
				15 00 00 00 00 00 02 0B 71
				15 00 00 00 00 00 02 0C 6E
				15 00 00 00 00 00 02 0D 68
				15 00 00 00 00 00 02 0E 65
				15 01 00 00 00 00 02 0F 5C
				15 00 00 00 00 00 02 10 32
				15 00 00 00 00 00 02 11 18
				15 00 00 00 00 00 02 12 00
				15 00 00 00 00 00 02 13 00
				15 00 00 00 00 00 02 1A 00
				15 00 00 00 00 00 02 1B 00
				15 00 00 00 00 00 02 1C 00
				15 00 00 00 00 00 02 1D 00
				15 00 00 00 00 00 02 1E 00
				15 00 00 00 00 00 02 1F 00
				15 00 00 00 00 00 02 20 00
				15 00 00 00 00 00 02 21 00
				15 00 00 00 00 00 02 22 00
				15 00 00 00 00 00 02 23 00
				15 00 00 00 00 00 02 24 00
				15 01 00 00 00 00 02 25 00
				15 00 00 00 00 00 02 26 00
				15 00 00 00 00 00 02 27 00
				15 00 00 00 00 00 02 28 00
				15 00 00 00 00 00 02 29 00
				15 00 00 00 00 00 02 2A 00
				15 00 00 00 00 00 02 2B 00
				15 00 00 00 00 00 02 2F 00
				15 00 00 00 00 00 02 30 00
				15 00 00 00 00 00 02 31 00
				15 00 00 00 00 00 02 32 0C
				15 00 00 00 00 00 02 33 0C
				15 00 00 00 00 00 02 34 0C
				15 00 00 00 00 00 02 35 0B
				15 00 00 00 00 00 02 36 09
				15 00 00 00 00 00 02 37 09
				15 01 00 00 00 00 02 38 08
				15 00 00 00 00 00 02 39 05
				15 00 00 00 00 00 02 3A 03
				15 00 00 00 00 00 02 3B 00
				15 00 00 00 00 00 02 3F 00
				15 00 00 00 00 00 02 40 00
				15 00 00 00 00 00 02 41 00
				15 00 00 00 00 00 02 42 00
				15 00 00 00 00 00 02 43 00
				15 00 00 00 00 00 02 44 00
				15 00 00 00 00 00 02 45 00
				15 00 00 00 00 00 02 46 00
				15 00 00 00 00 00 02 47 00
				15 00 00 00 00 00 02 48 00
				15 00 00 00 00 00 02 49 03
				15 00 00 00 00 00 02 4A 06
				15 01 00 00 00 00 02 4B 07
				15 00 00 00 00 00 02 4C 07
				15 00 00 00 00 00 02 4D 00
				15 00 00 00 00 00 02 4E 00
				15 00 00 00 00 00 02 4F 00
				15 00 00 00 00 00 02 50 00
				15 00 00 00 00 00 02 51 00
				15 00 00 00 00 00 02 52 00
				15 00 00 00 00 00 02 53 01
				15 00 00 00 00 00 02 54 01
				15 00 00 00 00 00 02 55 89
				15 00 00 00 00 00 02 56 00
				15 00 00 00 00 00 02 58 00
				15 00 00 00 00 00 02 68 00
				15 00 00 00 00 00 02 84 FF
				15 00 00 00 00 00 02 85 FF
				15 01 00 00 00 00 02 86 03
				15 00 00 00 00 00 02 87 00
				15 00 00 00 00 00 02 88 00
				15 00 00 00 00 00 02 A2 20
				15 00 00 00 00 00 02 A9 01
				15 00 00 00 00 00 02 AA 12
				15 00 00 00 00 00 02 AB 13
				15 00 00 00 00 00 02 AC 0A
				15 00 00 00 00 00 02 AD 74
				15 00 00 00 00 00 02 AF 33
				15 00 00 00 00 00 02 B0 03
				15 00 00 00 00 00 02 B1 14
				15 00 00 00 00 00 02 B2 42
				15 00 00 00 00 00 02 B3 40
				15 00 00 00 00 00 02 B4 A5
				15 01 00 00 00 00 02 B6 44
				15 00 00 00 00 00 02 B7 04
				15 00 00 00 00 00 02 B8 14
				15 00 00 00 00 00 02 B9 42
				15 00 00 00 00 00 02 BA 40
				15 00 00 00 00 00 02 BB A5
				15 00 00 00 00 00 02 BD 44
				15 00 00 00 00 00 02 BE 04
				15 00 00 00 00 00 02 BF 00
				15 00 00 00 00 00 02 C0 75
				15 00 00 00 00 00 02 C1 6A
				15 00 00 00 00 00 02 C2 A5
				15 00 00 00 00 00 02 C4 22
				15 00 00 00 00 00 02 C5 02
				15 00 00 00 00 00 02 C6 00
				15 01 00 00 00 00 02 C7 95
				15 00 00 00 00 00 02 C8 8A
				15 00 00 00 00 00 02 C9 A5
				15 00 00 00 00 00 02 CB 22
				15 00 00 00 00 00 02 CC 02
				15 00 00 00 00 00 02 CD 00
				15 00 00 00 00 00 02 CE B5
				15 00 00 00 00 00 02 CF AA
				15 00 00 00 00 00 02 D0 A5
				15 00 00 00 00 00 02 D2 22
				15 00 00 00 00 00 02 D3 02
				15 01 00 00 00 00 02 FB 01
				15 01 00 00 00 00 02 FF 10
				15 01 00 00 00 00 02 26 02
				15 00 00 00 00 00 02 35 00
				15 00 00 00 00 00 02 51 FF
				15 00 00 00 00 00 02 53 24
				15 00 00 00 00 00 02 55 00
				15 01 00 00 00 00 02 B0 00
				05 01 00 00 50 00 02 11 00
				05 01 00 00 14 00 02 29 00
		];
		qcom,mdss-dsi-off-command = [
				05 01 00 00 00 00 02 28 00
				05 01 00 00 46 00 02 10 00];
		qcom,mdss-dsi-displayoff-command = [05 01 00 00 14 00 02 28 00];
		qcom,mdss-dsi-displayon-command = [05 01 00 00 14 00 02 29 00];
		qcom,mdss-dsi-on-command-state = "dsi_lp_mode";
		qcom,mdss-dsi-off-command-state = "dsi_hs_mode";
		qcom,mdss-dsi-displayoff-command-state = "dsi_hs_mode";
		qcom,mdss-dsi-displayon-command-state = "dsi_hs_mode";
		qcom,mdss-dsi-h-sync-pulse = <1>;
		qcom,mdss-dsi-traffic-mode = "burst_mode";
		qcom,mdss-dsi-bllp-eof-power-mode;
		qcom,mdss-dsi-bllp-power-mode;
		qcom,mdss-dsi-lp11-init;
		qcom,mdss-dsi-lane-0-state;
		qcom,mdss-dsi-lane-1-state;
		qcom,mdss-dsi-lane-2-state;
		qcom,mdss-dsi-lane-3-state;
		qcom,mdss-dsi-panel-timings = [e3 50 36 00 a9 a3 3a 50 3d 03 04 00];
		qcom,mdss-dsi-t-clk-post = <0x20>;
		qcom,mdss-dsi-t-clk-pre = <0x36>;
		qcom,mdss-dsi-bl-min-level = <1>;
		qcom,mdss-dsi-bl-max-level = <4095>;
		qcom,mdss-brightness-max-level = <4095>;
		qcom,mdss-dsi-dma-trigger = "trigger_sw";
		qcom,mdss-dsi-mdp-trigger = "none";
		qcom,mdss-dsi-bl-pmic-control-type = "bl_ctrl_wled";
		qcom,mdss-dsi-reset-sequence =<0 10>, <1 10>;
		qcom,mdss-pan-physical-width-dimension = <68>;
		qcom,mdss-pan-physical-height-dimension = <136>;
		qcom,cont-splash-enabled;
		qcom,mdss-dsi-tx-eot-append;
		qcom,mdss-panel-on-dimming-delay = <120>;
		qcom,esd-err-irq-gpio = <&tlmm 52 0x2001>;
		qcom,esd-panel-onoff-tpg;
		qcom,mdss-dsi-min-refresh-rate = <55>;
		qcom,mdss-dsi-max-refresh-rate = <60>;
		qcom,mdss-dsi-pan-enable-dynamic-fps;
		qcom,mdss-dsi-pan-fps-update = "dfps_immediate_porch_mode_vfp";
		qcom,dispccbb-enabled;
		qcom,dispblnotify-enabled;
		qcom,dispparam-enabled;
		qcom,disp-paneloff-disablecabc-enabled;
		qcom,mdss-night-brightness = <7 25 43 61>;
		qcom,mdss-dsi-panel-xy-coordinate = <0xA1 0x0F 0x18>;
		qcom,mdss-dsi-dispparam-skin-ce-command = [
				15 01 00 00 00 00 02 55 83
		];
		qcom,mdss-dsi-dispparam-skin-ce-command-state = "dsi_hs_mode";
		qcom,mdss-dsi-dispparam-cabcon-command = [
				15 01 00 00 00 00 02 55 03
		];
		qcom,mdss-dsi-dispparam-cabcon-command-state = "dsi_hs_mode";
		qcom,mdss-dsi-dispparam-cabcguion-command = [
				15 01 00 00 00 00 02 55 03
		];
		qcom,mdss-dsi-dispparam-cabcguion-command-state = "dsi_hs_mode";
		qcom,mdss-dsi-dispparam-cabcstillon-command = [
				15 00 00 00 00 00 02 55 01
				15 01 00 00 00 00 03 68 01 01
		];
		qcom,mdss-dsi-dispparam-cabcstillon-command-state = "dsi_hs_mode";
		qcom,mdss-dsi-dispparam-cabcmovieon-command = [
				15 01 00 00 00 00 02 55 02
		];
		qcom,mdss-dsi-dispparam-cabcmovieon-command-state = "dsi_hs_mode";
		qcom,mdss-dsi-dispparam-cabcoff-command = [
				39 01 00 00 01 00 02 55 00
		];
		qcom,mdss-dsi-dispparam-dimmingon-command = [
				39 01 00 00 01 00 02 53 2C
		];
		qcom,mdss-dsi-dispparam-idleon-command = [
				39 01 00 00 01 00 02 39 00
		];
		qcom,mdss-dsi-dispparam-idleoff-command = [
				39 01 00 00 01 00 02 38 00
		];
		qcom,mdss-dsi-dispparam-papermode2-command = [
				15 01 00 00 00 00 02 FF 10
				15 01 00 00 10 00 02 26 01
				15 01 00 00 00 00 02 FF 20
				15 00 00 00 00 00 02 75 00
				15 00 00 00 00 00 02 76 00
				15 00 00 00 00 00 02 77 00
				15 00 00 00 00 00 02 78 27
				15 00 00 00 00 00 02 79 00
				15 00 00 00 00 00 02 7A 67
				15 00 00 00 00 00 02 7B 00
				15 00 00 00 00 00 02 7C 94
				15 00 00 00 00 00 02 7D 00
				15 00 00 00 00 00 02 7E B8
				15 00 00 00 00 00 02 7F 00
				15 00 00 00 00 00 02 80 D4
				15 00 00 00 00 00 02 81 00
				15 00 00 00 00 00 02 82 EA
				15 00 00 00 00 00 02 83 00
				15 00 00 00 00 00 02 84 FC
				15 00 00 00 00 00 02 85 01
				15 00 00 00 00 00 02 86 0F
				15 00 00 00 00 00 02 87 01
				15 00 00 00 00 00 02 88 46
				15 00 00 00 00 00 02 89 01
				15 00 00 00 00 00 02 8A 70
				15 00 00 00 00 00 02 8B 01
				15 00 00 00 00 00 02 8C AD
				15 00 00 00 00 00 02 8D 01
				15 00 00 00 00 00 02 8E DA
				15 00 00 00 00 00 02 8F 02
				15 00 00 00 00 00 02 90 1D
				15 00 00 00 00 00 02 91 02
				15 00 00 00 00 00 02 92 50
				15 00 00 00 00 00 02 93 02
				15 00 00 00 00 00 02 94 52
				15 00 00 00 00 00 02 95 02
				15 00 00 00 00 00 02 96 83
				15 00 00 00 00 00 02 97 02
				15 00 00 00 00 00 02 98 BA
				15 00 00 00 00 00 02 99 02
				15 00 00 00 00 00 02 9A DE
				15 00 00 00 00 00 02 9B 03
				15 00 00 00 00 00 02 9C 12
				15 00 00 00 00 00 02 9D 03
				15 00 00 00 00 00 02 9E 2E
				15 00 00 00 00 00 02 9F 03
				15 00 00 00 00 00 02 A0 54
				15 00 00 00 00 00 02 A2 03
				15 00 00 00 00 00 02 A3 61
				15 00 00 00 00 00 02 A4 03
				15 00 00 00 00 00 02 A5 6F
				15 00 00 00 00 00 02 A6 03
				15 00 00 00 00 00 02 A7 7E
				15 00 00 00 00 00 02 A9 03
				15 00 00 00 00 00 02 AA 90
				15 00 00 00 00 00 02 AB 03
				15 00 00 00 00 00 02 AC A7
				15 00 00 00 00 00 02 AD 03
				15 00 00 00 00 00 02 AE C2
				15 00 00 00 00 00 02 AF 03
				15 00 00 00 00 00 02 B0 D5
				15 00 00 00 00 00 02 B1 03
				15 01 00 00 00 00 02 B2 D8
				15 00 00 00 00 00 02 B3 00
				15 00 00 00 00 00 02 B4 00
				15 00 00 00 00 00 02 B5 00
				15 00 00 00 00 00 02 B6 27
				15 00 00 00 00 00 02 B7 00
				15 00 00 00 00 00 02 B8 67
				15 00 00 00 00 00 02 B9 00
				15 00 00 00 00 00 02 BA 94
				15 00 00 00 00 00 02 BB 00
				15 00 00 00 00 00 02 BC B8
				15 00 00 00 00 00 02 BD 00
				15 00 00 00 00 00 02 BE D4
				15 00 00 00 00 00 02 BF 00
				15 00 00 00 00 00 02 C0 EA
				15 00 00 00 00 00 02 C1 00
				15 00 00 00 00 00 02 C2 FC
				15 00 00 00 00 00 02 C3 01
				15 00 00 00 00 00 02 C4 0F
				15 00 00 00 00 00 02 C5 01
				15 00 00 00 00 00 02 C6 46
				15 00 00 00 00 00 02 C7 01
				15 00 00 00 00 00 02 C8 70
				15 00 00 00 00 00 02 C9 01
				15 00 00 00 00 00 02 CA AD
				15 00 00 00 00 00 02 CB 01
				15 00 00 00 00 00 02 CC DA
				15 00 00 00 00 00 02 CD 02
				15 00 00 00 00 00 02 CE 1D
				15 00 00 00 00 00 02 CF 02
				15 00 00 00 00 00 02 D0 50
				15 00 00 00 00 00 02 D1 02
				15 00 00 00 00 00 02 D2 52
				15 00 00 00 00 00 02 D3 02
				15 00 00 00 00 00 02 D4 83
				15 00 00 00 00 00 02 D5 02
				15 00 00 00 00 00 02 D6 BA
				15 00 00 00 00 00 02 D7 02
				15 00 00 00 00 00 02 D8 DE
				15 00 00 00 00 00 02 D9 03
				15 00 00 00 00 00 02 DA 12
				15 00 00 00 00 00 02 DB 03
				15 00 00 00 00 00 02 DC 2E
				15 00 00 00 00 00 02 DD 03
				15 00 00 00 00 00 02 DE 54
				15 00 00 00 00 00 02 DF 03
				15 00 00 00 00 00 02 E0 61
				15 00 00 00 00 00 02 E1 03
				15 00 00 00 00 00 02 E2 6F
				15 00 00 00 00 00 02 E3 03
				15 00 00 00 00 00 02 E4 7E
				15 00 00 00 00 00 02 E5 03
				15 00 00 00 00 00 02 E6 90
				15 00 00 00 00 00 02 E7 03
				15 00 00 00 00 00 02 E8 A7
				15 00 00 00 00 00 02 E9 03
				15 00 00 00 00 00 02 EA C2
				15 00 00 00 00 00 02 EB 03
				15 00 00 00 00 00 02 EC D5
				15 00 00 00 00 00 02 ED 03
				15 00 00 00 00 00 02 EE D8
				15 00 00 00 00 00 02 EF 00
				15 00 00 00 00 00 02 F0 BC
				15 00 00 00 00 00 02 F1 00
				15 00 00 00 00 00 02 F2 CB
				15 00 00 00 00 00 02 F3 00
				15 00 00 00 00 00 02 F4 E4
				15 00 00 00 00 00 02 F5 00
				15 00 00 00 00 00 02 F6 F9
				15 00 00 00 00 00 02 F7 01
				15 00 00 00 00 00 02 F8 0B
				15 00 00 00 00 00 02 F9 01
				15 00 00 00 00 00 02 FA 1B
				15 01 00 00 00 00 02 FF 21
				15 00 00 00 00 00 02 00 01
				15 00 00 00 00 00 02 01 2A
				15 00 00 00 00 00 02 02 01
				15 00 00 00 00 00 02 03 38
				15 00 00 00 00 00 02 04 01
				15 00 00 00 00 00 02 05 44
				15 00 00 00 00 00 02 06 01
				15 00 00 00 00 00 02 07 6E
				15 00 00 00 00 00 02 08 01
				15 00 00 00 00 00 02 09 8F
				15 00 00 00 00 00 02 0A 01
				15 00 00 00 00 00 02 0B C2
				15 00 00 00 00 00 02 0C 01
				15 00 00 00 00 00 02 0D E9
				15 00 00 00 00 00 02 0E 02
				15 00 00 00 00 00 02 0F 27
				15 00 00 00 00 00 02 10 02
				15 00 00 00 00 00 02 11 56
				15 00 00 00 00 00 02 12 02
				15 00 00 00 00 00 02 13 58
				15 00 00 00 00 00 02 14 02
				15 00 00 00 00 00 02 15 87
				15 00 00 00 00 00 02 16 02
				15 00 00 00 00 00 02 17 BD
				15 00 00 00 00 00 02 18 02
				15 00 00 00 00 00 02 19 E2
				15 00 00 00 00 00 02 1A 03
				15 00 00 00 00 00 02 1B 14
				15 00 00 00 00 00 02 1C 03
				15 00 00 00 00 00 02 1D 30
				15 00 00 00 00 00 02 1E 03
				15 00 00 00 00 00 02 1F 58
				15 00 00 00 00 00 02 20 03
				15 00 00 00 00 00 02 21 64
				15 00 00 00 00 00 02 22 03
				15 00 00 00 00 00 02 23 72
				15 00 00 00 00 00 02 24 03
				15 00 00 00 00 00 02 25 81
				15 00 00 00 00 00 02 26 03
				15 00 00 00 00 00 02 27 95
				15 00 00 00 00 00 02 28 03
				15 00 00 00 00 00 02 29 AD
				15 00 00 00 00 00 02 2A 03
				15 00 00 00 00 00 02 2B C6
				15 00 00 00 00 00 02 2D 03
				15 00 00 00 00 00 02 2F D6
				15 00 00 00 00 00 02 30 03
				15 01 00 00 00 00 02 31 D8
				15 00 00 00 00 00 02 32 00
				15 00 00 00 00 00 02 33 BC
				15 00 00 00 00 00 02 34 00
				15 00 00 00 00 00 02 35 CB
				15 00 00 00 00 00 02 36 00
				15 00 00 00 00 00 02 37 E4
				15 00 00 00 00 00 02 38 00
				15 00 00 00 00 00 02 39 F9
				15 00 00 00 00 00 02 3A 01
				15 00 00 00 00 00 02 3B 0B
				15 00 00 00 00 00 02 3D 01
				15 00 00 00 00 00 02 3F 1B
				15 00 00 00 00 00 02 40 01
				15 00 00 00 00 00 02 41 2A
				15 00 00 00 00 00 02 42 01
				15 00 00 00 00 00 02 43 38
				15 00 00 00 00 00 02 44 01
				15 00 00 00 00 00 02 45 44
				15 00 00 00 00 00 02 46 01
				15 00 00 00 00 00 02 47 6E
				15 00 00 00 00 00 02 48 01
				15 00 00 00 00 00 02 49 8F
				15 00 00 00 00 00 02 4A 01
				15 00 00 00 00 00 02 4B C2
				15 00 00 00 00 00 02 4C 01
				15 00 00 00 00 00 02 4D E9
				15 00 00 00 00 00 02 4E 02
				15 00 00 00 00 00 02 4F 27
				15 00 00 00 00 00 02 50 02
				15 00 00 00 00 00 02 51 56
				15 00 00 00 00 00 02 52 02
				15 00 00 00 00 00 02 53 58
				15 00 00 00 00 00 02 54 02
				15 00 00 00 00 00 02 55 87
				15 00 00 00 00 00 02 56 02
				15 00 00 00 00 00 02 58 BD
				15 00 00 00 00 00 02 59 02
				15 00 00 00 00 00 02 5A E2
				15 00 00 00 00 00 02 5B 03
				15 00 00 00 00 00 02 5C 14
				15 00 00 00 00 00 02 5D 03
				15 00 00 00 00 00 02 5E 30
				15 00 00 00 00 00 02 5F 03
				15 00 00 00 00 00 02 60 58
				15 00 00 00 00 00 02 61 03
				15 00 00 00 00 00 02 62 64
				15 00 00 00 00 00 02 63 03
				15 00 00 00 00 00 02 64 72
				15 00 00 00 00 00 02 65 03
				15 00 00 00 00 00 02 66 81
				15 00 00 00 00 00 02 67 03
				15 00 00 00 00 00 02 68 95
				15 00 00 00 00 00 02 69 03
				15 01 00 00 00 00 02 6A AD
				15 00 00 00 00 00 02 6B 03
				15 00 00 00 00 00 02 6C C6
				15 00 00 00 00 00 02 6D 03
				15 00 00 00 00 00 02 6E D6
				15 00 00 00 00 00 02 6F 03
				15 00 00 00 00 00 02 70 D8
				15 00 00 00 00 00 02 71 01
				15 00 00 00 00 00 02 72 7D
				15 00 00 00 00 00 02 73 01
				15 00 00 00 00 00 02 74 81
				15 00 00 00 00 00 02 75 01
				15 00 00 00 00 00 02 76 88
				15 00 00 00 00 00 02 77 01
				15 00 00 00 00 00 02 78 8F
				15 00 00 00 00 00 02 79 01
				15 00 00 00 00 00 02 7A 96
				15 00 00 00 00 00 02 7B 01
				15 00 00 00 00 00 02 7C 9D
				15 00 00 00 00 00 02 7D 01
				15 00 00 00 00 00 02 7E A3
				15 00 00 00 00 00 02 7F 01
				15 00 00 00 00 00 02 80 A8
				15 00 00 00 00 00 02 81 01
				15 00 00 00 00 00 02 82 AE
				15 00 00 00 00 00 02 83 01
				15 00 00 00 00 00 02 84 C3
				15 00 00 00 00 00 02 85 01
				15 00 00 00 00 00 02 86 D6
				15 00 00 00 00 00 02 87 01
				15 00 00 00 00 00 02 88 F5
				15 00 00 00 00 00 02 89 02
				15 00 00 00 00 00 02 8A 12
				15 00 00 00 00 00 02 8B 02
				15 00 00 00 00 00 02 8C 42
				15 00 00 00 00 00 02 8D 02
				15 00 00 00 00 00 02 8E 6B
				15 00 00 00 00 00 02 8F 02
				15 00 00 00 00 00 02 90 6C
				15 00 00 00 00 00 02 91 02
				15 00 00 00 00 00 02 92 98
				15 00 00 00 00 00 02 93 02
				15 00 00 00 00 00 02 94 CD
				15 00 00 00 00 00 02 95 02
				15 00 00 00 00 00 02 96 F2
				15 00 00 00 00 00 02 97 03
				15 00 00 00 00 00 02 98 20
				15 00 00 00 00 00 02 99 03
				15 00 00 00 00 00 02 9A 3C
				15 00 00 00 00 00 02 9B 03
				15 00 00 00 00 00 02 9C 61
				15 00 00 00 00 00 02 9D 03
				15 00 00 00 00 00 02 9E 6B
				15 00 00 00 00 00 02 9F 03
				15 00 00 00 00 00 02 A0 77
				15 00 00 00 00 00 02 A2 03
				15 00 00 00 00 00 02 A3 85
				15 00 00 00 00 00 02 A4 03
				15 00 00 00 00 00 02 A5 95
				15 00 00 00 00 00 02 A6 03
				15 00 00 00 00 00 02 A7 9F
				15 00 00 00 00 00 02 A9 03
				15 00 00 00 00 00 02 AA BF
				15 00 00 00 00 00 02 AB 03
				15 00 00 00 00 00 02 AC D6
				15 00 00 00 00 00 02 AD 03
				15 01 00 00 00 00 02 AE D8
				15 00 00 00 00 00 02 AF 01
				15 00 00 00 00 00 02 B0 7D
				15 00 00 00 00 00 02 B1 01
				15 00 00 00 00 00 02 B2 81
				15 00 00 00 00 00 02 B3 01
				15 00 00 00 00 00 02 B4 88
				15 00 00 00 00 00 02 B5 01
				15 00 00 00 00 00 02 B6 8F
				15 00 00 00 00 00 02 B7 01
				15 00 00 00 00 00 02 B8 96
				15 00 00 00 00 00 02 B9 01
				15 00 00 00 00 00 02 BA 9D
				15 00 00 00 00 00 02 BB 01
				15 00 00 00 00 00 02 BC A3
				15 00 00 00 00 00 02 BD 01
				15 00 00 00 00 00 02 BE A8
				15 00 00 00 00 00 02 BF 01
				15 00 00 00 00 00 02 C0 AE
				15 00 00 00 00 00 02 C1 01
				15 00 00 00 00 00 02 C2 C3
				15 00 00 00 00 00 02 C3 01
				15 00 00 00 00 00 02 C4 D6
				15 00 00 00 00 00 02 C5 01
				15 00 00 00 00 00 02 C6 F5
				15 00 00 00 00 00 02 C7 02
				15 00 00 00 00 00 02 C8 12
				15 00 00 00 00 00 02 C9 02
				15 00 00 00 00 00 02 CA 42
				15 00 00 00 00 00 02 CB 02
				15 00 00 00 00 00 02 CC 6B
				15 00 00 00 00 00 02 CD 02
				15 00 00 00 00 00 02 CE 6C
				15 00 00 00 00 00 02 CF 02
				15 00 00 00 00 00 02 D0 98
				15 00 00 00 00 00 02 D1 02
				15 00 00 00 00 00 02 D2 CD
				15 00 00 00 00 00 02 D3 02
				15 00 00 00 00 00 02 D4 F2
				15 00 00 00 00 00 02 D5 03
				15 00 00 00 00 00 02 D6 20
				15 00 00 00 00 00 02 D7 03
				15 00 00 00 00 00 02 D8 3C
				15 00 00 00 00 00 02 D9 03
				15 00 00 00 00 00 02 DA 61
				15 00 00 00 00 00 02 DB 03
				15 00 00 00 00 00 02 DC 6B
				15 00 00 00 00 00 02 DD 03
				15 00 00 00 00 00 02 DE 77
				15 00 00 00 00 00 02 DF 03
				15 00 00 00 00 00 02 E0 85
				15 00 00 00 00 00 02 E1 03
				15 00 00 00 00 00 02 E2 95
				15 00 00 00 00 00 02 E3 03
				15 00 00 00 00 00 02 E4 9F
				15 00 00 00 00 00 02 E5 03
				15 00 00 00 00 00 02 E6 BF
				15 00 00 00 00 00 02 E7 03
				15 00 00 00 00 00 02 E8 D6
				15 00 00 00 00 00 02 E9 03
				15 00 00 00 00 00 02 EA D8
				15 01 00 00 00 00 02 FF 10
		];
		qcom,mdss-dsi-dispparam-papermode2-command-state = "dsi_hs_mode";
		qcom,mdss-dsi-dispparam-default-command = [
				15 01 00 00 00 00 02 FF 10
				15 01 00 00 10 00 02 26 02
		];
		qcom,mdss-dsi-dispparam-default-command-state = "dsi_hs_mode";
		qcom,mdss-dsi-dispparam-normal1-command = [
				15 01 00 00 00 00 02 FF 10
				15 01 00 00 10 00 02 26 01
		];
		qcom,mdss-dsi-dispparam-normal1-command-state = "dsi_hs_mode";
		qcom,mdss-dsi-dispparam-normal2-command = [
				15 01 00 00 00 00 02 FF 10
				15 01 00 00 10 00 02 26 02
		];
		qcom,mdss-dsi-dispparam-normal2-command-state = "dsi_hs_mode";
	};
};
