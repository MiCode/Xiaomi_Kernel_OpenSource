/* Copyright (c) 2013, The Linux Foundation. All rights reserved.
 * Copyright (C) 2016 XiaoMi, Inc.
 *
 * This program is free software; you can redistribute it and/or modify
 * it under the terms of the GNU General Public License version 2 and
 * only version 2 as published by the Free Software Foundation.
 *
 * This program is distributed in the hope that it will be useful,
 * but WITHOUT ANY WARRANTY; without even the implied warranty of
 * MERCHANTABILITY or FITNESS FOR A PARTICULAR PURPOSE.  See the
 * GNU General Public License for more details.
 */

/*---------------------------------------------------------------------------
 * This file is autogenerated file using gcdb parser. Please do not edit it.
 * Update input XML file to add a new entry or update variable in this file
 * VERSION = "1.0"
 *---------------------------------------------------------------------------*/
&mdss_mdp {
	dsi_ebbgnt35521_720p_vid: qcom,mdss_dsi_ebbgnt35521_720p_video {
		qcom,mdss-dsi-panel-name = "ebbg nt35521 720p video mode dsi panel";
		qcom,mdss-dsi-panel-controller = <&mdss_dsi0>;
		qcom,mdss-dsi-panel-type = "dsi_video_mode";
		qcom,mdss-dsi-panel-destination = "display_1";
		qcom,cont-splash-enabled;
		qcom,mdss-dsi-panel-framerate = <60>;
		qcom,mdss-dsi-virtual-channel-id = <0>;
		qcom,mdss-dsi-stream = <0>;
		qcom,mdss-dsi-panel-width = <720>;
		qcom,mdss-dsi-panel-height = <1280>;
		qcom,mdss-dsi-h-front-porch = <180>;
		qcom,mdss-dsi-h-back-porch = <180>;
		qcom,mdss-dsi-h-pulse-width = <2>;
		qcom,mdss-dsi-h-sync-skew = <0>;
		qcom,mdss-dsi-v-back-porch = <12>;
		qcom,mdss-dsi-v-front-porch = <20>;
		qcom,mdss-dsi-v-pulse-width = <2>;
		qcom,mdss-dsi-h-left-border = <0>;
		qcom,mdss-dsi-h-right-border = <0>;
		qcom,mdss-dsi-v-top-border = <0>;
		qcom,mdss-dsi-v-bottom-border = <0>;
		qcom,mdss-dsi-bpp = <24>;
		qcom,mdss-dsi-underflow-color = <0xff>;
		qcom,mdss-dsi-border-color = <0>;
		qcom,mdss-dsi-pixel-packing = "tight";
		qcom,mdss-dsi-on-command = [
				39 01 00 00 00 00 06 F0 55 AA 52 08 01
				39 01 00 00 00 00 03 B8 05 05
				39 01 00 00 00 00 06 F0 55 AA 52 08 00
				23 01 00 00 00 00 02 C8 83
				29 01 00 00 00 00 02 51 FF
				29 01 00 00 00 00 02 53 2C
				29 01 00 00 00 00 02 55 01
				29 01 00 00 00 00 06 F0 55 AA 52 08 00
				29 01 00 00 00 00 05 E6 FF FE FA FA
				05 01 00 00 78 00 02 11 00
				05 01 00 00 23 00 02 29 00
				];
		qcom,mdss-dsi-off-command = [05 01 00 00 64 00 02 28 00
				05 01 00 00 00 00 02 10 00];
		ceon-command = [
				29 01 00 00 00 00 02 55 90
				29 01 00 00 00 00 06 F0 55 AA 52 08 00
				29 01 00 00 00 00 11 CC 40 36 87 00 00 00 00 00 00 00 00 00 40 08 A5 05
				29 01 00 00 00 00 11 D1 00 02 04 08 10 12 14 16 18 18 16 14 12 0E 08 00
				29 01 00 00 00 00 0D D7 26 28 25 23 23 00 00 00 00 00 00 00
				29 01 00 00 00 00 0E D8 00 00 00 00 00 00 00 00 00 00 23 25 00
				];
		ceoff-command = [
				15 01 00 00 10 00 02 55 01
				];
		warm-command = [
				29 01 00 00 00 00 06 F0 55 AA 52 08 02
				29 01 00 00 00 00 02 EE 03
				29 01 00 00 00 00 11 B0 00 00 00 13 00 38 00 55 00 6D 00 94 00 B4 00 E8
				29 01 00 00 00 00 11 B1 01 10 01 4D 01 7F 01 C9 02 04 02 06 02 3E 02 7E
				29 01 00 00 00 00 11 B2 02 A8 02 DE 03 05 03 34 03 53 03 7A 03 94 03 AC
				29 01 00 00 00 00 05 B3 03 B9 03 BE
				29 01 00 00 00 00 11 B4 00 E9 00 EE 00 F8 01 01 01 09 01 19 01 28 01 44
				29 01 00 00 00 00 11 B5 01 5D 01 88 01 AC 01 E7 02 1A 02 1B 02 4F 02 8E
				29 01 00 00 00 00 11 B6 02 B8 02 EC 03 11 03 3E 03 5A 03 7B 03 8E 03 A5
				29 01 00 00 00 00 05 B7 03 B9 03 BE
				29 01 00 00 00 00 11 B8 00 A8 00 AD 00 BA 00 C7 00 D3 00 E9 00 FD 01 1F
				29 01 00 00 00 00 11 B9 01 3C 01 6F 01 97 01 D9 02 10 02 12 02 47 02 88
				29 01 00 00 00 00 11 BA 02 B4 02 ED 03 19 03 49 03 6B 03 99 03 B3 03 BE
				29 01 00 00 00 00 05 BB 03 C7 03 BE
				];
		default-command = [
				29 01 00 00 00 00 06 F0 55 AA 52 08 02
				29 01 00 00 00 00 02 EE 03
				29 01 00 00 00 00 11 B0 00 00 00 16 00 40 00 5F 00 78 00 9D 00 BF 00 F2
				29 01 00 00 00 00 11 B1 01 1A 01 55 01 83 01 CB 02 07 02 09 02 4A 02 8F
				29 01 00 00 00 00 11 B2 02 BA 02 F9 03 21 03 52 03 6E 03 94 03 AB 03 BD
				29 01 00 00 00 00 05 B3 03 CC 03 CD
				29 01 00 00 00 00 11 B4 00 B9 00 C0 00 CD 00 D9 00 E4 00 F9 01 0C 01 2E
				29 01 00 00 00 00 11 B5 01 49 01 78 01 9D 01 DD 02 13 02 15 02 55 02 99
				29 01 00 00 00 00 11 B6 02 C5 03 00 03 27 03 54 03 70 03 93 03 AB 03 BD
				29 01 00 00 00 00 05 B7 03 CC 03 CD
				29 01 00 00 00 00 11 B8 00 00 00 11 00 33 00 4D 00 65 00 8B 00 AB 00 E0
				29 01 00 00 00 00 11 B9 01 08 01 49 01 78 01 C4 02 03 02 05 02 47 02 8E
				29 01 00 00 00 00 11 BA 02 BB 02 F8 03 20 03 5A 03 77 03 9C 03 AC 03 BD
				29 01 00 00 00 00 05 BB 03 CC 03 CD
				];
		cold-command = [
				29 01 00 00 00 00 06 F0 55 AA 52 08 02
				29 01 00 00 00 00 02 EE 03
				29 01 00 00 00 00 11 B0 00 C4 00 CA 00 D8 00 E3 00 ED 01 01 01 14 01 34
				29 01 00 00 00 00 11 B1 01 50 01 81 01 AA 01 ED 02 25 02 28 02 60 02 9E
				29 01 00 00 00 00 11 B2 02 C7 03 01 03 26 03 55 03 71 03 95 03 AA 03 C0
				29 01 00 00 00 00 05 B3 03 CA 03 CD
				29 01 00 00 00 00 11 B4 01 03 01 07 01 10 01 18 01 20 01 2F 01 3E 01 58
				29 01 00 00 00 00 11 B5 01 71 01 9A 01 BD 01 FA 02 2F 02 31 02 68 02 A7
				29 01 00 00 00 00 11 B6 02 CF 03 07 03 2C 03 5A 03 74 03 93 03 A3 03 B6
				29 01 00 00 00 00 05 B7 03 CA 03 CD
				29 01 00 00 00 00 11 B8 00 00 00 10 00 33 00 4E 00 65 00 8C 00 AF 00 E4
				29 01 00 00 00 00 11 B9 01 0E 01 4F 01 86 01 D6 02 15 02 18 02 54 02 95
				29 01 00 00 00 00 11 BA 02 C0 02 FF 03 28 03 50 03 79 03 A1 03 C4 03 CF
				29 01 00 00 00 00 05 BB 03 D6 03 CD
				];
		qcom,mdss-dsi-on-command-state = "dsi_lp_mode";
		qcom,mdss-dsi-off-command-state = "dsi_lp_mode";
		qcom,mdss-extra-command-state = "dsi_lp_mode";
		qcom,mdss-dsi-panel-status-command = [06 01 00 01 05 00 02 0A 08];
		qcom,mdss-dsi-panel-status-command-state = "dsi_lp_mode";
		qcom,mdss-dsi-panel-status-check-mode = "reg_read";
		qcom,mdss-dsi-panel-status-value = <0x9c>;
		qcom,esd-check-enabled;
		qcom,mdss-dsi-h-sync-pulse = <1>;
		qcom,mdss-dsi-traffic-mode = "burst_mode";
		qcom,mdss-dsi-bllp-eof-power-mode;
		qcom,mdss-dsi-bllp-power-mode;
		qcom,mdss-dsi-lane-0-state;
		qcom,mdss-dsi-lane-1-state;
		qcom,mdss-dsi-lane-2-state;
		qcom,mdss-dsi-lane-3-state;
		qcom,mdss-dsi-panel-timings = [94 20 14 00 46 4a 1a 24 18 03 04 00];
		qcom,mdss-dsi-t-clk-post = <0x20>;
		qcom,mdss-dsi-t-clk-pre = <0x2D>;
		qcom,mdss-dsi-bl-min-level = <1>;
		qcom,mdss-dsi-bl-max-level = <64>;
		qcom,mdss-dsi-dma-trigger = "trigger_sw";
		qcom,mdss-dsi-mdp-trigger = "none";
		qcom,mdss-dsi-bl-pmic-control-type = "bl_ctrl_gpio";
		qcom,mdss-dsi-pulse-gpio = <&msm_gpio 98 0>;
		qcom,mdss-dsi-reset-sequence = <1 20>, <0 20>, <1 120>;
		qcom,mdss-pan-physical-width-dimension = <68>;
		qcom,mdss-pan-physical-height-dimension = <121>;

	};
};

