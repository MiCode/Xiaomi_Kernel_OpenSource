/* Copyright (c) 2013-2014, The Linux Foundation. All rights reserved.
 * Copyright (C) 2017 XiaoMi, Inc.
 *
 * This program is free software; you can redistribute it and/or modify
 * it under the terms of the GNU General Public License version 2 and
 * only version 2 as published by the Free Software Foundation.
 *
 * This program is distributed in the hope that it will be useful,
 * but WITHOUT ANY WARRANTY; without even the implied warranty of
 * MERCHANTABILITY or FITNESS FOR A PARTICULAR PURPOSE.  See the
 * GNU General Public License for more details.
 */

&mdss_mdp {
	dsi_nt35596_1080_vid: qcom,mdss_dsi_nt35596_ebbg_1080p_video {
		qcom,mdss-dsi-panel-name = "nt35596_1080p_video_EBBG";
		qcom,mdss-dsi-panel-controller = <&mdss_dsi0>;
		qcom,mdss-dsi-panel-type = "dsi_video_mode";
		qcom,mdss-dsi-panel-destination = "display_1";
		qcom,mdss-dsi-panel-framerate = <60>;
		qcom,mdss-dsi-virtual-channel-id = <0>;
		qcom,mdss-dsi-stream = <0>;
		qcom,mdss-dsi-panel-width = <1080>;
		qcom,mdss-dsi-panel-height = <1920>;
		qcom,mdss-dsi-h-front-porch = <124>;
		qcom,mdss-dsi-h-back-porch = <120>;
		qcom,mdss-dsi-h-pulse-width = <4>;
		qcom,mdss-dsi-h-sync-skew = <0>;
		qcom,mdss-dsi-v-back-porch = <15>;
		qcom,mdss-dsi-v-front-porch = <8>;
		qcom,mdss-dsi-v-pulse-width = <5>;
		qcom,mdss-dsi-h-left-border = <0>;
		qcom,mdss-dsi-h-right-border = <0>;
		qcom,mdss-dsi-v-top-border = <0>;
		qcom,mdss-dsi-v-bottom-border = <0>;
		qcom,mdss-dsi-bpp = <24>;
		qcom,mdss-dsi-underflow-color = <0xff>;
		qcom,mdss-dsi-border-color = <0>;
		qcom,mdss-dsi-on-command = [29 01 00 00 00 00 02 FF EE
				29 01 00 00 0A 00 02 18 40
				29 01 00 00 0A 00 02 18 00
				29 01 00 00 00 00 02 FF 00
				29 01 00 00 00 00 02 35 00
				29 01 00 00 00 00 02 D3 14
				29 01 00 00 00 00 02 D4 08
				29 01 00 00 78 00 02 11 00
				29 01 00 00 0A 00 02 29 00];
		qcom,mdss-dsi-off-command = [05 01 00 00 32 00 02 28 00
					05 01 00 00 78 00 02 10 00];
		qcom,mdss-dsi-on-command-state = "dsi_lp_mode";
		qcom,mdss-dsi-off-command-state = "dsi_hs_mode";
		qcom,mdss-dsi-h-sync-pulse = <1>;
		qcom,mdss-dsi-traffic-mode = "burst_mode";
		qcom,mdss-dsi-bllp-eof-power-mode;
		qcom,mdss-dsi-bllp-power-mode;
		qcom,mdss-dsi-lane-0-state;
		qcom,mdss-dsi-lane-1-state;
		qcom,mdss-dsi-lane-2-state;
		qcom,mdss-dsi-lane-3-state;
		qcom,mdss-dsi-panel-timings = [F2 3A 28 00 6C 6E 2C 3E 2E 03 04 00];
		qcom,mdss-dsi-panel-timings-8996 = [24 1F 08 09 05 03 04 A0
				24 1F 08 09 05 03 04 A0
				24 1F 08 09 05 03 04 A0
				24 1F 08 09 05 03 04 A0
				24 1C 08 09 05 03 04 A0];
		qcom,mdss-dsi-t-clk-post = <0x2>;
		qcom,mdss-dsi-t-clk-pre = <0x2D>;
		qcom,mdss-dsi-bl-min-level = <1>;
		qcom,mdss-dsi-bl-max-level = <4095>;
		qcom,mdss-dsi-dma-trigger = "trigger_sw";
		qcom,mdss-dsi-mdp-trigger = "none";
		qcom,mdss-dsi-bl-pmic-control-type = "bl_ctrl_wled";
		qcom,mdss-dsi-reset-sequence = <1 20>, <0 10>, <1 20>, <0 10>, <1 20>;
		qcom,mdss-dsi-panel-warm-command = [29 01 00 00 00 00 02 FF 01
				29 00 00 00 00 00 02 75 00
				29 00 00 00 00 00 02 76 33
				29 00 00 00 00 00 02 77 00
				29 00 00 00 00 00 02 78 40
				29 00 00 00 00 00 02 79 00
				29 00 00 00 00 00 02 7A 5B
				29 00 00 00 00 00 02 7B 00
				29 00 00 00 00 00 02 7C 77
				29 00 00 00 00 00 02 7D 00
				29 00 00 00 00 00 02 7E 93
				29 00 00 00 00 00 02 7F 00
				29 00 00 00 00 00 02 80 A4
				29 00 00 00 00 00 02 81 00
				29 00 00 00 00 00 02 82 B4
				29 00 00 00 00 00 02 83 00
				29 00 00 00 00 00 02 84 C1
				29 00 00 00 00 00 02 85 00
				29 00 00 00 00 00 02 86 CB
				29 00 00 00 00 00 02 87 00
				29 00 00 00 00 00 02 88 FD
				29 00 00 00 00 00 02 89 01
				29 00 00 00 00 00 02 8A 20
				29 00 00 00 00 00 02 8B 01
				29 00 00 00 00 00 02 8C 5D
				29 00 00 00 00 00 02 8D 01
				29 00 00 00 00 00 02 8E 8A
				29 00 00 00 00 00 02 8F 01
				29 00 00 00 00 00 02 90 D4
				29 00 00 00 00 00 02 91 02
				29 00 00 00 00 00 02 92 12
				29 00 00 00 00 00 02 93 02
				29 00 00 00 00 00 02 94 14
				29 00 00 00 00 00 02 95 02
				29 00 00 00 00 00 02 96 4B
				29 00 00 00 00 00 02 97 02
				29 00 00 00 00 00 02 98 88
				29 00 00 00 00 00 02 99 02
				29 00 00 00 00 00 02 9A AC
				29 00 00 00 00 00 02 9B 02
				29 00 00 00 00 00 02 9C E2
				29 00 00 00 00 00 02 9D 03
				29 00 00 00 00 00 02 9E 0A
				29 00 00 00 00 00 02 9F 03
				29 00 00 00 00 00 02 A0 33
				29 00 00 00 00 00 02 A2 03
				29 00 00 00 00 00 02 A3 42
				29 00 00 00 00 00 02 A4 03
				29 00 00 00 00 00 02 A5 51
				29 00 00 00 00 00 02 A6 03
				29 00 00 00 00 00 02 A7 5F
				29 00 00 00 00 00 02 A9 03
				29 00 00 00 00 00 02 AA 72
				29 00 00 00 00 00 02 AB 03
				29 00 00 00 00 00 02 AC 88
				29 00 00 00 00 00 02 AD 03
				29 00 00 00 00 00 02 AE AB
				29 00 00 00 00 00 02 AF 03
				29 00 00 00 00 00 02 B0 C9
				29 00 00 00 00 00 02 B1 03
				29 00 00 00 00 00 02 B2 CB
				29 00 00 00 00 00 02 B3 00
				29 00 00 00 00 00 02 B4 33
				29 00 00 00 00 00 02 B5 00
				29 00 00 00 00 00 02 B6 40
				29 00 00 00 00 00 02 B7 00
				29 00 00 00 00 00 02 B8 5B
				29 00 00 00 00 00 02 B9 00
				29 00 00 00 00 00 02 BA 77
				29 00 00 00 00 00 02 BB 00
				29 00 00 00 00 00 02 BC 93
				29 00 00 00 00 00 02 BD 00
				29 00 00 00 00 00 02 BE A4
				29 00 00 00 00 00 02 BF 00
				29 00 00 00 00 00 02 C0 B4
				29 00 00 00 00 00 02 C1 00
				29 00 00 00 00 00 02 C2 C1
				29 00 00 00 00 00 02 C3 00
				29 00 00 00 00 00 02 C4 CB
				29 00 00 00 00 00 02 C5 00
				29 00 00 00 00 00 02 C6 FD
				29 00 00 00 00 00 02 C7 01
				29 00 00 00 00 00 02 C8 20
				29 00 00 00 00 00 02 C9 01
				29 00 00 00 00 00 02 CA 5D
				29 00 00 00 00 00 02 CB 01
				29 00 00 00 00 00 02 CC 8A
				29 00 00 00 00 00 02 CD 01
				29 00 00 00 00 00 02 CE D4
				29 00 00 00 00 00 02 CF 02
				29 00 00 00 00 00 02 D0 12
				29 00 00 00 00 00 02 D1 02
				29 00 00 00 00 00 02 D2 14
				29 00 00 00 00 00 02 D3 02
				29 00 00 00 00 00 02 D4 4B
				29 00 00 00 00 00 02 D5 02
				29 00 00 00 00 00 02 D6 88
				29 00 00 00 00 00 02 D7 02
				29 00 00 00 00 00 02 D8 AC
				29 00 00 00 00 00 02 D9 02
				29 00 00 00 00 00 02 DA E2
				29 00 00 00 00 00 02 DB 03
				29 00 00 00 00 00 02 DC 0A
				29 00 00 00 00 00 02 DD 03
				29 00 00 00 00 00 02 DE 33
				29 00 00 00 00 00 02 DF 03
				29 00 00 00 00 00 02 E0 42
				29 00 00 00 00 00 02 E1 03
				29 00 00 00 00 00 02 E2 51
				29 00 00 00 00 00 02 E3 03
				29 00 00 00 00 00 02 E4 5F
				29 00 00 00 00 00 02 E5 03
				29 00 00 00 00 00 02 E6 72
				29 00 00 00 00 00 02 E7 03
				29 00 00 00 00 00 02 E8 88
				29 00 00 00 00 00 02 E9 03
				29 00 00 00 00 00 02 EA AB
				29 00 00 00 00 00 02 EB 03
				29 00 00 00 00 00 02 EC C9
				29 00 00 00 00 00 02 ED 03
				29 00 00 00 00 00 02 EE CB
				29 00 00 00 00 00 02 EF 00
				29 00 00 00 00 00 02 F0 CB
				29 00 00 00 00 00 02 F1 00
				29 00 00 00 00 00 02 F2 D2
				29 00 00 00 00 00 02 F3 00
				29 00 00 00 00 00 02 F4 DD
				29 00 00 00 00 00 02 F5 00
				29 00 00 00 00 00 02 F6 E7
				29 00 00 00 00 00 02 F7 00
				29 00 00 00 00 00 02 F8 F1
				29 00 00 00 00 00 02 F9 00
				29 01 00 00 00 00 02 FA FA
				29 01 00 00 00 00 02 FB 01
				29 01 00 00 00 00 02 FF 02
				29 00 00 00 00 00 02 00 01
				29 00 00 00 00 00 02 01 04
				29 00 00 00 00 00 02 02 01
				29 00 00 00 00 00 02 03 0D
				29 00 00 00 00 00 02 04 01
				29 00 00 00 00 00 02 05 16
				29 00 00 00 00 00 02 06 01
				29 00 00 00 00 00 02 07 36
				29 00 00 00 00 00 02 08 01
				29 00 00 00 00 00 02 09 50
				29 00 00 00 00 00 02 0A 01
				29 00 00 00 00 00 02 0B 7E
				29 00 00 00 00 00 02 0C 01
				29 00 00 00 00 00 02 0D A5
				29 00 00 00 00 00 02 0E 01
				29 00 00 00 00 00 02 0F E7
				29 00 00 00 00 00 02 10 02
				29 00 00 00 00 00 02 11 1E
				29 00 00 00 00 00 02 12 02
				29 00 00 00 00 00 02 13 20
				29 00 00 00 00 00 02 14 02
				29 00 00 00 00 00 02 15 54
				29 00 00 00 00 00 02 16 02
				29 00 00 00 00 00 02 17 91
				29 00 00 00 00 00 02 18 02
				29 00 00 00 00 00 02 19 B8
				29 00 00 00 00 00 02 1A 02
				29 00 00 00 00 00 02 1B EB
				29 00 00 00 00 00 02 1C 03
				29 00 00 00 00 00 02 1D 0D
				29 00 00 00 00 00 02 1E 03
				29 00 00 00 00 00 02 1F 36
				29 00 00 00 00 00 02 20 03
				29 00 00 00 00 00 02 21 44
				29 00 00 00 00 00 02 22 03
				29 00 00 00 00 00 02 23 52
				29 00 00 00 00 00 02 24 03
				29 00 00 00 00 00 02 25 61
				29 00 00 00 00 00 02 26 03
				29 00 00 00 00 00 02 27 74
				29 00 00 00 00 00 02 28 03
				29 00 00 00 00 00 02 29 89
				29 00 00 00 00 00 02 2A 03
				29 00 00 00 00 00 02 2B 9E
				29 00 00 00 00 00 02 2D 03
				29 00 00 00 00 00 02 2F C5
				29 00 00 00 00 00 02 30 03
				29 00 00 00 00 00 02 31 CB
				29 00 00 00 00 00 02 32 00
				29 00 00 00 00 00 02 33 CB
				29 00 00 00 00 00 02 34 00
				29 00 00 00 00 00 02 35 D2
				29 00 00 00 00 00 02 36 00
				29 00 00 00 00 00 02 37 DD
				29 00 00 00 00 00 02 38 00
				29 00 00 00 00 00 02 39 E7
				29 00 00 00 00 00 02 3A 00
				29 00 00 00 00 00 02 3B F1
				29 00 00 00 00 00 02 3D 00
				29 00 00 00 00 00 02 3F FA
				29 00 00 00 00 00 02 40 01
				29 00 00 00 00 00 02 41 04
				29 00 00 00 00 00 02 42 01
				29 00 00 00 00 00 02 43 0D
				29 00 00 00 00 00 02 44 01
				29 00 00 00 00 00 02 45 16
				29 00 00 00 00 00 02 46 01
				29 00 00 00 00 00 02 47 36
				29 00 00 00 00 00 02 48 01
				29 00 00 00 00 00 02 49 50
				29 00 00 00 00 00 02 4A 01
				29 00 00 00 00 00 02 4B 7E
				29 00 00 00 00 00 02 4C 01
				29 00 00 00 00 00 02 4D A5
				29 00 00 00 00 00 02 4E 01
				29 00 00 00 00 00 02 4F E7
				29 00 00 00 00 00 02 50 02
				29 00 00 00 00 00 02 51 1E
				29 00 00 00 00 00 02 52 02
				29 00 00 00 00 00 02 53 20
				29 00 00 00 00 00 02 54 02
				29 00 00 00 00 00 02 55 54
				29 00 00 00 00 00 02 56 02
				29 00 00 00 00 00 02 58 91
				29 00 00 00 00 00 02 59 02
				29 00 00 00 00 00 02 5A B8
				29 00 00 00 00 00 02 5B 02
				29 00 00 00 00 00 02 5C EB
				29 00 00 00 00 00 02 5D 03
				29 00 00 00 00 00 02 5E 0D
				29 00 00 00 00 00 02 5F 03
				29 00 00 00 00 00 02 60 36
				29 00 00 00 00 00 02 61 03
				29 00 00 00 00 00 02 62 44
				29 00 00 00 00 00 02 63 03
				29 00 00 00 00 00 02 64 52
				29 00 00 00 00 00 02 65 03
				29 00 00 00 00 00 02 66 61
				29 00 00 00 00 00 02 67 03
				29 00 00 00 00 00 02 68 74
				29 00 00 00 00 00 02 69 03
				29 00 00 00 00 00 02 6A 89
				29 00 00 00 00 00 02 6B 03
				29 00 00 00 00 00 02 6C 9E
				29 00 00 00 00 00 02 6D 03
				29 00 00 00 00 00 02 6E C5
				29 00 00 00 00 00 02 6F 03
				29 00 00 00 00 00 02 70 CB
				29 00 00 00 00 00 02 71 00
				29 00 00 00 00 00 02 72 F2
				29 00 00 00 00 00 02 73 00
				29 00 00 00 00 00 02 74 F6
				29 00 00 00 00 00 02 75 00
				29 00 00 00 00 00 02 76 FE
				29 00 00 00 00 00 02 77 01
				29 00 00 00 00 00 02 78 07
				29 00 00 00 00 00 02 79 01
				29 00 00 00 00 00 02 7A 0F
				29 00 00 00 00 00 02 7B 01
				29 00 00 00 00 00 02 7C 17
				29 00 00 00 00 00 02 7D 01
				29 00 00 00 00 00 02 7E 1E
				29 00 00 00 00 00 02 7F 01
				29 00 00 00 00 00 02 80 24
				29 00 00 00 00 00 02 81 01
				29 00 00 00 00 00 02 82 2B
				29 00 00 00 00 00 02 83 01
				29 00 00 00 00 00 02 84 48
				29 00 00 00 00 00 02 85 01
				29 00 00 00 00 00 02 86 5F
				29 00 00 00 00 00 02 87 01
				29 00 00 00 00 00 02 88 88
				29 00 00 00 00 00 02 89 01
				29 00 00 00 00 00 02 8A AF
				29 00 00 00 00 00 02 8B 01
				29 00 00 00 00 00 02 8C EC
				29 00 00 00 00 00 02 8D 02
				29 00 00 00 00 00 02 8E 22
				29 00 00 00 00 00 02 8F 02
				29 00 00 00 00 00 02 90 23
				29 00 00 00 00 00 02 91 02
				29 00 00 00 00 00 02 92 57
				29 00 00 00 00 00 02 93 02
				29 00 00 00 00 00 02 94 93
				29 00 00 00 00 00 02 95 02
				29 00 00 00 00 00 02 96 BA
				29 00 00 00 00 00 02 97 02
				29 00 00 00 00 00 02 98 EF
				29 00 00 00 00 00 02 99 03
				29 00 00 00 00 00 02 9A 08
				29 00 00 00 00 00 02 9B 03
				29 00 00 00 00 00 02 9C 29
				29 00 00 00 00 00 02 9D 03
				29 00 00 00 00 00 02 9E 33
				29 00 00 00 00 00 02 9F 03
				29 00 00 00 00 00 02 A0 42
				29 00 00 00 00 00 02 A2 03
				29 00 00 00 00 00 02 A3 52
				29 00 00 00 00 00 02 A4 03
				29 00 00 00 00 00 02 A5 63
				29 00 00 00 00 00 02 A6 03
				29 00 00 00 00 00 02 A7 7B
				29 00 00 00 00 00 02 A9 03
				29 00 00 00 00 00 02 AA 9B
				29 00 00 00 00 00 02 AB 03
				29 00 00 00 00 00 02 AC C7
				29 00 00 00 00 00 02 AD 03
				29 00 00 00 00 00 02 AE CB
				29 00 00 00 00 00 02 AF 00
				29 00 00 00 00 00 02 B0 F2
				29 00 00 00 00 00 02 B1 00
				29 00 00 00 00 00 02 B2 F6
				29 00 00 00 00 00 02 B3 00
				29 00 00 00 00 00 02 B4 FE
				29 00 00 00 00 00 02 B5 01
				29 00 00 00 00 00 02 B6 07
				29 00 00 00 00 00 02 B7 01
				29 00 00 00 00 00 02 B8 0F
				29 00 00 00 00 00 02 B9 01
				29 00 00 00 00 00 02 BA 17
				29 00 00 00 00 00 02 BB 01
				29 00 00 00 00 00 02 BC 1E
				29 00 00 00 00 00 02 BD 01
				29 00 00 00 00 00 02 BE 24
				29 00 00 00 00 00 02 BF 01
				29 00 00 00 00 00 02 C0 2B
				29 00 00 00 00 00 02 C1 01
				29 00 00 00 00 00 02 C2 48
				29 00 00 00 00 00 02 C3 01
				29 00 00 00 00 00 02 C4 5F
				29 00 00 00 00 00 02 C5 01
				29 00 00 00 00 00 02 C6 88
				29 00 00 00 00 00 02 C7 01
				29 00 00 00 00 00 02 C8 AF
				29 00 00 00 00 00 02 C9 01
				29 00 00 00 00 00 02 CA EC
				29 00 00 00 00 00 02 CB 02
				29 00 00 00 00 00 02 CC 22
				29 00 00 00 00 00 02 CD 02
				29 00 00 00 00 00 02 CE 23
				29 00 00 00 00 00 02 CF 02
				29 00 00 00 00 00 02 D0 57
				29 00 00 00 00 00 02 D1 02
				29 00 00 00 00 00 02 D2 93
				29 00 00 00 00 00 02 D3 02
				29 00 00 00 00 00 02 D4 BA
				29 00 00 00 00 00 02 D5 02
				29 00 00 00 00 00 02 D6 EF
				29 00 00 00 00 00 02 D7 03
				29 00 00 00 00 00 02 D8 08
				29 00 00 00 00 00 02 D9 03
				29 00 00 00 00 00 02 DA 29
				29 00 00 00 00 00 02 DB 03
				29 00 00 00 00 00 02 DC 33
				29 00 00 00 00 00 02 DD 03
				29 00 00 00 00 00 02 DE 42
				29 00 00 00 00 00 02 DF 03
				29 00 00 00 00 00 02 E0 52
				29 00 00 00 00 00 02 E1 03
				29 00 00 00 00 00 02 E2 63
				29 00 00 00 00 00 02 E3 03
				29 00 00 00 00 00 02 E4 7B
				29 00 00 00 00 00 02 E5 03
				29 00 00 00 00 00 02 E6 9B
				29 00 00 00 00 00 02 E7 03
				29 00 00 00 00 00 02 E8 C7
				29 00 00 00 00 00 02 E9 03
				29 01 00 00 00 00 02 EA CB
				29 01 00 00 00 00 02 FB 01];
		qcom,mdss-dsi-panel-cool-command = [29 01 00 00 00 00 02 FF 01
				29 00 00 00 00 00 02 75 00
				29 00 00 00 00 00 02 76 B0
				29 00 00 00 00 00 02 77 00
				29 00 00 00 00 00 02 78 B9
				29 00 00 00 00 00 02 79 00
				29 00 00 00 00 00 02 7A C5
				29 00 00 00 00 00 02 7B 00
				29 00 00 00 00 00 02 7C D0
				29 00 00 00 00 00 02 7D 00
				29 00 00 00 00 00 02 7E DE
				29 00 00 00 00 00 02 7F 00
				29 00 00 00 00 00 02 80 EF
				29 00 00 00 00 00 02 81 00
				29 00 00 00 00 00 02 82 FB
				29 00 00 00 00 00 02 83 01
				29 00 00 00 00 00 02 84 05
				29 00 00 00 00 00 02 85 01
				29 00 00 00 00 00 02 86 0E
				29 00 00 00 00 00 02 87 01
				29 00 00 00 00 00 02 88 2F
				29 00 00 00 00 00 02 89 01
				29 00 00 00 00 00 02 8A 53
				29 00 00 00 00 00 02 8B 01
				29 00 00 00 00 00 02 8C 81
				29 00 00 00 00 00 02 8D 01
				29 00 00 00 00 00 02 8E AB
				29 00 00 00 00 00 02 8F 01
				29 00 00 00 00 00 02 90 F1
				29 00 00 00 00 00 02 91 02
				29 00 00 00 00 00 02 92 29
				29 00 00 00 00 00 02 93 02
				29 00 00 00 00 00 02 94 2A
				29 00 00 00 00 00 02 95 02
				29 00 00 00 00 00 02 96 60
				29 00 00 00 00 00 02 97 02
				29 00 00 00 00 00 02 98 9F
				29 00 00 00 00 00 02 99 02
				29 00 00 00 00 00 02 9A C7
				29 00 00 00 00 00 02 9B 02
				29 00 00 00 00 00 02 9C FD
				29 00 00 00 00 00 02 9D 03
				29 00 00 00 00 00 02 9E 1F
				29 00 00 00 00 00 02 9F 03
				29 00 00 00 00 00 02 A0 4A
				29 00 00 00 00 00 02 A2 03
				29 00 00 00 00 00 02 A3 58
				29 00 00 00 00 00 02 A4 03
				29 00 00 00 00 00 02 A5 63
				29 00 00 00 00 00 02 A6 03
				29 00 00 00 00 00 02 A7 75
				29 00 00 00 00 00 02 A9 03
				29 00 00 00 00 00 02 AA 86
				29 00 00 00 00 00 02 AB 03
				29 00 00 00 00 00 02 AC 9E
				29 00 00 00 00 00 02 AD 03
				29 00 00 00 00 00 02 AE C5
				29 00 00 00 00 00 02 AF 03
				29 00 00 00 00 00 02 B0 CA
				29 00 00 00 00 00 02 B1 03
				29 00 00 00 00 00 02 B2 CB
				29 00 00 00 00 00 02 B3 00
				29 00 00 00 00 00 02 B4 B0
				29 00 00 00 00 00 02 B5 00
				29 00 00 00 00 00 02 B6 B9
				29 00 00 00 00 00 02 B7 00
				29 00 00 00 00 00 02 B8 C5
				29 00 00 00 00 00 02 B9 00
				29 00 00 00 00 00 02 BA D0
				29 00 00 00 00 00 02 BB 00
				29 00 00 00 00 00 02 BC DE
				29 00 00 00 00 00 02 BD 00
				29 00 00 00 00 00 02 BE EF
				29 00 00 00 00 00 02 BF 00
				29 00 00 00 00 00 02 C0 FB
				29 00 00 00 00 00 02 C1 01
				29 00 00 00 00 00 02 C2 05
				29 00 00 00 00 00 02 C3 01
				29 00 00 00 00 00 02 C4 0E
				29 00 00 00 00 00 02 C5 01
				29 00 00 00 00 00 02 C6 2F
				29 00 00 00 00 00 02 C7 01
				29 00 00 00 00 00 02 C8 53
				29 00 00 00 00 00 02 C9 01
				29 00 00 00 00 00 02 CA 81
				29 00 00 00 00 00 02 CB 01
				29 00 00 00 00 00 02 CC AB
				29 00 00 00 00 00 02 CD 01
				29 00 00 00 00 00 02 CE F1
				29 00 00 00 00 00 02 CF 02
				29 00 00 00 00 00 02 D0 29
				29 00 00 00 00 00 02 D1 02
				29 00 00 00 00 00 02 D2 2A
				29 00 00 00 00 00 02 D3 02
				29 00 00 00 00 00 02 D4 60
				29 00 00 00 00 00 02 D5 02
				29 00 00 00 00 00 02 D6 9F
				29 00 00 00 00 00 02 D7 02
				29 00 00 00 00 00 02 D8 C7
				29 00 00 00 00 00 02 D9 02
				29 00 00 00 00 00 02 DA FD
				29 00 00 00 00 00 02 DB 03
				29 00 00 00 00 00 02 DC 1F
				29 00 00 00 00 00 02 DD 03
				29 00 00 00 00 00 02 DE 4A
				29 00 00 00 00 00 02 DF 03
				29 00 00 00 00 00 02 E0 58
				29 00 00 00 00 00 02 E1 03
				29 00 00 00 00 00 02 E2 63
				29 00 00 00 00 00 02 E3 03
				29 00 00 00 00 00 02 E4 75
				29 00 00 00 00 00 02 E5 03
				29 00 00 00 00 00 02 E6 86
				29 00 00 00 00 00 02 E7 03
				29 00 00 00 00 00 02 E8 9E
				29 00 00 00 00 00 02 E9 03
				29 00 00 00 00 00 02 EA C5
				29 00 00 00 00 00 02 EB 03
				29 00 00 00 00 00 02 EC CA
				29 00 00 00 00 00 02 ED 03
				29 00 00 00 00 00 02 EE CB
				29 00 00 00 00 00 02 EF 00
				29 00 00 00 00 00 02 F0 9E
				29 00 00 00 00 00 02 F1 00
				29 00 00 00 00 00 02 F2 A6
				29 00 00 00 00 00 02 F3 00
				29 00 00 00 00 00 02 F4 B7
				29 00 00 00 00 00 02 F5 00
				29 00 00 00 00 00 02 F6 C6
				29 00 00 00 00 00 02 F7 00
				29 00 00 00 00 00 02 F8 D5
				29 00 00 00 00 00 02 F9 00
				29 01 00 00 00 00 02 FA E1
				29 01 00 00 00 00 02 FB 01
				29 01 00 00 00 00 02 FF 02
				29 00 00 00 00 00 02 00 00
				29 00 00 00 00 00 02 01 EC
				29 00 00 00 00 00 02 02 00
				29 00 00 00 00 00 02 03 F6
				29 00 00 00 00 00 02 04 01
				29 00 00 00 00 00 02 05 00
				29 00 00 00 00 00 02 06 01
				29 00 00 00 00 00 02 07 25
				29 00 00 00 00 00 02 08 01
				29 00 00 00 00 00 02 09 46
				29 00 00 00 00 00 02 0A 01
				29 00 00 00 00 00 02 0B 7A
				29 00 00 00 00 00 02 0C 01
				29 00 00 00 00 00 02 0D A6
				29 00 00 00 00 00 02 0E 01
				29 00 00 00 00 00 02 0F EC
				29 00 00 00 00 00 02 10 02
				29 00 00 00 00 00 02 11 26
				29 00 00 00 00 00 02 12 02
				29 00 00 00 00 00 02 13 28
				29 00 00 00 00 00 02 14 02
				29 00 00 00 00 00 02 15 5F
				29 00 00 00 00 00 02 16 02
				29 00 00 00 00 00 02 17 9F
				29 00 00 00 00 00 02 18 02
				29 00 00 00 00 00 02 19 C7
				29 00 00 00 00 00 02 1A 02
				29 00 00 00 00 00 02 1B FD
				29 00 00 00 00 00 02 1C 03
				29 00 00 00 00 00 02 1D 1F
				29 00 00 00 00 00 02 1E 03
				29 00 00 00 00 00 02 1F 4A
				29 00 00 00 00 00 02 20 03
				29 00 00 00 00 00 02 21 58
				29 00 00 00 00 00 02 22 03
				29 00 00 00 00 00 02 23 64
				29 00 00 00 00 00 02 24 03
				29 00 00 00 00 00 02 25 76
				29 00 00 00 00 00 02 26 03
				29 00 00 00 00 00 02 27 86
				29 00 00 00 00 00 02 28 03
				29 00 00 00 00 00 02 29 99
				29 00 00 00 00 00 02 2A 03
				29 00 00 00 00 00 02 2B AE
				29 00 00 00 00 00 02 2D 03
				29 00 00 00 00 00 02 2F C9
				29 00 00 00 00 00 02 30 03
				29 00 00 00 00 00 02 31 CB
				29 00 00 00 00 00 02 32 00
				29 00 00 00 00 00 02 33 9E
				29 00 00 00 00 00 02 34 00
				29 00 00 00 00 00 02 35 A6
				29 00 00 00 00 00 02 36 00
				29 00 00 00 00 00 02 37 B7
				29 00 00 00 00 00 02 38 00
				29 00 00 00 00 00 02 39 C6
				29 00 00 00 00 00 02 3A 00
				29 00 00 00 00 00 02 3B D5
				29 00 00 00 00 00 02 3D 00
				29 00 00 00 00 00 02 3F E1
				29 00 00 00 00 00 02 40 00
				29 00 00 00 00 00 02 41 EC
				29 00 00 00 00 00 02 42 00
				29 00 00 00 00 00 02 43 F6
				29 00 00 00 00 00 02 44 01
				29 00 00 00 00 00 02 45 00
				29 00 00 00 00 00 02 46 01
				29 00 00 00 00 00 02 47 25
				29 00 00 00 00 00 02 48 01
				29 00 00 00 00 00 02 49 46
				29 00 00 00 00 00 02 4A 01
				29 00 00 00 00 00 02 4B 7A
				29 00 00 00 00 00 02 4C 01
				29 00 00 00 00 00 02 4D A6
				29 00 00 00 00 00 02 4E 01
				29 00 00 00 00 00 02 4F EC
				29 00 00 00 00 00 02 50 02
				29 00 00 00 00 00 02 51 26
				29 00 00 00 00 00 02 52 02
				29 00 00 00 00 00 02 53 28
				29 00 00 00 00 00 02 54 02
				29 00 00 00 00 00 02 55 5F
				29 00 00 00 00 00 02 56 02
				29 00 00 00 00 00 02 58 9F
				29 00 00 00 00 00 02 59 02
				29 00 00 00 00 00 02 5A C7
				29 00 00 00 00 00 02 5B 02
				29 00 00 00 00 00 02 5C FD
				29 00 00 00 00 00 02 5D 03
				29 00 00 00 00 00 02 5E 1F
				29 00 00 00 00 00 02 5F 03
				29 00 00 00 00 00 02 60 4A
				29 00 00 00 00 00 02 61 03
				29 00 00 00 00 00 02 62 58
				29 00 00 00 00 00 02 63 03
				29 00 00 00 00 00 02 64 64
				29 00 00 00 00 00 02 65 03
				29 00 00 00 00 00 02 66 75
				29 00 00 00 00 00 02 67 03
				29 00 00 00 00 00 02 68 86
				29 00 00 00 00 00 02 69 03
				29 00 00 00 00 00 02 6A 99
				29 00 00 00 00 00 02 6B 03
				29 00 00 00 00 00 02 6C AE
				29 00 00 00 00 00 02 6D 03
				29 00 00 00 00 00 02 6E C9
				29 00 00 00 00 00 02 6F 03
				29 00 00 00 00 00 02 70 CB
				29 00 00 00 00 00 02 71 00
				29 00 00 00 00 00 02 72 30
				29 00 00 00 00 00 02 73 00
				29 00 00 00 00 00 02 74 3F
				29 00 00 00 00 00 02 75 00
				29 00 00 00 00 00 02 76 5C
				29 00 00 00 00 00 02 77 00
				29 00 00 00 00 00 02 78 72
				29 00 00 00 00 00 02 79 00
				29 00 00 00 00 00 02 7A 85
				29 00 00 00 00 00 02 7B 00
				29 00 00 00 00 00 02 7C 97
				29 00 00 00 00 00 02 7D 00
				29 00 00 00 00 00 02 7E A9
				29 00 00 00 00 00 02 7F 00
				29 00 00 00 00 00 02 80 BA
				29 00 00 00 00 00 02 81 00
				29 00 00 00 00 00 02 82 C7
				29 00 00 00 00 00 02 83 00
				29 00 00 00 00 00 02 84 F7
				29 00 00 00 00 00 02 85 01
				29 00 00 00 00 00 02 86 1E
				29 00 00 00 00 00 02 87 01
				29 00 00 00 00 00 02 88 5C
				29 00 00 00 00 00 02 89 01
				29 00 00 00 00 00 02 8A 8C
				29 00 00 00 00 00 02 8B 01
				29 00 00 00 00 00 02 8C DC
				29 00 00 00 00 00 02 8D 02
				29 00 00 00 00 00 02 8E 1B
				29 00 00 00 00 00 02 8F 02
				29 00 00 00 00 00 02 90 1D
				29 00 00 00 00 00 02 91 02
				29 00 00 00 00 00 02 92 56
				29 00 00 00 00 00 02 93 02
				29 00 00 00 00 00 02 94 98
				29 00 00 00 00 00 02 95 02
				29 00 00 00 00 00 02 96 C1
				29 00 00 00 00 00 02 97 02
				29 00 00 00 00 00 02 98 FB
				29 00 00 00 00 00 02 99 03
				29 00 00 00 00 00 02 9A 1D
				29 00 00 00 00 00 02 9B 03
				29 00 00 00 00 00 02 9C 47
				29 00 00 00 00 00 02 9D 03
				29 00 00 00 00 00 02 9E 54
				29 00 00 00 00 00 02 9F 03
				29 00 00 00 00 00 02 A0 60
				29 00 00 00 00 00 02 A2 03
				29 00 00 00 00 00 02 A3 72
				29 00 00 00 00 00 02 A4 03
				29 00 00 00 00 00 02 A5 82
				29 00 00 00 00 00 02 A6 03
				29 00 00 00 00 00 02 A7 9C
				29 00 00 00 00 00 02 A9 03
				29 00 00 00 00 00 02 AA C3
				29 00 00 00 00 00 02 AB 03
				29 00 00 00 00 00 02 AC C9
				29 00 00 00 00 00 02 AD 03
				29 00 00 00 00 00 02 AE CB
				29 00 00 00 00 00 02 AF 00
				29 00 00 00 00 00 02 B0 30
				29 00 00 00 00 00 02 B1 00
				29 00 00 00 00 00 02 B2 3F
				29 00 00 00 00 00 02 B3 00
				29 00 00 00 00 00 02 B4 5C
				29 00 00 00 00 00 02 B5 00
				29 00 00 00 00 00 02 B6 72
				29 00 00 00 00 00 02 B7 00
				29 00 00 00 00 00 02 B8 85
				29 00 00 00 00 00 02 B9 00
				29 00 00 00 00 00 02 BA 97
				29 00 00 00 00 00 02 BB 00
				29 00 00 00 00 00 02 BC A9
				29 00 00 00 00 00 02 BD 00
				29 00 00 00 00 00 02 BE BA
				29 00 00 00 00 00 02 BF 00
				29 00 00 00 00 00 02 C0 C7
				29 00 00 00 00 00 02 C1 00
				29 00 00 00 00 00 02 C2 F7
				29 00 00 00 00 00 02 C3 01
				29 00 00 00 00 00 02 C4 1E
				29 00 00 00 00 00 02 C5 01
				29 00 00 00 00 00 02 C6 5C
				29 00 00 00 00 00 02 C7 01
				29 00 00 00 00 00 02 C8 8C
				29 00 00 00 00 00 02 C9 01
				29 00 00 00 00 00 02 CA DC
				29 00 00 00 00 00 02 CB 02
				29 00 00 00 00 00 02 CC 1B
				29 00 00 00 00 00 02 CD 02
				29 00 00 00 00 00 02 CE 1D
				29 00 00 00 00 00 02 CF 02
				29 00 00 00 00 00 02 D0 56
				29 00 00 00 00 00 02 D1 02
				29 00 00 00 00 00 02 D2 98
				29 00 00 00 00 00 02 D3 02
				29 00 00 00 00 00 02 D4 C1
				29 00 00 00 00 00 02 D5 02
				29 00 00 00 00 00 02 D6 FB
				29 00 00 00 00 00 02 D7 03
				29 00 00 00 00 00 02 D8 1D
				29 00 00 00 00 00 02 D9 03
				29 00 00 00 00 00 02 DA 47
				29 00 00 00 00 00 02 DB 03
				29 00 00 00 00 00 02 DC 54
				29 00 00 00 00 00 02 DD 03
				29 00 00 00 00 00 02 DE 60
				29 00 00 00 00 00 02 DF 03
				29 00 00 00 00 00 02 E0 72
				29 00 00 00 00 00 02 E1 03
				29 00 00 00 00 00 02 E2 82
				29 00 00 00 00 00 02 E3 03
				29 00 00 00 00 00 02 E4 9C
				29 00 00 00 00 00 02 E5 03
				29 00 00 00 00 00 02 E6 C3
				29 00 00 00 00 00 02 E7 03
				29 00 00 00 00 00 02 E8 C9
				29 00 00 00 00 00 02 E9 03
				29 01 00 00 00 00 02 EA CB
				29 01 00 00 00 00 02 FB 01];
		qcom,mdss-dsi-panel-nature-command = [
				29 01 00 00 00 00 02 FB 00
				29 01 00 00 00 00 02 FF 00
				29 01 00 00 00 00 02 11 00];
		qcom,mdss-dsi-panel-ce-std-command = [29 01 00 00 00 00 02 FF 00
				29 01 00 00 00 00 02 55 00];
		qcom,mdss-dsi-panel-ce-bright-command = [29 01 00 00 00 00 02 FF 00
				29 01 00 00 00 00 02 55 80];
		qcom,mdss-dsi-panel-ce-vivid-command = [29 01 00 00 00 00 02 FF 00
				29 01 00 00 00 00 02 55 B0];
		qcom,mdss-dsi-panel-gamma-command-state = "dsi_hs_mode";
		qcom,mdss-dsi-panel-ce-command-state = "dsi_hs_mode";
		qcom,mdss-dsi-lp11-init;
		qcom,mdss-dsi-init-delay-us = <50000>;
		qcom,mdss-pan-physical-width-dimension = <62>;
		qcom,mdss-pan-physical-height-dimension = <110>;

	};
};
