/* Copyright (c) 2015, The Linux Foundation. All rights reserved.
 *
 * This program is free software; you can redistribute it and/or modify
 * it under the terms of the GNU General Public License version 2 and
 * only version 2 as published by the Free Software Foundation.
 *
 * This program is distributed in the hope that it will be useful,
 * but WITHOUT ANY WARRANTY; without even the implied warranty of
 * MERCHANTABILITY or FITNESS FOR A PARTICULAR PURPOSE.  See the
 * GNU General Public License for more details.
 */

/*---------------------------------------------------------------------------
 * This file is autogenerated file using gcdb parser. Please do not edit it.
 * Update input XML file to add a new entry or update variable in this file
 * VERSION = "1.0"
 *---------------------------------------------------------------------------*/
&mdss_mdp {
	dsi_r63417_1080p_video: qcom,mdss_dsi_r63417_1080p_video {
		qcom,mdss-dsi-panel-name = "r63417 1080p video mode dsi panel";
		qcom,mdss-dsi-panel-controller = <&mdss_dsi0>;
		qcom,mdss-dsi-panel-type = "dsi_video_mode";
		qcom,mdss-dsi-panel-destination = "display_1";
		qcom,mdss-dsi-panel-framerate = <60>;
		qcom,mdss-dsi-virtual-channel-id = <0>;
		qcom,mdss-dsi-stream = <0>;
		qcom,mdss-dsi-panel-width = <1080>;
		qcom,mdss-dsi-panel-height = <1920>;
		qcom,mdss-dsi-h-front-porch = <100>;
		qcom,mdss-dsi-h-back-porch = <12>;
		qcom,mdss-dsi-h-pulse-width = <60>;
		qcom,mdss-dsi-h-sync-skew = <0>;
		qcom,mdss-dsi-v-back-porch = <6>;
		qcom,mdss-dsi-v-front-porch = <25>;
		qcom,mdss-dsi-v-pulse-width = <2>;
		qcom,mdss-dsi-h-left-border = <0>;
		qcom,mdss-dsi-h-right-border = <0>;
		qcom,mdss-dsi-v-top-border = <0>;
		qcom,mdss-dsi-v-bottom-border = <0>;
		qcom,mdss-dsi-bpp = <24>;
		qcom,mdss-dsi-color-order = "rgb_swap_rgb";
		qcom,mdss-dsi-underflow-color = <0xff>;
		qcom,mdss-dsi-border-color = <0>;
		qcom,mdss-dsi-on-command = [39 01 00 00 78 00 02 11 00
		29 01 00 00 00 00 02 B0 04
		29 01 00 00 00 00 07 B3 14 00 00 00 00 00
		29 01 00 00 00 00 03 B6 3A C3
		29 01 00 00 00 00 02 C0 00
		29 01 00 00 00 00 23 C1 C4 60 10 EB FF 6F CE FF FF 17 12 58 73 AE 31 20 C6 FF FF 1F F3 FF 5F 10 10 10 10 00 62 01 22 22 00 01
		29 01 00 00 00 00 08 C2 31 F7 80 08 08 00 00
		29 01 00 00 00 00 17 C4 70 00 00 00 00 00 00 00 00 06 05 00 00 00 00 00 00 00 00 00 06 05
		29 01 00 00 00 00 29 C6 C8 01 69 01 69 00 00 00 00 00 00 00 00 00 00 00 00 0B 17 09 C8 08 67 08 67 00 00 00 00 00 00 00 00 00 00 00 00 16 18 08
		29 01 00 00 00 00 0A CB 31 FC 3F 8C 00 00 00 00 C0
		29 01 00 00 00 00 02 CC 0B
		29 01 00 00 00 00 0B D0 22 82 BB 19 99 4C 19 19 0C 00
		29 01 00 00 00 00 1a D3 1B 33 BB BB B3 33 33 33 01 01 00 A0 D8 A0 0D 55 55 33 3B 37 72 07 3D BF 44
		29 01 00 00 00 00 08 D5 06 00 00 01 67 01 67
		29 01 00 00 00 00 1f C7 0C 1B 22 2B 37 43 4C 5B 3F 47 52 5F 67 6B 6E 0C 1B 22 2B 37 43 4C 5B 3F 47 52 5F 67 6B 6E
		29 01 00 00 00 00 14 C8 01 00 00 03 FB FB EF 00 00 03 FB FB EF 00 00 03 FB FB EF
		39 01 00 00 00 00 02 53 2C
		39 01 00 00 00 00 02 55 03
		39 01 00 00 00 00 02 35 00
		39 01 00 00 64 00 02 29 00];
		qcom,mdss-dsi-off-command = [05 01 00 00 32 00 02 28 00
					05 01 00 00 78 00 02 10 00];
		qcom,mdss-dsi-on-command-state = "dsi_lp_mode";
		qcom,mdss-dsi-off-command-state = "dsi_hs_mode";
		qcom,mdss-dsi-h-sync-pulse = <1>;
		qcom,mdss-dsi-traffic-mode = "burst_mode";
		qcom,mdss-dsi-lane-map = "lane_map_0123";
		qcom,mdss-dsi-bllp-eof-power-mode;
		qcom,mdss-dsi-bllp-power-mode;
		qcom,mdss-dsi-lane-0-state;
		qcom,mdss-dsi-lane-1-state;
		qcom,mdss-dsi-lane-2-state;
		qcom,mdss-dsi-lane-3-state;
		qcom,mdss-dsi-panel-timings = [AE 44 37 00 5D 55 39 46 5B 03 04 00];
		qcom,mdss-dsi-t-clk-post = <0x1e>;
		qcom,mdss-dsi-t-clk-pre = <0x34>;
		qcom,mdss-dsi-bl-min-level = <1>;
		qcom,mdss-dsi-bl-max-level = <255>;
		qcom,mdss-dsi-dma-trigger = "trigger_sw";
		qcom,mdss-dsi-mdp-trigger = "none";
		qcom,mdss-dsi-bl-pmic-control-type = "bl_ctrl_dcs";
		qcom,mdss-dsi-reset-sequence = <1 20>, <0 2>, <1 20>;
	};
};
