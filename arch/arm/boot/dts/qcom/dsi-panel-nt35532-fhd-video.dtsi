/* Copyright (c) 2012-2015, The Linux Foundation. All rights reserved.
 * Copyright (C) 2017 XiaoMi, Inc.
 *
 * This program is free software; you can redistribute it and/or modify
 * it under the terms of the GNU General Public License version 2 and
 * only version 2 as published by the Free Software Foundation.
 *
 * This program is distributed in the hope that it will be useful,
 * but WITHOUT ANY WARRANTY; without even the implied warranty of
 * MERCHANTABILITY or FITNESS FOR A PARTICULAR PURPOSE.  See the
 * GNU General Public License for more details.
 */

&mdss_mdp {
	dsi_nt35532_fhd_vid: qcom,mdss_dsi_nt35532_fhd_video {
		qcom,mdss-dsi-panel-name = "nt35532 fhd video mode dsi panel";
		qcom,mdss-dsi-panel-type = "dsi_video_mode";
		qcom,mdss-dsi-panel-framerate = <60>;
		qcom,mdss-dsi-virtual-channel-id = <0>;
		qcom,mdss-dsi-stream = <0>;
		qcom,mdss-dsi-panel-width = <1080>;
		qcom,mdss-dsi-panel-height = <1920>;
		qcom,mdss-dsi-h-front-porch = <124>;
		qcom,mdss-dsi-h-back-porch = <64>;
		qcom,mdss-dsi-h-pulse-width = <16>;
		qcom,mdss-dsi-h-sync-skew = <0>;
		qcom,mdss-dsi-v-back-porch = <12>;
		qcom,mdss-dsi-v-front-porch = <7>;
		qcom,mdss-dsi-v-pulse-width = <2>;
		qcom,mdss-dsi-h-left-border = <0>;
		qcom,mdss-dsi-h-right-border = <0>;
		qcom,mdss-dsi-v-top-border = <0>;
		qcom,mdss-dsi-v-bottom-border = <0>;
		qcom,mdss-dsi-bpp = <24>;
		qcom,mdss-dsi-underflow-color = <0xff>;
		qcom,mdss-dsi-border-color = <0>;
		qcom,mdss-dsi-on-command = [29 01 00 00 01 00 02 ff 05
				29 01 00 00 00 00 02 fb 01
				29 01 00 00 00 00 02 d6 22
				29 01 00 00 00 00 02 ff 00
				29 01 00 00 00 00 02 fb 01
				29 01 00 00 00 00 02 35 00
				29 01 00 00 00 00 02 51 ff
				29 01 00 00 00 00 02 53 2c
				29 01 00 00 00 00 02 55 00
				29 01 00 00 00 00 02 d3 0E
				29 01 00 00 00 00 02 d4 07
				29 01 00 00 78 00 02 11 00
				29 01 00 00 14 00 02 29 00];
		qcom,mdss-dsi-off-command = [29 01 00 00 00 00 02 ff 00
				05 01 00 00 14 00 02 28 00
				05 01 00 00 3C 00 02 10 00
				29 01 00 00 00 00 02 ff 00
				29 01 00 00 14 00 02 4F 01];
		qcom,mdss-dsi-CABC_on-command = [29 01 00 00 00 00 02 ff 00
				29 01 00 00 00 00 02 55 B1];
		qcom,mdss-dsi-CABC_off-command = [29 01 00 00 00 00 02 ff 00
				29 01 00 00 00 00 02 55 00];
		qcom,mdss-dsi-CE_off-command = [29 01 00 00 00 00 02 ff 00
				29 01 00 00 00 00 02 55 00];
		qcom,mdss-dsi-CE_on-command = [23 00 00 00 00 00 02 FF 00
				23 00 00 00 00 00 02 FB 01
				23 00 00 00 00 00 02 55 B0
				23 00 00 00 00 00 02 FF 03
				23 00 00 00 00 00 02 FB 01
				23 00 00 00 00 00 02 00 00
				23 00 00 00 00 00 02 01 0D
				23 00 00 00 00 00 02 02 15
				23 00 00 00 00 00 02 03 1C
				23 00 00 00 00 00 02 04 21
				23 00 00 00 00 00 02 05 26
				23 00 00 00 00 00 02 06 2B
				23 00 00 00 00 00 02 07 2C
				23 00 00 00 00 00 02 08 2D
				23 00 00 00 00 00 02 09 2D
				23 00 00 00 00 00 02 0A 2D
				23 00 00 00 00 00 02 0B 2D
				23 00 00 00 00 00 02 0C 2C
				23 00 00 00 00 00 02 0D 2A
				23 00 00 00 00 00 02 0E 27
				23 00 00 00 00 00 02 0F 23
				23 00 00 00 00 00 02 10 1D
				23 00 00 00 00 00 02 11 17
				23 00 00 00 00 00 02 12 0B
				23 00 00 00 00 00 02 13 00
				23 00 00 00 00 00 02 1A 00
				23 00 00 00 00 00 02 1B 00
				23 00 00 00 00 00 02 1C 00
				23 00 00 00 00 00 02 1D 00
				23 00 00 00 00 00 02 1E 00
				23 00 00 00 00 00 02 1F 00
				23 00 00 00 00 00 02 20 00
				23 00 00 00 00 00 02 21 00
				23 00 00 00 00 00 02 22 00
				23 00 00 00 00 00 02 23 00
				23 00 00 00 00 00 02 24 00
				23 00 00 00 00 00 02 25 00
				23 00 00 00 00 00 02 26 00
				23 00 00 00 00 00 02 27 00
				23 00 00 00 00 00 02 28 00
				23 01 00 00 00 00 02 29 00

				23 00 00 00 00 00 02 2A 00
				23 00 00 00 00 00 02 2B 00
				23 00 00 00 00 00 02 2F 00
				23 00 00 00 00 00 02 30 00
				23 00 00 00 00 00 02 31 00
				23 00 00 00 00 00 02 32 85
				23 00 00 00 00 00 02 33 07
				23 00 00 00 00 00 02 34 0A
				23 00 00 00 00 00 02 35 0D
				23 00 00 00 00 00 02 36 12
				23 00 00 00 00 00 02 37 16
				23 00 00 00 00 00 02 38 1B
				23 00 00 00 00 00 02 39 1D
				23 00 00 00 00 00 02 3A 1C
				23 00 00 00 00 00 02 3B 1B
				23 00 00 00 00 00 02 3F 18
				23 00 00 00 00 00 02 40 14
				23 00 00 00 00 00 02 41 13
				23 00 00 00 00 00 02 42 12
				23 00 00 00 00 00 02 43 13
				23 00 00 00 00 00 02 44 13
				23 00 00 00 00 00 02 45 11
				23 00 00 00 00 00 02 46 0D
				23 00 00 00 00 00 02 47 09
				23 00 00 00 00 00 02 48 07
				23 00 00 00 00 00 02 49 07
				23 00 00 00 00 00 02 4A 07
				23 00 00 00 00 00 02 4B 06
				23 00 00 00 00 00 02 4C 06
				23 00 00 00 00 00 02 4D 00
				23 00 00 00 00 00 02 4E 00
				23 00 00 00 00 00 02 4F 00
				23 00 00 00 00 00 02 50 00
				23 00 00 00 00 00 02 51 00
				23 00 00 00 00 00 02 52 00
				23 00 00 00 00 00 02 53 05
				23 00 00 00 00 00 02 54 04
				23 00 00 00 00 00 02 55 04
				23 00 00 00 00 00 02 56 00
				23 01 00 00 00 00 02 68 00];

		qcom,mdss-dsi-cold_gamma-command = [23 00 00 00 00 00 02 FF 01
				23 00 00 00 00 00 02 FB 01
				23 00 00 00 00 00 02 6E 80
				23 00 00 00 00 00 02 75 00
				23 00 00 00 00 00 02 76 D6
				23 00 00 00 00 00 02 77 00
				23 00 00 00 00 00 02 78 DE
				23 00 00 00 00 00 02 79 00
				23 00 00 00 00 00 02 7A ED
				23 00 00 00 00 00 02 7B 00
				23 00 00 00 00 00 02 7C FA
				23 00 00 00 00 00 02 7D 01
				23 00 00 00 00 00 02 7E 08
				23 00 00 00 00 00 02 7F 01
				23 00 00 00 00 00 02 80 13
				23 00 00 00 00 00 02 81 01
				23 00 00 00 00 00 02 82 1D
				23 00 00 00 00 00 02 83 01
				23 00 00 00 00 00 02 84 28
				23 00 00 00 00 00 02 85 01
				23 00 00 00 00 00 02 86 31
				23 00 00 00 00 00 02 87 01
				23 00 00 00 00 00 02 88 53
				23 00 00 00 00 00 02 89 01
				23 00 00 00 00 00 02 8A 71
				23 00 00 00 00 00 02 8B 01
				23 00 00 00 00 00 02 8C A0
				23 00 00 00 00 00 02 8D 01
				23 00 00 00 00 00 02 8E C7
				23 00 00 00 00 00 02 8F 02
				23 00 00 00 00 00 02 90 05
				23 00 00 00 00 00 02 91 02
				23 01 00 00 00 00 02 92 37

				23 00 00 00 00 00 02 93 02
				23 00 00 00 00 00 02 94 38
				23 00 00 00 00 00 02 95 02
				23 00 00 00 00 00 02 96 68
				23 00 00 00 00 00 02 97 02
				23 00 00 00 00 00 02 98 9D
				23 00 00 00 00 00 02 99 02
				23 00 00 00 00 00 02 9A C0
				23 00 00 00 00 00 02 9B 02
				23 00 00 00 00 00 02 9C F3
				23 00 00 00 00 00 02 9D 03
				23 00 00 00 00 00 02 9E 16
				23 00 00 00 00 00 02 9F 03
				23 00 00 00 00 00 02 A0 43
				23 00 00 00 00 00 02 A2 03
				23 00 00 00 00 00 02 A3 52
				23 00 00 00 00 00 02 A4 03
				23 00 00 00 00 00 02 A5 63
				23 00 00 00 00 00 02 A6 03
				23 00 00 00 00 00 02 A7 77
				23 00 00 00 00 00 02 A9 03
				23 00 00 00 00 00 02 AA 91
				23 00 00 00 00 00 02 AB 03
				23 00 00 00 00 00 02 AC AF
				23 00 00 00 00 00 02 AD 03
				23 00 00 00 00 00 02 AE C0
				23 00 00 00 00 00 02 AF 03
				23 00 00 00 00 00 02 B0 C8
				23 00 00 00 00 00 02 B1 03
				23 01 00 00 00 00 02 B2 C9
				23 00 00 00 00 00 02 B3 00
				23 00 00 00 00 00 02 B4 D6
				23 00 00 00 00 00 02 B5 00
				23 00 00 00 00 00 02 B6 DE
				23 00 00 00 00 00 02 B7 00
				23 00 00 00 00 00 02 B8 ED
				23 00 00 00 00 00 02 B9 00
				23 00 00 00 00 00 02 BA FA
				23 00 00 00 00 00 02 BB 01
				23 00 00 00 00 00 02 BC 08
				23 00 00 00 00 00 02 BD 01
				23 00 00 00 00 00 02 BE 13
				23 00 00 00 00 00 02 BF 01
				23 00 00 00 00 00 02 C0 1D
				23 00 00 00 00 00 02 C1 01
				23 00 00 00 00 00 02 C2 28
				23 00 00 00 00 00 02 C3 01
				23 00 00 00 00 00 02 C4 31
				23 00 00 00 00 00 02 C5 01
				23 00 00 00 00 00 02 C6 53
				23 00 00 00 00 00 02 C7 01
				23 00 00 00 00 00 02 C8 71
				23 00 00 00 00 00 02 C9 01
				23 00 00 00 00 00 02 CA A0
				23 00 00 00 00 00 02 CB 01
				23 00 00 00 00 00 02 CC C7
				23 00 00 00 00 00 02 CD 02
				23 00 00 00 00 00 02 CE 05
				23 00 00 00 00 00 02 CF 02
				23 01 00 00 00 00 02 D0 37

				23 00 00 00 00 00 02 D1 02
				23 00 00 00 00 00 02 D2 38
				23 00 00 00 00 00 02 D3 02
				23 00 00 00 00 00 02 D4 68
				23 00 00 00 00 00 02 D5 02
				23 00 00 00 00 00 02 D6 9D
				23 00 00 00 00 00 02 D7 02
				23 00 00 00 00 00 02 D8 C0
				23 00 00 00 00 00 02 D9 02
				23 00 00 00 00 00 02 DA F3
				23 00 00 00 00 00 02 DB 03
				23 00 00 00 00 00 02 DC 16
				23 00 00 00 00 00 02 DD 03
				23 00 00 00 00 00 02 DE 43
				23 00 00 00 00 00 02 DF 03
				23 00 00 00 00 00 02 E0 52
				23 00 00 00 00 00 02 E1 03
				23 00 00 00 00 00 02 E2 63
				23 00 00 00 00 00 02 E3 03
				23 00 00 00 00 00 02 E4 77
				23 00 00 00 00 00 02 E5 03
				23 00 00 00 00 00 02 E6 91
				23 00 00 00 00 00 02 E7 03
				23 00 00 00 00 00 02 E8 AF
				23 00 00 00 00 00 02 E9 03
				23 00 00 00 00 00 02 EA C0
				23 00 00 00 00 00 02 EB 03
				23 00 00 00 00 00 02 EC C8
				23 00 00 00 00 00 02 ED 03
				23 01 00 00 00 00 02 EE C9
				23 00 00 00 00 00 02 EF 01
				23 00 00 00 00 00 02 F0 03
				23 00 00 00 00 00 02 F1 01
				23 00 00 00 00 00 02 F2 09
				23 00 00 00 00 00 02 F3 01
				23 00 00 00 00 00 02 F4 13
				23 00 00 00 00 00 02 F5 01
				23 00 00 00 00 00 02 F6 1E
				23 00 00 00 00 00 02 F7 01
				23 00 00 00 00 00 02 F8 27
				23 00 00 00 00 00 02 F9 01
				23 00 00 00 00 00 02 FA 30
				23 00 00 00 00 00 02 FF 02
				23 00 00 00 00 00 02 FB 01
				23 00 00 00 00 00 02 00 01
				23 00 00 00 00 00 02 01 39
				23 00 00 00 00 00 02 02 01
				23 00 00 00 00 00 02 03 41
				23 00 00 00 00 00 02 04 01
				23 00 00 00 00 00 02 05 49
				23 00 00 00 00 00 02 06 01
				23 00 00 00 00 00 02 07 66
				23 00 00 00 00 00 02 08 01
				23 00 00 00 00 00 02 09 80
				23 00 00 00 00 00 02 0A 01
				23 00 00 00 00 00 02 0B AB
				23 00 00 00 00 00 02 0C 01
				23 00 00 00 00 00 02 0D CF
				23 00 00 00 00 00 02 0E 02
				23 00 00 00 00 00 02 0F 09
				23 00 00 00 00 00 02 10 02
				23 01 00 00 00 00 02 11 39

				23 00 00 00 00 00 02 12 02
				23 00 00 00 00 00 02 13 3B
				23 00 00 00 00 00 02 14 02
				23 00 00 00 00 00 02 15 69
				23 00 00 00 00 00 02 16 02
				23 00 00 00 00 00 02 17 9E
				23 00 00 00 00 00 02 18 02
				23 00 00 00 00 00 02 19 C1
				23 00 00 00 00 00 02 1A 02
				23 00 00 00 00 00 02 1B F4
				23 00 00 00 00 00 02 1C 03
				23 00 00 00 00 00 02 1D 18
				23 00 00 00 00 00 02 1E 03
				23 00 00 00 00 00 02 1F 45
				23 00 00 00 00 00 02 20 03
				23 00 00 00 00 00 02 21 54
				23 00 00 00 00 00 02 22 03
				23 00 00 00 00 00 02 23 65
				23 00 00 00 00 00 02 24 03
				23 00 00 00 00 00 02 25 7A
				23 00 00 00 00 00 02 26 03
				23 00 00 00 00 00 02 27 94
				23 00 00 00 00 00 02 28 03
				23 00 00 00 00 00 02 29 AE
				23 00 00 00 00 00 02 2A 03
				23 00 00 00 00 00 02 2B C0
				23 00 00 00 00 00 02 2D 03
				23 00 00 00 00 00 02 2F C8
				23 00 00 00 00 00 02 30 03
				23 01 00 00 00 00 02 31 C9
				23 00 00 00 00 00 02 32 01
				23 00 00 00 00 00 02 33 03
				23 00 00 00 00 00 02 34 01
				23 00 00 00 00 00 02 35 09
				23 00 00 00 00 00 02 36 01
				23 00 00 00 00 00 02 37 13
				23 00 00 00 00 00 02 38 01
				23 00 00 00 00 00 02 39 1E
				23 00 00 00 00 00 02 3A 01
				23 00 00 00 00 00 02 3B 27
				23 00 00 00 00 00 02 3D 01
				23 00 00 00 00 00 02 3F 30
				23 00 00 00 00 00 02 40 01
				23 00 00 00 00 00 02 41 39
				23 00 00 00 00 00 02 42 01
				23 00 00 00 00 00 02 43 41
				23 00 00 00 00 00 02 44 01
				23 00 00 00 00 00 02 45 49
				23 00 00 00 00 00 02 46 01
				23 00 00 00 00 00 02 47 66
				23 00 00 00 00 00 02 48 01
				23 00 00 00 00 00 02 49 80
				23 00 00 00 00 00 02 4A 01
				23 00 00 00 00 00 02 4B AB
				23 00 00 00 00 00 02 4C 01
				23 00 00 00 00 00 02 4D CF
				23 00 00 00 00 00 02 4E 02
				23 00 00 00 00 00 02 4F 09
				23 00 00 00 00 00 02 50 02
				23 01 00 00 00 00 02 51 39

				23 00 00 00 00 00 02 52 02
				23 00 00 00 00 00 02 53 3B
				23 00 00 00 00 00 02 54 02
				23 00 00 00 00 00 02 55 69
				23 00 00 00 00 00 02 56 02
				23 00 00 00 00 00 02 58 9E
				23 00 00 00 00 00 02 59 02
				23 00 00 00 00 00 02 5A C1
				23 00 00 00 00 00 02 5B 02
				23 00 00 00 00 00 02 5C F4
				23 00 00 00 00 00 02 5D 03
				23 00 00 00 00 00 02 5E 18
				23 00 00 00 00 00 02 5F 03
				23 00 00 00 00 00 02 60 45
				23 00 00 00 00 00 02 61 03
				23 00 00 00 00 00 02 62 54
				23 00 00 00 00 00 02 63 03
				23 00 00 00 00 00 02 64 65
				23 00 00 00 00 00 02 65 03
				23 00 00 00 00 00 02 66 7A
				23 00 00 00 00 00 02 67 03
				23 00 00 00 00 00 02 68 94
				23 00 00 00 00 00 02 69 03
				23 00 00 00 00 00 02 6A AE
				23 00 00 00 00 00 02 6B 03
				23 00 00 00 00 00 02 6C C0
				23 00 00 00 00 00 02 6D 03
				23 00 00 00 00 00 02 6E C8
				23 00 00 00 00 00 02 6F 03
				23 01 00 00 00 00 02 70 C9
				23 00 00 00 00 00 02 71 00
				23 00 00 00 00 00 02 72 01
				23 00 00 00 00 00 02 73 00
				23 00 00 00 00 00 02 74 40
				23 00 00 00 00 00 02 75 00
				23 00 00 00 00 00 02 76 70
				23 00 00 00 00 00 02 77 00
				23 00 00 00 00 00 02 78 8F
				23 00 00 00 00 00 02 79 00
				23 00 00 00 00 00 02 7A AA
				23 00 00 00 00 00 02 7B 00
				23 00 00 00 00 00 02 7C BD
				23 00 00 00 00 00 02 7D 00
				23 00 00 00 00 00 02 7E CE
				23 00 00 00 00 00 02 7F 00
				23 00 00 00 00 00 02 80 DF
				23 00 00 00 00 00 02 81 00
				23 00 00 00 00 00 02 82 EC
				23 00 00 00 00 00 02 83 01
				23 00 00 00 00 00 02 84 1C
				23 00 00 00 00 00 02 85 01
				23 00 00 00 00 00 02 86 43
				23 00 00 00 00 00 02 87 01
				23 00 00 00 00 00 02 88 7D
				23 00 00 00 00 00 02 89 01
				23 00 00 00 00 00 02 8A AB
				23 00 00 00 00 00 02 8B 01
				23 00 00 00 00 00 02 8C F2
				23 00 00 00 00 00 02 8D 02
				23 01 00 00 00 00 02 8E 29

				23 00 00 00 00 00 02 8F 02
				23 00 00 00 00 00 02 90 2B
				23 00 00 00 00 00 02 91 02
				23 00 00 00 00 00 02 92 5D
				23 00 00 00 00 00 02 93 02
				23 00 00 00 00 00 02 94 94
				23 00 00 00 00 00 02 95 02
				23 00 00 00 00 00 02 96 B7
				23 00 00 00 00 00 02 97 02
				23 00 00 00 00 00 02 98 EB
				23 00 00 00 00 00 02 99 03
				23 00 00 00 00 00 02 9A 14
				23 00 00 00 00 00 02 9B 03
				23 00 00 00 00 00 02 9C 4B
				23 00 00 00 00 00 02 9D 03
				23 00 00 00 00 00 02 9E 62
				23 00 00 00 00 00 02 9F 03
				23 00 00 00 00 00 02 A0 86
				23 00 00 00 00 00 02 A2 03
				23 00 00 00 00 00 02 A3 A5
				23 00 00 00 00 00 02 A4 03
				23 00 00 00 00 00 02 A5 B3
				23 00 00 00 00 00 02 A6 03
				23 00 00 00 00 00 02 A7 BC
				23 00 00 00 00 00 02 A9 03
				23 00 00 00 00 00 02 AA C2
				23 00 00 00 00 00 02 AB 03
				23 00 00 00 00 00 02 AC C8
				23 00 00 00 00 00 02 AD 03
				23 01 00 00 00 00 02 AE C9
				23 00 00 00 00 00 02 AF 00
				23 00 00 00 00 00 02 B0 01
				23 00 00 00 00 00 02 B1 00
				23 00 00 00 00 00 02 B2 40
				23 00 00 00 00 00 02 B3 00
				23 00 00 00 00 00 02 B4 70
				23 00 00 00 00 00 02 B5 00
				23 00 00 00 00 00 02 B6 8F
				23 00 00 00 00 00 02 B7 00
				23 00 00 00 00 00 02 B8 AA
				23 00 00 00 00 00 02 B9 00
				23 00 00 00 00 00 02 BA BD
				23 00 00 00 00 00 02 BB 00
				23 00 00 00 00 00 02 BC CE
				23 00 00 00 00 00 02 BD 00
				23 00 00 00 00 00 02 BE DF
				23 00 00 00 00 00 02 BF 00
				23 00 00 00 00 00 02 C0 EC
				23 00 00 00 00 00 02 C1 01
				23 00 00 00 00 00 02 C2 1C
				23 00 00 00 00 00 02 C3 01
				23 00 00 00 00 00 02 C4 43
				23 00 00 00 00 00 02 C5 01
				23 00 00 00 00 00 02 C6 7D
				23 00 00 00 00 00 02 C7 01
				23 00 00 00 00 00 02 C8 AB
				23 00 00 00 00 00 02 C9 01
				23 00 00 00 00 00 02 CA F2
				23 00 00 00 00 00 02 CB 02
				23 01 00 00 00 00 02 CC 29

				23 00 00 00 00 00 02 CD 02
				23 00 00 00 00 00 02 CE 2B
				23 00 00 00 00 00 02 CF 02
				23 00 00 00 00 00 02 D0 5D
				23 00 00 00 00 00 02 D1 02
				23 00 00 00 00 00 02 D2 94
				23 00 00 00 00 00 02 D3 02
				23 00 00 00 00 00 02 D4 B7
				23 00 00 00 00 00 02 D5 02
				23 00 00 00 00 00 02 D6 EB
				23 00 00 00 00 00 02 D7 03
				23 00 00 00 00 00 02 D8 14
				23 00 00 00 00 00 02 D9 03
				23 00 00 00 00 00 02 DA 4B
				23 00 00 00 00 00 02 DB 03
				23 00 00 00 00 00 02 DC 62
				23 00 00 00 00 00 02 DD 03
				23 00 00 00 00 00 02 DE 86
				23 00 00 00 00 00 02 DF 03
				23 00 00 00 00 00 02 E0 A5
				23 00 00 00 00 00 02 E1 03
				23 00 00 00 00 00 02 E2 B3
				23 00 00 00 00 00 02 E3 03
				23 00 00 00 00 00 02 E4 BC
				23 00 00 00 00 00 02 E5 03
				23 00 00 00 00 00 02 E6 C2
				23 00 00 00 00 00 02 E7 03
				23 00 00 00 00 00 02 E8 C8
				23 00 00 00 00 00 02 E9 03
				23 01 00 00 00 00 02 EA C9];


		qcom,mdss-dsi-warm_gamma-command = [23 00 00 00 00 00 02 FF 01
				23 00 00 00 00 00 02 FB 01
				23 00 00 00 00 00 02 6E 80
				23 00 00 00 00 00 02 75 00
				23 00 00 00 00 00 02 76 01
				23 00 00 00 00 00 02 77 00
				23 00 00 00 00 00 02 78 4C
				23 00 00 00 00 00 02 79 00
				23 00 00 00 00 00 02 7A 7A
				23 00 00 00 00 00 02 7B 00
				23 00 00 00 00 00 02 7C 98
				23 00 00 00 00 00 02 7D 00
				23 00 00 00 00 00 02 7E AF
				23 00 00 00 00 00 02 7F 00
				23 00 00 00 00 00 02 80 C2
				23 00 00 00 00 00 02 81 00
				23 00 00 00 00 00 02 82 D3
				23 00 00 00 00 00 02 83 00
				23 00 00 00 00 00 02 84 E2
				23 00 00 00 00 00 02 85 00
				23 00 00 00 00 00 02 86 F0
				23 00 00 00 00 00 02 87 01
				23 00 00 00 00 00 02 88 1D
				23 00 00 00 00 00 02 89 01
				23 00 00 00 00 00 02 8A 41
				23 00 00 00 00 00 02 8B 01
				23 00 00 00 00 00 02 8C 7A
				23 00 00 00 00 00 02 8D 01
				23 00 00 00 00 00 02 8E A7
				23 00 00 00 00 00 02 8F 01
				23 00 00 00 00 00 02 90 EC
				23 00 00 00 00 00 02 91 02
				23 01 00 00 00 00 02 92 22

				23 00 00 00 00 00 02 93 02
				23 00 00 00 00 00 02 94 24
				23 00 00 00 00 00 02 95 02
				23 00 00 00 00 00 02 96 54
				23 00 00 00 00 00 02 97 02
				23 00 00 00 00 00 02 98 87
				23 00 00 00 00 00 02 99 02
				23 00 00 00 00 00 02 9A A7
				23 00 00 00 00 00 02 9B 02
				23 00 00 00 00 00 02 9C D7
				23 00 00 00 00 00 02 9D 02
				23 00 00 00 00 00 02 9E F7
				23 00 00 00 00 00 02 9F 03
				23 00 00 00 00 00 02 A0 22
				23 00 00 00 00 00 02 A2 03
				23 00 00 00 00 00 02 A3 2F
				23 00 00 00 00 00 02 A4 03
				23 00 00 00 00 00 02 A5 3D
				23 00 00 00 00 00 02 A6 03
				23 00 00 00 00 00 02 A7 4D
				23 00 00 00 00 00 02 A9 03
				23 00 00 00 00 00 02 AA 62
				23 00 00 00 00 00 02 AB 03
				23 00 00 00 00 00 02 AC 83
				23 00 00 00 00 00 02 AD 03
				23 00 00 00 00 00 02 AE AF
				23 00 00 00 00 00 02 AF 03
				23 00 00 00 00 00 02 B0 C6
				23 00 00 00 00 00 02 B1 03
				23 01 00 00 00 00 02 B2 C9
				23 00 00 00 00 00 02 B3 00
				23 00 00 00 00 00 02 B4 01
				23 00 00 00 00 00 02 B5 00
				23 00 00 00 00 00 02 B6 4C
				23 00 00 00 00 00 02 B7 00
				23 00 00 00 00 00 02 B8 7A
				23 00 00 00 00 00 02 B9 00
				23 00 00 00 00 00 02 BA 98
				23 00 00 00 00 00 02 BB 00
				23 00 00 00 00 00 02 BC AF
				23 00 00 00 00 00 02 BD 00
				23 00 00 00 00 00 02 BE C2
				23 00 00 00 00 00 02 BF 00
				23 00 00 00 00 00 02 C0 D3
				23 00 00 00 00 00 02 C1 00
				23 00 00 00 00 00 02 C2 E2
				23 00 00 00 00 00 02 C3 00
				23 00 00 00 00 00 02 C4 F0
				23 00 00 00 00 00 02 C5 01
				23 00 00 00 00 00 02 C6 1D
				23 00 00 00 00 00 02 C7 01
				23 00 00 00 00 00 02 C8 41
				23 00 00 00 00 00 02 C9 01
				23 00 00 00 00 00 02 CA 7A
				23 00 00 00 00 00 02 CB 01
				23 00 00 00 00 00 02 CC A7
				23 00 00 00 00 00 02 CD 01
				23 00 00 00 00 00 02 CE EC
				23 00 00 00 00 00 02 CF 02
				23 01 00 00 00 00 02 D0 22

				23 00 00 00 00 00 02 D1 02
				23 00 00 00 00 00 02 D2 24
				23 00 00 00 00 00 02 D3 02
				23 00 00 00 00 00 02 D4 54
				23 00 00 00 00 00 02 D5 02
				23 00 00 00 00 00 02 D6 87
				23 00 00 00 00 00 02 D7 02
				23 00 00 00 00 00 02 D8 A7
				23 00 00 00 00 00 02 D9 02
				23 00 00 00 00 00 02 DA D7
				23 00 00 00 00 00 02 DB 02
				23 00 00 00 00 00 02 DC F7
				23 00 00 00 00 00 02 DD 03
				23 00 00 00 00 00 02 DE 22
				23 00 00 00 00 00 02 DF 03
				23 00 00 00 00 00 02 E0 2F
				23 00 00 00 00 00 02 E1 03
				23 00 00 00 00 00 02 E2 3D
				23 00 00 00 00 00 02 E3 03
				23 00 00 00 00 00 02 E4 4D
				23 00 00 00 00 00 02 E5 03
				23 00 00 00 00 00 02 E6 62
				23 00 00 00 00 00 02 E7 03
				23 00 00 00 00 00 02 E8 83
				23 00 00 00 00 00 02 E9 03
				23 00 00 00 00 00 02 EA AF
				23 00 00 00 00 00 02 EB 03
				23 00 00 00 00 00 02 EC C6
				23 00 00 00 00 00 02 ED 03
				23 01 00 00 00 00 02 EE C9
				23 00 00 00 00 00 02 EF 01
				23 00 00 00 00 00 02 F0 2D
				23 00 00 00 00 00 02 F1 01
				23 00 00 00 00 00 02 F2 31
				23 00 00 00 00 00 02 F3 01
				23 00 00 00 00 00 02 F4 39
				23 00 00 00 00 00 02 F5 01
				23 00 00 00 00 00 02 F6 41
				23 00 00 00 00 00 02 F7 01
				23 00 00 00 00 00 02 F8 48
				23 00 00 00 00 00 02 F9 01
				23 00 00 00 00 00 02 FA 4E
				23 00 00 00 00 00 02 FF 02
				23 00 00 00 00 00 02 FB 01
				23 00 00 00 00 00 02 00 01
				23 00 00 00 00 00 02 01 55
				23 00 00 00 00 00 02 02 01
				23 00 00 00 00 00 02 03 5B
				23 00 00 00 00 00 02 04 01
				23 00 00 00 00 00 02 05 62
				23 00 00 00 00 00 02 06 01
				23 00 00 00 00 00 02 07 7A
				23 00 00 00 00 00 02 08 01
				23 00 00 00 00 00 02 09 8F
				23 00 00 00 00 00 02 0A 01
				23 00 00 00 00 00 02 0B B4
				23 00 00 00 00 00 02 0C 01
				23 00 00 00 00 00 02 0D D4
				23 00 00 00 00 00 02 0E 02
				23 00 00 00 00 00 02 0F 08
				23 00 00 00 00 00 02 10 02
				23 01 00 00 00 00 02 11 36

				23 00 00 00 00 00 02 12 02
				23 00 00 00 00 00 02 13 37
				23 00 00 00 00 00 02 14 02
				23 00 00 00 00 00 02 15 62
				23 00 00 00 00 00 02 16 02
				23 00 00 00 00 00 02 17 93
				23 00 00 00 00 00 02 18 02
				23 00 00 00 00 00 02 19 B3
				23 00 00 00 00 00 02 1A 02
				23 00 00 00 00 00 02 1B E3
				23 00 00 00 00 00 02 1C 03
				23 00 00 00 00 00 02 1D 04
				23 00 00 00 00 00 02 1E 03
				23 00 00 00 00 00 02 1F 2F
				23 00 00 00 00 00 02 20 03
				23 00 00 00 00 00 02 21 3D
				23 00 00 00 00 00 02 22 03
				23 00 00 00 00 00 02 23 4C
				23 00 00 00 00 00 02 24 03
				23 00 00 00 00 00 02 25 5F
				23 00 00 00 00 00 02 26 03
				23 00 00 00 00 00 02 27 77
				23 00 00 00 00 00 02 28 03
				23 00 00 00 00 00 02 29 97
				23 00 00 00 00 00 02 2A 03
				23 00 00 00 00 00 02 2B B5
				23 00 00 00 00 00 02 2D 03
				23 00 00 00 00 00 02 2F C7
				23 00 00 00 00 00 02 30 03
				23 01 00 00 00 00 02 31 C9
				23 00 00 00 00 00 02 32 01
				23 00 00 00 00 00 02 33 2D
				23 00 00 00 00 00 02 34 01
				23 00 00 00 00 00 02 35 31
				23 00 00 00 00 00 02 36 01
				23 00 00 00 00 00 02 37 39
				23 00 00 00 00 00 02 38 01
				23 00 00 00 00 00 02 39 41
				23 00 00 00 00 00 02 3A 01
				23 00 00 00 00 00 02 3B 48
				23 00 00 00 00 00 02 3D 01
				23 00 00 00 00 00 02 3F 4E
				23 00 00 00 00 00 02 40 01
				23 00 00 00 00 00 02 41 55
				23 00 00 00 00 00 02 42 01
				23 00 00 00 00 00 02 43 5B
				23 00 00 00 00 00 02 44 01
				23 00 00 00 00 00 02 45 62
				23 00 00 00 00 00 02 46 01
				23 00 00 00 00 00 02 47 7A
				23 00 00 00 00 00 02 48 01
				23 00 00 00 00 00 02 49 8F
				23 00 00 00 00 00 02 4A 01
				23 00 00 00 00 00 02 4B B4
				23 00 00 00 00 00 02 4C 01
				23 00 00 00 00 00 02 4D D4
				23 00 00 00 00 00 02 4E 02
				23 00 00 00 00 00 02 4F 08
				23 00 00 00 00 00 02 50 02
				23 01 00 00 00 00 02 51 36

				23 00 00 00 00 00 02 52 02
				23 00 00 00 00 00 02 53 37
				23 00 00 00 00 00 02 54 02
				23 00 00 00 00 00 02 55 62
				23 00 00 00 00 00 02 56 02
				23 00 00 00 00 00 02 58 93
				23 00 00 00 00 00 02 59 02
				23 00 00 00 00 00 02 5A B3
				23 00 00 00 00 00 02 5B 02
				23 00 00 00 00 00 02 5C E3
				23 00 00 00 00 00 02 5D 03
				23 00 00 00 00 00 02 5E 04
				23 00 00 00 00 00 02 5F 03
				23 00 00 00 00 00 02 60 2F
				23 00 00 00 00 00 02 61 03
				23 00 00 00 00 00 02 62 3D
				23 00 00 00 00 00 02 63 03
				23 00 00 00 00 00 02 64 4C
				23 00 00 00 00 00 02 65 03
				23 00 00 00 00 00 02 66 5F
				23 00 00 00 00 00 02 67 03
				23 00 00 00 00 00 02 68 77
				23 00 00 00 00 00 02 69 03
				23 00 00 00 00 00 02 6A 97
				23 00 00 00 00 00 02 6B 03
				23 00 00 00 00 00 02 6C B5
				23 00 00 00 00 00 02 6D 03
				23 00 00 00 00 00 02 6E C7
				23 00 00 00 00 00 02 6F 03
				23 01 00 00 00 00 02 70 C9
				23 00 00 00 00 00 02 71 01
				23 00 00 00 00 00 02 72 2C
				23 00 00 00 00 00 02 73 01
				23 00 00 00 00 00 02 74 30
				23 00 00 00 00 00 02 75 01
				23 00 00 00 00 00 02 76 38
				23 00 00 00 00 00 02 77 01
				23 00 00 00 00 00 02 78 3F
				23 00 00 00 00 00 02 79 01
				23 00 00 00 00 00 02 7A 46
				23 00 00 00 00 00 02 7B 01
				23 00 00 00 00 00 02 7C 4C
				23 00 00 00 00 00 02 7D 01
				23 00 00 00 00 00 02 7E 53
				23 00 00 00 00 00 02 7F 01
				23 00 00 00 00 00 02 80 59
				23 00 00 00 00 00 02 81 01
				23 00 00 00 00 00 02 82 60
				23 00 00 00 00 00 02 83 01
				23 00 00 00 00 00 02 84 77
				23 00 00 00 00 00 02 85 01
				23 00 00 00 00 00 02 86 8C
				23 00 00 00 00 00 02 87 01
				23 00 00 00 00 00 02 88 B1
				23 00 00 00 00 00 02 89 01
				23 00 00 00 00 00 02 8A D1
				23 00 00 00 00 00 02 8B 02
				23 00 00 00 00 00 02 8C 06
				23 00 00 00 00 00 02 8D 02
				23 01 00 00 00 00 02 8E 34

				23 00 00 00 00 00 02 8F 02
				23 00 00 00 00 00 02 90 35
				23 00 00 00 00 00 02 91 02
				23 00 00 00 00 00 02 92 61
				23 00 00 00 00 00 02 93 02
				23 00 00 00 00 00 02 94 92
				23 00 00 00 00 00 02 95 02
				23 00 00 00 00 00 02 96 B2
				23 00 00 00 00 00 02 97 02
				23 00 00 00 00 00 02 98 E4
				23 00 00 00 00 00 02 99 03
				23 00 00 00 00 00 02 9A 08
				23 00 00 00 00 00 02 9B 03
				23 00 00 00 00 00 02 9C 3B
				23 00 00 00 00 00 02 9D 03
				23 00 00 00 00 00 02 9E 4F
				23 00 00 00 00 00 02 9F 03
				23 00 00 00 00 00 02 A0 69
				23 00 00 00 00 00 02 A2 03
				23 00 00 00 00 00 02 A3 9C
				23 00 00 00 00 00 02 A4 03
				23 00 00 00 00 00 02 A5 B9
				23 00 00 00 00 00 02 A6 03
				23 00 00 00 00 00 02 A7 BE
				23 00 00 00 00 00 02 A9 03
				23 00 00 00 00 00 02 AA C1
				23 00 00 00 00 00 02 AB 03
				23 00 00 00 00 00 02 AC C8
				23 00 00 00 00 00 02 AD 03
				23 01 00 00 00 00 02 AE C9
				23 00 00 00 00 00 02 AF 01
				23 00 00 00 00 00 02 B0 2C
				23 00 00 00 00 00 02 B1 01
				23 00 00 00 00 00 02 B2 30
				23 00 00 00 00 00 02 B3 01
				23 00 00 00 00 00 02 B4 38
				23 00 00 00 00 00 02 B5 01
				23 00 00 00 00 00 02 B6 3F
				23 00 00 00 00 00 02 B7 01
				23 00 00 00 00 00 02 B8 46
				23 00 00 00 00 00 02 B9 01
				23 00 00 00 00 00 02 BA 4C
				23 00 00 00 00 00 02 BB 01
				23 00 00 00 00 00 02 BC 53
				23 00 00 00 00 00 02 BD 01
				23 00 00 00 00 00 02 BE 59
				23 00 00 00 00 00 02 BF 01
				23 00 00 00 00 00 02 C0 60
				23 00 00 00 00 00 02 C1 01
				23 00 00 00 00 00 02 C2 77
				23 00 00 00 00 00 02 C3 01
				23 00 00 00 00 00 02 C4 8C
				23 00 00 00 00 00 02 C5 01
				23 00 00 00 00 00 02 C6 B1
				23 00 00 00 00 00 02 C7 01
				23 00 00 00 00 00 02 C8 D1
				23 00 00 00 00 00 02 C9 02
				23 00 00 00 00 00 02 CA 06
				23 00 00 00 00 00 02 CB 02
				23 01 00 00 00 00 02 CC 34

				23 00 00 00 00 00 02 CD 02
				23 00 00 00 00 00 02 CE 35
				23 00 00 00 00 00 02 CF 02
				23 00 00 00 00 00 02 D0 61
				23 00 00 00 00 00 02 D1 02
				23 00 00 00 00 00 02 D2 92
				23 00 00 00 00 00 02 D3 02
				23 00 00 00 00 00 02 D4 B2
				23 00 00 00 00 00 02 D5 02
				23 00 00 00 00 00 02 D6 E4
				23 00 00 00 00 00 02 D7 03
				23 00 00 00 00 00 02 D8 08
				23 00 00 00 00 00 02 D9 03
				23 00 00 00 00 00 02 DA 3B
				23 00 00 00 00 00 02 DB 03
				23 00 00 00 00 00 02 DC 4F
				23 00 00 00 00 00 02 DD 03
				23 00 00 00 00 00 02 DE 69
				23 00 00 00 00 00 02 DF 03
				23 00 00 00 00 00 02 E0 9C
				23 00 00 00 00 00 02 E1 03
				23 00 00 00 00 00 02 E2 B9
				23 00 00 00 00 00 02 E3 03
				23 00 00 00 00 00 02 E4 BE
				23 00 00 00 00 00 02 E5 03
				23 00 00 00 00 00 02 E6 C1
				23 00 00 00 00 00 02 E7 03
				23 00 00 00 00 00 02 E8 C8
				23 00 00 00 00 00 02 E9 03
				23 01 00 00 00 00 02 EA C9];

		qcom,mdss-dsi-default_gamma-command = [23 00 00 00 00 00 02 FF 01
				23 00 00 00 00 00 02 FB 01
				23 00 00 00 00 00 02 6E 80
				23 00 00 00 00 00 02 75 00
				23 00 00 00 00 00 02 76 01
				23 00 00 00 00 00 02 77 00
				23 00 00 00 00 00 02 78 4F
				23 00 00 00 00 00 02 79 00
				23 00 00 00 00 00 02 7A 7F
				23 00 00 00 00 00 02 7B 00
				23 00 00 00 00 00 02 7C 9E
				23 00 00 00 00 00 02 7D 00
				23 00 00 00 00 00 02 7E B6
				23 00 00 00 00 00 02 7F 00
				23 00 00 00 00 00 02 80 C9
				23 00 00 00 00 00 02 81 00
				23 00 00 00 00 00 02 82 DB
				23 00 00 00 00 00 02 83 00
				23 00 00 00 00 00 02 84 EB
				23 00 00 00 00 00 02 85 00
				23 00 00 00 00 00 02 86 F9
				23 00 00 00 00 00 02 87 01
				23 00 00 00 00 00 02 88 27
				23 00 00 00 00 00 02 89 01
				23 00 00 00 00 00 02 8A 4C
				23 00 00 00 00 00 02 8B 01
				23 00 00 00 00 00 02 8C 86
				23 00 00 00 00 00 02 8D 01
				23 00 00 00 00 00 02 8E B4
				23 00 00 00 00 00 02 8F 01
				23 00 00 00 00 00 02 90 F9
				23 00 00 00 00 00 02 91 02
				23 01 00 00 00 00 02 92 2F

				23 00 00 00 00 00 02 93 02
				23 00 00 00 00 00 02 94 30
				23 00 00 00 00 00 02 95 02
				23 00 00 00 00 00 02 96 61
				23 00 00 00 00 00 02 97 02
				23 00 00 00 00 00 02 98 97
				23 00 00 00 00 00 02 99 02
				23 00 00 00 00 00 02 9A B9
				23 00 00 00 00 00 02 9B 02
				23 00 00 00 00 00 02 9C EB
				23 00 00 00 00 00 02 9D 03
				23 00 00 00 00 00 02 9E 0F
				23 00 00 00 00 00 02 9F 03
				23 00 00 00 00 00 02 A0 3C
				23 00 00 00 00 00 02 A2 03
				23 00 00 00 00 00 02 A3 4A
				23 00 00 00 00 00 02 A4 03
				23 00 00 00 00 00 02 A5 59
				23 00 00 00 00 00 02 A6 03
				23 00 00 00 00 00 02 A7 6C
				23 00 00 00 00 00 02 A9 03
				23 00 00 00 00 00 02 AA 87
				23 00 00 00 00 00 02 AB 03
				23 00 00 00 00 00 02 AC AA
				23 00 00 00 00 00 02 AD 03
				23 00 00 00 00 00 02 AE C3
				23 00 00 00 00 00 02 AF 03
				23 00 00 00 00 00 02 B0 CC
				23 00 00 00 00 00 02 B1 03
				23 01 00 00 00 00 02 B2 CD
				23 00 00 00 00 00 02 B3 00
				23 00 00 00 00 00 02 B4 01
				23 00 00 00 00 00 02 B5 00
				23 00 00 00 00 00 02 B6 4F
				23 00 00 00 00 00 02 B7 00
				23 00 00 00 00 00 02 B8 7F
				23 00 00 00 00 00 02 B9 00
				23 00 00 00 00 00 02 BA 9E
				23 00 00 00 00 00 02 BB 00
				23 00 00 00 00 00 02 BC B6
				23 00 00 00 00 00 02 BD 00
				23 00 00 00 00 00 02 BE C9
				23 00 00 00 00 00 02 BF 00
				23 00 00 00 00 00 02 C0 DB
				23 00 00 00 00 00 02 C1 00
				23 00 00 00 00 00 02 C2 EB
				23 00 00 00 00 00 02 C3 00
				23 00 00 00 00 00 02 C4 F9
				23 00 00 00 00 00 02 C5 01
				23 00 00 00 00 00 02 C6 27
				23 00 00 00 00 00 02 C7 01
				23 00 00 00 00 00 02 C8 4C
				23 00 00 00 00 00 02 C9 01
				23 00 00 00 00 00 02 CA 86
				23 00 00 00 00 00 02 CB 01
				23 00 00 00 00 00 02 CC B4
				23 00 00 00 00 00 02 CD 01
				23 00 00 00 00 00 02 CE F9
				23 00 00 00 00 00 02 CF 02
				23 01 00 00 00 00 02 D0 2F

				23 00 00 00 00 00 02 D1 02
				23 00 00 00 00 00 02 D2 30
				23 00 00 00 00 00 02 D3 02
				23 00 00 00 00 00 02 D4 61
				23 00 00 00 00 00 02 D5 02
				23 00 00 00 00 00 02 D6 97
				23 00 00 00 00 00 02 D7 02
				23 00 00 00 00 00 02 D8 B9
				23 00 00 00 00 00 02 D9 02
				23 00 00 00 00 00 02 DA EB
				23 00 00 00 00 00 02 DB 03
				23 00 00 00 00 00 02 DC 0F
				23 00 00 00 00 00 02 DD 03
				23 00 00 00 00 00 02 DE 3C
				23 00 00 00 00 00 02 DF 03
				23 00 00 00 00 00 02 E0 4A
				23 00 00 00 00 00 02 E1 03
				23 00 00 00 00 00 02 E2 59
				23 00 00 00 00 00 02 E3 03
				23 00 00 00 00 00 02 E4 6C
				23 00 00 00 00 00 02 E5 03
				23 00 00 00 00 00 02 E6 87
				23 00 00 00 00 00 02 E7 03
				23 00 00 00 00 00 02 E8 AA
				23 00 00 00 00 00 02 E9 03
				23 00 00 00 00 00 02 EA C3
				23 00 00 00 00 00 02 EB 03
				23 00 00 00 00 00 02 EC CC
				23 00 00 00 00 00 02 ED 03
				23 01 00 00 00 00 02 EE CD
				23 00 00 00 00 00 02 EF 00
				23 00 00 00 00 00 02 F0 F1
				23 00 00 00 00 00 02 F1 00
				23 00 00 00 00 00 02 F2 F7
				23 00 00 00 00 00 02 F3 01
				23 00 00 00 00 00 02 F4 04
				23 00 00 00 00 00 02 F5 01
				23 00 00 00 00 00 02 F6 0F
				23 00 00 00 00 00 02 F7 01
				23 00 00 00 00 00 02 F8 19
				23 00 00 00 00 00 02 F9 01
				23 00 00 00 00 00 02 FA 23
				23 00 00 00 00 00 02 FF 02
				23 00 00 00 00 00 02 FB 01
				23 00 00 00 00 00 02 00 01
				23 00 00 00 00 00 02 01 2D
				23 00 00 00 00 00 02 02 01
				23 00 00 00 00 00 02 03 37
				23 00 00 00 00 00 02 04 01
				23 00 00 00 00 00 02 05 3F
				23 00 00 00 00 00 02 06 01
				23 00 00 00 00 00 02 07 5E
				23 00 00 00 00 00 02 08 01
				23 00 00 00 00 00 02 09 79
				23 00 00 00 00 00 02 0A 01
				23 00 00 00 00 00 02 0B A7
				23 00 00 00 00 00 02 0C 01
				23 00 00 00 00 00 02 0D CC
				23 00 00 00 00 00 02 0E 02
				23 00 00 00 00 00 02 0F 08
				23 00 00 00 00 00 02 10 02
				23 01 00 00 00 00 02 11 39

				23 00 00 00 00 00 02 12 02
				23 00 00 00 00 00 02 13 3A
				23 00 00 00 00 00 02 14 02
				23 00 00 00 00 00 02 15 69
				23 00 00 00 00 00 02 16 02
				23 00 00 00 00 00 02 17 9D
				23 00 00 00 00 00 02 18 02
				23 00 00 00 00 00 02 19 C0
				23 00 00 00 00 00 02 1A 02
				23 00 00 00 00 00 02 1B F3
				23 00 00 00 00 00 02 1C 03
				23 00 00 00 00 00 02 1D 16
				23 00 00 00 00 00 02 1E 03
				23 00 00 00 00 00 02 1F 44
				23 00 00 00 00 00 02 20 03
				23 00 00 00 00 00 02 21 53
				23 00 00 00 00 00 02 22 03
				23 00 00 00 00 00 02 23 64
				23 00 00 00 00 00 02 24 03
				23 00 00 00 00 00 02 25 7A
				23 00 00 00 00 00 02 26 03
				23 00 00 00 00 00 02 27 95
				23 00 00 00 00 00 02 28 03
				23 00 00 00 00 00 02 29 B0
				23 00 00 00 00 00 02 2A 03
				23 00 00 00 00 00 02 2B C3
				23 00 00 00 00 00 02 2D 03
				23 00 00 00 00 00 02 2F CC
				23 00 00 00 00 00 02 30 03
				23 01 00 00 00 00 02 31 CD
				23 00 00 00 00 00 02 32 00
				23 00 00 00 00 00 02 33 F1
				23 00 00 00 00 00 02 34 00
				23 00 00 00 00 00 02 35 F7
				23 00 00 00 00 00 02 36 01
				23 00 00 00 00 00 02 37 04
				23 00 00 00 00 00 02 38 01
				23 00 00 00 00 00 02 39 0F
				23 00 00 00 00 00 02 3A 01
				23 00 00 00 00 00 02 3B 19
				23 00 00 00 00 00 02 3D 01
				23 00 00 00 00 00 02 3F 23
				23 00 00 00 00 00 02 40 01
				23 00 00 00 00 00 02 41 2D
				23 00 00 00 00 00 02 42 01
				23 00 00 00 00 00 02 43 37
				23 00 00 00 00 00 02 44 01
				23 00 00 00 00 00 02 45 3F
				23 00 00 00 00 00 02 46 01
				23 00 00 00 00 00 02 47 5E
				23 00 00 00 00 00 02 48 01
				23 00 00 00 00 00 02 49 79
				23 00 00 00 00 00 02 4A 01
				23 00 00 00 00 00 02 4B A7
				23 00 00 00 00 00 02 4C 01
				23 00 00 00 00 00 02 4D CC
				23 00 00 00 00 00 02 4E 02
				23 00 00 00 00 00 02 4F 08
				23 00 00 00 00 00 02 50 02
				23 01 00 00 00 00 02 51 39

				23 00 00 00 00 00 02 52 02
				23 00 00 00 00 00 02 53 3A
				23 00 00 00 00 00 02 54 02
				23 00 00 00 00 00 02 55 69
				23 00 00 00 00 00 02 56 02
				23 00 00 00 00 00 02 58 9D
				23 00 00 00 00 00 02 59 02
				23 00 00 00 00 00 02 5A C0
				23 00 00 00 00 00 02 5B 02
				23 00 00 00 00 00 02 5C F3
				23 00 00 00 00 00 02 5D 03
				23 00 00 00 00 00 02 5E 16
				23 00 00 00 00 00 02 5F 03
				23 00 00 00 00 00 02 60 44
				23 00 00 00 00 00 02 61 03
				23 00 00 00 00 00 02 62 53
				23 00 00 00 00 00 02 63 03
				23 00 00 00 00 00 02 64 64
				23 00 00 00 00 00 02 65 03
				23 00 00 00 00 00 02 66 7A
				23 00 00 00 00 00 02 67 03
				23 00 00 00 00 00 02 68 95
				23 00 00 00 00 00 02 69 03
				23 00 00 00 00 00 02 6A B0
				23 00 00 00 00 00 02 6B 03
				23 00 00 00 00 00 02 6C C3
				23 00 00 00 00 00 02 6D 03
				23 00 00 00 00 00 02 6E CC
				23 00 00 00 00 00 02 6F 03
				23 01 00 00 00 00 02 70 CD
				23 00 00 00 00 00 02 71 00
				23 00 00 00 00 00 02 72 A9
				23 00 00 00 00 00 02 73 00
				23 00 00 00 00 00 02 74 B3
				23 00 00 00 00 00 02 75 00
				23 00 00 00 00 00 02 76 C6
				23 00 00 00 00 00 02 77 00
				23 00 00 00 00 00 02 78 D6
				23 00 00 00 00 00 02 79 00
				23 00 00 00 00 00 02 7A E4
				23 00 00 00 00 00 02 7B 00
				23 00 00 00 00 00 02 7C F1
				23 00 00 00 00 00 02 7D 00
				23 00 00 00 00 00 02 7E FE
				23 00 00 00 00 00 02 7F 01
				23 00 00 00 00 00 02 80 0B
				23 00 00 00 00 00 02 81 01
				23 00 00 00 00 00 02 82 15
				23 00 00 00 00 00 02 83 01
				23 00 00 00 00 00 02 84 3B
				23 00 00 00 00 00 02 85 01
				23 00 00 00 00 00 02 86 5B
				23 00 00 00 00 00 02 87 01
				23 00 00 00 00 00 02 88 8F
				23 00 00 00 00 00 02 89 01
				23 00 00 00 00 00 02 8A B9
				23 00 00 00 00 00 02 8B 01
				23 00 00 00 00 00 02 8C FB
				23 00 00 00 00 00 02 8D 02
				23 01 00 00 00 00 02 8E 30

				23 00 00 00 00 00 02 8F 02
				23 00 00 00 00 00 02 90 31
				23 00 00 00 00 00 02 91 02
				23 00 00 00 00 00 02 92 62
				23 00 00 00 00 00 02 93 02
				23 00 00 00 00 00 02 94 98
				23 00 00 00 00 00 02 95 02
				23 00 00 00 00 00 02 96 BB
				23 00 00 00 00 00 02 97 02
				23 00 00 00 00 00 02 98 F0
				23 00 00 00 00 00 02 99 03
				23 00 00 00 00 00 02 9A 17
				23 00 00 00 00 00 02 9B 03
				23 00 00 00 00 00 02 9C 52
				23 00 00 00 00 00 02 9D 03
				23 00 00 00 00 00 02 9E 6C
				23 00 00 00 00 00 02 9F 03
				23 00 00 00 00 00 02 A0 97
				23 00 00 00 00 00 02 A2 03
				23 00 00 00 00 00 02 A3 B6
				23 00 00 00 00 00 02 A4 03
				23 00 00 00 00 00 02 A5 BF
				23 00 00 00 00 00 02 A6 03
				23 00 00 00 00 00 02 A7 C2
				23 00 00 00 00 00 02 A9 03
				23 00 00 00 00 00 02 AA C7
				23 00 00 00 00 00 02 AB 03
				23 00 00 00 00 00 02 AC CC
				23 00 00 00 00 00 02 AD 03
				23 01 00 00 00 00 02 AE CD
				23 00 00 00 00 00 02 AF 00
				23 00 00 00 00 00 02 B0 A9
				23 00 00 00 00 00 02 B1 00
				23 00 00 00 00 00 02 B2 B3
				23 00 00 00 00 00 02 B3 00
				23 00 00 00 00 00 02 B4 C6
				23 00 00 00 00 00 02 B5 00
				23 00 00 00 00 00 02 B6 D6
				23 00 00 00 00 00 02 B7 00
				23 00 00 00 00 00 02 B8 E4
				23 00 00 00 00 00 02 B9 00
				23 00 00 00 00 00 02 BA F1
				23 00 00 00 00 00 02 BB 00
				23 00 00 00 00 00 02 BC FE
				23 00 00 00 00 00 02 BD 01
				23 00 00 00 00 00 02 BE 0B
				23 00 00 00 00 00 02 BF 01
				23 00 00 00 00 00 02 C0 15
				23 00 00 00 00 00 02 C1 01
				23 00 00 00 00 00 02 C2 3B
				23 00 00 00 00 00 02 C3 01
				23 00 00 00 00 00 02 C4 5B
				23 00 00 00 00 00 02 C5 01
				23 00 00 00 00 00 02 C6 8F
				23 00 00 00 00 00 02 C7 01
				23 00 00 00 00 00 02 C8 B9
				23 00 00 00 00 00 02 C9 01
				23 00 00 00 00 00 02 CA FB
				23 00 00 00 00 00 02 CB 02
				23 01 00 00 00 00 02 CC 30

				23 00 00 00 00 00 02 CD 02
				23 00 00 00 00 00 02 CE 31
				23 00 00 00 00 00 02 CF 02
				23 00 00 00 00 00 02 D0 62
				23 00 00 00 00 00 02 D1 02
				23 00 00 00 00 00 02 D2 98
				23 00 00 00 00 00 02 D3 02
				23 00 00 00 00 00 02 D4 BB
				23 00 00 00 00 00 02 D5 02
				23 00 00 00 00 00 02 D6 F0
				23 00 00 00 00 00 02 D7 03
				23 00 00 00 00 00 02 D8 17
				23 00 00 00 00 00 02 D9 03
				23 00 00 00 00 00 02 DA 52
				23 00 00 00 00 00 02 DB 03
				23 00 00 00 00 00 02 DC 6C
				23 00 00 00 00 00 02 DD 03
				23 00 00 00 00 00 02 DE 97
				23 00 00 00 00 00 02 DF 03
				23 00 00 00 00 00 02 E0 B6
				23 00 00 00 00 00 02 E1 03
				23 00 00 00 00 00 02 E2 BF
				23 00 00 00 00 00 02 E3 03
				23 00 00 00 00 00 02 E4 C2
				23 00 00 00 00 00 02 E5 03
				23 00 00 00 00 00 02 E6 C7
				23 00 00 00 00 00 02 E7 03
				23 00 00 00 00 00 02 E8 CC
				23 00 00 00 00 00 02 E9 03
				23 01 00 00 00 00 02 EA CD];

		qcom,mdss-dsi-PM1-command = [23 00 00 00 00 00 02 FF 01
				23 00 00 00 00 00 02 FB 01
				23 00 00 00 00 00 02 75 00
				23 00 00 00 00 00 02 76 00
				23 00 00 00 00 00 02 77 00
				23 00 00 00 00 00 02 78 4C
				23 00 00 00 00 00 02 79 00
				23 00 00 00 00 00 02 7A 7C
				23 00 00 00 00 00 02 7B 00
				23 00 00 00 00 00 02 7C 9B
				23 00 00 00 00 00 02 7D 00
				23 00 00 00 00 00 02 7E B4
				23 00 00 00 00 00 02 7F 00
				23 00 00 00 00 00 02 80 C8
				23 00 00 00 00 00 02 81 00
				23 00 00 00 00 00 02 82 DA
				23 00 00 00 00 00 02 83 00
				23 00 00 00 00 00 02 84 E9
				23 00 00 00 00 00 02 85 00
				23 00 00 00 00 00 02 86 F7
				23 00 00 00 00 00 02 87 01
				23 00 00 00 00 00 02 88 27
				23 00 00 00 00 00 02 89 01
				23 00 00 00 00 00 02 8A 4C
				23 00 00 00 00 00 02 8B 01
				23 00 00 00 00 00 02 8C 86
				23 00 00 00 00 00 02 8D 01
				23 00 00 00 00 00 02 8E B3
				23 00 00 00 00 00 02 8F 01
				23 00 00 00 00 00 02 90 F8
				23 00 00 00 00 00 02 91 02
				23 00 00 00 00 00 02 92 2F
				23 00 00 00 00 00 02 93 02
				23 00 00 00 00 00 02 94 30
				23 00 00 00 00 00 02 95 02
				23 00 00 00 00 00 02 96 61
				23 00 00 00 00 00 02 97 02
				23 00 00 00 00 00 02 98 97
				23 00 00 00 00 00 02 99 02
				23 00 00 00 00 00 02 9A BB
				23 00 00 00 00 00 02 9B 02
				23 00 00 00 00 00 02 9C ED
				23 00 00 00 00 00 02 9D 03
				23 00 00 00 00 00 02 9E 11
				23 00 00 00 00 00 02 9F 03
				23 00 00 00 00 00 02 A0 3F
				23 00 00 00 00 00 02 A2 03
				23 00 00 00 00 00 02 A3 4E
				23 00 00 00 00 00 02 A4 03
				23 00 00 00 00 00 02 A5 60
				23 00 00 00 00 00 02 A6 03
				23 00 00 00 00 00 02 A7 77
				23 00 00 00 00 00 02 A9 03
				23 00 00 00 00 00 02 AA 94
				23 00 00 00 00 00 02 AB 03
				23 00 00 00 00 00 02 AC B0
				23 00 00 00 00 00 02 AD 03
				23 00 00 00 00 00 02 AE C4
				23 00 00 00 00 00 02 AF 03
				23 00 00 00 00 00 02 B0 CD
				23 00 00 00 00 00 02 B1 03
				23 01 00 00 00 00 02 B2 CE
				23 00 00 00 00 00 02 B3 00
				23 00 00 00 00 00 02 B4 00
				23 00 00 00 00 00 02 B5 00
				23 00 00 00 00 00 02 B6 4C
				23 00 00 00 00 00 02 B7 00
				23 00 00 00 00 00 02 B8 7C
				23 00 00 00 00 00 02 B9 00
				23 00 00 00 00 00 02 BA 9B
				23 00 00 00 00 00 02 BB 00
				23 00 00 00 00 00 02 BC B4
				23 00 00 00 00 00 02 BD 00
				23 00 00 00 00 00 02 BE C8
				23 00 00 00 00 00 02 BF 00
				23 00 00 00 00 00 02 C0 DA
				23 00 00 00 00 00 02 C1 00
				23 00 00 00 00 00 02 C2 E9
				23 00 00 00 00 00 02 C3 00
				23 00 00 00 00 00 02 C4 F7
				23 00 00 00 00 00 02 C5 01
				23 00 00 00 00 00 02 C6 27
				23 00 00 00 00 00 02 C7 01
				23 00 00 00 00 00 02 C8 4C
				23 00 00 00 00 00 02 C9 01
				23 00 00 00 00 00 02 CA 86
				23 00 00 00 00 00 02 CB 01
				23 00 00 00 00 00 02 CC B3
				23 00 00 00 00 00 02 CD 01
				23 00 00 00 00 00 02 CE F8
				23 00 00 00 00 00 02 CF 02
				23 00 00 00 00 00 02 D0 2F
				23 00 00 00 00 00 02 D1 02
				23 00 00 00 00 00 02 D2 30
				23 00 00 00 00 00 02 D3 02
				23 00 00 00 00 00 02 D4 61
				23 00 00 00 00 00 02 D5 02
				23 00 00 00 00 00 02 D6 97
				23 00 00 00 00 00 02 D7 02
				23 00 00 00 00 00 02 D8 BB
				23 00 00 00 00 00 02 D9 02
				23 00 00 00 00 00 02 DA ED
				23 00 00 00 00 00 02 DB 03
				23 00 00 00 00 00 02 DC 11
				23 00 00 00 00 00 02 DD 03
				23 00 00 00 00 00 02 DE 3F
				23 00 00 00 00 00 02 DF 03
				23 00 00 00 00 00 02 E0 4E
				23 00 00 00 00 00 02 E1 03
				23 00 00 00 00 00 02 E2 60
				23 00 00 00 00 00 02 E3 03
				23 00 00 00 00 00 02 E4 77
				23 00 00 00 00 00 02 E5 03
				23 00 00 00 00 00 02 E6 94
				23 00 00 00 00 00 02 E7 03
				23 00 00 00 00 00 02 E8 B0
				23 00 00 00 00 00 02 E9 03
				23 00 00 00 00 00 02 EA C4
				23 00 00 00 00 00 02 EB 03
				23 00 00 00 00 00 02 EC CD
				23 00 00 00 00 00 02 ED 03
				23 01 00 00 00 00 02 EE CE
				23 00 00 00 00 00 02 EF 00
				23 00 00 00 00 00 02 F0 F1
				23 00 00 00 00 00 02 F1 00
				23 00 00 00 00 00 02 F2 F7
				23 00 00 00 00 00 02 F3 01
				23 00 00 00 00 00 02 F4 03
				23 00 00 00 00 00 02 F5 01
				23 00 00 00 00 00 02 F6 0F
				23 00 00 00 00 00 02 F7 01
				23 00 00 00 00 00 02 F8 19
				23 00 00 00 00 00 02 F9 01
				23 00 00 00 00 00 02 FA 23
				23 00 00 00 00 00 02 FF 02
				23 00 00 00 00 00 02 FB 01
				23 00 00 00 00 00 02 00 01
				23 00 00 00 00 00 02 01 2C
				23 00 00 00 00 00 02 02 01
				23 00 00 00 00 00 02 03 35
				23 00 00 00 00 00 02 04 01
				23 00 00 00 00 00 02 05 3E
				23 00 00 00 00 00 02 06 01
				23 00 00 00 00 00 02 07 5D
				23 00 00 00 00 00 02 08 01
				23 00 00 00 00 00 02 09 78
				23 00 00 00 00 00 02 0A 01
				23 00 00 00 00 00 02 0B A5
				23 00 00 00 00 00 02 0C 01
				23 00 00 00 00 00 02 0D CA
				23 00 00 00 00 00 02 0E 02
				23 00 00 00 00 00 02 0F 06
				23 00 00 00 00 00 02 10 02
				23 00 00 00 00 00 02 11 37
				23 00 00 00 00 00 02 12 02
				23 00 00 00 00 00 02 13 38
				23 00 00 00 00 00 02 14 02
				23 00 00 00 00 00 02 15 67
				23 00 00 00 00 00 02 16 02
				23 00 00 00 00 00 02 17 9C
				23 00 00 00 00 00 02 18 02
				23 00 00 00 00 00 02 19 C0
				23 00 00 00 00 00 02 1A 02
				23 00 00 00 00 00 02 1B F3
				23 00 00 00 00 00 02 1C 03
				23 00 00 00 00 00 02 1D 17
				23 00 00 00 00 00 02 1E 03
				23 00 00 00 00 00 02 1F 44
				23 00 00 00 00 00 02 20 03
				23 00 00 00 00 00 02 21 53
				23 00 00 00 00 00 02 22 03
				23 00 00 00 00 00 02 23 64
				23 00 00 00 00 00 02 24 03
				23 00 00 00 00 00 02 25 7A
				23 00 00 00 00 00 02 26 03
				23 00 00 00 00 00 02 27 95
				23 00 00 00 00 00 02 28 03
				23 00 00 00 00 00 02 29 B0
				23 00 00 00 00 00 02 2A 03
				23 00 00 00 00 00 02 2B C4
				23 00 00 00 00 00 02 2D 03
				23 00 00 00 00 00 02 2F CD
				23 00 00 00 00 00 02 30 03
				23 01 00 00 00 00 02 31 CE
				23 00 00 00 00 00 02 32 00
				23 00 00 00 00 00 02 33 F1
				23 00 00 00 00 00 02 34 00
				23 00 00 00 00 00 02 35 F7
				23 00 00 00 00 00 02 36 01
				23 00 00 00 00 00 02 37 03
				23 00 00 00 00 00 02 38 01
				23 00 00 00 00 00 02 39 0F
				23 00 00 00 00 00 02 3A 01
				23 00 00 00 00 00 02 3B 19
				23 00 00 00 00 00 02 3D 01
				23 00 00 00 00 00 02 3F 23
				23 00 00 00 00 00 02 40 01
				23 00 00 00 00 00 02 41 2C
				23 00 00 00 00 00 02 42 01
				23 00 00 00 00 00 02 43 35
				23 00 00 00 00 00 02 44 01
				23 00 00 00 00 00 02 45 3E
				23 00 00 00 00 00 02 46 01
				23 00 00 00 00 00 02 47 5D
				23 00 00 00 00 00 02 48 01
				23 00 00 00 00 00 02 49 78
				23 00 00 00 00 00 02 4A 01
				23 00 00 00 00 00 02 4B A5
				23 00 00 00 00 00 02 4C 01
				23 00 00 00 00 00 02 4D CA
				23 00 00 00 00 00 02 4E 02
				23 00 00 00 00 00 02 4F 06
				23 00 00 00 00 00 02 50 02
				23 00 00 00 00 00 02 51 37
				23 00 00 00 00 00 02 52 02
				23 00 00 00 00 00 02 53 38
				23 00 00 00 00 00 02 54 02
				23 00 00 00 00 00 02 55 67
				23 00 00 00 00 00 02 56 02
				23 00 00 00 00 00 02 58 9C
				23 00 00 00 00 00 02 59 02
				23 00 00 00 00 00 02 5A C0
				23 00 00 00 00 00 02 5B 02
				23 00 00 00 00 00 02 5C F3
				23 00 00 00 00 00 02 5D 03
				23 00 00 00 00 00 02 5E 17
				23 00 00 00 00 00 02 5F 03
				23 00 00 00 00 00 02 60 44
				23 00 00 00 00 00 02 61 03
				23 00 00 00 00 00 02 62 53
				23 00 00 00 00 00 02 63 03
				23 00 00 00 00 00 02 64 64
				23 00 00 00 00 00 02 65 03
				23 00 00 00 00 00 02 66 7A
				23 00 00 00 00 00 02 67 03
				23 00 00 00 00 00 02 68 95
				23 00 00 00 00 00 02 69 03
				23 00 00 00 00 00 02 6A B0
				23 00 00 00 00 00 02 6B 03
				23 00 00 00 00 00 02 6C C4
				23 00 00 00 00 00 02 6D 03
				23 00 00 00 00 00 02 6E CD
				23 00 00 00 00 00 02 6F 03
				23 01 00 00 00 00 02 70 CE
				23 00 00 00 00 00 02 71 01
				23 00 00 00 00 00 02 72 09
				23 00 00 00 00 00 02 73 01
				23 00 00 00 00 00 02 74 0E
				23 00 00 00 00 00 02 75 01
				23 00 00 00 00 00 02 76 19
				23 00 00 00 00 00 02 77 01
				23 00 00 00 00 00 02 78 22
				23 00 00 00 00 00 02 79 01
				23 00 00 00 00 00 02 7A 2C
				23 00 00 00 00 00 02 7B 01
				23 00 00 00 00 00 02 7C 34
				23 00 00 00 00 00 02 7D 01
				23 00 00 00 00 00 02 7E 3D
				23 00 00 00 00 00 02 7F 01
				23 00 00 00 00 00 02 80 45
				23 00 00 00 00 00 02 81 01
				23 00 00 00 00 00 02 82 4C
				23 00 00 00 00 00 02 83 01
				23 00 00 00 00 00 02 84 69
				23 00 00 00 00 00 02 85 01
				23 00 00 00 00 00 02 86 82
				23 00 00 00 00 00 02 87 01
				23 00 00 00 00 00 02 88 AC
				23 00 00 00 00 00 02 89 01
				23 00 00 00 00 00 02 8A D0
				23 00 00 00 00 00 02 8B 02
				23 00 00 00 00 00 02 8C 0A
				23 00 00 00 00 00 02 8D 02
				23 00 00 00 00 00 02 8E 3A
				23 00 00 00 00 00 02 8F 02
				23 00 00 00 00 00 02 90 3B
				23 00 00 00 00 00 02 91 02
				23 00 00 00 00 00 02 92 69
				23 00 00 00 00 00 02 93 02
				23 00 00 00 00 00 02 94 9D
				23 00 00 00 00 00 02 95 02
				23 00 00 00 00 00 02 96 C1
				23 00 00 00 00 00 02 97 02
				23 00 00 00 00 00 02 98 F4
				23 00 00 00 00 00 02 99 03
				23 00 00 00 00 00 02 9A 17
				23 00 00 00 00 00 02 9B 03
				23 00 00 00 00 00 02 9C 42
				23 00 00 00 00 00 02 9D 03
				23 00 00 00 00 00 02 9E 50
				23 00 00 00 00 00 02 9F 03
				23 00 00 00 00 00 02 A0 5F
				23 00 00 00 00 00 02 A2 03
				23 00 00 00 00 00 02 A3 71
				23 00 00 00 00 00 02 A4 03
				23 00 00 00 00 00 02 A5 88
				23 00 00 00 00 00 02 A6 03
				23 00 00 00 00 00 02 A7 A6
				23 00 00 00 00 00 02 A9 03
				23 00 00 00 00 00 02 AA C0
				23 00 00 00 00 00 02 AB 03
				23 00 00 00 00 00 02 AC CD
				23 00 00 00 00 00 02 AD 03
				23 01 00 00 00 00 02 AE CE
				23 00 00 00 00 00 02 AF 01
				23 00 00 00 00 00 02 B0 09
				23 00 00 00 00 00 02 B1 01
				23 00 00 00 00 00 02 B2 0E
				23 00 00 00 00 00 02 B3 01
				23 00 00 00 00 00 02 B4 19
				23 00 00 00 00 00 02 B5 01
				23 00 00 00 00 00 02 B6 22
				23 00 00 00 00 00 02 B7 01
				23 00 00 00 00 00 02 B8 2C
				23 00 00 00 00 00 02 B9 01
				23 00 00 00 00 00 02 BA 34
				23 00 00 00 00 00 02 BB 01
				23 00 00 00 00 00 02 BC 3D
				23 00 00 00 00 00 02 BD 01
				23 00 00 00 00 00 02 BE 45
				23 00 00 00 00 00 02 BF 01
				23 00 00 00 00 00 02 C0 4C
				23 00 00 00 00 00 02 C1 01
				23 00 00 00 00 00 02 C2 69
				23 00 00 00 00 00 02 C3 01
				23 00 00 00 00 00 02 C4 82
				23 00 00 00 00 00 02 C5 01
				23 00 00 00 00 00 02 C6 AC
				23 00 00 00 00 00 02 C7 01
				23 00 00 00 00 00 02 C8 D0
				23 00 00 00 00 00 02 C9 02
				23 00 00 00 00 00 02 CA 0A
				23 00 00 00 00 00 02 CB 02
				23 00 00 00 00 00 02 CC 3A
				23 00 00 00 00 00 02 CD 02
				23 00 00 00 00 00 02 CE 3B
				23 00 00 00 00 00 02 CF 02
				23 00 00 00 00 00 02 D0 69
				23 00 00 00 00 00 02 D1 02
				23 00 00 00 00 00 02 D2 9D
				23 00 00 00 00 00 02 D3 02
				23 00 00 00 00 00 02 D4 C1
				23 00 00 00 00 00 02 D5 02
				23 00 00 00 00 00 02 D6 F4
				23 00 00 00 00 00 02 D7 03
				23 00 00 00 00 00 02 D8 17
				23 00 00 00 00 00 02 D9 03
				23 00 00 00 00 00 02 DA 42
				23 00 00 00 00 00 02 DB 03
				23 00 00 00 00 00 02 DC 50
				23 00 00 00 00 00 02 DD 03
				23 00 00 00 00 00 02 DE 5F
				23 00 00 00 00 00 02 DF 03
				23 00 00 00 00 00 02 E0 71
				23 00 00 00 00 00 02 E1 03
				23 00 00 00 00 00 02 E2 88
				23 00 00 00 00 00 02 E3 03
				23 00 00 00 00 00 02 E4 A6
				23 00 00 00 00 00 02 E5 03
				23 00 00 00 00 00 02 E6 C0
				23 00 00 00 00 00 02 E7 03
				23 00 00 00 00 00 02 E8 CD
				23 00 00 00 00 00 02 E9 03
				23 01 00 00 00 00 02 EA CE];

		qcom,mdss-dsi-PM2-command = [23 00 00 00 00 00 02 FF 01
				23 00 00 00 00 00 02 FB 01
				23 00 00 00 00 00 02 75 00
				23 00 00 00 00 00 02 76 00
				23 00 00 00 00 00 02 77 00
				23 00 00 00 00 00 02 78 4C
				23 00 00 00 00 00 02 79 00
				23 00 00 00 00 00 02 7A 7C
				23 00 00 00 00 00 02 7B 00
				23 00 00 00 00 00 02 7C 9B
				23 00 00 00 00 00 02 7D 00
				23 00 00 00 00 00 02 7E B4
				23 00 00 00 00 00 02 7F 00
				23 00 00 00 00 00 02 80 C8
				23 00 00 00 00 00 02 81 00
				23 00 00 00 00 00 02 82 DA
				23 00 00 00 00 00 02 83 00
				23 00 00 00 00 00 02 84 E9
				23 00 00 00 00 00 02 85 00
				23 00 00 00 00 00 02 86 F7
				23 00 00 00 00 00 02 87 01
				23 00 00 00 00 00 02 88 27
				23 00 00 00 00 00 02 89 01
				23 00 00 00 00 00 02 8A 4C
				23 00 00 00 00 00 02 8B 01
				23 00 00 00 00 00 02 8C 86
				23 00 00 00 00 00 02 8D 01
				23 00 00 00 00 00 02 8E B3
				23 00 00 00 00 00 02 8F 01
				23 00 00 00 00 00 02 90 F8
				23 00 00 00 00 00 02 91 02
				23 00 00 00 00 00 02 92 2F
				23 00 00 00 00 00 02 93 02
				23 00 00 00 00 00 02 94 30
				23 00 00 00 00 00 02 95 02
				23 00 00 00 00 00 02 96 61
				23 00 00 00 00 00 02 97 02
				23 00 00 00 00 00 02 98 97
				23 00 00 00 00 00 02 99 02
				23 00 00 00 00 00 02 9A BB
				23 00 00 00 00 00 02 9B 02
				23 00 00 00 00 00 02 9C ED
				23 00 00 00 00 00 02 9D 03
				23 00 00 00 00 00 02 9E 11
				23 00 00 00 00 00 02 9F 03
				23 00 00 00 00 00 02 A0 3F
				23 00 00 00 00 00 02 A2 03
				23 00 00 00 00 00 02 A3 4E
				23 00 00 00 00 00 02 A4 03
				23 00 00 00 00 00 02 A5 60
				23 00 00 00 00 00 02 A6 03
				23 00 00 00 00 00 02 A7 77
				23 00 00 00 00 00 02 A9 03
				23 00 00 00 00 00 02 AA 94
				23 00 00 00 00 00 02 AB 03
				23 00 00 00 00 00 02 AC B0
				23 00 00 00 00 00 02 AD 03
				23 00 00 00 00 00 02 AE C4
				23 00 00 00 00 00 02 AF 03
				23 00 00 00 00 00 02 B0 CD
				23 00 00 00 00 00 02 B1 03
				23 01 00 00 00 00 02 B2 CE
				23 00 00 00 00 00 02 B3 00
				23 00 00 00 00 00 02 B4 00
				23 00 00 00 00 00 02 B5 00
				23 00 00 00 00 00 02 B6 4C
				23 00 00 00 00 00 02 B7 00
				23 00 00 00 00 00 02 B8 7C
				23 00 00 00 00 00 02 B9 00
				23 00 00 00 00 00 02 BA 9B
				23 00 00 00 00 00 02 BB 00
				23 00 00 00 00 00 02 BC B4
				23 00 00 00 00 00 02 BD 00
				23 00 00 00 00 00 02 BE C8
				23 00 00 00 00 00 02 BF 00
				23 00 00 00 00 00 02 C0 DA
				23 00 00 00 00 00 02 C1 00
				23 00 00 00 00 00 02 C2 E9
				23 00 00 00 00 00 02 C3 00
				23 00 00 00 00 00 02 C4 F7
				23 00 00 00 00 00 02 C5 01
				23 00 00 00 00 00 02 C6 27
				23 00 00 00 00 00 02 C7 01
				23 00 00 00 00 00 02 C8 4C
				23 00 00 00 00 00 02 C9 01
				23 00 00 00 00 00 02 CA 86
				23 00 00 00 00 00 02 CB 01
				23 00 00 00 00 00 02 CC B3
				23 00 00 00 00 00 02 CD 01
				23 00 00 00 00 00 02 CE F8
				23 00 00 00 00 00 02 CF 02
				23 00 00 00 00 00 02 D0 2F
				23 00 00 00 00 00 02 D1 02
				23 00 00 00 00 00 02 D2 30
				23 00 00 00 00 00 02 D3 02
				23 00 00 00 00 00 02 D4 61
				23 00 00 00 00 00 02 D5 02
				23 00 00 00 00 00 02 D6 97
				23 00 00 00 00 00 02 D7 02
				23 00 00 00 00 00 02 D8 BB
				23 00 00 00 00 00 02 D9 02
				23 00 00 00 00 00 02 DA ED
				23 00 00 00 00 00 02 DB 03
				23 00 00 00 00 00 02 DC 11
				23 00 00 00 00 00 02 DD 03
				23 00 00 00 00 00 02 DE 3F
				23 00 00 00 00 00 02 DF 03
				23 00 00 00 00 00 02 E0 4E
				23 00 00 00 00 00 02 E1 03
				23 00 00 00 00 00 02 E2 60
				23 00 00 00 00 00 02 E3 03
				23 00 00 00 00 00 02 E4 77
				23 00 00 00 00 00 02 E5 03
				23 00 00 00 00 00 02 E6 94
				23 00 00 00 00 00 02 E7 03
				23 00 00 00 00 00 02 E8 B0
				23 00 00 00 00 00 02 E9 03
				23 00 00 00 00 00 02 EA C4
				23 00 00 00 00 00 02 EB 03
				23 00 00 00 00 00 02 EC CD
				23 00 00 00 00 00 02 ED 03
				23 01 00 00 00 00 02 EE CE
				23 00 00 00 00 00 02 EF 00
				23 00 00 00 00 00 02 F0 F1
				23 00 00 00 00 00 02 F1 00
				23 00 00 00 00 00 02 F2 F7
				23 00 00 00 00 00 02 F3 01
				23 00 00 00 00 00 02 F4 03
				23 00 00 00 00 00 02 F5 01
				23 00 00 00 00 00 02 F6 0F
				23 00 00 00 00 00 02 F7 01
				23 00 00 00 00 00 02 F8 19
				23 00 00 00 00 00 02 F9 01
				23 00 00 00 00 00 02 FA 23
				23 00 00 00 00 00 02 FF 02
				23 00 00 00 00 00 02 FB 01
				23 00 00 00 00 00 02 00 01
				23 00 00 00 00 00 02 01 2C
				23 00 00 00 00 00 02 02 01
				23 00 00 00 00 00 02 03 35
				23 00 00 00 00 00 02 04 01
				23 00 00 00 00 00 02 05 3E
				23 00 00 00 00 00 02 06 01
				23 00 00 00 00 00 02 07 5D
				23 00 00 00 00 00 02 08 01
				23 00 00 00 00 00 02 09 78
				23 00 00 00 00 00 02 0A 01
				23 00 00 00 00 00 02 0B A5
				23 00 00 00 00 00 02 0C 01
				23 00 00 00 00 00 02 0D CA
				23 00 00 00 00 00 02 0E 02
				23 00 00 00 00 00 02 0F 06
				23 00 00 00 00 00 02 10 02
				23 00 00 00 00 00 02 11 37
				23 00 00 00 00 00 02 12 02
				23 00 00 00 00 00 02 13 38
				23 00 00 00 00 00 02 14 02
				23 00 00 00 00 00 02 15 67
				23 00 00 00 00 00 02 16 02
				23 00 00 00 00 00 02 17 9C
				23 00 00 00 00 00 02 18 02
				23 00 00 00 00 00 02 19 C0
				23 00 00 00 00 00 02 1A 02
				23 00 00 00 00 00 02 1B F3
				23 00 00 00 00 00 02 1C 03
				23 00 00 00 00 00 02 1D 17
				23 00 00 00 00 00 02 1E 03
				23 00 00 00 00 00 02 1F 44
				23 00 00 00 00 00 02 20 03
				23 00 00 00 00 00 02 21 53
				23 00 00 00 00 00 02 22 03
				23 00 00 00 00 00 02 23 64
				23 00 00 00 00 00 02 24 03
				23 00 00 00 00 00 02 25 7A
				23 00 00 00 00 00 02 26 03
				23 00 00 00 00 00 02 27 95
				23 00 00 00 00 00 02 28 03
				23 00 00 00 00 00 02 29 B0
				23 00 00 00 00 00 02 2A 03
				23 00 00 00 00 00 02 2B C4
				23 00 00 00 00 00 02 2D 03
				23 00 00 00 00 00 02 2F CD
				23 00 00 00 00 00 02 30 03
				23 01 00 00 00 00 02 31 CE
				23 00 00 00 00 00 02 32 00
				23 00 00 00 00 00 02 33 F1
				23 00 00 00 00 00 02 34 00
				23 00 00 00 00 00 02 35 F7
				23 00 00 00 00 00 02 36 01
				23 00 00 00 00 00 02 37 03
				23 00 00 00 00 00 02 38 01
				23 00 00 00 00 00 02 39 0F
				23 00 00 00 00 00 02 3A 01
				23 00 00 00 00 00 02 3B 19
				23 00 00 00 00 00 02 3D 01
				23 00 00 00 00 00 02 3F 23
				23 00 00 00 00 00 02 40 01
				23 00 00 00 00 00 02 41 2C
				23 00 00 00 00 00 02 42 01
				23 00 00 00 00 00 02 43 35
				23 00 00 00 00 00 02 44 01
				23 00 00 00 00 00 02 45 3E
				23 00 00 00 00 00 02 46 01
				23 00 00 00 00 00 02 47 5D
				23 00 00 00 00 00 02 48 01
				23 00 00 00 00 00 02 49 78
				23 00 00 00 00 00 02 4A 01
				23 00 00 00 00 00 02 4B A5
				23 00 00 00 00 00 02 4C 01
				23 00 00 00 00 00 02 4D CA
				23 00 00 00 00 00 02 4E 02
				23 00 00 00 00 00 02 4F 06
				23 00 00 00 00 00 02 50 02
				23 00 00 00 00 00 02 51 37
				23 00 00 00 00 00 02 52 02
				23 00 00 00 00 00 02 53 38
				23 00 00 00 00 00 02 54 02
				23 00 00 00 00 00 02 55 67
				23 00 00 00 00 00 02 56 02
				23 00 00 00 00 00 02 58 9C
				23 00 00 00 00 00 02 59 02
				23 00 00 00 00 00 02 5A C0
				23 00 00 00 00 00 02 5B 02
				23 00 00 00 00 00 02 5C F3
				23 00 00 00 00 00 02 5D 03
				23 00 00 00 00 00 02 5E 17
				23 00 00 00 00 00 02 5F 03
				23 00 00 00 00 00 02 60 44
				23 00 00 00 00 00 02 61 03
				23 00 00 00 00 00 02 62 53
				23 00 00 00 00 00 02 63 03
				23 00 00 00 00 00 02 64 64
				23 00 00 00 00 00 02 65 03
				23 00 00 00 00 00 02 66 7A
				23 00 00 00 00 00 02 67 03
				23 00 00 00 00 00 02 68 95
				23 00 00 00 00 00 02 69 03
				23 00 00 00 00 00 02 6A B0
				23 00 00 00 00 00 02 6B 03
				23 00 00 00 00 00 02 6C C4
				23 00 00 00 00 00 02 6D 03
				23 00 00 00 00 00 02 6E CD
				23 00 00 00 00 00 02 6F 03
				23 01 00 00 00 00 02 70 CE
				23 00 00 00 00 00 02 71 01
				23 00 00 00 00 00 02 72 4A
				23 00 00 00 00 00 02 73 01
				23 00 00 00 00 00 02 74 4E
				23 00 00 00 00 00 02 75 01
				23 00 00 00 00 00 02 76 55
				23 00 00 00 00 00 02 77 01
				23 00 00 00 00 00 02 78 5B
				23 00 00 00 00 00 02 79 01
				23 00 00 00 00 00 02 7A 62
				23 00 00 00 00 00 02 7B 01
				23 00 00 00 00 00 02 7C 68
				23 00 00 00 00 00 02 7D 01
				23 00 00 00 00 00 02 7E 6E
				23 00 00 00 00 00 02 7F 01
				23 00 00 00 00 00 02 80 74
				23 00 00 00 00 00 02 81 01
				23 00 00 00 00 00 02 82 7A
				23 00 00 00 00 00 02 83 01
				23 00 00 00 00 00 02 84 90
				23 00 00 00 00 00 02 85 01
				23 00 00 00 00 00 02 86 A4
				23 00 00 00 00 00 02 87 01
				23 00 00 00 00 00 02 88 C7
				23 00 00 00 00 00 02 89 01
				23 00 00 00 00 00 02 8A E5
				23 00 00 00 00 00 02 8B 02
				23 00 00 00 00 00 02 8C 18
				23 00 00 00 00 00 02 8D 02
				23 00 00 00 00 00 02 8E 44
				23 00 00 00 00 00 02 8F 02
				23 00 00 00 00 00 02 90 45
				23 00 00 00 00 00 02 91 02
				23 00 00 00 00 00 02 92 71
				23 00 00 00 00 00 02 93 02
				23 00 00 00 00 00 02 94 A4
				23 00 00 00 00 00 02 95 02
				23 00 00 00 00 00 02 96 C8
				23 00 00 00 00 00 02 97 02
				23 00 00 00 00 00 02 98 FB
				23 00 00 00 00 00 02 99 03
				23 00 00 00 00 00 02 9A 1D
				23 00 00 00 00 00 02 9B 03
				23 00 00 00 00 00 02 9C 48
				23 00 00 00 00 00 02 9D 03
				23 00 00 00 00 00 02 9E 55
				23 00 00 00 00 00 02 9F 03
				23 00 00 00 00 00 02 A0 64
				23 00 00 00 00 00 02 A2 03
				23 00 00 00 00 00 02 A3 76
				23 00 00 00 00 00 02 A4 03
				23 00 00 00 00 00 02 A5 8E
				23 00 00 00 00 00 02 A6 03
				23 00 00 00 00 00 02 A7 AA
				23 00 00 00 00 00 02 A9 03
				23 00 00 00 00 00 02 AA C2
				23 00 00 00 00 00 02 AB 03
				23 00 00 00 00 00 02 AC CD
				23 00 00 00 00 00 02 AD 03
				23 01 00 00 00 00 02 AE CE
				23 00 00 00 00 00 02 AF 01
				23 00 00 00 00 00 02 B0 4A
				23 00 00 00 00 00 02 B1 01
				23 00 00 00 00 00 02 B2 4E
				23 00 00 00 00 00 02 B3 01
				23 00 00 00 00 00 02 B4 55
				23 00 00 00 00 00 02 B5 01
				23 00 00 00 00 00 02 B6 5B
				23 00 00 00 00 00 02 B7 01
				23 00 00 00 00 00 02 B8 62
				23 00 00 00 00 00 02 B9 01
				23 00 00 00 00 00 02 BA 68
				23 00 00 00 00 00 02 BB 01
				23 00 00 00 00 00 02 BC 6E
				23 00 00 00 00 00 02 BD 01
				23 00 00 00 00 00 02 BE 74
				23 00 00 00 00 00 02 BF 01
				23 00 00 00 00 00 02 C0 7A
				23 00 00 00 00 00 02 C1 01
				23 00 00 00 00 00 02 C2 90
				23 00 00 00 00 00 02 C3 01
				23 00 00 00 00 00 02 C4 A4
				23 00 00 00 00 00 02 C5 01
				23 00 00 00 00 00 02 C6 C7
				23 00 00 00 00 00 02 C7 01
				23 00 00 00 00 00 02 C8 E5
				23 00 00 00 00 00 02 C9 02
				23 00 00 00 00 00 02 CA 18
				23 00 00 00 00 00 02 CB 02
				23 00 00 00 00 00 02 CC 44
				23 00 00 00 00 00 02 CD 02
				23 00 00 00 00 00 02 CE 45
				23 00 00 00 00 00 02 CF 02
				23 00 00 00 00 00 02 D0 71
				23 00 00 00 00 00 02 D1 02
				23 00 00 00 00 00 02 D2 A4
				23 00 00 00 00 00 02 D3 02
				23 00 00 00 00 00 02 D4 C8
				23 00 00 00 00 00 02 D5 02
				23 00 00 00 00 00 02 D6 FB
				23 00 00 00 00 00 02 D7 03
				23 00 00 00 00 00 02 D8 1D
				23 00 00 00 00 00 02 D9 03
				23 00 00 00 00 00 02 DA 48
				23 00 00 00 00 00 02 DB 03
				23 00 00 00 00 00 02 DC 55
				23 00 00 00 00 00 02 DD 03
				23 00 00 00 00 00 02 DE 64
				23 00 00 00 00 00 02 DF 03
				23 00 00 00 00 00 02 E0 76
				23 00 00 00 00 00 02 E1 03
				23 00 00 00 00 00 02 E2 8E
				23 00 00 00 00 00 02 E3 03
				23 00 00 00 00 00 02 E4 AA
				23 00 00 00 00 00 02 E5 03
				23 00 00 00 00 00 02 E6 C2
				23 00 00 00 00 00 02 E7 03
				23 00 00 00 00 00 02 E8 CD
				23 00 00 00 00 00 02 E9 03
				23 01 00 00 00 00 02 EA CE];

		qcom,mdss-dsi-PM3-command = [23 00 00 00 00 00 02 FF 01
				23 00 00 00 00 00 02 FB 01
				23 00 00 00 00 00 02 75 00
				23 00 00 00 00 00 02 76 00
				23 00 00 00 00 00 02 77 00
				23 00 00 00 00 00 02 78 4C
				23 00 00 00 00 00 02 79 00
				23 00 00 00 00 00 02 7A 7C
				23 00 00 00 00 00 02 7B 00
				23 00 00 00 00 00 02 7C 9B
				23 00 00 00 00 00 02 7D 00
				23 00 00 00 00 00 02 7E B4
				23 00 00 00 00 00 02 7F 00
				23 00 00 00 00 00 02 80 C8
				23 00 00 00 00 00 02 81 00
				23 00 00 00 00 00 02 82 DA
				23 00 00 00 00 00 02 83 00
				23 00 00 00 00 00 02 84 E9
				23 00 00 00 00 00 02 85 00
				23 00 00 00 00 00 02 86 F7
				23 00 00 00 00 00 02 87 01
				23 00 00 00 00 00 02 88 27
				23 00 00 00 00 00 02 89 01
				23 00 00 00 00 00 02 8A 4C
				23 00 00 00 00 00 02 8B 01
				23 00 00 00 00 00 02 8C 86
				23 00 00 00 00 00 02 8D 01
				23 00 00 00 00 00 02 8E B3
				23 00 00 00 00 00 02 8F 01
				23 00 00 00 00 00 02 90 F8
				23 00 00 00 00 00 02 91 02
				23 00 00 00 00 00 02 92 2F
				23 00 00 00 00 00 02 93 02
				23 00 00 00 00 00 02 94 30
				23 00 00 00 00 00 02 95 02
				23 00 00 00 00 00 02 96 61
				23 00 00 00 00 00 02 97 02
				23 00 00 00 00 00 02 98 97
				23 00 00 00 00 00 02 99 02
				23 00 00 00 00 00 02 9A BB
				23 00 00 00 00 00 02 9B 02
				23 00 00 00 00 00 02 9C ED
				23 00 00 00 00 00 02 9D 03
				23 00 00 00 00 00 02 9E 11
				23 00 00 00 00 00 02 9F 03
				23 00 00 00 00 00 02 A0 3F
				23 00 00 00 00 00 02 A2 03
				23 00 00 00 00 00 02 A3 4E
				23 00 00 00 00 00 02 A4 03
				23 00 00 00 00 00 02 A5 60
				23 00 00 00 00 00 02 A6 03
				23 00 00 00 00 00 02 A7 77
				23 00 00 00 00 00 02 A9 03
				23 00 00 00 00 00 02 AA 94
				23 00 00 00 00 00 02 AB 03
				23 00 00 00 00 00 02 AC B0
				23 00 00 00 00 00 02 AD 03
				23 00 00 00 00 00 02 AE C4
				23 00 00 00 00 00 02 AF 03
				23 00 00 00 00 00 02 B0 CD
				23 00 00 00 00 00 02 B1 03
				23 01 00 00 00 00 02 B2 CE
				23 00 00 00 00 00 02 B3 00
				23 00 00 00 00 00 02 B4 00
				23 00 00 00 00 00 02 B5 00
				23 00 00 00 00 00 02 B6 4C
				23 00 00 00 00 00 02 B7 00
				23 00 00 00 00 00 02 B8 7C
				23 00 00 00 00 00 02 B9 00
				23 00 00 00 00 00 02 BA 9B
				23 00 00 00 00 00 02 BB 00
				23 00 00 00 00 00 02 BC B4
				23 00 00 00 00 00 02 BD 00
				23 00 00 00 00 00 02 BE C8
				23 00 00 00 00 00 02 BF 00
				23 00 00 00 00 00 02 C0 DA
				23 00 00 00 00 00 02 C1 00
				23 00 00 00 00 00 02 C2 E9
				23 00 00 00 00 00 02 C3 00
				23 00 00 00 00 00 02 C4 F7
				23 00 00 00 00 00 02 C5 01
				23 00 00 00 00 00 02 C6 27
				23 00 00 00 00 00 02 C7 01
				23 00 00 00 00 00 02 C8 4C
				23 00 00 00 00 00 02 C9 01
				23 00 00 00 00 00 02 CA 86
				23 00 00 00 00 00 02 CB 01
				23 00 00 00 00 00 02 CC B3
				23 00 00 00 00 00 02 CD 01
				23 00 00 00 00 00 02 CE F8
				23 00 00 00 00 00 02 CF 02
				23 00 00 00 00 00 02 D0 2F
				23 00 00 00 00 00 02 D1 02
				23 00 00 00 00 00 02 D2 30
				23 00 00 00 00 00 02 D3 02
				23 00 00 00 00 00 02 D4 61
				23 00 00 00 00 00 02 D5 02
				23 00 00 00 00 00 02 D6 97
				23 00 00 00 00 00 02 D7 02
				23 00 00 00 00 00 02 D8 BB
				23 00 00 00 00 00 02 D9 02
				23 00 00 00 00 00 02 DA ED
				23 00 00 00 00 00 02 DB 03
				23 00 00 00 00 00 02 DC 11
				23 00 00 00 00 00 02 DD 03
				23 00 00 00 00 00 02 DE 3F
				23 00 00 00 00 00 02 DF 03
				23 00 00 00 00 00 02 E0 4E
				23 00 00 00 00 00 02 E1 03
				23 00 00 00 00 00 02 E2 60
				23 00 00 00 00 00 02 E3 03
				23 00 00 00 00 00 02 E4 77
				23 00 00 00 00 00 02 E5 03
				23 00 00 00 00 00 02 E6 94
				23 00 00 00 00 00 02 E7 03
				23 00 00 00 00 00 02 E8 B0
				23 00 00 00 00 00 02 E9 03
				23 00 00 00 00 00 02 EA C4
				23 00 00 00 00 00 02 EB 03
				23 00 00 00 00 00 02 EC CD
				23 00 00 00 00 00 02 ED 03
				23 01 00 00 00 00 02 EE CE
				23 00 00 00 00 00 02 EF 00
				23 00 00 00 00 00 02 F0 F1
				23 00 00 00 00 00 02 F1 00
				23 00 00 00 00 00 02 F2 F7
				23 00 00 00 00 00 02 F3 01
				23 00 00 00 00 00 02 F4 03
				23 00 00 00 00 00 02 F5 01
				23 00 00 00 00 00 02 F6 0F
				23 00 00 00 00 00 02 F7 01
				23 00 00 00 00 00 02 F8 19
				23 00 00 00 00 00 02 F9 01
				23 00 00 00 00 00 02 FA 23
				23 00 00 00 00 00 02 FF 02
				23 00 00 00 00 00 02 FB 01
				23 00 00 00 00 00 02 00 01
				23 00 00 00 00 00 02 01 2C
				23 00 00 00 00 00 02 02 01
				23 00 00 00 00 00 02 03 35
				23 00 00 00 00 00 02 04 01
				23 00 00 00 00 00 02 05 3E
				23 00 00 00 00 00 02 06 01
				23 00 00 00 00 00 02 07 5D
				23 00 00 00 00 00 02 08 01
				23 00 00 00 00 00 02 09 78
				23 00 00 00 00 00 02 0A 01
				23 00 00 00 00 00 02 0B A5
				23 00 00 00 00 00 02 0C 01
				23 00 00 00 00 00 02 0D CA
				23 00 00 00 00 00 02 0E 02
				23 00 00 00 00 00 02 0F 06
				23 00 00 00 00 00 02 10 02
				23 00 00 00 00 00 02 11 37
				23 00 00 00 00 00 02 12 02
				23 00 00 00 00 00 02 13 38
				23 00 00 00 00 00 02 14 02
				23 00 00 00 00 00 02 15 67
				23 00 00 00 00 00 02 16 02
				23 00 00 00 00 00 02 17 9C
				23 00 00 00 00 00 02 18 02
				23 00 00 00 00 00 02 19 C0
				23 00 00 00 00 00 02 1A 02
				23 00 00 00 00 00 02 1B F3
				23 00 00 00 00 00 02 1C 03
				23 00 00 00 00 00 02 1D 17
				23 00 00 00 00 00 02 1E 03
				23 00 00 00 00 00 02 1F 44
				23 00 00 00 00 00 02 20 03
				23 00 00 00 00 00 02 21 53
				23 00 00 00 00 00 02 22 03
				23 00 00 00 00 00 02 23 64
				23 00 00 00 00 00 02 24 03
				23 00 00 00 00 00 02 25 7A
				23 00 00 00 00 00 02 26 03
				23 00 00 00 00 00 02 27 95
				23 00 00 00 00 00 02 28 03
				23 00 00 00 00 00 02 29 B0
				23 00 00 00 00 00 02 2A 03
				23 00 00 00 00 00 02 2B C4
				23 00 00 00 00 00 02 2D 03
				23 00 00 00 00 00 02 2F CD
				23 00 00 00 00 00 02 30 03
				23 01 00 00 00 00 02 31 CE
				23 00 00 00 00 00 02 32 00
				23 00 00 00 00 00 02 33 F1
				23 00 00 00 00 00 02 34 00
				23 00 00 00 00 00 02 35 F7
				23 00 00 00 00 00 02 36 01
				23 00 00 00 00 00 02 37 03
				23 00 00 00 00 00 02 38 01
				23 00 00 00 00 00 02 39 0F
				23 00 00 00 00 00 02 3A 01
				23 00 00 00 00 00 02 3B 19
				23 00 00 00 00 00 02 3D 01
				23 00 00 00 00 00 02 3F 23
				23 00 00 00 00 00 02 40 01
				23 00 00 00 00 00 02 41 2C
				23 00 00 00 00 00 02 42 01
				23 00 00 00 00 00 02 43 35
				23 00 00 00 00 00 02 44 01
				23 00 00 00 00 00 02 45 3E
				23 00 00 00 00 00 02 46 01
				23 00 00 00 00 00 02 47 5D
				23 00 00 00 00 00 02 48 01
				23 00 00 00 00 00 02 49 78
				23 00 00 00 00 00 02 4A 01
				23 00 00 00 00 00 02 4B A5
				23 00 00 00 00 00 02 4C 01
				23 00 00 00 00 00 02 4D CA
				23 00 00 00 00 00 02 4E 02
				23 00 00 00 00 00 02 4F 06
				23 00 00 00 00 00 02 50 02
				23 00 00 00 00 00 02 51 37
				23 00 00 00 00 00 02 52 02
				23 00 00 00 00 00 02 53 38
				23 00 00 00 00 00 02 54 02
				23 00 00 00 00 00 02 55 67
				23 00 00 00 00 00 02 56 02
				23 00 00 00 00 00 02 58 9C
				23 00 00 00 00 00 02 59 02
				23 00 00 00 00 00 02 5A C0
				23 00 00 00 00 00 02 5B 02
				23 00 00 00 00 00 02 5C F3
				23 00 00 00 00 00 02 5D 03
				23 00 00 00 00 00 02 5E 17
				23 00 00 00 00 00 02 5F 03
				23 00 00 00 00 00 02 60 44
				23 00 00 00 00 00 02 61 03
				23 00 00 00 00 00 02 62 53
				23 00 00 00 00 00 02 63 03
				23 00 00 00 00 00 02 64 64
				23 00 00 00 00 00 02 65 03
				23 00 00 00 00 00 02 66 7A
				23 00 00 00 00 00 02 67 03
				23 00 00 00 00 00 02 68 95
				23 00 00 00 00 00 02 69 03
				23 00 00 00 00 00 02 6A B0
				23 00 00 00 00 00 02 6B 03
				23 00 00 00 00 00 02 6C C4
				23 00 00 00 00 00 02 6D 03
				23 00 00 00 00 00 02 6E CD
				23 00 00 00 00 00 02 6F 03
				23 01 00 00 00 00 02 70 CE
				23 00 00 00 00 00 02 71 01
				23 00 00 00 00 00 02 72 7A
				23 00 00 00 00 00 02 73 01
				23 00 00 00 00 00 02 74 7D
				23 00 00 00 00 00 02 75 01
				23 00 00 00 00 00 02 76 82
				23 00 00 00 00 00 02 77 01
				23 00 00 00 00 00 02 78 87
				23 00 00 00 00 00 02 79 01
				23 00 00 00 00 00 02 7A 8C
				23 00 00 00 00 00 02 7B 01
				23 00 00 00 00 00 02 7C 91
				23 00 00 00 00 00 02 7D 01
				23 00 00 00 00 00 02 7E 96
				23 00 00 00 00 00 02 7F 01
				23 00 00 00 00 00 02 80 9B
				23 00 00 00 00 00 02 81 01
				23 00 00 00 00 00 02 82 9F
				23 00 00 00 00 00 02 83 01
				23 00 00 00 00 00 02 84 B1
				23 00 00 00 00 00 02 85 01
				23 00 00 00 00 00 02 86 C1
				23 00 00 00 00 00 02 87 01
				23 00 00 00 00 00 02 88 DE
				23 00 00 00 00 00 02 89 01
				23 00 00 00 00 00 02 8A F8
				23 00 00 00 00 00 02 8B 02
				23 00 00 00 00 00 02 8C 25
				23 00 00 00 00 00 02 8D 02
				23 00 00 00 00 00 02 8E 4E
				23 00 00 00 00 00 02 8F 02
				23 00 00 00 00 00 02 90 4F
				23 00 00 00 00 00 02 91 02
				23 00 00 00 00 00 02 92 79
				23 00 00 00 00 00 02 93 02
				23 00 00 00 00 00 02 94 AB
				23 00 00 00 00 00 02 95 02
				23 00 00 00 00 00 02 96 D0
				23 00 00 00 00 00 02 97 03
				23 00 00 00 00 00 02 98 02
				23 00 00 00 00 00 02 99 03
				23 00 00 00 00 00 02 9A 24
				23 00 00 00 00 00 02 9B 03
				23 00 00 00 00 00 02 9C 4D
				23 00 00 00 00 00 02 9D 03
				23 00 00 00 00 00 02 9E 5A
				23 00 00 00 00 00 02 9F 03
				23 00 00 00 00 00 02 A0 6A
				23 00 00 00 00 00 02 A2 03
				23 00 00 00 00 00 02 A3 7C
				23 00 00 00 00 00 02 A4 03
				23 00 00 00 00 00 02 A5 93
				23 00 00 00 00 00 02 A6 03
				23 00 00 00 00 00 02 A7 AE
				23 00 00 00 00 00 02 A9 03
				23 00 00 00 00 00 02 AA C3
				23 00 00 00 00 00 02 AB 03
				23 00 00 00 00 00 02 AC CD
				23 00 00 00 00 00 02 AD 03
				23 01 00 00 00 00 02 AE CE
				23 00 00 00 00 00 02 AF 01
				23 00 00 00 00 00 02 B0 7A
				23 00 00 00 00 00 02 B1 01
				23 00 00 00 00 00 02 B2 7D
				23 00 00 00 00 00 02 B3 01
				23 00 00 00 00 00 02 B4 82
				23 00 00 00 00 00 02 B5 01
				23 00 00 00 00 00 02 B6 87
				23 00 00 00 00 00 02 B7 01
				23 00 00 00 00 00 02 B8 8C
				23 00 00 00 00 00 02 B9 01
				23 00 00 00 00 00 02 BA 91
				23 00 00 00 00 00 02 BB 01
				23 00 00 00 00 00 02 BC 96
				23 00 00 00 00 00 02 BD 01
				23 00 00 00 00 00 02 BE 9B
				23 00 00 00 00 00 02 BF 01
				23 00 00 00 00 00 02 C0 9F
				23 00 00 00 00 00 02 C1 01
				23 00 00 00 00 00 02 C2 B1
				23 00 00 00 00 00 02 C3 01
				23 00 00 00 00 00 02 C4 C1
				23 00 00 00 00 00 02 C5 01
				23 00 00 00 00 00 02 C6 DE
				23 00 00 00 00 00 02 C7 01
				23 00 00 00 00 00 02 C8 F8
				23 00 00 00 00 00 02 C9 02
				23 00 00 00 00 00 02 CA 25
				23 00 00 00 00 00 02 CB 02
				23 00 00 00 00 00 02 CC 4E
				23 00 00 00 00 00 02 CD 02
				23 00 00 00 00 00 02 CE 4F
				23 00 00 00 00 00 02 CF 02
				23 00 00 00 00 00 02 D0 79
				23 00 00 00 00 00 02 D1 02
				23 00 00 00 00 00 02 D2 AB
				23 00 00 00 00 00 02 D3 02
				23 00 00 00 00 00 02 D4 D0
				23 00 00 00 00 00 02 D5 03
				23 00 00 00 00 00 02 D6 02
				23 00 00 00 00 00 02 D7 03
				23 00 00 00 00 00 02 D8 24
				23 00 00 00 00 00 02 D9 03
				23 00 00 00 00 00 02 DA 4D
				23 00 00 00 00 00 02 DB 03
				23 00 00 00 00 00 02 DC 5A
				23 00 00 00 00 00 02 DD 03
				23 00 00 00 00 00 02 DE 6A
				23 00 00 00 00 00 02 DF 03
				23 00 00 00 00 00 02 E0 7C
				23 00 00 00 00 00 02 E1 03
				23 00 00 00 00 00 02 E2 93
				23 00 00 00 00 00 02 E3 03
				23 00 00 00 00 00 02 E4 AE
				23 00 00 00 00 00 02 E5 03
				23 00 00 00 00 00 02 E6 C3
				23 00 00 00 00 00 02 E7 03
				23 00 00 00 00 00 02 E8 CD
				23 00 00 00 00 00 02 E9 03
				23 01 00 00 00 00 02 EA CE];


		qcom,mdss-dsi-PM4-command = [23 00 00 00 00 00 02 FF 01
				23 00 00 00 00 00 02 FB 01
				23 00 00 00 00 00 02 75 00
				23 00 00 00 00 00 02 76 00
				23 00 00 00 00 00 02 77 00
				23 00 00 00 00 00 02 78 4C
				23 00 00 00 00 00 02 79 00
				23 00 00 00 00 00 02 7A 7C
				23 00 00 00 00 00 02 7B 00
				23 00 00 00 00 00 02 7C 9B
				23 00 00 00 00 00 02 7D 00
				23 00 00 00 00 00 02 7E B4
				23 00 00 00 00 00 02 7F 00
				23 00 00 00 00 00 02 80 C8
				23 00 00 00 00 00 02 81 00
				23 00 00 00 00 00 02 82 DA
				23 00 00 00 00 00 02 83 00
				23 00 00 00 00 00 02 84 E9
				23 00 00 00 00 00 02 85 00
				23 00 00 00 00 00 02 86 F7
				23 00 00 00 00 00 02 87 01
				23 00 00 00 00 00 02 88 27
				23 00 00 00 00 00 02 89 01
				23 00 00 00 00 00 02 8A 4C
				23 00 00 00 00 00 02 8B 01
				23 00 00 00 00 00 02 8C 86
				23 00 00 00 00 00 02 8D 01
				23 00 00 00 00 00 02 8E B3
				23 00 00 00 00 00 02 8F 01
				23 00 00 00 00 00 02 90 F8
				23 00 00 00 00 00 02 91 02
				23 00 00 00 00 00 02 92 2F
				23 00 00 00 00 00 02 93 02
				23 00 00 00 00 00 02 94 30
				23 00 00 00 00 00 02 95 02
				23 00 00 00 00 00 02 96 61
				23 00 00 00 00 00 02 97 02
				23 00 00 00 00 00 02 98 97
				23 00 00 00 00 00 02 99 02
				23 00 00 00 00 00 02 9A BB
				23 00 00 00 00 00 02 9B 02
				23 00 00 00 00 00 02 9C ED
				23 00 00 00 00 00 02 9D 03
				23 00 00 00 00 00 02 9E 11
				23 00 00 00 00 00 02 9F 03
				23 00 00 00 00 00 02 A0 3F
				23 00 00 00 00 00 02 A2 03
				23 00 00 00 00 00 02 A3 4E
				23 00 00 00 00 00 02 A4 03
				23 00 00 00 00 00 02 A5 60
				23 00 00 00 00 00 02 A6 03
				23 00 00 00 00 00 02 A7 77
				23 00 00 00 00 00 02 A9 03
				23 00 00 00 00 00 02 AA 94
				23 00 00 00 00 00 02 AB 03
				23 00 00 00 00 00 02 AC B0
				23 00 00 00 00 00 02 AD 03
				23 00 00 00 00 00 02 AE C4
				23 00 00 00 00 00 02 AF 03
				23 00 00 00 00 00 02 B0 CD
				23 00 00 00 00 00 02 B1 03
				23 01 00 00 00 00 02 B2 CE
				23 00 00 00 00 00 02 B3 00
				23 00 00 00 00 00 02 B4 00
				23 00 00 00 00 00 02 B5 00
				23 00 00 00 00 00 02 B6 4C
				23 00 00 00 00 00 02 B7 00
				23 00 00 00 00 00 02 B8 7C
				23 00 00 00 00 00 02 B9 00
				23 00 00 00 00 00 02 BA 9B
				23 00 00 00 00 00 02 BB 00
				23 00 00 00 00 00 02 BC B4
				23 00 00 00 00 00 02 BD 00
				23 00 00 00 00 00 02 BE C8
				23 00 00 00 00 00 02 BF 00
				23 00 00 00 00 00 02 C0 DA
				23 00 00 00 00 00 02 C1 00
				23 00 00 00 00 00 02 C2 E9
				23 00 00 00 00 00 02 C3 00
				23 00 00 00 00 00 02 C4 F7
				23 00 00 00 00 00 02 C5 01
				23 00 00 00 00 00 02 C6 27
				23 00 00 00 00 00 02 C7 01
				23 00 00 00 00 00 02 C8 4C
				23 00 00 00 00 00 02 C9 01
				23 00 00 00 00 00 02 CA 86
				23 00 00 00 00 00 02 CB 01
				23 00 00 00 00 00 02 CC B3
				23 00 00 00 00 00 02 CD 01
				23 00 00 00 00 00 02 CE F8
				23 00 00 00 00 00 02 CF 02
				23 00 00 00 00 00 02 D0 2F
				23 00 00 00 00 00 02 D1 02
				23 00 00 00 00 00 02 D2 30
				23 00 00 00 00 00 02 D3 02
				23 00 00 00 00 00 02 D4 61
				23 00 00 00 00 00 02 D5 02
				23 00 00 00 00 00 02 D6 97
				23 00 00 00 00 00 02 D7 02
				23 00 00 00 00 00 02 D8 BB
				23 00 00 00 00 00 02 D9 02
				23 00 00 00 00 00 02 DA ED
				23 00 00 00 00 00 02 DB 03
				23 00 00 00 00 00 02 DC 11
				23 00 00 00 00 00 02 DD 03
				23 00 00 00 00 00 02 DE 3F
				23 00 00 00 00 00 02 DF 03
				23 00 00 00 00 00 02 E0 4E
				23 00 00 00 00 00 02 E1 03
				23 00 00 00 00 00 02 E2 60
				23 00 00 00 00 00 02 E3 03
				23 00 00 00 00 00 02 E4 77
				23 00 00 00 00 00 02 E5 03
				23 00 00 00 00 00 02 E6 94
				23 00 00 00 00 00 02 E7 03
				23 00 00 00 00 00 02 E8 B0
				23 00 00 00 00 00 02 E9 03
				23 00 00 00 00 00 02 EA C4
				23 00 00 00 00 00 02 EB 03
				23 00 00 00 00 00 02 EC CD
				23 00 00 00 00 00 02 ED 03
				23 01 00 00 00 00 02 EE CE
				23 00 00 00 00 00 02 EF 00
				23 00 00 00 00 00 02 F0 F1
				23 00 00 00 00 00 02 F1 00
				23 00 00 00 00 00 02 F2 F7
				23 00 00 00 00 00 02 F3 01
				23 00 00 00 00 00 02 F4 03
				23 00 00 00 00 00 02 F5 01
				23 00 00 00 00 00 02 F6 0F
				23 00 00 00 00 00 02 F7 01
				23 00 00 00 00 00 02 F8 19
				23 00 00 00 00 00 02 F9 01
				23 00 00 00 00 00 02 FA 23
				23 00 00 00 00 00 02 FF 02
				23 00 00 00 00 00 02 FB 01
				23 00 00 00 00 00 02 00 01
				23 00 00 00 00 00 02 01 2C
				23 00 00 00 00 00 02 02 01
				23 00 00 00 00 00 02 03 35
				23 00 00 00 00 00 02 04 01
				23 00 00 00 00 00 02 05 3E
				23 00 00 00 00 00 02 06 01
				23 00 00 00 00 00 02 07 5D
				23 00 00 00 00 00 02 08 01
				23 00 00 00 00 00 02 09 78
				23 00 00 00 00 00 02 0A 01
				23 00 00 00 00 00 02 0B A5
				23 00 00 00 00 00 02 0C 01
				23 00 00 00 00 00 02 0D CA
				23 00 00 00 00 00 02 0E 02
				23 00 00 00 00 00 02 0F 06
				23 00 00 00 00 00 02 10 02
				23 00 00 00 00 00 02 11 37
				23 00 00 00 00 00 02 12 02
				23 00 00 00 00 00 02 13 38
				23 00 00 00 00 00 02 14 02
				23 00 00 00 00 00 02 15 67
				23 00 00 00 00 00 02 16 02
				23 00 00 00 00 00 02 17 9C
				23 00 00 00 00 00 02 18 02
				23 00 00 00 00 00 02 19 C0
				23 00 00 00 00 00 02 1A 02
				23 00 00 00 00 00 02 1B F3
				23 00 00 00 00 00 02 1C 03
				23 00 00 00 00 00 02 1D 17
				23 00 00 00 00 00 02 1E 03
				23 00 00 00 00 00 02 1F 44
				23 00 00 00 00 00 02 20 03
				23 00 00 00 00 00 02 21 53
				23 00 00 00 00 00 02 22 03
				23 00 00 00 00 00 02 23 64
				23 00 00 00 00 00 02 24 03
				23 00 00 00 00 00 02 25 7A
				23 00 00 00 00 00 02 26 03
				23 00 00 00 00 00 02 27 95
				23 00 00 00 00 00 02 28 03
				23 00 00 00 00 00 02 29 B0
				23 00 00 00 00 00 02 2A 03
				23 00 00 00 00 00 02 2B C4
				23 00 00 00 00 00 02 2D 03
				23 00 00 00 00 00 02 2F CD
				23 00 00 00 00 00 02 30 03
				23 01 00 00 00 00 02 31 CE
				23 00 00 00 00 00 02 32 00
				23 00 00 00 00 00 02 33 F1
				23 00 00 00 00 00 02 34 00
				23 00 00 00 00 00 02 35 F7
				23 00 00 00 00 00 02 36 01
				23 00 00 00 00 00 02 37 03
				23 00 00 00 00 00 02 38 01
				23 00 00 00 00 00 02 39 0F
				23 00 00 00 00 00 02 3A 01
				23 00 00 00 00 00 02 3B 19
				23 00 00 00 00 00 02 3D 01
				23 00 00 00 00 00 02 3F 23
				23 00 00 00 00 00 02 40 01
				23 00 00 00 00 00 02 41 2C
				23 00 00 00 00 00 02 42 01
				23 00 00 00 00 00 02 43 35
				23 00 00 00 00 00 02 44 01
				23 00 00 00 00 00 02 45 3E
				23 00 00 00 00 00 02 46 01
				23 00 00 00 00 00 02 47 5D
				23 00 00 00 00 00 02 48 01
				23 00 00 00 00 00 02 49 78
				23 00 00 00 00 00 02 4A 01
				23 00 00 00 00 00 02 4B A5
				23 00 00 00 00 00 02 4C 01
				23 00 00 00 00 00 02 4D CA
				23 00 00 00 00 00 02 4E 02
				23 00 00 00 00 00 02 4F 06
				23 00 00 00 00 00 02 50 02
				23 00 00 00 00 00 02 51 37
				23 00 00 00 00 00 02 52 02
				23 00 00 00 00 00 02 53 38
				23 00 00 00 00 00 02 54 02
				23 00 00 00 00 00 02 55 67
				23 00 00 00 00 00 02 56 02
				23 00 00 00 00 00 02 58 9C
				23 00 00 00 00 00 02 59 02
				23 00 00 00 00 00 02 5A C0
				23 00 00 00 00 00 02 5B 02
				23 00 00 00 00 00 02 5C F3
				23 00 00 00 00 00 02 5D 03
				23 00 00 00 00 00 02 5E 17
				23 00 00 00 00 00 02 5F 03
				23 00 00 00 00 00 02 60 44
				23 00 00 00 00 00 02 61 03
				23 00 00 00 00 00 02 62 53
				23 00 00 00 00 00 02 63 03
				23 00 00 00 00 00 02 64 64
				23 00 00 00 00 00 02 65 03
				23 00 00 00 00 00 02 66 7A
				23 00 00 00 00 00 02 67 03
				23 00 00 00 00 00 02 68 95
				23 00 00 00 00 00 02 69 03
				23 00 00 00 00 00 02 6A B0
				23 00 00 00 00 00 02 6B 03
				23 00 00 00 00 00 02 6C C4
				23 00 00 00 00 00 02 6D 03
				23 00 00 00 00 00 02 6E CD
				23 00 00 00 00 00 02 6F 03
				23 01 00 00 00 00 02 70 CE
				23 00 00 00 00 00 02 71 01
				23 00 00 00 00 00 02 72 99
				23 00 00 00 00 00 02 73 01
				23 00 00 00 00 00 02 74 9B
				23 00 00 00 00 00 02 75 01
				23 00 00 00 00 00 02 76 A0
				23 00 00 00 00 00 02 77 01
				23 00 00 00 00 00 02 78 A4
				23 00 00 00 00 00 02 79 01
				23 00 00 00 00 00 02 7A A8
				23 00 00 00 00 00 02 7B 01
				23 00 00 00 00 00 02 7C AC
				23 00 00 00 00 00 02 7D 01
				23 00 00 00 00 00 02 7E B0
				23 00 00 00 00 00 02 7F 01
				23 00 00 00 00 00 02 80 B4
				23 00 00 00 00 00 02 81 01
				23 00 00 00 00 00 02 82 B8
				23 00 00 00 00 00 02 83 01
				23 00 00 00 00 00 02 84 C7
				23 00 00 00 00 00 02 85 01
				23 00 00 00 00 00 02 86 D5
				23 00 00 00 00 00 02 87 01
				23 00 00 00 00 00 02 88 EF
				23 00 00 00 00 00 02 89 02
				23 00 00 00 00 00 02 8A 06
				23 00 00 00 00 00 02 8B 02
				23 00 00 00 00 00 02 8C 2F
				23 00 00 00 00 00 02 8D 02
				23 00 00 00 00 00 02 8E 56
				23 00 00 00 00 00 02 8F 02
				23 00 00 00 00 00 02 90 57
				23 00 00 00 00 00 02 91 02
				23 00 00 00 00 00 02 92 7F
				23 00 00 00 00 00 02 93 02
				23 00 00 00 00 00 02 94 B1
				23 00 00 00 00 00 02 95 02
				23 00 00 00 00 00 02 96 D7
				23 00 00 00 00 00 02 97 03
				23 00 00 00 00 00 02 98 08
				23 00 00 00 00 00 02 99 03
				23 00 00 00 00 00 02 9A 29
				23 00 00 00 00 00 02 9B 03
				23 00 00 00 00 00 02 9C 52
				23 00 00 00 00 00 02 9D 03
				23 00 00 00 00 00 02 9E 5F
				23 00 00 00 00 00 02 9F 03
				23 00 00 00 00 00 02 A0 6E
				23 00 00 00 00 00 02 A2 03
				23 00 00 00 00 00 02 A3 80
				23 00 00 00 00 00 02 A4 03
				23 00 00 00 00 00 02 A5 98
				23 00 00 00 00 00 02 A6 03
				23 00 00 00 00 00 02 A7 B1
				23 00 00 00 00 00 02 A9 03
				23 00 00 00 00 00 02 AA C4
				23 00 00 00 00 00 02 AB 03
				23 00 00 00 00 00 02 AC CD
				23 00 00 00 00 00 02 AD 03
				23 01 00 00 00 00 02 AE CE
				23 00 00 00 00 00 02 AF 01
				23 00 00 00 00 00 02 B0 99
				23 00 00 00 00 00 02 B1 01
				23 00 00 00 00 00 02 B2 9B
				23 00 00 00 00 00 02 B3 01
				23 00 00 00 00 00 02 B4 A0
				23 00 00 00 00 00 02 B5 01
				23 00 00 00 00 00 02 B6 A4
				23 00 00 00 00 00 02 B7 01
				23 00 00 00 00 00 02 B8 A8
				23 00 00 00 00 00 02 B9 01
				23 00 00 00 00 00 02 BA AC
				23 00 00 00 00 00 02 BB 01
				23 00 00 00 00 00 02 BC B0
				23 00 00 00 00 00 02 BD 01
				23 00 00 00 00 00 02 BE B4
				23 00 00 00 00 00 02 BF 01
				23 00 00 00 00 00 02 C0 B8
				23 00 00 00 00 00 02 C1 01
				23 00 00 00 00 00 02 C2 C7
				23 00 00 00 00 00 02 C3 01
				23 00 00 00 00 00 02 C4 D5
				23 00 00 00 00 00 02 C5 01
				23 00 00 00 00 00 02 C6 EF
				23 00 00 00 00 00 02 C7 02
				23 00 00 00 00 00 02 C8 06
				23 00 00 00 00 00 02 C9 02
				23 00 00 00 00 00 02 CA 2F
				23 00 00 00 00 00 02 CB 02
				23 00 00 00 00 00 02 CC 56
				23 00 00 00 00 00 02 CD 02
				23 00 00 00 00 00 02 CE 57
				23 00 00 00 00 00 02 CF 02
				23 00 00 00 00 00 02 D0 7F
				23 00 00 00 00 00 02 D1 02
				23 00 00 00 00 00 02 D2 B1
				23 00 00 00 00 00 02 D3 02
				23 00 00 00 00 00 02 D4 D7
				23 00 00 00 00 00 02 D5 03
				23 00 00 00 00 00 02 D6 08
				23 00 00 00 00 00 02 D7 03
				23 00 00 00 00 00 02 D8 29
				23 00 00 00 00 00 02 D9 03
				23 00 00 00 00 00 02 DA 52
				23 00 00 00 00 00 02 DB 03
				23 00 00 00 00 00 02 DC 5F
				23 00 00 00 00 00 02 DD 03
				23 00 00 00 00 00 02 DE 6E
				23 00 00 00 00 00 02 DF 03
				23 00 00 00 00 00 02 E0 80
				23 00 00 00 00 00 02 E1 03
				23 00 00 00 00 00 02 E2 98
				23 00 00 00 00 00 02 E3 03
				23 00 00 00 00 00 02 E4 B1
				23 00 00 00 00 00 02 E5 03
				23 00 00 00 00 00 02 E6 C4
				23 00 00 00 00 00 02 E7 03
				23 00 00 00 00 00 02 E8 CD
				23 00 00 00 00 00 02 E9 03
				23 01 00 00 00 00 02 EA CE];

		qcom,mdss-dsi-PM5-command = [23 00 00 00 00 00 02 FF 01
				23 00 00 00 00 00 02 FB 01
				23 00 00 00 00 00 02 75 00
				23 00 00 00 00 00 02 76 00
				23 00 00 00 00 00 02 77 00
				23 00 00 00 00 00 02 78 4C
				23 00 00 00 00 00 02 79 00
				23 00 00 00 00 00 02 7A 7C
				23 00 00 00 00 00 02 7B 00
				23 00 00 00 00 00 02 7C 9B
				23 00 00 00 00 00 02 7D 00
				23 00 00 00 00 00 02 7E B4
				23 00 00 00 00 00 02 7F 00
				23 00 00 00 00 00 02 80 C8
				23 00 00 00 00 00 02 81 00
				23 00 00 00 00 00 02 82 DA
				23 00 00 00 00 00 02 83 00
				23 00 00 00 00 00 02 84 E9
				23 00 00 00 00 00 02 85 00
				23 00 00 00 00 00 02 86 F7
				23 00 00 00 00 00 02 87 01
				23 00 00 00 00 00 02 88 27
				23 00 00 00 00 00 02 89 01
				23 00 00 00 00 00 02 8A 4C
				23 00 00 00 00 00 02 8B 01
				23 00 00 00 00 00 02 8C 86
				23 00 00 00 00 00 02 8D 01
				23 00 00 00 00 00 02 8E B3
				23 00 00 00 00 00 02 8F 01
				23 00 00 00 00 00 02 90 F8
				23 00 00 00 00 00 02 91 02
				23 00 00 00 00 00 02 92 2F
				23 00 00 00 00 00 02 93 02
				23 00 00 00 00 00 02 94 30
				23 00 00 00 00 00 02 95 02
				23 00 00 00 00 00 02 96 61
				23 00 00 00 00 00 02 97 02
				23 00 00 00 00 00 02 98 97
				23 00 00 00 00 00 02 99 02
				23 00 00 00 00 00 02 9A BB
				23 00 00 00 00 00 02 9B 02
				23 00 00 00 00 00 02 9C ED
				23 00 00 00 00 00 02 9D 03
				23 00 00 00 00 00 02 9E 11
				23 00 00 00 00 00 02 9F 03
				23 00 00 00 00 00 02 A0 3F
				23 00 00 00 00 00 02 A2 03
				23 00 00 00 00 00 02 A3 4E
				23 00 00 00 00 00 02 A4 03
				23 00 00 00 00 00 02 A5 60
				23 00 00 00 00 00 02 A6 03
				23 00 00 00 00 00 02 A7 77
				23 00 00 00 00 00 02 A9 03
				23 00 00 00 00 00 02 AA 94
				23 00 00 00 00 00 02 AB 03
				23 00 00 00 00 00 02 AC B0
				23 00 00 00 00 00 02 AD 03
				23 00 00 00 00 00 02 AE C4
				23 00 00 00 00 00 02 AF 03
				23 00 00 00 00 00 02 B0 CD
				23 00 00 00 00 00 02 B1 03
				23 01 00 00 00 00 02 B2 CE
				23 00 00 00 00 00 02 B3 00
				23 00 00 00 00 00 02 B4 00
				23 00 00 00 00 00 02 B5 00
				23 00 00 00 00 00 02 B6 4C
				23 00 00 00 00 00 02 B7 00
				23 00 00 00 00 00 02 B8 7C
				23 00 00 00 00 00 02 B9 00
				23 00 00 00 00 00 02 BA 9B
				23 00 00 00 00 00 02 BB 00
				23 00 00 00 00 00 02 BC B4
				23 00 00 00 00 00 02 BD 00
				23 00 00 00 00 00 02 BE C8
				23 00 00 00 00 00 02 BF 00
				23 00 00 00 00 00 02 C0 DA
				23 00 00 00 00 00 02 C1 00
				23 00 00 00 00 00 02 C2 E9
				23 00 00 00 00 00 02 C3 00
				23 00 00 00 00 00 02 C4 F7
				23 00 00 00 00 00 02 C5 01
				23 00 00 00 00 00 02 C6 27
				23 00 00 00 00 00 02 C7 01
				23 00 00 00 00 00 02 C8 4C
				23 00 00 00 00 00 02 C9 01
				23 00 00 00 00 00 02 CA 86
				23 00 00 00 00 00 02 CB 01
				23 00 00 00 00 00 02 CC B3
				23 00 00 00 00 00 02 CD 01
				23 00 00 00 00 00 02 CE F8
				23 00 00 00 00 00 02 CF 02
				23 00 00 00 00 00 02 D0 2F
				23 00 00 00 00 00 02 D1 02
				23 00 00 00 00 00 02 D2 30
				23 00 00 00 00 00 02 D3 02
				23 00 00 00 00 00 02 D4 61
				23 00 00 00 00 00 02 D5 02
				23 00 00 00 00 00 02 D6 97
				23 00 00 00 00 00 02 D7 02
				23 00 00 00 00 00 02 D8 BB
				23 00 00 00 00 00 02 D9 02
				23 00 00 00 00 00 02 DA ED
				23 00 00 00 00 00 02 DB 03
				23 00 00 00 00 00 02 DC 11
				23 00 00 00 00 00 02 DD 03
				23 00 00 00 00 00 02 DE 3F
				23 00 00 00 00 00 02 DF 03
				23 00 00 00 00 00 02 E0 4E
				23 00 00 00 00 00 02 E1 03
				23 00 00 00 00 00 02 E2 60
				23 00 00 00 00 00 02 E3 03
				23 00 00 00 00 00 02 E4 77
				23 00 00 00 00 00 02 E5 03
				23 00 00 00 00 00 02 E6 94
				23 00 00 00 00 00 02 E7 03
				23 00 00 00 00 00 02 E8 B0
				23 00 00 00 00 00 02 E9 03
				23 00 00 00 00 00 02 EA C4
				23 00 00 00 00 00 02 EB 03
				23 00 00 00 00 00 02 EC CD
				23 00 00 00 00 00 02 ED 03
				23 01 00 00 00 00 02 EE CE
				23 00 00 00 00 00 02 EF 00
				23 00 00 00 00 00 02 F0 F1
				23 00 00 00 00 00 02 F1 00
				23 00 00 00 00 00 02 F2 F7
				23 00 00 00 00 00 02 F3 01
				23 00 00 00 00 00 02 F4 03
				23 00 00 00 00 00 02 F5 01
				23 00 00 00 00 00 02 F6 0F
				23 00 00 00 00 00 02 F7 01
				23 00 00 00 00 00 02 F8 19
				23 00 00 00 00 00 02 F9 01
				23 00 00 00 00 00 02 FA 23
				23 00 00 00 00 00 02 FF 02
				23 00 00 00 00 00 02 FB 01
				23 00 00 00 00 00 02 00 01
				23 00 00 00 00 00 02 01 2C
				23 00 00 00 00 00 02 02 01
				23 00 00 00 00 00 02 03 35
				23 00 00 00 00 00 02 04 01
				23 00 00 00 00 00 02 05 3E
				23 00 00 00 00 00 02 06 01
				23 00 00 00 00 00 02 07 5D
				23 00 00 00 00 00 02 08 01
				23 00 00 00 00 00 02 09 78
				23 00 00 00 00 00 02 0A 01
				23 00 00 00 00 00 02 0B A5
				23 00 00 00 00 00 02 0C 01
				23 00 00 00 00 00 02 0D CA
				23 00 00 00 00 00 02 0E 02
				23 00 00 00 00 00 02 0F 06
				23 00 00 00 00 00 02 10 02
				23 00 00 00 00 00 02 11 37
				23 00 00 00 00 00 02 12 02
				23 00 00 00 00 00 02 13 38
				23 00 00 00 00 00 02 14 02
				23 00 00 00 00 00 02 15 67
				23 00 00 00 00 00 02 16 02
				23 00 00 00 00 00 02 17 9C
				23 00 00 00 00 00 02 18 02
				23 00 00 00 00 00 02 19 C0
				23 00 00 00 00 00 02 1A 02
				23 00 00 00 00 00 02 1B F3
				23 00 00 00 00 00 02 1C 03
				23 00 00 00 00 00 02 1D 17
				23 00 00 00 00 00 02 1E 03
				23 00 00 00 00 00 02 1F 44
				23 00 00 00 00 00 02 20 03
				23 00 00 00 00 00 02 21 53
				23 00 00 00 00 00 02 22 03
				23 00 00 00 00 00 02 23 64
				23 00 00 00 00 00 02 24 03
				23 00 00 00 00 00 02 25 7A
				23 00 00 00 00 00 02 26 03
				23 00 00 00 00 00 02 27 95
				23 00 00 00 00 00 02 28 03
				23 00 00 00 00 00 02 29 B0
				23 00 00 00 00 00 02 2A 03
				23 00 00 00 00 00 02 2B C4
				23 00 00 00 00 00 02 2D 03
				23 00 00 00 00 00 02 2F CD
				23 00 00 00 00 00 02 30 03
				23 01 00 00 00 00 02 31 CE
				23 00 00 00 00 00 02 32 00
				23 00 00 00 00 00 02 33 F1
				23 00 00 00 00 00 02 34 00
				23 00 00 00 00 00 02 35 F7
				23 00 00 00 00 00 02 36 01
				23 00 00 00 00 00 02 37 03
				23 00 00 00 00 00 02 38 01
				23 00 00 00 00 00 02 39 0F
				23 00 00 00 00 00 02 3A 01
				23 00 00 00 00 00 02 3B 19
				23 00 00 00 00 00 02 3D 01
				23 00 00 00 00 00 02 3F 23
				23 00 00 00 00 00 02 40 01
				23 00 00 00 00 00 02 41 2C
				23 00 00 00 00 00 02 42 01
				23 00 00 00 00 00 02 43 35
				23 00 00 00 00 00 02 44 01
				23 00 00 00 00 00 02 45 3E
				23 00 00 00 00 00 02 46 01
				23 00 00 00 00 00 02 47 5D
				23 00 00 00 00 00 02 48 01
				23 00 00 00 00 00 02 49 78
				23 00 00 00 00 00 02 4A 01
				23 00 00 00 00 00 02 4B A5
				23 00 00 00 00 00 02 4C 01
				23 00 00 00 00 00 02 4D CA
				23 00 00 00 00 00 02 4E 02
				23 00 00 00 00 00 02 4F 06
				23 00 00 00 00 00 02 50 02
				23 00 00 00 00 00 02 51 37
				23 00 00 00 00 00 02 52 02
				23 00 00 00 00 00 02 53 38
				23 00 00 00 00 00 02 54 02
				23 00 00 00 00 00 02 55 67
				23 00 00 00 00 00 02 56 02
				23 00 00 00 00 00 02 58 9C
				23 00 00 00 00 00 02 59 02
				23 00 00 00 00 00 02 5A C0
				23 00 00 00 00 00 02 5B 02
				23 00 00 00 00 00 02 5C F3
				23 00 00 00 00 00 02 5D 03
				23 00 00 00 00 00 02 5E 17
				23 00 00 00 00 00 02 5F 03
				23 00 00 00 00 00 02 60 44
				23 00 00 00 00 00 02 61 03
				23 00 00 00 00 00 02 62 53
				23 00 00 00 00 00 02 63 03
				23 00 00 00 00 00 02 64 64
				23 00 00 00 00 00 02 65 03
				23 00 00 00 00 00 02 66 7A
				23 00 00 00 00 00 02 67 03
				23 00 00 00 00 00 02 68 95
				23 00 00 00 00 00 02 69 03
				23 00 00 00 00 00 02 6A B0
				23 00 00 00 00 00 02 6B 03
				23 00 00 00 00 00 02 6C C4
				23 00 00 00 00 00 02 6D 03
				23 00 00 00 00 00 02 6E CD
				23 00 00 00 00 00 02 6F 03
				23 01 00 00 00 00 02 70 CE
				23 00 00 00 00 00 02 71 01
				23 00 00 00 00 00 02 72 BF
				23 00 00 00 00 00 02 73 01
				23 00 00 00 00 00 02 74 C1
				23 00 00 00 00 00 02 75 01
				23 00 00 00 00 00 02 76 C4
				23 00 00 00 00 00 02 77 01
				23 00 00 00 00 00 02 78 C8
				23 00 00 00 00 00 02 79 01
				23 00 00 00 00 00 02 7A CB
				23 00 00 00 00 00 02 7B 01
				23 00 00 00 00 00 02 7C CE
				23 00 00 00 00 00 02 7D 01
				23 00 00 00 00 00 02 7E D1
				23 00 00 00 00 00 02 7F 01
				23 00 00 00 00 00 02 80 D5
				23 00 00 00 00 00 02 81 01
				23 00 00 00 00 00 02 82 D8
				23 00 00 00 00 00 02 83 01
				23 00 00 00 00 00 02 84 E4
				23 00 00 00 00 00 02 85 01
				23 00 00 00 00 00 02 86 EF
				23 00 00 00 00 00 02 87 02
				23 00 00 00 00 00 02 88 05
				23 00 00 00 00 00 02 89 02
				23 00 00 00 00 00 02 8A 19
				23 00 00 00 00 00 02 8B 02
				23 00 00 00 00 00 02 8C 3D
				23 00 00 00 00 00 02 8D 02
				23 00 00 00 00 00 02 8E 61
				23 00 00 00 00 00 02 8F 02
				23 00 00 00 00 00 02 90 62
				23 00 00 00 00 00 02 91 02
				23 00 00 00 00 00 02 92 89
				23 00 00 00 00 00 02 93 02
				23 00 00 00 00 00 02 94 BA
				23 00 00 00 00 00 02 95 02
				23 00 00 00 00 00 02 96 E0
				23 00 00 00 00 00 02 97 03
				23 00 00 00 00 00 02 98 11
				23 00 00 00 00 00 02 99 03
				23 00 00 00 00 00 02 9A 30
				23 00 00 00 00 00 02 9B 03
				23 00 00 00 00 00 02 9C 59
				23 00 00 00 00 00 02 9D 03
				23 00 00 00 00 00 02 9E 66
				23 00 00 00 00 00 02 9F 03
				23 00 00 00 00 00 02 A0 75
				23 00 00 00 00 00 02 A2 03
				23 00 00 00 00 00 02 A3 88
				23 00 00 00 00 00 02 A4 03
				23 00 00 00 00 00 02 A5 9E
				23 00 00 00 00 00 02 A6 03
				23 00 00 00 00 00 02 A7 B5
				23 00 00 00 00 00 02 A9 03
				23 00 00 00 00 00 02 AA C6
				23 00 00 00 00 00 02 AB 03
				23 00 00 00 00 00 02 AC CD
				23 00 00 00 00 00 02 AD 03
				23 01 00 00 00 00 02 AE CE
				23 00 00 00 00 00 02 AF 01
				23 00 00 00 00 00 02 B0 BF
				23 00 00 00 00 00 02 B1 01
				23 00 00 00 00 00 02 B2 C1
				23 00 00 00 00 00 02 B3 01
				23 00 00 00 00 00 02 B4 C4
				23 00 00 00 00 00 02 B5 01
				23 00 00 00 00 00 02 B6 C8
				23 00 00 00 00 00 02 B7 01
				23 00 00 00 00 00 02 B8 CB
				23 00 00 00 00 00 02 B9 01
				23 00 00 00 00 00 02 BA CE
				23 00 00 00 00 00 02 BB 01
				23 00 00 00 00 00 02 BC D1
				23 00 00 00 00 00 02 BD 01
				23 00 00 00 00 00 02 BE D5
				23 00 00 00 00 00 02 BF 01
				23 00 00 00 00 00 02 C0 D8
				23 00 00 00 00 00 02 C1 01
				23 00 00 00 00 00 02 C2 E4
				23 00 00 00 00 00 02 C3 01
				23 00 00 00 00 00 02 C4 EF
				23 00 00 00 00 00 02 C5 02
				23 00 00 00 00 00 02 C6 05
				23 00 00 00 00 00 02 C7 02
				23 00 00 00 00 00 02 C8 19
				23 00 00 00 00 00 02 C9 02
				23 00 00 00 00 00 02 CA 3D
				23 00 00 00 00 00 02 CB 02
				23 00 00 00 00 00 02 CC 61
				23 00 00 00 00 00 02 CD 02
				23 00 00 00 00 00 02 CE 62
				23 00 00 00 00 00 02 CF 02
				23 00 00 00 00 00 02 D0 89
				23 00 00 00 00 00 02 D1 02
				23 00 00 00 00 00 02 D2 BA
				23 00 00 00 00 00 02 D3 02
				23 00 00 00 00 00 02 D4 E0
				23 00 00 00 00 00 02 D5 03
				23 00 00 00 00 00 02 D6 11
				23 00 00 00 00 00 02 D7 03
				23 00 00 00 00 00 02 D8 30
				23 00 00 00 00 00 02 D9 03
				23 00 00 00 00 00 02 DA 59
				23 00 00 00 00 00 02 DB 03
				23 00 00 00 00 00 02 DC 66
				23 00 00 00 00 00 02 DD 03
				23 00 00 00 00 00 02 DE 75
				23 00 00 00 00 00 02 DF 03
				23 00 00 00 00 00 02 E0 88
				23 00 00 00 00 00 02 E1 03
				23 00 00 00 00 00 02 E2 9E
				23 00 00 00 00 00 02 E3 03
				23 00 00 00 00 00 02 E4 B5
				23 00 00 00 00 00 02 E5 03
				23 00 00 00 00 00 02 E6 C6
				23 00 00 00 00 00 02 E7 03
				23 00 00 00 00 00 02 E8 CD
				23 00 00 00 00 00 02 E9 03
				23 01 00 00 00 00 02 EA CE];

		qcom,mdss-dsi-PM6-command = [23 00 00 00 00 00 02 FF 01
				23 00 00 00 00 00 02 FB 01
				23 00 00 00 00 00 02 75 00
				23 00 00 00 00 00 02 76 00
				23 00 00 00 00 00 02 77 00
				23 00 00 00 00 00 02 78 4C
				23 00 00 00 00 00 02 79 00
				23 00 00 00 00 00 02 7A 7C
				23 00 00 00 00 00 02 7B 00
				23 00 00 00 00 00 02 7C 9B
				23 00 00 00 00 00 02 7D 00
				23 00 00 00 00 00 02 7E B4
				23 00 00 00 00 00 02 7F 00
				23 00 00 00 00 00 02 80 C8
				23 00 00 00 00 00 02 81 00
				23 00 00 00 00 00 02 82 DA
				23 00 00 00 00 00 02 83 00
				23 00 00 00 00 00 02 84 E9
				23 00 00 00 00 00 02 85 00
				23 00 00 00 00 00 02 86 F7
				23 00 00 00 00 00 02 87 01
				23 00 00 00 00 00 02 88 27
				23 00 00 00 00 00 02 89 01
				23 00 00 00 00 00 02 8A 4C
				23 00 00 00 00 00 02 8B 01
				23 00 00 00 00 00 02 8C 86
				23 00 00 00 00 00 02 8D 01
				23 00 00 00 00 00 02 8E B3
				23 00 00 00 00 00 02 8F 01
				23 00 00 00 00 00 02 90 F8
				23 00 00 00 00 00 02 91 02
				23 00 00 00 00 00 02 92 2F
				23 00 00 00 00 00 02 93 02
				23 00 00 00 00 00 02 94 30
				23 00 00 00 00 00 02 95 02
				23 00 00 00 00 00 02 96 61
				23 00 00 00 00 00 02 97 02
				23 00 00 00 00 00 02 98 97
				23 00 00 00 00 00 02 99 02
				23 00 00 00 00 00 02 9A BB
				23 00 00 00 00 00 02 9B 02
				23 00 00 00 00 00 02 9C ED
				23 00 00 00 00 00 02 9D 03
				23 00 00 00 00 00 02 9E 11
				23 00 00 00 00 00 02 9F 03
				23 00 00 00 00 00 02 A0 3F
				23 00 00 00 00 00 02 A2 03
				23 00 00 00 00 00 02 A3 4E
				23 00 00 00 00 00 02 A4 03
				23 00 00 00 00 00 02 A5 60
				23 00 00 00 00 00 02 A6 03
				23 00 00 00 00 00 02 A7 77
				23 00 00 00 00 00 02 A9 03
				23 00 00 00 00 00 02 AA 94
				23 00 00 00 00 00 02 AB 03
				23 00 00 00 00 00 02 AC B0
				23 00 00 00 00 00 02 AD 03
				23 00 00 00 00 00 02 AE C4
				23 00 00 00 00 00 02 AF 03
				23 00 00 00 00 00 02 B0 CD
				23 00 00 00 00 00 02 B1 03
				23 01 00 00 00 00 02 B2 CE
				23 00 00 00 00 00 02 B3 00
				23 00 00 00 00 00 02 B4 00
				23 00 00 00 00 00 02 B5 00
				23 00 00 00 00 00 02 B6 4C
				23 00 00 00 00 00 02 B7 00
				23 00 00 00 00 00 02 B8 7C
				23 00 00 00 00 00 02 B9 00
				23 00 00 00 00 00 02 BA 9B
				23 00 00 00 00 00 02 BB 00
				23 00 00 00 00 00 02 BC B4
				23 00 00 00 00 00 02 BD 00
				23 00 00 00 00 00 02 BE C8
				23 00 00 00 00 00 02 BF 00
				23 00 00 00 00 00 02 C0 DA
				23 00 00 00 00 00 02 C1 00
				23 00 00 00 00 00 02 C2 E9
				23 00 00 00 00 00 02 C3 00
				23 00 00 00 00 00 02 C4 F7
				23 00 00 00 00 00 02 C5 01
				23 00 00 00 00 00 02 C6 27
				23 00 00 00 00 00 02 C7 01
				23 00 00 00 00 00 02 C8 4C
				23 00 00 00 00 00 02 C9 01
				23 00 00 00 00 00 02 CA 86
				23 00 00 00 00 00 02 CB 01
				23 00 00 00 00 00 02 CC B3
				23 00 00 00 00 00 02 CD 01
				23 00 00 00 00 00 02 CE F8
				23 00 00 00 00 00 02 CF 02
				23 00 00 00 00 00 02 D0 2F
				23 00 00 00 00 00 02 D1 02
				23 00 00 00 00 00 02 D2 30
				23 00 00 00 00 00 02 D3 02
				23 00 00 00 00 00 02 D4 61
				23 00 00 00 00 00 02 D5 02
				23 00 00 00 00 00 02 D6 97
				23 00 00 00 00 00 02 D7 02
				23 00 00 00 00 00 02 D8 BB
				23 00 00 00 00 00 02 D9 02
				23 00 00 00 00 00 02 DA ED
				23 00 00 00 00 00 02 DB 03
				23 00 00 00 00 00 02 DC 11
				23 00 00 00 00 00 02 DD 03
				23 00 00 00 00 00 02 DE 3F
				23 00 00 00 00 00 02 DF 03
				23 00 00 00 00 00 02 E0 4E
				23 00 00 00 00 00 02 E1 03
				23 00 00 00 00 00 02 E2 60
				23 00 00 00 00 00 02 E3 03
				23 00 00 00 00 00 02 E4 77
				23 00 00 00 00 00 02 E5 03
				23 00 00 00 00 00 02 E6 94
				23 00 00 00 00 00 02 E7 03
				23 00 00 00 00 00 02 E8 B0
				23 00 00 00 00 00 02 E9 03
				23 00 00 00 00 00 02 EA C4
				23 00 00 00 00 00 02 EB 03
				23 00 00 00 00 00 02 EC CD
				23 00 00 00 00 00 02 ED 03
				23 01 00 00 00 00 02 EE CE
				23 00 00 00 00 00 02 EF 00
				23 00 00 00 00 00 02 F0 F1
				23 00 00 00 00 00 02 F1 00
				23 00 00 00 00 00 02 F2 F7
				23 00 00 00 00 00 02 F3 01
				23 00 00 00 00 00 02 F4 03
				23 00 00 00 00 00 02 F5 01
				23 00 00 00 00 00 02 F6 0F
				23 00 00 00 00 00 02 F7 01
				23 00 00 00 00 00 02 F8 19
				23 00 00 00 00 00 02 F9 01
				23 00 00 00 00 00 02 FA 23
				23 00 00 00 00 00 02 FF 02
				23 00 00 00 00 00 02 FB 01
				23 00 00 00 00 00 02 00 01
				23 00 00 00 00 00 02 01 2C
				23 00 00 00 00 00 02 02 01
				23 00 00 00 00 00 02 03 35
				23 00 00 00 00 00 02 04 01
				23 00 00 00 00 00 02 05 3E
				23 00 00 00 00 00 02 06 01
				23 00 00 00 00 00 02 07 5D
				23 00 00 00 00 00 02 08 01
				23 00 00 00 00 00 02 09 78
				23 00 00 00 00 00 02 0A 01
				23 00 00 00 00 00 02 0B A5
				23 00 00 00 00 00 02 0C 01
				23 00 00 00 00 00 02 0D CA
				23 00 00 00 00 00 02 0E 02
				23 00 00 00 00 00 02 0F 06
				23 00 00 00 00 00 02 10 02
				23 00 00 00 00 00 02 11 37
				23 00 00 00 00 00 02 12 02
				23 00 00 00 00 00 02 13 38
				23 00 00 00 00 00 02 14 02
				23 00 00 00 00 00 02 15 67
				23 00 00 00 00 00 02 16 02
				23 00 00 00 00 00 02 17 9C
				23 00 00 00 00 00 02 18 02
				23 00 00 00 00 00 02 19 C0
				23 00 00 00 00 00 02 1A 02
				23 00 00 00 00 00 02 1B F3
				23 00 00 00 00 00 02 1C 03
				23 00 00 00 00 00 02 1D 17
				23 00 00 00 00 00 02 1E 03
				23 00 00 00 00 00 02 1F 44
				23 00 00 00 00 00 02 20 03
				23 00 00 00 00 00 02 21 53
				23 00 00 00 00 00 02 22 03
				23 00 00 00 00 00 02 23 64
				23 00 00 00 00 00 02 24 03
				23 00 00 00 00 00 02 25 7A
				23 00 00 00 00 00 02 26 03
				23 00 00 00 00 00 02 27 95
				23 00 00 00 00 00 02 28 03
				23 00 00 00 00 00 02 29 B0
				23 00 00 00 00 00 02 2A 03
				23 00 00 00 00 00 02 2B C4
				23 00 00 00 00 00 02 2D 03
				23 00 00 00 00 00 02 2F CD
				23 00 00 00 00 00 02 30 03
				23 01 00 00 00 00 02 31 CE
				23 00 00 00 00 00 02 32 00
				23 00 00 00 00 00 02 33 F1
				23 00 00 00 00 00 02 34 00
				23 00 00 00 00 00 02 35 F7
				23 00 00 00 00 00 02 36 01
				23 00 00 00 00 00 02 37 03
				23 00 00 00 00 00 02 38 01
				23 00 00 00 00 00 02 39 0F
				23 00 00 00 00 00 02 3A 01
				23 00 00 00 00 00 02 3B 19
				23 00 00 00 00 00 02 3D 01
				23 00 00 00 00 00 02 3F 23
				23 00 00 00 00 00 02 40 01
				23 00 00 00 00 00 02 41 2C
				23 00 00 00 00 00 02 42 01
				23 00 00 00 00 00 02 43 35
				23 00 00 00 00 00 02 44 01
				23 00 00 00 00 00 02 45 3E
				23 00 00 00 00 00 02 46 01
				23 00 00 00 00 00 02 47 5D
				23 00 00 00 00 00 02 48 01
				23 00 00 00 00 00 02 49 78
				23 00 00 00 00 00 02 4A 01
				23 00 00 00 00 00 02 4B A5
				23 00 00 00 00 00 02 4C 01
				23 00 00 00 00 00 02 4D CA
				23 00 00 00 00 00 02 4E 02
				23 00 00 00 00 00 02 4F 06
				23 00 00 00 00 00 02 50 02
				23 00 00 00 00 00 02 51 37
				23 00 00 00 00 00 02 52 02
				23 00 00 00 00 00 02 53 38
				23 00 00 00 00 00 02 54 02
				23 00 00 00 00 00 02 55 67
				23 00 00 00 00 00 02 56 02
				23 00 00 00 00 00 02 58 9C
				23 00 00 00 00 00 02 59 02
				23 00 00 00 00 00 02 5A C0
				23 00 00 00 00 00 02 5B 02
				23 00 00 00 00 00 02 5C F3
				23 00 00 00 00 00 02 5D 03
				23 00 00 00 00 00 02 5E 17
				23 00 00 00 00 00 02 5F 03
				23 00 00 00 00 00 02 60 44
				23 00 00 00 00 00 02 61 03
				23 00 00 00 00 00 02 62 53
				23 00 00 00 00 00 02 63 03
				23 00 00 00 00 00 02 64 64
				23 00 00 00 00 00 02 65 03
				23 00 00 00 00 00 02 66 7A
				23 00 00 00 00 00 02 67 03
				23 00 00 00 00 00 02 68 95
				23 00 00 00 00 00 02 69 03
				23 00 00 00 00 00 02 6A B0
				23 00 00 00 00 00 02 6B 03
				23 00 00 00 00 00 02 6C C4
				23 00 00 00 00 00 02 6D 03
				23 00 00 00 00 00 02 6E CD
				23 00 00 00 00 00 02 6F 03
				23 01 00 00 00 00 02 70 CE
				23 00 00 00 00 00 02 71 01
				23 00 00 00 00 00 02 72 D6
				23 00 00 00 00 00 02 73 01
				23 00 00 00 00 00 02 74 D7
				23 00 00 00 00 00 02 75 01
				23 00 00 00 00 00 02 76 DA
				23 00 00 00 00 00 02 77 01
				23 00 00 00 00 00 02 78 DD
				23 00 00 00 00 00 02 79 01
				23 00 00 00 00 00 02 7A E0
				23 00 00 00 00 00 02 7B 01
				23 00 00 00 00 00 02 7C E3
				23 00 00 00 00 00 02 7D 01
				23 00 00 00 00 00 02 7E E6
				23 00 00 00 00 00 02 7F 01
				23 00 00 00 00 00 02 80 E9
				23 00 00 00 00 00 02 81 01
				23 00 00 00 00 00 02 82 EB
				23 00 00 00 00 00 02 83 01
				23 00 00 00 00 00 02 84 F5
				23 00 00 00 00 00 02 85 02
				23 00 00 00 00 00 02 86 00
				23 00 00 00 00 00 02 87 02
				23 00 00 00 00 00 02 88 13
				23 00 00 00 00 00 02 89 02
				23 00 00 00 00 00 02 8A 25
				23 00 00 00 00 00 02 8B 02
				23 00 00 00 00 00 02 8C 47
				23 00 00 00 00 00 02 8D 02
				23 00 00 00 00 00 02 8E 69
				23 00 00 00 00 00 02 8F 02
				23 00 00 00 00 00 02 90 6A
				23 00 00 00 00 00 02 91 02
				23 00 00 00 00 00 02 92 90
				23 00 00 00 00 00 02 93 02
				23 00 00 00 00 00 02 94 C1
				23 00 00 00 00 00 02 95 02
				23 00 00 00 00 00 02 96 E6
				23 00 00 00 00 00 02 97 03
				23 00 00 00 00 00 02 98 17
				23 00 00 00 00 00 02 99 03
				23 00 00 00 00 00 02 9A 36
				23 00 00 00 00 00 02 9B 03
				23 00 00 00 00 00 02 9C 5E
				23 00 00 00 00 00 02 9D 03
				23 00 00 00 00 00 02 9E 6B
				23 00 00 00 00 00 02 9F 03
				23 00 00 00 00 00 02 A0 7A
				23 00 00 00 00 00 02 A2 03
				23 00 00 00 00 00 02 A3 8D
				23 00 00 00 00 00 02 A4 03
				23 00 00 00 00 00 02 A5 A3
				23 00 00 00 00 00 02 A6 03
				23 00 00 00 00 00 02 A7 B8
				23 00 00 00 00 00 02 A9 03
				23 00 00 00 00 00 02 AA C7
				23 00 00 00 00 00 02 AB 03
				23 00 00 00 00 00 02 AC CD
				23 00 00 00 00 00 02 AD 03
				23 01 00 00 00 00 02 AE CE
				23 00 00 00 00 00 02 AF 01
				23 00 00 00 00 00 02 B0 D6
				23 00 00 00 00 00 02 B1 01
				23 00 00 00 00 00 02 B2 D7
				23 00 00 00 00 00 02 B3 01
				23 00 00 00 00 00 02 B4 DA
				23 00 00 00 00 00 02 B5 01
				23 00 00 00 00 00 02 B6 DD
				23 00 00 00 00 00 02 B7 01
				23 00 00 00 00 00 02 B8 E0
				23 00 00 00 00 00 02 B9 01
				23 00 00 00 00 00 02 BA E3
				23 00 00 00 00 00 02 BB 01
				23 00 00 00 00 00 02 BC E6
				23 00 00 00 00 00 02 BD 01
				23 00 00 00 00 00 02 BE E9
				23 00 00 00 00 00 02 BF 01
				23 00 00 00 00 00 02 C0 EB
				23 00 00 00 00 00 02 C1 01
				23 00 00 00 00 00 02 C2 F5
				23 00 00 00 00 00 02 C3 02
				23 00 00 00 00 00 02 C4 00
				23 00 00 00 00 00 02 C5 02
				23 00 00 00 00 00 02 C6 13
				23 00 00 00 00 00 02 C7 02
				23 00 00 00 00 00 02 C8 25
				23 00 00 00 00 00 02 C9 02
				23 00 00 00 00 00 02 CA 47
				23 00 00 00 00 00 02 CB 02
				23 00 00 00 00 00 02 CC 69
				23 00 00 00 00 00 02 CD 02
				23 00 00 00 00 00 02 CE 6A
				23 00 00 00 00 00 02 CF 02
				23 00 00 00 00 00 02 D0 90
				23 00 00 00 00 00 02 D1 02
				23 00 00 00 00 00 02 D2 C1
				23 00 00 00 00 00 02 D3 02
				23 00 00 00 00 00 02 D4 E6
				23 00 00 00 00 00 02 D5 03
				23 00 00 00 00 00 02 D6 17
				23 00 00 00 00 00 02 D7 03
				23 00 00 00 00 00 02 D8 36
				23 00 00 00 00 00 02 D9 03
				23 00 00 00 00 00 02 DA 5E
				23 00 00 00 00 00 02 DB 03
				23 00 00 00 00 00 02 DC 6B
				23 00 00 00 00 00 02 DD 03
				23 00 00 00 00 00 02 DE 7A
				23 00 00 00 00 00 02 DF 03
				23 00 00 00 00 00 02 E0 8D
				23 00 00 00 00 00 02 E1 03
				23 00 00 00 00 00 02 E2 A3
				23 00 00 00 00 00 02 E3 03
				23 00 00 00 00 00 02 E4 B8
				23 00 00 00 00 00 02 E5 03
				23 00 00 00 00 00 02 E6 C7
				23 00 00 00 00 00 02 E7 03
				23 00 00 00 00 00 02 E8 CD
				23 00 00 00 00 00 02 E9 03
				23 01 00 00 00 00 02 EA CE];

		qcom,mdss-dsi-PM7-command = [23 00 00 00 00 00 02 FF 01
				23 00 00 00 00 00 02 FB 01
				23 00 00 00 00 00 02 75 00
				23 00 00 00 00 00 02 76 00
				23 00 00 00 00 00 02 77 00
				23 00 00 00 00 00 02 78 4C
				23 00 00 00 00 00 02 79 00
				23 00 00 00 00 00 02 7A 7C
				23 00 00 00 00 00 02 7B 00
				23 00 00 00 00 00 02 7C 9B
				23 00 00 00 00 00 02 7D 00
				23 00 00 00 00 00 02 7E B4
				23 00 00 00 00 00 02 7F 00
				23 00 00 00 00 00 02 80 C8
				23 00 00 00 00 00 02 81 00
				23 00 00 00 00 00 02 82 DA
				23 00 00 00 00 00 02 83 00
				23 00 00 00 00 00 02 84 E9
				23 00 00 00 00 00 02 85 00
				23 00 00 00 00 00 02 86 F7
				23 00 00 00 00 00 02 87 01
				23 00 00 00 00 00 02 88 27
				23 00 00 00 00 00 02 89 01
				23 00 00 00 00 00 02 8A 4C
				23 00 00 00 00 00 02 8B 01
				23 00 00 00 00 00 02 8C 86
				23 00 00 00 00 00 02 8D 01
				23 00 00 00 00 00 02 8E B3
				23 00 00 00 00 00 02 8F 01
				23 00 00 00 00 00 02 90 F8
				23 00 00 00 00 00 02 91 02
				23 00 00 00 00 00 02 92 2F
				23 00 00 00 00 00 02 93 02
				23 00 00 00 00 00 02 94 30
				23 00 00 00 00 00 02 95 02
				23 00 00 00 00 00 02 96 61
				23 00 00 00 00 00 02 97 02
				23 00 00 00 00 00 02 98 97
				23 00 00 00 00 00 02 99 02
				23 00 00 00 00 00 02 9A BB
				23 00 00 00 00 00 02 9B 02
				23 00 00 00 00 00 02 9C ED
				23 00 00 00 00 00 02 9D 03
				23 00 00 00 00 00 02 9E 11
				23 00 00 00 00 00 02 9F 03
				23 00 00 00 00 00 02 A0 3F
				23 00 00 00 00 00 02 A2 03
				23 00 00 00 00 00 02 A3 4E
				23 00 00 00 00 00 02 A4 03
				23 00 00 00 00 00 02 A5 60
				23 00 00 00 00 00 02 A6 03
				23 00 00 00 00 00 02 A7 77
				23 00 00 00 00 00 02 A9 03
				23 00 00 00 00 00 02 AA 94
				23 00 00 00 00 00 02 AB 03
				23 00 00 00 00 00 02 AC B0
				23 00 00 00 00 00 02 AD 03
				23 00 00 00 00 00 02 AE C4
				23 00 00 00 00 00 02 AF 03
				23 00 00 00 00 00 02 B0 CD
				23 00 00 00 00 00 02 B1 03
				23 01 00 00 00 00 02 B2 CE
				23 00 00 00 00 00 02 B3 00
				23 00 00 00 00 00 02 B4 00
				23 00 00 00 00 00 02 B5 00
				23 00 00 00 00 00 02 B6 4C
				23 00 00 00 00 00 02 B7 00
				23 00 00 00 00 00 02 B8 7C
				23 00 00 00 00 00 02 B9 00
				23 00 00 00 00 00 02 BA 9B
				23 00 00 00 00 00 02 BB 00
				23 00 00 00 00 00 02 BC B4
				23 00 00 00 00 00 02 BD 00
				23 00 00 00 00 00 02 BE C8
				23 00 00 00 00 00 02 BF 00
				23 00 00 00 00 00 02 C0 DA
				23 00 00 00 00 00 02 C1 00
				23 00 00 00 00 00 02 C2 E9
				23 00 00 00 00 00 02 C3 00
				23 00 00 00 00 00 02 C4 F7
				23 00 00 00 00 00 02 C5 01
				23 00 00 00 00 00 02 C6 27
				23 00 00 00 00 00 02 C7 01
				23 00 00 00 00 00 02 C8 4C
				23 00 00 00 00 00 02 C9 01
				23 00 00 00 00 00 02 CA 86
				23 00 00 00 00 00 02 CB 01
				23 00 00 00 00 00 02 CC B3
				23 00 00 00 00 00 02 CD 01
				23 00 00 00 00 00 02 CE F8
				23 00 00 00 00 00 02 CF 02
				23 00 00 00 00 00 02 D0 2F
				23 00 00 00 00 00 02 D1 02
				23 00 00 00 00 00 02 D2 30
				23 00 00 00 00 00 02 D3 02
				23 00 00 00 00 00 02 D4 61
				23 00 00 00 00 00 02 D5 02
				23 00 00 00 00 00 02 D6 97
				23 00 00 00 00 00 02 D7 02
				23 00 00 00 00 00 02 D8 BB
				23 00 00 00 00 00 02 D9 02
				23 00 00 00 00 00 02 DA ED
				23 00 00 00 00 00 02 DB 03
				23 00 00 00 00 00 02 DC 11
				23 00 00 00 00 00 02 DD 03
				23 00 00 00 00 00 02 DE 3F
				23 00 00 00 00 00 02 DF 03
				23 00 00 00 00 00 02 E0 4E
				23 00 00 00 00 00 02 E1 03
				23 00 00 00 00 00 02 E2 60
				23 00 00 00 00 00 02 E3 03
				23 00 00 00 00 00 02 E4 77
				23 00 00 00 00 00 02 E5 03
				23 00 00 00 00 00 02 E6 94
				23 00 00 00 00 00 02 E7 03
				23 00 00 00 00 00 02 E8 B0
				23 00 00 00 00 00 02 E9 03
				23 00 00 00 00 00 02 EA C4
				23 00 00 00 00 00 02 EB 03
				23 00 00 00 00 00 02 EC CD
				23 00 00 00 00 00 02 ED 03
				23 01 00 00 00 00 02 EE CE
				23 00 00 00 00 00 02 EF 00
				23 00 00 00 00 00 02 F0 F1
				23 00 00 00 00 00 02 F1 00
				23 00 00 00 00 00 02 F2 F7
				23 00 00 00 00 00 02 F3 01
				23 00 00 00 00 00 02 F4 03
				23 00 00 00 00 00 02 F5 01
				23 00 00 00 00 00 02 F6 0F
				23 00 00 00 00 00 02 F7 01
				23 00 00 00 00 00 02 F8 19
				23 00 00 00 00 00 02 F9 01
				23 00 00 00 00 00 02 FA 23
				23 00 00 00 00 00 02 FF 02
				23 00 00 00 00 00 02 FB 01
				23 00 00 00 00 00 02 00 01
				23 00 00 00 00 00 02 01 2C
				23 00 00 00 00 00 02 02 01
				23 00 00 00 00 00 02 03 35
				23 00 00 00 00 00 02 04 01
				23 00 00 00 00 00 02 05 3E
				23 00 00 00 00 00 02 06 01
				23 00 00 00 00 00 02 07 5D
				23 00 00 00 00 00 02 08 01
				23 00 00 00 00 00 02 09 78
				23 00 00 00 00 00 02 0A 01
				23 00 00 00 00 00 02 0B A5
				23 00 00 00 00 00 02 0C 01
				23 00 00 00 00 00 02 0D CA
				23 00 00 00 00 00 02 0E 02
				23 00 00 00 00 00 02 0F 06
				23 00 00 00 00 00 02 10 02
				23 00 00 00 00 00 02 11 37
				23 00 00 00 00 00 02 12 02
				23 00 00 00 00 00 02 13 38
				23 00 00 00 00 00 02 14 02
				23 00 00 00 00 00 02 15 67
				23 00 00 00 00 00 02 16 02
				23 00 00 00 00 00 02 17 9C
				23 00 00 00 00 00 02 18 02
				23 00 00 00 00 00 02 19 C0
				23 00 00 00 00 00 02 1A 02
				23 00 00 00 00 00 02 1B F3
				23 00 00 00 00 00 02 1C 03
				23 00 00 00 00 00 02 1D 17
				23 00 00 00 00 00 02 1E 03
				23 00 00 00 00 00 02 1F 44
				23 00 00 00 00 00 02 20 03
				23 00 00 00 00 00 02 21 53
				23 00 00 00 00 00 02 22 03
				23 00 00 00 00 00 02 23 64
				23 00 00 00 00 00 02 24 03
				23 00 00 00 00 00 02 25 7A
				23 00 00 00 00 00 02 26 03
				23 00 00 00 00 00 02 27 95
				23 00 00 00 00 00 02 28 03
				23 00 00 00 00 00 02 29 B0
				23 00 00 00 00 00 02 2A 03
				23 00 00 00 00 00 02 2B C4
				23 00 00 00 00 00 02 2D 03
				23 00 00 00 00 00 02 2F CD
				23 00 00 00 00 00 02 30 03
				23 01 00 00 00 00 02 31 CE
				23 00 00 00 00 00 02 32 00
				23 00 00 00 00 00 02 33 F1
				23 00 00 00 00 00 02 34 00
				23 00 00 00 00 00 02 35 F7
				23 00 00 00 00 00 02 36 01
				23 00 00 00 00 00 02 37 03
				23 00 00 00 00 00 02 38 01
				23 00 00 00 00 00 02 39 0F
				23 00 00 00 00 00 02 3A 01
				23 00 00 00 00 00 02 3B 19
				23 00 00 00 00 00 02 3D 01
				23 00 00 00 00 00 02 3F 23
				23 00 00 00 00 00 02 40 01
				23 00 00 00 00 00 02 41 2C
				23 00 00 00 00 00 02 42 01
				23 00 00 00 00 00 02 43 35
				23 00 00 00 00 00 02 44 01
				23 00 00 00 00 00 02 45 3E
				23 00 00 00 00 00 02 46 01
				23 00 00 00 00 00 02 47 5D
				23 00 00 00 00 00 02 48 01
				23 00 00 00 00 00 02 49 78
				23 00 00 00 00 00 02 4A 01
				23 00 00 00 00 00 02 4B A5
				23 00 00 00 00 00 02 4C 01
				23 00 00 00 00 00 02 4D CA
				23 00 00 00 00 00 02 4E 02
				23 00 00 00 00 00 02 4F 06
				23 00 00 00 00 00 02 50 02
				23 00 00 00 00 00 02 51 37
				23 00 00 00 00 00 02 52 02
				23 00 00 00 00 00 02 53 38
				23 00 00 00 00 00 02 54 02
				23 00 00 00 00 00 02 55 67
				23 00 00 00 00 00 02 56 02
				23 00 00 00 00 00 02 58 9C
				23 00 00 00 00 00 02 59 02
				23 00 00 00 00 00 02 5A C0
				23 00 00 00 00 00 02 5B 02
				23 00 00 00 00 00 02 5C F3
				23 00 00 00 00 00 02 5D 03
				23 00 00 00 00 00 02 5E 17
				23 00 00 00 00 00 02 5F 03
				23 00 00 00 00 00 02 60 44
				23 00 00 00 00 00 02 61 03
				23 00 00 00 00 00 02 62 53
				23 00 00 00 00 00 02 63 03
				23 00 00 00 00 00 02 64 64
				23 00 00 00 00 00 02 65 03
				23 00 00 00 00 00 02 66 7A
				23 00 00 00 00 00 02 67 03
				23 00 00 00 00 00 02 68 95
				23 00 00 00 00 00 02 69 03
				23 00 00 00 00 00 02 6A B0
				23 00 00 00 00 00 02 6B 03
				23 00 00 00 00 00 02 6C C4
				23 00 00 00 00 00 02 6D 03
				23 00 00 00 00 00 02 6E CD
				23 00 00 00 00 00 02 6F 03
				23 01 00 00 00 00 02 70 CE
				23 00 00 00 00 00 02 71 01
				23 00 00 00 00 00 02 72 EF
				23 00 00 00 00 00 02 73 01
				23 00 00 00 00 00 02 74 F0
				23 00 00 00 00 00 02 75 01
				23 00 00 00 00 00 02 76 F2
				23 00 00 00 00 00 02 77 01
				23 00 00 00 00 00 02 78 F4
				23 00 00 00 00 00 02 79 01
				23 00 00 00 00 00 02 7A F7
				23 00 00 00 00 00 02 7B 01
				23 00 00 00 00 00 02 7C F9
				23 00 00 00 00 00 02 7D 01
				23 00 00 00 00 00 02 7E FC
				23 00 00 00 00 00 02 7F 01
				23 00 00 00 00 00 02 80 FE
				23 00 00 00 00 00 02 81 02
				23 00 00 00 00 00 02 82 00
				23 00 00 00 00 00 02 83 02
				23 00 00 00 00 00 02 84 0A
				23 00 00 00 00 00 02 85 02
				23 00 00 00 00 00 02 86 12
				23 00 00 00 00 00 02 87 02
				23 00 00 00 00 00 02 88 23
				23 00 00 00 00 00 02 89 02
				23 00 00 00 00 00 02 8A 33
				23 00 00 00 00 00 02 8B 02
				23 00 00 00 00 00 02 8C 53
				23 00 00 00 00 00 02 8D 02
				23 00 00 00 00 00 02 8E 73
				23 00 00 00 00 00 02 8F 02
				23 00 00 00 00 00 02 90 74
				23 00 00 00 00 00 02 91 02
				23 00 00 00 00 00 02 92 98
				23 00 00 00 00 00 02 93 02
				23 00 00 00 00 00 02 94 CB
				23 00 00 00 00 00 02 95 02
				23 00 00 00 00 00 02 96 EE
				23 00 00 00 00 00 02 97 03
				23 00 00 00 00 00 02 98 1F
				23 00 00 00 00 00 02 99 03
				23 00 00 00 00 00 02 9A 3D
				23 00 00 00 00 00 02 9B 03
				23 00 00 00 00 00 02 9C 64
				23 00 00 00 00 00 02 9D 03
				23 00 00 00 00 00 02 9E 71
				23 00 00 00 00 00 02 9F 03
				23 00 00 00 00 00 02 A0 81
				23 00 00 00 00 00 02 A2 03
				23 00 00 00 00 00 02 A3 93
				23 00 00 00 00 00 02 A4 03
				23 00 00 00 00 00 02 A5 A9
				23 00 00 00 00 00 02 A6 03
				23 00 00 00 00 00 02 A7 BB
				23 00 00 00 00 00 02 A9 03
				23 00 00 00 00 00 02 AA C8
				23 00 00 00 00 00 02 AB 03
				23 00 00 00 00 00 02 AC CD
				23 00 00 00 00 00 02 AD 03
				23 01 00 00 00 00 02 AE CE
				23 00 00 00 00 00 02 AF 01
				23 00 00 00 00 00 02 B0 EF
				23 00 00 00 00 00 02 B1 01
				23 00 00 00 00 00 02 B2 F0
				23 00 00 00 00 00 02 B3 01
				23 00 00 00 00 00 02 B4 F2
				23 00 00 00 00 00 02 B5 01
				23 00 00 00 00 00 02 B6 F4
				23 00 00 00 00 00 02 B7 01
				23 00 00 00 00 00 02 B8 F7
				23 00 00 00 00 00 02 B9 01
				23 00 00 00 00 00 02 BA F9
				23 00 00 00 00 00 02 BB 01
				23 00 00 00 00 00 02 BC FC
				23 00 00 00 00 00 02 BD 01
				23 00 00 00 00 00 02 BE FE
				23 00 00 00 00 00 02 BF 02
				23 00 00 00 00 00 02 C0 00
				23 00 00 00 00 00 02 C1 02
				23 00 00 00 00 00 02 C2 0A
				23 00 00 00 00 00 02 C3 02
				23 00 00 00 00 00 02 C4 12
				23 00 00 00 00 00 02 C5 02
				23 00 00 00 00 00 02 C6 23
				23 00 00 00 00 00 02 C7 02
				23 00 00 00 00 00 02 C8 33
				23 00 00 00 00 00 02 C9 02
				23 00 00 00 00 00 02 CA 53
				23 00 00 00 00 00 02 CB 02
				23 00 00 00 00 00 02 CC 73
				23 00 00 00 00 00 02 CD 02
				23 00 00 00 00 00 02 CE 74
				23 00 00 00 00 00 02 CF 02
				23 00 00 00 00 00 02 D0 98
				23 00 00 00 00 00 02 D1 02
				23 00 00 00 00 00 02 D2 CB
				23 00 00 00 00 00 02 D3 02
				23 00 00 00 00 00 02 D4 EE
				23 00 00 00 00 00 02 D5 03
				23 00 00 00 00 00 02 D6 1F
				23 00 00 00 00 00 02 D7 03
				23 00 00 00 00 00 02 D8 3D
				23 00 00 00 00 00 02 D9 03
				23 00 00 00 00 00 02 DA 64
				23 00 00 00 00 00 02 DB 03
				23 00 00 00 00 00 02 DC 71
				23 00 00 00 00 00 02 DD 03
				23 00 00 00 00 00 02 DE 81
				23 00 00 00 00 00 02 DF 03
				23 00 00 00 00 00 02 E0 93
				23 00 00 00 00 00 02 E1 03
				23 00 00 00 00 00 02 E2 A9
				23 00 00 00 00 00 02 E3 03
				23 00 00 00 00 00 02 E4 BB
				23 00 00 00 00 00 02 E5 03
				23 00 00 00 00 00 02 E6 C8
				23 00 00 00 00 00 02 E7 03
				23 00 00 00 00 00 02 E8 CD
				23 00 00 00 00 00 02 E9 03
				23 01 00 00 00 00 02 EA CE];

		qcom,mdss-dsi-PM8-command = [23 00 00 00 00 00 02 FF 01
				23 00 00 00 00 00 02 FB 01
				23 00 00 00 00 00 02 75 00
				23 00 00 00 00 00 02 76 00
				23 00 00 00 00 00 02 77 00
				23 00 00 00 00 00 02 78 4C
				23 00 00 00 00 00 02 79 00
				23 00 00 00 00 00 02 7A 7C
				23 00 00 00 00 00 02 7B 00
				23 00 00 00 00 00 02 7C 9B
				23 00 00 00 00 00 02 7D 00
				23 00 00 00 00 00 02 7E B4
				23 00 00 00 00 00 02 7F 00
				23 00 00 00 00 00 02 80 C8
				23 00 00 00 00 00 02 81 00
				23 00 00 00 00 00 02 82 DA
				23 00 00 00 00 00 02 83 00
				23 00 00 00 00 00 02 84 E9
				23 00 00 00 00 00 02 85 00
				23 00 00 00 00 00 02 86 F7
				23 00 00 00 00 00 02 87 01
				23 00 00 00 00 00 02 88 27
				23 00 00 00 00 00 02 89 01
				23 00 00 00 00 00 02 8A 4C
				23 00 00 00 00 00 02 8B 01
				23 00 00 00 00 00 02 8C 86
				23 00 00 00 00 00 02 8D 01
				23 00 00 00 00 00 02 8E B3
				23 00 00 00 00 00 02 8F 01
				23 00 00 00 00 00 02 90 F8
				23 00 00 00 00 00 02 91 02
				23 00 00 00 00 00 02 92 2F
				23 00 00 00 00 00 02 93 02
				23 00 00 00 00 00 02 94 30
				23 00 00 00 00 00 02 95 02
				23 00 00 00 00 00 02 96 61
				23 00 00 00 00 00 02 97 02
				23 00 00 00 00 00 02 98 97
				23 00 00 00 00 00 02 99 02
				23 00 00 00 00 00 02 9A BB
				23 00 00 00 00 00 02 9B 02
				23 00 00 00 00 00 02 9C ED
				23 00 00 00 00 00 02 9D 03
				23 00 00 00 00 00 02 9E 11
				23 00 00 00 00 00 02 9F 03
				23 00 00 00 00 00 02 A0 3F
				23 00 00 00 00 00 02 A2 03
				23 00 00 00 00 00 02 A3 4E
				23 00 00 00 00 00 02 A4 03
				23 00 00 00 00 00 02 A5 60
				23 00 00 00 00 00 02 A6 03
				23 00 00 00 00 00 02 A7 77
				23 00 00 00 00 00 02 A9 03
				23 00 00 00 00 00 02 AA 94
				23 00 00 00 00 00 02 AB 03
				23 00 00 00 00 00 02 AC B0
				23 00 00 00 00 00 02 AD 03
				23 00 00 00 00 00 02 AE C4
				23 00 00 00 00 00 02 AF 03
				23 00 00 00 00 00 02 B0 CD
				23 00 00 00 00 00 02 B1 03
				23 01 00 00 00 00 02 B2 CE
				23 00 00 00 00 00 02 B3 00
				23 00 00 00 00 00 02 B4 00
				23 00 00 00 00 00 02 B5 00
				23 00 00 00 00 00 02 B6 4C
				23 00 00 00 00 00 02 B7 00
				23 00 00 00 00 00 02 B8 7C
				23 00 00 00 00 00 02 B9 00
				23 00 00 00 00 00 02 BA 9B
				23 00 00 00 00 00 02 BB 00
				23 00 00 00 00 00 02 BC B4
				23 00 00 00 00 00 02 BD 00
				23 00 00 00 00 00 02 BE C8
				23 00 00 00 00 00 02 BF 00
				23 00 00 00 00 00 02 C0 DA
				23 00 00 00 00 00 02 C1 00
				23 00 00 00 00 00 02 C2 E9
				23 00 00 00 00 00 02 C3 00
				23 00 00 00 00 00 02 C4 F7
				23 00 00 00 00 00 02 C5 01
				23 00 00 00 00 00 02 C6 27
				23 00 00 00 00 00 02 C7 01
				23 00 00 00 00 00 02 C8 4C
				23 00 00 00 00 00 02 C9 01
				23 00 00 00 00 00 02 CA 86
				23 00 00 00 00 00 02 CB 01
				23 00 00 00 00 00 02 CC B3
				23 00 00 00 00 00 02 CD 01
				23 00 00 00 00 00 02 CE F8
				23 00 00 00 00 00 02 CF 02
				23 00 00 00 00 00 02 D0 2F
				23 00 00 00 00 00 02 D1 02
				23 00 00 00 00 00 02 D2 30
				23 00 00 00 00 00 02 D3 02
				23 00 00 00 00 00 02 D4 61
				23 00 00 00 00 00 02 D5 02
				23 00 00 00 00 00 02 D6 97
				23 00 00 00 00 00 02 D7 02
				23 00 00 00 00 00 02 D8 BB
				23 00 00 00 00 00 02 D9 02
				23 00 00 00 00 00 02 DA ED
				23 00 00 00 00 00 02 DB 03
				23 00 00 00 00 00 02 DC 11
				23 00 00 00 00 00 02 DD 03
				23 00 00 00 00 00 02 DE 3F
				23 00 00 00 00 00 02 DF 03
				23 00 00 00 00 00 02 E0 4E
				23 00 00 00 00 00 02 E1 03
				23 00 00 00 00 00 02 E2 60
				23 00 00 00 00 00 02 E3 03
				23 00 00 00 00 00 02 E4 77
				23 00 00 00 00 00 02 E5 03
				23 00 00 00 00 00 02 E6 94
				23 00 00 00 00 00 02 E7 03
				23 00 00 00 00 00 02 E8 B0
				23 00 00 00 00 00 02 E9 03
				23 00 00 00 00 00 02 EA C4
				23 00 00 00 00 00 02 EB 03
				23 00 00 00 00 00 02 EC CD
				23 00 00 00 00 00 02 ED 03
				23 01 00 00 00 00 02 EE CE
				23 00 00 00 00 00 02 EF 00
				23 00 00 00 00 00 02 F0 F1
				23 00 00 00 00 00 02 F1 00
				23 00 00 00 00 00 02 F2 F7
				23 00 00 00 00 00 02 F3 01
				23 00 00 00 00 00 02 F4 03
				23 00 00 00 00 00 02 F5 01
				23 00 00 00 00 00 02 F6 0F
				23 00 00 00 00 00 02 F7 01
				23 00 00 00 00 00 02 F8 19
				23 00 00 00 00 00 02 F9 01
				23 00 00 00 00 00 02 FA 23
				23 00 00 00 00 00 02 FF 02
				23 00 00 00 00 00 02 FB 01
				23 00 00 00 00 00 02 00 01
				23 00 00 00 00 00 02 01 2C
				23 00 00 00 00 00 02 02 01
				23 00 00 00 00 00 02 03 35
				23 00 00 00 00 00 02 04 01
				23 00 00 00 00 00 02 05 3E
				23 00 00 00 00 00 02 06 01
				23 00 00 00 00 00 02 07 5D
				23 00 00 00 00 00 02 08 01
				23 00 00 00 00 00 02 09 78
				23 00 00 00 00 00 02 0A 01
				23 00 00 00 00 00 02 0B A5
				23 00 00 00 00 00 02 0C 01
				23 00 00 00 00 00 02 0D CA
				23 00 00 00 00 00 02 0E 02
				23 00 00 00 00 00 02 0F 06
				23 00 00 00 00 00 02 10 02
				23 00 00 00 00 00 02 11 37
				23 00 00 00 00 00 02 12 02
				23 00 00 00 00 00 02 13 38
				23 00 00 00 00 00 02 14 02
				23 00 00 00 00 00 02 15 67
				23 00 00 00 00 00 02 16 02
				23 00 00 00 00 00 02 17 9C
				23 00 00 00 00 00 02 18 02
				23 00 00 00 00 00 02 19 C0
				23 00 00 00 00 00 02 1A 02
				23 00 00 00 00 00 02 1B F3
				23 00 00 00 00 00 02 1C 03
				23 00 00 00 00 00 02 1D 17
				23 00 00 00 00 00 02 1E 03
				23 00 00 00 00 00 02 1F 44
				23 00 00 00 00 00 02 20 03
				23 00 00 00 00 00 02 21 53
				23 00 00 00 00 00 02 22 03
				23 00 00 00 00 00 02 23 64
				23 00 00 00 00 00 02 24 03
				23 00 00 00 00 00 02 25 7A
				23 00 00 00 00 00 02 26 03
				23 00 00 00 00 00 02 27 95
				23 00 00 00 00 00 02 28 03
				23 00 00 00 00 00 02 29 B0
				23 00 00 00 00 00 02 2A 03
				23 00 00 00 00 00 02 2B C4
				23 00 00 00 00 00 02 2D 03
				23 00 00 00 00 00 02 2F CD
				23 00 00 00 00 00 02 30 03
				23 01 00 00 00 00 02 31 CE
				23 00 00 00 00 00 02 32 00
				23 00 00 00 00 00 02 33 F1
				23 00 00 00 00 00 02 34 00
				23 00 00 00 00 00 02 35 F7
				23 00 00 00 00 00 02 36 01
				23 00 00 00 00 00 02 37 03
				23 00 00 00 00 00 02 38 01
				23 00 00 00 00 00 02 39 0F
				23 00 00 00 00 00 02 3A 01
				23 00 00 00 00 00 02 3B 19
				23 00 00 00 00 00 02 3D 01
				23 00 00 00 00 00 02 3F 23
				23 00 00 00 00 00 02 40 01
				23 00 00 00 00 00 02 41 2C
				23 00 00 00 00 00 02 42 01
				23 00 00 00 00 00 02 43 35
				23 00 00 00 00 00 02 44 01
				23 00 00 00 00 00 02 45 3E
				23 00 00 00 00 00 02 46 01
				23 00 00 00 00 00 02 47 5D
				23 00 00 00 00 00 02 48 01
				23 00 00 00 00 00 02 49 78
				23 00 00 00 00 00 02 4A 01
				23 00 00 00 00 00 02 4B A5
				23 00 00 00 00 00 02 4C 01
				23 00 00 00 00 00 02 4D CA
				23 00 00 00 00 00 02 4E 02
				23 00 00 00 00 00 02 4F 06
				23 00 00 00 00 00 02 50 02
				23 00 00 00 00 00 02 51 37
				23 00 00 00 00 00 02 52 02
				23 00 00 00 00 00 02 53 38
				23 00 00 00 00 00 02 54 02
				23 00 00 00 00 00 02 55 67
				23 00 00 00 00 00 02 56 02
				23 00 00 00 00 00 02 58 9C
				23 00 00 00 00 00 02 59 02
				23 00 00 00 00 00 02 5A C0
				23 00 00 00 00 00 02 5B 02
				23 00 00 00 00 00 02 5C F3
				23 00 00 00 00 00 02 5D 03
				23 00 00 00 00 00 02 5E 17
				23 00 00 00 00 00 02 5F 03
				23 00 00 00 00 00 02 60 44
				23 00 00 00 00 00 02 61 03
				23 00 00 00 00 00 02 62 53
				23 00 00 00 00 00 02 63 03
				23 00 00 00 00 00 02 64 64
				23 00 00 00 00 00 02 65 03
				23 00 00 00 00 00 02 66 7A
				23 00 00 00 00 00 02 67 03
				23 00 00 00 00 00 02 68 95
				23 00 00 00 00 00 02 69 03
				23 00 00 00 00 00 02 6A B0
				23 00 00 00 00 00 02 6B 03
				23 00 00 00 00 00 02 6C C4
				23 00 00 00 00 00 02 6D 03
				23 00 00 00 00 00 02 6E CD
				23 00 00 00 00 00 02 6F 03
				23 01 00 00 00 00 02 70 CE
				23 00 00 00 00 00 02 71 02
				23 00 00 00 00 00 02 72 11
				23 00 00 00 00 00 02 73 02
				23 00 00 00 00 00 02 74 12
				23 00 00 00 00 00 02 75 02
				23 00 00 00 00 00 02 76 14
				23 00 00 00 00 00 02 77 02
				23 00 00 00 00 00 02 78 16
				23 00 00 00 00 00 02 79 02
				23 00 00 00 00 00 02 7A 18
				23 00 00 00 00 00 02 7B 02
				23 00 00 00 00 00 02 7C 1A
				23 00 00 00 00 00 02 7D 02
				23 00 00 00 00 00 02 7E 1B
				23 00 00 00 00 00 02 7F 02
				23 00 00 00 00 00 02 80 1D
				23 00 00 00 00 00 02 81 02
				23 00 00 00 00 00 02 82 1F
				23 00 00 00 00 00 02 83 02
				23 00 00 00 00 00 02 84 26
				23 00 00 00 00 00 02 85 02
				23 00 00 00 00 00 02 86 2D
				23 00 00 00 00 00 02 87 02
				23 00 00 00 00 00 02 88 3B
				23 00 00 00 00 00 02 89 02
				23 00 00 00 00 00 02 8A 49
				23 00 00 00 00 00 02 8B 02
				23 00 00 00 00 00 02 8C 65
				23 00 00 00 00 00 02 8D 02
				23 00 00 00 00 00 02 8E 83
				23 00 00 00 00 00 02 8F 02
				23 00 00 00 00 00 02 90 84
				23 00 00 00 00 00 02 91 02
				23 00 00 00 00 00 02 92 A7
				23 00 00 00 00 00 02 93 02
				23 00 00 00 00 00 02 94 DB
				23 00 00 00 00 00 02 95 02
				23 00 00 00 00 00 02 96 FE
				23 00 00 00 00 00 02 97 03
				23 00 00 00 00 00 02 98 2C
				23 00 00 00 00 00 02 99 03
				23 00 00 00 00 00 02 9A 49
				23 00 00 00 00 00 02 9B 03
				23 00 00 00 00 00 02 9C 70
				23 00 00 00 00 00 02 9D 03
				23 00 00 00 00 00 02 9E 7D
				23 00 00 00 00 00 02 9F 03
				23 00 00 00 00 00 02 A0 8C
				23 00 00 00 00 00 02 A2 03
				23 00 00 00 00 00 02 A3 9E
				23 00 00 00 00 00 02 A4 03
				23 00 00 00 00 00 02 A5 B1
				23 00 00 00 00 00 02 A6 03
				23 00 00 00 00 00 02 A7 BF
				23 00 00 00 00 00 02 A9 03
				23 00 00 00 00 00 02 AA C9
				23 00 00 00 00 00 02 AB 03
				23 00 00 00 00 00 02 AC CE
				23 00 00 00 00 00 02 AD 03
				23 01 00 00 00 00 02 AE CF
				23 00 00 00 00 00 02 AF 02
				23 00 00 00 00 00 02 B0 11
				23 00 00 00 00 00 02 B1 02
				23 00 00 00 00 00 02 B2 12
				23 00 00 00 00 00 02 B3 02
				23 00 00 00 00 00 02 B4 14
				23 00 00 00 00 00 02 B5 02
				23 00 00 00 00 00 02 B6 16
				23 00 00 00 00 00 02 B7 02
				23 00 00 00 00 00 02 B8 18
				23 00 00 00 00 00 02 B9 02
				23 00 00 00 00 00 02 BA 1A
				23 00 00 00 00 00 02 BB 02
				23 00 00 00 00 00 02 BC 1B
				23 00 00 00 00 00 02 BD 02
				23 00 00 00 00 00 02 BE 1D
				23 00 00 00 00 00 02 BF 02
				23 00 00 00 00 00 02 C0 1F
				23 00 00 00 00 00 02 C1 02
				23 00 00 00 00 00 02 C2 26
				23 00 00 00 00 00 02 C3 02
				23 00 00 00 00 00 02 C4 2D
				23 00 00 00 00 00 02 C5 02
				23 00 00 00 00 00 02 C6 3B
				23 00 00 00 00 00 02 C7 02
				23 00 00 00 00 00 02 C8 49
				23 00 00 00 00 00 02 C9 02
				23 00 00 00 00 00 02 CA 65
				23 00 00 00 00 00 02 CB 02
				23 00 00 00 00 00 02 CC 83
				23 00 00 00 00 00 02 CD 02
				23 00 00 00 00 00 02 CE 84
				23 00 00 00 00 00 02 CF 02
				23 00 00 00 00 00 02 D0 A7
				23 00 00 00 00 00 02 D1 02
				23 00 00 00 00 00 02 D2 DB
				23 00 00 00 00 00 02 D3 02
				23 00 00 00 00 00 02 D4 FE
				23 00 00 00 00 00 02 D5 03
				23 00 00 00 00 00 02 D6 2C
				23 00 00 00 00 00 02 D7 03
				23 00 00 00 00 00 02 D8 49
				23 00 00 00 00 00 02 D9 03
				23 00 00 00 00 00 02 DA 70
				23 00 00 00 00 00 02 DB 03
				23 00 00 00 00 00 02 DC 7D
				23 00 00 00 00 00 02 DD 03
				23 00 00 00 00 00 02 DE 8C
				23 00 00 00 00 00 02 DF 03
				23 00 00 00 00 00 02 E0 9E
				23 00 00 00 00 00 02 E1 03
				23 00 00 00 00 00 02 E2 B1
				23 00 00 00 00 00 02 E3 03
				23 00 00 00 00 00 02 E4 BF
				23 00 00 00 00 00 02 E5 03
				23 00 00 00 00 00 02 E6 C9
				23 00 00 00 00 00 02 E7 03
				23 00 00 00 00 00 02 E8 CE
				23 00 00 00 00 00 02 E9 03
				23 01 00 00 00 00 02 EA CF];

		qcom,mdss-dsi-on-command-state = "dsi_lp_mode";
		qcom,mdss-dsi-off-command-state = "dsi_hs_mode";
		qcom,mdss-dsi-CABC_on-command-state = "dsi_hs_mode";
		qcom,mdss-dsi-CABC_off-command-state = "dsi_hs_mode";
		qcom,mdss-dsi-CE_on-command-state = "dsi_hs_mode";
		qcom,mdss-dsi-CE_off-command-state = "dsi_hs_mode";
		qcom,mdss-dsi-cold_gamma-command-state = "dsi_hs_mode";
		qcom,mdss-dsi-warm_gamma-command-state = "dsi_hs_mode";
		qcom,mdss-dsi-default_gamma-command-state = "dsi_hs_mode";
		qcom,mdss-dsi-PM1-command-state = "dsi_hs_mode";
		qcom,mdss-dsi-PM2-command-state = "dsi_hs_mode";
		qcom,mdss-dsi-PM3-command-state = "dsi_hs_mode";
		qcom,mdss-dsi-PM4-command-state = "dsi_hs_mode";
		qcom,mdss-dsi-PM5-command-state = "dsi_hs_mode";
		qcom,mdss-dsi-PM6-command-state = "dsi_hs_mode";
		qcom,mdss-dsi-PM7-command-state = "dsi_hs_mode";
		qcom,mdss-dsi-PM8-command-state = "dsi_hs_mode";

		qcom,mdss-dsi-h-sync-pulse = <1>;
		qcom,mdss-dsi-traffic-mode = "burst_mode";
		qcom,mdss-dsi-bllp-eof-power-mode;
		qcom,mdss-dsi-bllp-power-mode;
		qcom,mdss-dsi-lane-0-state;
		qcom,mdss-dsi-lane-1-state;
		qcom,mdss-dsi-lane-2-state;
		qcom,mdss-dsi-lane-3-state;
		qcom,mdss-dsi-panel-timings = [7d 25 1d 00 37 33
				22 27 1e 03 04 00];
		qcom,mdss-dsi-t-clk-post = <0x0d>;
		qcom,mdss-dsi-t-clk-pre = <0x30>;
		qcom,mdss-dsi-bl-min-level = <1>;
		qcom,mdss-dsi-bl-max-level = <4095>;
		qcom,mdss-dsi-dma-trigger = "trigger_sw";
		qcom,mdss-dsi-mdp-trigger = "none";
		qcom,mdss-dsi-bl-pmic-control-type = "bl_ctrl_wled";
		qcom,mdss-dsi-reset-sequence = <1 10>, <0 10>, <1 10>;
		qcom,esd-check-enabled;
		qcom,mdss-dsi-panel-status-command = [06 01 00 01 05 00 01 0A];
		qcom,mdss-dsi-panel-status-command-mode = "dsi_lp_mode";
		qcom,mdss-dsi-panel-status-check-mode = "TE_check_NT35596";
		qcom,mdss-dsi-panel-status-read-length = <1>;
		qcom,mdss-dsi-panel-status-value = <0x9C>;
		qcom,mdss-dsi-panel-max-error-count = <3>;
		qcom,mdss-pan-physical-width-dimension = <69>;
		qcom,mdss-pan-physical-height-dimension = <122>;
	};
};
