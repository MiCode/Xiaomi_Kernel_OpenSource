/* Copyright (c) 2015, The Linux Foundation. All rights reserved.
*
* This program is free software; you can redistribute it and/or modify
* it under the terms of the GNU General Public License version 2 and
* only version 2 as published by the Free Software Foundation.
*
* This program is distributed in the hope that it will be useful,
* but WITHOUT ANY WARRANTY; without even the implied warranty of
* MERCHANTABILITY or FITNESS FOR A PARTICULAR PURPOSE.  See the
* GNU General Public License for more details.
*/

/dts-v1/;

#include "msm8939.dtsi"
#include "msm8939-cdp.dtsi"
#include "msm8939-regulator.dtsi"

/ {
	model = "Qualcomm Technologies, Inc. MSM 8939 CDP JDI 5.5-inch A216 FHD";
	compatible = "qcom,msm8939-cdp", "qcom,msm8939", "qcom,cdp";
	qcom,board-id = <1 2>;
};
