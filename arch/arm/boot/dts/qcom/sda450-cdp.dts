/*
 * Copyright (c) 2018, The Linux Foundation. All rights reserved.
 *
 * This program is free software; you can redistribute it and/or modify
 * it under the terms of the GNU General Public License version 2 and
 * only version 2 as published by the Free Software Foundation.
 *
 * This program is distributed in the hope that it will be useful,
 * but WITHOUT ANY WARRANTY; without even the implied warranty of
 * MERCHANTABILITY or FITNESS FOR A PARTICULAR PURPOSE.  See the
 * GNU General Public License for more details.
 */

/dts-v1/;

#include "sda450.dtsi"
#include "msm-pmi8950.dtsi"
#include "msm8953-cdp.dtsi"
#include "msm8953-pmi8950.dtsi"
#include "msm8953-camera-sensor-cdp.dtsi"

/ {
	model = "Qualcomm Technologies, Inc. SDA450 + PMI8950 CDP";
	compatible = "qcom,sda450-cdp", "qcom,sda450", "qcom,cdp";
	qcom,board-id = <1 0>;
};

&pmi8950_charger {
	qcom,external-typec;
	qcom,typec-psy-name = "typec";
};
