/* Copyright (c) 2013-2014, The Linux Foundation. All rights reserved.
 *
 * This program is free software; you can redistribute it and/or modify
 * it under the terms of the GNU General Public License version 2 and
 * only version 2 as published by the Free Software Foundation.
 *
 * This program is distributed in the hope that it will be useful,
 * but WITHOUT ANY WARRANTY; without even the implied warranty of
 * MERCHANTABILITY or FITNESS FOR A PARTICULAR PURPOSE.  See the
 * GNU General Public License for more details.
 */


/dts-v1/;

/memreserve/ 0x06000000 0x00001000;

#include "msm8992.dtsi"
#include "msm8992-pinctrl.dtsi"

/ {
	model = "Qualcomm Technologies, Inc. MSM 8992SIM";
	compatible = "qcom,msm8992-sim", "qcom,msm8992", "qcom,sim";
	qcom,board-id = <16 0>;
};

&blsp1_uart2 {
	status = "ok";
};
