/*
 * Copyright (c) 2016, The Linux Foundation. All rights reserved.
 *
 * This program is free software; you can redistribute it and/or modify
 * it under the terms of the GNU General Public License version 2 and
 * only version 2 as published by the Free Software Foundation.
 *
 * This program is distributed in the hope that it will be useful,
 * but WITHOUT ANY WARRANTY; without even the implied warranty of
 * MERCHANTABILITY or FITNESS FOR A PARTICULAR PURPOSE.  See the
 * GNU General Public License for more details.
 */

/dts-v1/;

#include "msmgold.dtsi"
#include "msmgold-pmi8937-qrd-sku5.dtsi"

/ {
	model = "Qualcomm Technologies, Inc. MSMGOLD-PMI8937 QRD SKU5";
	compatible = "qcom,msmgold-qrd-sku5", "qcom,msmgold-qrd",
		   "qcom,msmgold", "qcom,qrd";
	qcom,board-id= <0x1000b 0>;
};

&int_codec {
	qcom,model = "msm8952-sku2-snd-card";
};
