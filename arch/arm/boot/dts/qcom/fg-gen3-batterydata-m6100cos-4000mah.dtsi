
qcom,m6100cos_4000mah {
	qcom, = <24>;
	/* #3884533_LC_M6100_Coslight_4000mAH_PM660_FG_averaged_MasterSlave_Feb20th2019*/
	qcom,max-voltage-uv = <4400000>;
	qcom,fastchg-current-ma = <2900>;
	qcom,fg-cc-cv-threshold-mv = <4390>;
	qcom,nom-batt-capacity-mah = <4000>;
	qcom,batt-id-kohm = <100>;
	qcom,battery-beta = <4250>;
	qcom,battery-full-design = <4000>;
	qcom,battery-type = "3884533_lc_m6100_coslight_4000mah_pm660_fg_averaged_masterslave_feb20th2019";
	qcom,checksum = <0x7832>;
	qcom,gui-version = "PM660GUI - 0.0.0.45";
	qcom,fg-profile-data = [
		 A0 1E C3 06
		 10 03 1F F5
		 C8 1C 4E 02
		 00 0D 83 0B
		 0D 18 22 23
		 77 45 D5 52
		 64 00 00 00
		 13 00 00 00
		 00 00 57 AD
		 D7 CD BD BB
		 1E 00 08 00
		 54 E2 C9 E4
		 3B 05 E7 01
		 90 15 83 02
		 DC ED CA 2B
		 2D 06 09 20
		 27 00 14 00
		 C7 1F B5 05
		 3F 0A 41 FD
		 D8 1C BC 02
		 80 0C B1 0B
		 94 18 D5 23
		 E6 4D 31 5B
		 70 00 00 00
		 0E 00 00 00
		 00 00 B6 CC
		 CB C2 98 BD
		 15 00 00 00
		 0E EA C9 E4
		 97 FC 1D FA
		 AE F4 31 03
		 4B FA 95 22
		 BF 33 CC FF
		 07 10 00 00
		 C6 0F 66 46
		 15 00 40 00
		 8F 01 0A FA
		 FF 00 00 00
		 00 00 00 00
		 00 00 00 00
		 00 00 00 00
		 00 00 00 00
		 00 00 00 00
		 00 00 00 00
		 00 00 00 00
		 00 00 00 00
		 00 00 00 00
		 00 00 00 00
		 00 00 00 00
		 00 00 00 00
		 00 00 00 00
		 00 00 00 00
		 00 00 00 00
		 00 00 00 00
		 00 00 00 00
		 00 00 00 00
	];
};
