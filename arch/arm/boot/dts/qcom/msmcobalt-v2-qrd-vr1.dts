/* Copyright (c) 2016, The Linux Foundation. All rights reserved.
 *
 * This program is free software; you can redistribute it and/or modify
 * it under the terms of the GNU General Public License version 2 and
 * only version 2 as published by the Free Software Foundation.
 *
 * This program is distributed in the hope that it will be useful,
 * but WITHOUT ANY WARRANTY; without even the implied warranty of
 * MERCHANTABILITY or FITNESS FOR A PARTICULAR PURPOSE.  See the
 * GNU General Public License for more details.
 */


/dts-v1/;

#include "msmcobalt-v2.dtsi"
#include "msmcobalt-qrd-vr1.dtsi"

/ {
	model = "Qualcomm Technologies, Inc. MSM COBALT V2 VR1 Board";
	compatible = "qcom,msmcobalt-qrd", "qcom,msmcobalt", "qcom,qrd";
	qcom,board-id = <0x02000b 0x80>;
};
