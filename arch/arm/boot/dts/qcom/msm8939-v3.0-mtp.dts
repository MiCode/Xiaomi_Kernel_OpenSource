/*
 * Copyright (c) 2015, The Linux Foundation. All rights reserved.
 *
 * This program is free software; you can redistribute it and/or modify
 * it under the terms of the GNU General Public License version 2 and
 * only version 2 as published by the Free Software Foundation.
 *
 * This program is distributed in the hope that it will be useful,
 * but WITHOUT ANY WARRANTY; without even the implied warranty of
 * MERCHANTABILITY or FITNESS FOR A PARTICULAR PURPOSE.  See the
 * GNU General Public License for more details.
 */

/dts-v1/;

#include "msm8939-v3.0.dtsi"
#include "msm8939-mtp.dtsi"
#include "msm8939-audio-internal_codec.dtsi"

/ {
	model = "Qualcomm Technologies, Inc. MSM 8939v3.0 MTP";
	compatible = "qcom,msm8939-mtp", "qcom,msm8939", "qcom,mtp";
	qcom,board-id = <8 1>;
};

&cci {
	led_flash0: qcom,led-flash@66 {
		cell-index = <0>;
		reg = <0x66>;
		qcom,slave-id = <0x66 0x00 0x0011>;
		compatible = "qcom,led-flash1";
		label = "bd7710";
		qcom,flash-type = <1>;
		qcom,gpio-no-mux = <0>;
		qcom,enable_pinctrl;
		pinctrl-names = "cam_flash_default", "cam_flash_suspend";
		pinctrl-0 = <&cam_sensor_flash_default>;
		pinctrl-1 = <&cam_sensor_flash_sleep>;
		gpios = <&msm_gpio 36 0>,
			<&msm_gpio 32 0>,
			<&msm_gpio 31 0>;
		qcom,gpio-flash-reset = <0>;
		qcom,gpio-flash-en = <1>;
		qcom,gpio-flash-now = <2>;
		qcom,gpio-req-tbl-num = <0 1 2>;
		qcom,gpio-req-tbl-flags = <0 0 0>;
		qcom,gpio-req-tbl-label = "FLASH_RST",
			"FLASH_EN",
			"FLASH_NOW";
		qcom,cci-master = <0>;
	};

	qcom,camera@0 {
		qcom,led-flash-src = <&led_flash0>;
	};
};
