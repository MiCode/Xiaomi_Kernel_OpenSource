/* Copyright (c) 2012-2014, The Linux Foundation. All rights reserved.
 *
 * This program is free software; you can redistribute it and/or modify
 * it under the terms of the GNU General Public License version 2 and
 * only version 2 as published by the Free Software Foundation.
 *
 * This program is distributed in the hope that it will be useful,
 * but WITHOUT ANY WARRANTY; without even the implied warranty of
 * MERCHANTABILITY or FITNESS FOR A PARTICULAR PURPOSE.  See the
 * GNU General Public License for more details.
 */

/dts-v1/;

#include "msm8974-v1.dtsi"
#include "msm8974-fluid.dtsi"

/ {
	model = "Qualcomm Technologies, Inc. MSM 8974 FLUID";
	compatible = "qcom,msm8974-fluid", "qcom,msm8974", "qcom,fluid";
	qcom,msm-id = <126 3 0>,
		      <185 3 0>,
		      <186 3 0>;

};

&pm8941_chg {
	qcom,charging-disabled;
};
