/* Copyright (c) 2014-2016, The Linux Foundation. All rights reserved.
 *
 * This program is free software; you can redistribute it and/or modify
 * it under the terms of the GNU General Public License version 2 and
 * only version 2 as published by the Free Software Foundation.
 *
 * This program is distributed in the hope that it will be useful,
 * but WITHOUT ANY WARRANTY; without even the implied warranty of
 * MERCHANTABILITY or FITNESS FOR A PARTICULAR PURPOSE.  See the
 * GNU General Public License for more details.
 */

&mdss_mdp {
	dsi_dual_sharp_1080_120hz_cmd: qcom,mdss_dual_sharp_1080p_120hz_cmd {
		qcom,mdss-dsi-panel-name =
			"sharp 1080p 120hz dual dsi cmd mode panel";
		qcom,mdss-dsi-panel-type = "dsi_cmd_mode";
		qcom,mdss-dsi-panel-framerate = <120>;
		qcom,mdss-dsi-virtual-channel-id = <0>;
		qcom,mdss-dsi-stream = <0>;
		qcom,mdss-dsi-panel-width = <540>;
		qcom,mdss-dsi-panel-height = <1920>;
		qcom,mdss-dsi-h-front-porch = <28>;
		qcom,mdss-dsi-h-back-porch = <4>;
		qcom,mdss-dsi-h-pulse-width = <4>;
		qcom,mdss-dsi-h-sync-skew = <0>;
		qcom,mdss-dsi-v-back-porch = <12>;
		qcom,mdss-dsi-v-front-porch = <12>;
		qcom,mdss-dsi-v-pulse-width = <2>;
		qcom,mdss-dsi-h-left-border = <0>;
		qcom,mdss-dsi-h-right-border = <0>;
		qcom,mdss-dsi-v-top-border = <0>;
		qcom,mdss-dsi-v-bottom-border = <0>;
		qcom,mdss-dsi-bpp = <24>;
		qcom,mdss-dsi-underflow-color = <0xff>;
		qcom,mdss-dsi-border-color = <0>;
		qcom,mdss-dsi-reset-sequence = <1 20>, <0 1>, <1 10>;
		qcom,mdss-dsi-on-command = [15 01 00 00 00 00 02 ff 10
			15 01 00 00 00 00 02 fb 01
			15 01 00 00 00 00 02 ba 07
			15 01 00 00 00 00 02 c0 00
			15 01 00 00 00 00 02 bb 10
			15 01 00 00 00 00 02 d9 00
			15 01 00 00 00 00 02 ef 70
			15 01 00 00 00 00 02 f7 80
			39 01 00 00 00 00 06 3b 03 0e 0c 08 1c
			15 01 00 00 00 00 02 e9 0e
			15 01 00 00 00 00 02 ea 0c
			15 01 00 00 00 00 02 35 00
			15 01 00 00 00 00 02 c0 00
			15 01 00 00 00 00 02 ff 20
			15 01 00 00 00 00 02 fb 01
			15 01 00 00 00 00 02 59 6a
			15 01 00 00 00 00 02 0b 1b
			15 01 00 00 00 00 02 61 f7
			15 01 00 00 00 00 02 62 6c
			15 01 00 00 00 00 02 00 01
			15 01 00 00 00 00 02 01 55
			15 01 00 00 00 00 02 04 c8
			15 01 00 00 00 00 02 05 1a
			15 01 00 00 00 00 02 0d 93
			15 01 00 00 00 00 02 0e 93
			15 01 00 00 00 00 02 0f 7e
			15 01 00 00 00 00 02 06 69
			15 01 00 00 00 00 02 07 bc
			15 01 00 00 00 00 02 10 03
			15 01 00 00 00 00 02 11 64
			15 01 00 00 00 00 02 12 5a
			15 01 00 00 00 00 02 13 40
			15 01 00 00 00 00 02 14 40
			15 01 00 00 00 00 02 15 00
			15 01 00 00 00 00 02 33 13
			15 01 00 00 00 00 02 5a 40
			15 01 00 00 00 00 02 5b 40
			15 01 00 00 00 00 02 5e 80
			15 01 00 00 00 00 02 ff 24
			15 01 00 00 00 00 02 fb 01
			15 01 00 00 00 00 02 00 80
			15 01 00 00 00 00 02 14 80
			15 01 00 00 00 00 02 01 80
			15 01 00 00 00 00 02 15 80
			15 01 00 00 00 00 02 02 80
			15 01 00 00 00 00 02 16 80
			15 01 00 00 00 00 02 03 0a
			15 01 00 00 00 00 02 17 0c
			15 01 00 00 00 00 02 04 06
			15 01 00 00 00 00 02 18 08
			15 01 00 00 00 00 02 05 80
			15 01 00 00 00 00 02 19 80
			15 01 00 00 00 00 02 06 80
			15 01 00 00 00 00 02 1a 80
			15 01 00 00 00 00 02 07 80
			15 01 00 00 00 00 02 1b 80
			15 01 00 00 00 00 02 08 80
			15 01 00 00 00 00 02 1c 80
			15 01 00 00 00 00 02 09 80
			15 01 00 00 00 00 02 1d 80
			15 01 00 00 00 00 02 0a 80
			15 01 00 00 00 00 02 1e 80
			15 01 00 00 00 00 02 0b 1a
			15 01 00 00 00 00 02 1f 1b
			15 01 00 00 00 00 02 0c 16
			15 01 00 00 00 00 02 20 17
			15 01 00 00 00 00 02 0d 1c
			15 01 00 00 00 00 02 21 1d
			15 01 00 00 00 00 02 0e 18
			15 01 00 00 00 00 02 22 19
			15 01 00 00 00 00 02 0f 0e
			15 01 00 00 00 00 02 23 10
			15 01 00 00 00 00 02 10 80
			15 01 00 00 00 00 02 24 80
			15 01 00 00 00 00 02 11 80
			15 01 00 00 00 00 02 25 80
			15 01 00 00 00 00 02 12 80
			15 01 00 00 00 00 02 26 80
			15 01 00 00 00 00 02 13 80
			15 01 00 00 00 00 02 27 80
			15 01 00 00 00 00 02 74 ff
			15 01 00 00 00 00 02 75 ff
			15 01 00 00 00 00 02 8d 00
			15 01 00 00 00 00 02 8e 00
			15 01 00 00 00 00 02 8f 9c
			15 01 00 00 00 00 02 90 0c
			15 01 00 00 00 00 02 91 0e
			15 01 00 00 00 00 02 d6 00
			15 01 00 00 00 00 02 d7 20
			15 01 00 00 00 00 02 d8 00
			15 01 00 00 00 00 02 d9 88
			15 01 00 00 00 00 02 e5 05
			15 01 00 00 00 00 02 e6 10
			15 01 00 00 00 00 02 54 06
			15 01 00 00 00 00 02 55 05
			15 01 00 00 00 00 02 56 04
			15 01 00 00 00 00 02 58 03
			15 01 00 00 00 00 02 59 33
			15 01 00 00 00 00 02 5a 33
			15 01 00 00 00 00 02 5b 01
			15 01 00 00 00 00 02 5c 00
			15 01 00 00 00 00 02 5d 01
			15 01 00 00 00 00 02 5e 0a
			15 01 00 00 00 00 02 5f 0a
			15 01 00 00 00 00 02 60 0a
			15 01 00 00 00 00 02 61 0a
			15 01 00 00 00 00 02 62 10
			15 01 00 00 00 00 02 63 01
			15 01 00 00 00 00 02 64 00
			15 01 00 00 00 00 02 65 00
			15 01 00 00 00 00 02 ef 00
			15 01 00 00 00 00 02 f0 00
			15 01 00 00 00 00 02 6d 20
			15 01 00 00 00 00 02 66 44
			15 01 00 00 00 00 02 68 01
			15 01 00 00 00 00 02 69 00
			15 01 00 00 00 00 02 67 11
			15 01 00 00 00 00 02 6a 06
			15 01 00 00 00 00 02 6b 31
			15 01 00 00 00 00 02 6c 90
			15 01 00 00 00 00 02 ab c3
			15 01 00 00 00 00 02 b1 49
			15 01 00 00 00 00 02 aa 80
			15 01 00 00 00 00 02 b0 90
			15 01 00 00 00 00 02 b2 a4
			15 01 00 00 00 00 02 b3 00
			15 01 00 00 00 00 02 b4 23
			15 01 00 00 00 00 02 b5 00
			15 01 00 00 00 00 02 b6 00
			15 01 00 00 00 00 02 b7 00
			15 01 00 00 00 00 02 b8 00
			15 01 00 00 00 00 02 b9 00
			15 01 00 00 00 00 02 ba 00
			15 01 00 00 00 00 02 bb 00
			15 01 00 00 00 00 02 bc 00
			15 01 00 00 00 00 02 bd 00
			15 01 00 00 00 00 02 be 00
			15 01 00 00 00 00 02 bf 00
			15 01 00 00 00 00 02 c0 00
			15 01 00 00 00 00 02 c7 40
			15 01 00 00 00 00 02 c9 00
			15 01 00 00 00 00 02 c1 2a
			15 01 00 00 00 00 02 c2 2a
			15 01 00 00 00 00 02 c3 00
			15 01 00 00 00 00 02 c4 00
			15 01 00 00 00 00 02 c5 00
			15 01 00 00 00 00 02 c6 00
			15 01 00 00 00 00 02 c8 ab
			15 01 00 00 00 00 02 ca 00
			15 01 00 00 00 00 02 cb 00
			15 01 00 00 00 00 02 cc 20
			15 01 00 00 00 00 02 cd 40
			15 01 00 00 00 00 02 ce a8
			15 01 00 00 00 00 02 cf a8
			15 01 00 00 00 00 02 d0 00
			15 01 00 00 00 00 02 d1 00
			15 01 00 00 00 00 02 d2 00
			15 01 00 00 00 00 02 d3 00
			15 01 00 00 00 00 02 af 01
			15 01 00 00 00 00 02 a4 1e
			15 01 00 00 00 00 02 95 41
			15 01 00 00 00 00 02 96 03
			15 01 00 00 00 00 02 98 00
			15 01 00 00 00 00 02 9a 9a
			15 01 00 00 00 00 02 9b 03
			15 01 00 00 00 00 02 9d 80
			15 01 00 00 00 00 02 ff 26
			15 01 00 00 00 00 02 fb 01
			15 01 00 00 00 00 02 fa d0
			15 01 00 00 00 00 02 6b 80
			15 01 00 00 00 00 02 6c 5c
			15 01 00 00 00 00 02 6d 0c
			15 01 00 00 00 00 02 6e 0e
			15 01 00 00 00 00 02 58 01
			15 01 00 00 00 00 02 59 15
			15 01 00 00 00 00 02 5a 01
			15 01 00 00 00 00 02 5b 00
			15 01 00 00 00 00 02 5c 01
			15 01 00 00 00 00 02 5d 2b
			15 01 00 00 00 00 02 74 00
			15 01 00 00 00 00 02 75 ba
			15 01 00 00 00 00 02 81 0a
			15 01 00 00 00 00 02 4e 81
			15 01 00 00 00 00 02 4f 83
			15 01 00 00 00 00 02 51 00
			15 01 00 00 00 00 02 53 4d
			15 01 00 00 00 00 02 54 03
			15 01 00 00 00 00 02 ff e0
			15 01 00 00 00 00 02 fb 01
			15 01 00 00 00 00 02 b2 81
			15 01 00 00 00 00 02 62 28
			15 01 00 00 00 00 02 a2 09
			15 01 00 00 00 00 02 b3 01
			15 01 00 00 00 00 02 ed 00
			15 01 00 00 00 00 02 ff 10
			05 01 00 00 78 00 01 11
			15 01 00 00 00 00 02 ff 20
			15 01 00 00 00 00 02 75 00
			15 01 00 00 00 00 02 76 71
			15 01 00 00 00 00 02 77 00
			15 01 00 00 00 00 02 78 84
			15 01 00 00 00 00 02 79 00
			15 01 00 00 00 00 02 7a a5
			15 01 00 00 00 00 02 7b 00
			15 01 00 00 00 00 02 7c bb
			15 01 00 00 00 00 02 7d 00
			15 01 00 00 00 00 02 7e ce
			15 01 00 00 00 00 02 7f 00
			15 01 00 00 00 00 02 80 e0
			15 01 00 00 00 00 02 81 00
			15 01 00 00 00 00 02 82 ef
			15 01 00 00 00 00 02 83 00
			15 01 00 00 00 00 02 84 ff
			15 01 00 00 00 00 02 85 01
			15 01 00 00 00 00 02 86 0b
			15 01 00 00 00 00 02 87 01
			15 01 00 00 00 00 02 88 38
			15 01 00 00 00 00 02 89 01
			15 01 00 00 00 00 02 8a 5b
			15 01 00 00 00 00 02 8b 01
			15 01 00 00 00 00 02 8c 95
			15 01 00 00 00 00 02 8d 01
			15 01 00 00 00 00 02 8e c4
			15 01 00 00 00 00 02 8f 02
			15 01 00 00 00 00 02 90 0d
			15 01 00 00 00 00 02 91 02
			15 01 00 00 00 00 02 92 4a
			15 01 00 00 00 00 02 93 02
			15 01 00 00 00 00 02 94 4c
			15 01 00 00 00 00 02 95 02
			15 01 00 00 00 00 02 96 85
			15 01 00 00 00 00 02 97 02
			15 01 00 00 00 00 02 98 c3
			15 01 00 00 00 00 02 99 02
			15 01 00 00 00 00 02 9a e9
			15 01 00 00 00 00 02 9b 03
			15 01 00 00 00 00 02 9c 16
			15 01 00 00 00 00 02 9d 03
			15 01 00 00 00 00 02 9e 34
			15 01 00 00 00 00 02 9f 03
			15 01 00 00 00 00 02 a0 56
			15 01 00 00 00 00 02 a2 03
			15 01 00 00 00 00 02 a3 62
			15 01 00 00 00 00 02 a4 03
			15 01 00 00 00 00 02 a5 6c
			15 01 00 00 00 00 02 a6 03
			15 01 00 00 00 00 02 a7 74
			15 01 00 00 00 00 02 a9 03
			15 01 00 00 00 00 02 aa 80
			15 01 00 00 00 00 02 ab 03
			15 01 00 00 00 00 02 ac 89
			15 01 00 00 00 00 02 ad 03
			15 01 00 00 00 00 02 ae 8b
			15 01 00 00 00 00 02 af 03
			15 01 00 00 00 00 02 b0 8d
			15 01 00 00 00 00 02 b1 03
			15 01 00 00 00 00 02 b2 8e
			15 01 00 00 00 00 02 b3 00
			15 01 00 00 00 00 02 b4 71
			15 01 00 00 00 00 02 b5 00
			15 01 00 00 00 00 02 b6 84
			15 01 00 00 00 00 02 b7 00
			15 01 00 00 00 00 02 b8 a5
			15 01 00 00 00 00 02 b9 00
			15 01 00 00 00 00 02 ba bb
			15 01 00 00 00 00 02 bb 00
			15 01 00 00 00 00 02 bc ce
			15 01 00 00 00 00 02 bd 00
			15 01 00 00 00 00 02 be e0
			15 01 00 00 00 00 02 bf 00
			15 01 00 00 00 00 02 c0 ef
			15 01 00 00 00 00 02 c1 00
			15 01 00 00 00 00 02 c2 ff
			15 01 00 00 00 00 02 c3 01
			15 01 00 00 00 00 02 c4 0b
			15 01 00 00 00 00 02 c5 01
			15 01 00 00 00 00 02 c6 38
			15 01 00 00 00 00 02 c7 01
			15 01 00 00 00 00 02 c8 5b
			15 01 00 00 00 00 02 c9 01
			15 01 00 00 00 00 02 ca 95
			15 01 00 00 00 00 02 cb 01
			15 01 00 00 00 00 02 cc c4
			15 01 00 00 00 00 02 cd 02
			15 01 00 00 00 00 02 ce 0d
			15 01 00 00 00 00 02 cf 02
			15 01 00 00 00 00 02 d0 4a
			15 01 00 00 00 00 02 d1 02
			15 01 00 00 00 00 02 d2 4c
			15 01 00 00 00 00 02 d3 02
			15 01 00 00 00 00 02 d4 85
			15 01 00 00 00 00 02 d5 02
			15 01 00 00 00 00 02 d6 c3
			15 01 00 00 00 00 02 d7 02
			15 01 00 00 00 00 02 d8 e9
			15 01 00 00 00 00 02 d9 03
			15 01 00 00 00 00 02 da 16
			15 01 00 00 00 00 02 db 03
			15 01 00 00 00 00 02 dc 34
			15 01 00 00 00 00 02 dd 03
			15 01 00 00 00 00 02 de 56
			15 01 00 00 00 00 02 df 03
			15 01 00 00 00 00 02 e0 62
			15 01 00 00 00 00 02 e1 03
			15 01 00 00 00 00 02 e2 6c
			15 01 00 00 00 00 02 e3 03
			15 01 00 00 00 00 02 e4 74
			15 01 00 00 00 00 02 e5 03
			15 01 00 00 00 00 02 e6 80
			15 01 00 00 00 00 02 e7 03
			15 01 00 00 00 00 02 e8 89
			15 01 00 00 00 00 02 e9 03
			15 01 00 00 00 00 02 ea 8b
			15 01 00 00 00 00 02 eb 03
			15 01 00 00 00 00 02 ec 8d
			15 01 00 00 00 00 02 ed 03
			15 01 00 00 00 00 02 ee 8e
			15 01 00 00 00 00 02 ef 00
			15 01 00 00 00 00 02 f0 71
			15 01 00 00 00 00 02 f1 00
			15 01 00 00 00 00 02 f2 84
			15 01 00 00 00 00 02 f3 00
			15 01 00 00 00 00 02 f4 a5
			15 01 00 00 00 00 02 f5 00
			15 01 00 00 00 00 02 f6 bb
			15 01 00 00 00 00 02 f7 00
			15 01 00 00 00 00 02 f8 ce
			15 01 00 00 00 00 02 f9 00
			15 01 00 00 00 00 02 fa e0
			15 01 00 00 00 00 02 ff 21
			15 01 00 00 00 00 02 fb 01
			15 01 00 00 00 00 02 00 00
			15 01 00 00 00 00 02 01 ef
			15 01 00 00 00 00 02 02 00
			15 01 00 00 00 00 02 03 ff
			15 01 00 00 00 00 02 04 01
			15 01 00 00 00 00 02 05 0b
			15 01 00 00 00 00 02 06 01
			15 01 00 00 00 00 02 07 38
			15 01 00 00 00 00 02 08 01
			15 01 00 00 00 00 02 09 5b
			15 01 00 00 00 00 02 0a 01
			15 01 00 00 00 00 02 0b 95
			15 01 00 00 00 00 02 0c 01
			15 01 00 00 00 00 02 0d c4
			15 01 00 00 00 00 02 0e 02
			15 01 00 00 00 00 02 0f 0d
			15 01 00 00 00 00 02 10 02
			15 01 00 00 00 00 02 11 4a
			15 01 00 00 00 00 02 12 02
			15 01 00 00 00 00 02 13 4c
			15 01 00 00 00 00 02 14 02
			15 01 00 00 00 00 02 15 85
			15 01 00 00 00 00 02 16 02
			15 01 00 00 00 00 02 17 c3
			15 01 00 00 00 00 02 18 02
			15 01 00 00 00 00 02 19 e9
			15 01 00 00 00 00 02 1a 03
			15 01 00 00 00 00 02 1b 16
			15 01 00 00 00 00 02 1c 03
			15 01 00 00 00 00 02 1d 34
			15 01 00 00 00 00 02 1e 03
			15 01 00 00 00 00 02 1f 56
			15 01 00 00 00 00 02 20 03
			15 01 00 00 00 00 02 21 62
			15 01 00 00 00 00 02 22 03
			15 01 00 00 00 00 02 23 6c
			15 01 00 00 00 00 02 24 03
			15 01 00 00 00 00 02 25 74
			15 01 00 00 00 00 02 26 03
			15 01 00 00 00 00 02 27 80
			15 01 00 00 00 00 02 28 03
			15 01 00 00 00 00 02 29 89
			15 01 00 00 00 00 02 2a 03
			15 01 00 00 00 00 02 2b 8b
			15 01 00 00 00 00 02 2d 03
			15 01 00 00 00 00 02 2f 8d
			15 01 00 00 00 00 02 30 03
			15 01 00 00 00 00 02 31 8e
			15 01 00 00 00 00 02 32 00
			15 01 00 00 00 00 02 33 71
			15 01 00 00 00 00 02 34 00
			15 01 00 00 00 00 02 35 84
			15 01 00 00 00 00 02 36 00
			15 01 00 00 00 00 02 37 a5
			15 01 00 00 00 00 02 38 00
			15 01 00 00 00 00 02 39 bb
			15 01 00 00 00 00 02 3a 00
			15 01 00 00 00 00 02 3b ce
			15 01 00 00 00 00 02 3d 00
			15 01 00 00 00 00 02 3f e0
			15 01 00 00 00 00 02 40 00
			15 01 00 00 00 00 02 41 ef
			15 01 00 00 00 00 02 42 00
			15 01 00 00 00 00 02 43 ff
			15 01 00 00 00 00 02 44 01
			15 01 00 00 00 00 02 45 0b
			15 01 00 00 00 00 02 46 01
			15 01 00 00 00 00 02 47 38
			15 01 00 00 00 00 02 48 01
			15 01 00 00 00 00 02 49 5b
			15 01 00 00 00 00 02 4a 01
			15 01 00 00 00 00 02 4b 95
			15 01 00 00 00 00 02 4c 01
			15 01 00 00 00 00 02 4d c4
			15 01 00 00 00 00 02 4e 02
			15 01 00 00 00 00 02 4f 0d
			15 01 00 00 00 00 02 50 02
			15 01 00 00 00 00 02 51 4a
			15 01 00 00 00 00 02 52 02
			15 01 00 00 00 00 02 53 4c
			15 01 00 00 00 00 02 54 02
			15 01 00 00 00 00 02 55 85
			15 01 00 00 00 00 02 56 02
			15 01 00 00 00 00 02 58 c3
			15 01 00 00 00 00 02 59 02
			15 01 00 00 00 00 02 5a e9
			15 01 00 00 00 00 02 5b 03
			15 01 00 00 00 00 02 5c 16
			15 01 00 00 00 00 02 5d 03
			15 01 00 00 00 00 02 5e 34
			15 01 00 00 00 00 02 5f 03
			15 01 00 00 00 00 02 60 56
			15 01 00 00 00 00 02 61 03
			15 01 00 00 00 00 02 62 62
			15 01 00 00 00 00 02 63 03
			15 01 00 00 00 00 02 64 6c
			15 01 00 00 00 00 02 65 03
			15 01 00 00 00 00 02 66 74
			15 01 00 00 00 00 02 67 03
			15 01 00 00 00 00 02 68 80
			15 01 00 00 00 00 02 69 03
			15 01 00 00 00 00 02 6a 89
			15 01 00 00 00 00 02 6b 03
			15 01 00 00 00 00 02 6c 8b
			15 01 00 00 00 00 02 6d 03
			15 01 00 00 00 00 02 6e 8d
			15 01 00 00 00 00 02 6f 03
			15 01 00 00 00 00 02 70 8e
			15 01 00 00 00 00 02 71 00
			15 01 00 00 00 00 02 72 71
			15 01 00 00 00 00 02 73 00
			15 01 00 00 00 00 02 74 84
			15 01 00 00 00 00 02 75 00
			15 01 00 00 00 00 02 76 a5
			15 01 00 00 00 00 02 77 00
			15 01 00 00 00 00 02 78 bb
			15 01 00 00 00 00 02 79 00
			15 01 00 00 00 00 02 7a ce
			15 01 00 00 00 00 02 7b 00
			15 01 00 00 00 00 02 7c e0
			15 01 00 00 00 00 02 7d 00
			15 01 00 00 00 00 02 7e ef
			15 01 00 00 00 00 02 7f 00
			15 01 00 00 00 00 02 80 ff
			15 01 00 00 00 00 02 81 01
			15 01 00 00 00 00 02 82 0b
			15 01 00 00 00 00 02 83 01
			15 01 00 00 00 00 02 84 38
			15 01 00 00 00 00 02 85 01
			15 01 00 00 00 00 02 86 5b
			15 01 00 00 00 00 02 87 01
			15 01 00 00 00 00 02 88 95
			15 01 00 00 00 00 02 89 01
			15 01 00 00 00 00 02 8a c4
			15 01 00 00 00 00 02 8b 02
			15 01 00 00 00 00 02 8c 0d
			15 01 00 00 00 00 02 8d 02
			15 01 00 00 00 00 02 8e 4a
			15 01 00 00 00 00 02 8f 02
			15 01 00 00 00 00 02 90 4c
			15 01 00 00 00 00 02 91 02
			15 01 00 00 00 00 02 92 85
			15 01 00 00 00 00 02 93 02
			15 01 00 00 00 00 02 94 c3
			15 01 00 00 00 00 02 95 02
			15 01 00 00 00 00 02 96 e9
			15 01 00 00 00 00 02 97 03
			15 01 00 00 00 00 02 98 16
			15 01 00 00 00 00 02 99 03
			15 01 00 00 00 00 02 9a 34
			15 01 00 00 00 00 02 9b 03
			15 01 00 00 00 00 02 9c 56
			15 01 00 00 00 00 02 9d 03
			15 01 00 00 00 00 02 9e 62
			15 01 00 00 00 00 02 9f 03
			15 01 00 00 00 00 02 a0 6c
			15 01 00 00 00 00 02 a2 03
			15 01 00 00 00 00 02 a3 74
			15 01 00 00 00 00 02 a4 03
			15 01 00 00 00 00 02 a5 80
			15 01 00 00 00 00 02 a6 03
			15 01 00 00 00 00 02 a7 89
			15 01 00 00 00 00 02 a9 03
			15 01 00 00 00 00 02 aa 8b
			15 01 00 00 00 00 02 ab 03
			15 01 00 00 00 00 02 ac 8d
			15 01 00 00 00 00 02 ad 03
			15 01 00 00 00 00 02 ae 8e
			15 01 00 00 00 00 02 af 00
			15 01 00 00 00 00 02 b0 71
			15 01 00 00 00 00 02 b1 00
			15 01 00 00 00 00 02 b2 84
			15 01 00 00 00 00 02 b3 00
			15 01 00 00 00 00 02 b4 a5
			15 01 00 00 00 00 02 b5 00
			15 01 00 00 00 00 02 b6 bb
			15 01 00 00 00 00 02 b7 00
			15 01 00 00 00 00 02 b8 ce
			15 01 00 00 00 00 02 b9 00
			15 01 00 00 00 00 02 ba e0
			15 01 00 00 00 00 02 bb 00
			15 01 00 00 00 00 02 bc ef
			15 01 00 00 00 00 02 bd 00
			15 01 00 00 00 00 02 be ff
			15 01 00 00 00 00 02 bf 01
			15 01 00 00 00 00 02 c0 0b
			15 01 00 00 00 00 02 c1 01
			15 01 00 00 00 00 02 c2 38
			15 01 00 00 00 00 02 c3 01
			15 01 00 00 00 00 02 c4 5b
			15 01 00 00 00 00 02 c5 01
			15 01 00 00 00 00 02 c6 95
			15 01 00 00 00 00 02 c7 01
			15 01 00 00 00 00 02 c8 c4
			15 01 00 00 00 00 02 c9 02
			15 01 00 00 00 00 02 ca 0d
			15 01 00 00 00 00 02 cb 02
			15 01 00 00 00 00 02 cc 4a
			15 01 00 00 00 00 02 cd 02
			15 01 00 00 00 00 02 ce 4c
			15 01 00 00 00 00 02 cf 02
			15 01 00 00 00 00 02 d0 85
			15 01 00 00 00 00 02 d1 02
			15 01 00 00 00 00 02 d2 c3
			15 01 00 00 00 00 02 d3 02
			15 01 00 00 00 00 02 d4 e9
			15 01 00 00 00 00 02 d5 03
			15 01 00 00 00 00 02 d6 16
			15 01 00 00 00 00 02 d7 03
			15 01 00 00 00 00 02 d8 34
			15 01 00 00 00 00 02 d9 03
			15 01 00 00 00 00 02 da 56
			15 01 00 00 00 00 02 db 03
			15 01 00 00 00 00 02 dc 62
			15 01 00 00 00 00 02 dd 03
			15 01 00 00 00 00 02 de 6c
			15 01 00 00 00 00 02 df 03
			15 01 00 00 00 00 02 e0 74
			15 01 00 00 00 00 02 e1 03
			15 01 00 00 00 00 02 e2 80
			15 01 00 00 00 00 02 e3 03
			15 01 00 00 00 00 02 e4 89
			15 01 00 00 00 00 02 e5 03
			15 01 00 00 00 00 02 e6 8b
			15 01 00 00 00 00 02 e7 03
			15 01 00 00 00 00 02 e8 8d
			15 01 00 00 00 00 02 e9 03
			15 01 00 00 00 00 02 ea 8e
			15 01 00 00 00 00 02 FF 10
			05 01 00 00 00 00 01 29];
		qcom,mdss-dsi-off-command = [15 01 00 00 00 00 02 ff 10
			05 01 00 00 10 00 01 28
			15 01 00 00 00 00 02 b0 00
			05 01 00 00 40 00 01 10
			15 01 00 00 00 00 02 4f 01];
		qcom,mdss-dsi-on-command-state = "dsi_lp_mode";
		qcom,mdss-dsi-off-command-state = "dsi_hs_mode";
		qcom,mdss-dsi-h-sync-pulse = <0>;
		qcom,mdss-dsi-traffic-mode = "burst_mode";
		qcom,mdss-dsi-bllp-eof-power-mode;
		qcom,mdss-dsi-bllp-power-mode;
		qcom,cmd-sync-wait-broadcast;
		qcom,cmd-sync-wait-trigger;
		qcom,mdss-tear-check-frame-rate = <12000>;
		qcom,mdss-dsi-lane-0-state;
		qcom,mdss-dsi-lane-1-state;
		qcom,mdss-dsi-lane-2-state;
		qcom,mdss-dsi-lane-3-state;
		qcom,mdss-dsi-panel-timings = [d6 32 22 00 60 66 26 36 28 03 04
			00];
		qcom,mdss-dsi-t-clk-post = <0x04>;
		qcom,mdss-dsi-t-clk-pre = <0x1b>;
		qcom,mdss-dsi-dma-trigger = "trigger_sw";
		qcom,mdss-dsi-mdp-trigger = "none";
		qcom,mdss-dsi-te-pin-select = <1>;
		qcom,mdss-dsi-wr-mem-start = <0x2c>;
		qcom,mdss-dsi-wr-mem-continue = <0x3c>;
		qcom,mdss-dsi-te-dcs-command = <1>;
		qcom,mdss-dsi-te-check-enable;
		qcom,mdss-dsi-te-using-te-pin;

		qcom,config-select = <&dsi_dual_sharp_cmd_config0>;

		dsi_dual_sharp_cmd_config0: config0 {
			qcom,split-mode = "dualctl-split";
		};
	};
};
