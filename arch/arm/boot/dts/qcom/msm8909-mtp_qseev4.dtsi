/*
 * Copyright (c) 2018, The Linux Foundation. All rights reserved.
 *
 * This program is free software; you can redistribute it and/or modify
 * it under the terms of the GNU General Public License version 2 and
 * only version 2 as published by the Free Software Foundation.
 *
 * This program is distributed in the hope that it will be useful,
 * but WITHOUT ANY WARRANTY; without even the implied warranty of
 * MERCHANTABILITY or FITNESS FOR A PARTICULAR PURPOSE.  See the
 * GNU General Public License for more details.
 */

&reserved_mem {
	secure_display_memory: secure_region {
		compatible = "shared-dma-pool";
		label = "secure_display_mem";
		size = <0 0x1400000>;
		reusable;
	};
};

&ion {
	secure_display_heap: qcom,ion-heap@10 { /* SECURE DISPLAY HEAP */
		reg = <10>;
		memory-region = <&secure_display_memory>;
		qcom,ion-heap-type = "SECURE_DMA";
	};
};
