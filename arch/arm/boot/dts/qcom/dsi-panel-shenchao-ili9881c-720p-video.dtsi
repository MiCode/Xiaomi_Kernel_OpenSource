/*
 * Copyright (c) 2015, The Linux Foundation. All rights reserved.
 * Copyright (C) 2019 XiaoMi, Inc.
 *
 * This program is free software; you can redistribute it and/or modify
 * it under the terms of the GNU General Public License version 2 and
 * only version 2 as published by the Free Software Foundation.
 *
 * This program is distributed in the hope that it will be useful,
 * but WITHOUT ANY WARRANTY; without even the implied warranty of
 * MERCHANTABILITY or FITNESS FOR A PARTICULAR PURPOSE.  See the
 * GNU General Public License for more details.
 */

/*---------------------------------------------------------------------------
 * This file is autogenerated file using gcdb parser. Please do not edit it.
 * Update input XML file to add a new entry or update variable in this file
 * VERSION = "1.0"
 *---------------------------------------------------------------------------*/
&mdss_mdp {
	dsi_sc_ili9881c_720p_video: qcom,mdss_dsi_sc_ili9881c_720p_video {
		qcom,mdss-dsi-panel-name = "shenchao ili9881c 720p video mode dsi panel";
		qcom,mdss-dsi-panel-controller = <&mdss_dsi0>;
		qcom,mdss-dsi-panel-type = "dsi_video_mode";
		qcom,mdss-dsi-panel-destination = "display_1";
		qcom,mdss-dsi-panel-framerate = <60>;
		qcom,mdss-dsi-virtual-channel-id = <0>;
		qcom,mdss-dsi-stream = <0>;
		qcom,mdss-dsi-panel-width = <720>;
		qcom,mdss-dsi-panel-height = <1280>;
		qcom,mdss-dsi-h-front-porch = <100>;
		qcom,mdss-dsi-h-back-porch = <100>;
		qcom,mdss-dsi-h-pulse-width = <10>;
		qcom,mdss-dsi-h-sync-skew = <0>;
		qcom,mdss-dsi-v-back-porch = <36>;
		qcom,mdss-dsi-v-front-porch = <36>;
		qcom,mdss-dsi-v-pulse-width = <10>;
		qcom,mdss-dsi-h-left-border = <0>;
		qcom,mdss-dsi-h-right-border = <0>;
		qcom,mdss-dsi-v-top-border = <0>;
		qcom,mdss-dsi-v-bottom-border = <0>;
		qcom,mdss-dsi-bpp = <24>;
		qcom,mdss-dsi-underflow-color = <0xff>;
		qcom,mdss-dsi-border-color = <0>;
		qcom,mdss-dsi-on-command = [
				39 01 00 00 00 00 04 FF 98 81 00
				39 01 00 00 1E 00 02 11 00
				39 01 00 00 0a 00 02 29 00
				39 01 00 00 00 00 03 68 04 01
				39 01 00 00 00 00 02 35 00
				39 01 00 00 00 00 02 53 2C
				39 01 00 00 00 00 04 FF 98 81 02
				39 01 00 00 00 00 02 06 40
				39 01 00 00 00 00 02 07 05
				39 01 00 00 00 00 04 FF 98 81 03
				39 01 00 00 00 00 02 2C 0C
				39 01 00 00 00 00 04 FF 98 81 00];

		qcom,mdss-dsi-off-command = [05 01 00 00 10 00 02 28 00
				05 01 00 00 78 00 02 10 00];

		qcom,mdss-dsi-warm-command = [
				39 00 00 00 00 00 04 FF 98 81 01
				39 00 00 00 00 00 04 FF 98 81 01
				39 00 00 00 00 00 02 A0 04
				39 00 00 00 00 00 02 A1 31
				39 00 00 00 00 00 02 A2 41
				39 00 00 00 00 00 02 A3 14
				39 00 00 00 00 00 02 A4 18
				39 00 00 00 00 00 02 A5 2B
				39 00 00 00 00 00 02 A6 1F
				39 00 00 00 00 00 02 A7 21
				39 00 00 00 00 00 02 A8 B6
				39 00 00 00 00 00 02 A9 1C
				39 00 00 00 00 00 02 AA 28
				39 00 00 00 00 00 02 AB 9F
				39 00 00 00 00 00 02 AC 1E
				39 00 00 00 00 00 02 AD 1F
				39 00 00 00 00 00 02 AE 53
				39 00 00 00 00 00 02 AF 27
				39 00 00 00 00 00 02 B0 2B
				39 00 00 00 00 00 02 B1 59
				39 00 00 00 00 00 02 B2 66
				39 00 00 00 00 00 02 B3 32
				39 00 00 00 00 00 02 C0 04
				39 00 00 00 00 00 02 C1 31
				39 00 00 00 00 00 02 C2 41
				39 00 00 00 00 00 02 C3 14
				39 00 00 00 00 00 02 C4 18
				39 00 00 00 00 00 02 C5 2B
				39 00 00 00 00 00 02 C6 1F
				39 00 00 00 00 00 02 C7 21
				39 00 00 00 00 00 02 C8 B6
				39 00 00 00 00 00 02 C9 1C
				39 00 00 00 00 00 02 CA 28
				39 00 00 00 00 00 02 CB 9F
				39 00 00 00 00 00 02 CC 1E
				39 00 00 00 00 00 02 CD 1F
				39 00 00 00 00 00 02 CE 53
				39 00 00 00 00 00 02 CF 27
				39 00 00 00 00 00 02 D0 2B
				39 00 00 00 00 00 02 D1 59
				39 00 00 00 00 00 02 D2 66
				39 01 00 00 00 00 02 D3 32
				39 00 00 00 00 00 04 FF 98 81 05
				39 00 00 00 00 00 04 FF 98 81 05
				39 00 00 00 00 00 02 85 48
				39 00 00 00 00 00 02 00 00
				39 00 00 00 00 00 02 01 00
				39 00 00 00 00 00 02 02 00
				39 00 00 00 00 00 02 03 11
				39 00 00 00 00 00 02 04 00
				39 00 00 00 00 00 02 05 20
				39 00 00 00 00 00 02 06 00
				39 00 00 00 00 00 02 07 31
				39 00 00 00 00 00 02 08 00
				39 00 00 00 00 00 02 09 40
				39 00 00 00 00 00 02 0A 00
				39 00 00 00 00 00 02 0B 50
				39 00 00 00 00 00 02 0C 00
				39 00 00 00 00 00 02 0D 61
				39 00 00 00 00 00 02 0E 00
				39 00 00 00 00 00 02 0F 72
				39 00 00 00 00 00 02 10 00
				39 00 00 00 00 00 02 11 83
				39 00 00 00 00 00 02 12 00
				39 00 00 00 00 00 02 13 92
				39 00 00 00 00 00 02 14 00
				39 00 00 00 00 00 02 15 A4
				39 00 00 00 00 00 02 16 00
				39 00 00 00 00 00 02 17 B3
				39 00 00 00 00 00 02 18 00
				39 00 00 00 00 00 02 19 C1
				39 00 00 00 00 00 02 1A 00
				39 00 00 00 00 00 02 1B D1
				39 00 00 00 00 00 02 1C 00
				39 00 00 00 00 00 02 1D E3
				39 00 00 00 00 00 02 1E 00
				39 00 00 00 00 00 02 1F F3
				39 00 00 00 00 00 02 20 01
				39 00 00 00 00 00 02 21 04
				39 00 00 00 00 00 02 22 01
				39 00 00 00 00 00 02 23 14
				39 00 00 00 00 00 02 24 01
				39 00 00 00 00 00 02 25 23
				39 00 00 00 00 00 02 26 01
				39 00 00 00 00 00 02 27 32
				39 00 00 00 00 00 02 28 01
				39 00 00 00 00 00 02 29 41
				39 00 00 00 00 00 02 2A 01
				39 00 00 00 00 00 02 2B 51
				39 00 00 00 00 00 02 2C 01
				39 00 00 00 00 00 02 2D 61
				39 00 00 00 00 00 02 2E 01
				39 00 00 00 00 00 02 2F 71
				39 00 00 00 00 00 02 30 01
				39 00 00 00 00 00 02 31 81
				39 00 00 00 00 00 02 32 01
				39 00 00 00 00 00 02 33 91
				39 00 00 00 00 00 02 34 01
				39 00 00 00 00 00 02 35 A1
				39 00 00 00 00 00 02 36 01
				39 00 00 00 00 00 02 37 C0
				39 00 00 00 00 00 02 38 01
				39 00 00 00 00 00 02 39 DF
				39 00 00 00 00 00 02 3A 01
				39 00 00 00 00 00 02 3B FC
				39 00 00 00 00 00 02 3C 02
				39 00 00 00 00 00 02 3D 1E
				39 00 00 00 00 00 02 3E 02
				39 00 00 00 00 00 02 3F 40
				39 00 00 00 00 00 02 40 02
				39 00 00 00 00 00 02 41 5E
				39 00 00 00 00 00 02 42 02
				39 00 00 00 00 00 02 43 7D
				39 00 00 00 00 00 02 44 02
				39 00 00 00 00 00 02 45 9D
				39 00 00 00 00 00 02 46 02
				39 00 00 00 00 00 02 47 BF
				39 00 00 00 00 00 02 48 02
				39 00 00 00 00 00 02 49 DD
				39 00 00 00 00 00 02 4A 02
				39 00 00 00 00 00 02 4B FD
				39 00 00 00 00 00 02 4C 03
				39 00 00 00 00 00 02 4D 1E
				39 00 00 00 00 00 02 4E 03
				39 00 00 00 00 00 02 4F 3D
				39 00 00 00 00 00 02 50 03
				39 00 00 00 00 00 02 51 5C
				39 00 00 00 00 00 02 52 03
				39 00 00 00 00 00 02 53 81
				39 00 00 00 00 00 02 54 03
				39 00 00 00 00 00 02 55 A2
				39 00 00 00 00 00 02 56 03
				39 00 00 00 00 00 02 57 C2
				39 00 00 00 00 00 02 58 03
				39 00 00 00 00 00 02 59 E0
				39 00 00 00 00 00 02 5A 00
				39 01 00 00 00 00 02 5B 00
				39 00 00 00 00 00 04 FF 98 81 06
				39 00 00 00 00 00 04 FF 98 81 06
				39 00 00 00 00 00 02 00 00
				39 00 00 00 00 00 02 01 00
				39 00 00 00 00 00 02 02 00
				39 00 00 00 00 00 02 03 10
				39 00 00 00 00 00 02 04 00
				39 00 00 00 00 00 02 05 1F
				39 00 00 00 00 00 02 06 00
				39 00 00 00 00 00 02 07 30
				39 00 00 00 00 00 02 08 00
				39 00 00 00 00 00 02 09 3F
				39 00 00 00 00 00 02 0A 00
				39 00 00 00 00 00 02 0B 50
				39 00 00 00 00 00 02 0C 00
				39 00 00 00 00 00 02 0D 60
				39 00 00 00 00 00 02 0E 00
				39 00 00 00 00 00 02 0F 71
				39 00 00 00 00 00 02 10 00
				39 00 00 00 00 00 02 11 81
				39 00 00 00 00 00 02 12 00
				39 00 00 00 00 00 02 13 91
				39 00 00 00 00 00 02 14 00
				39 00 00 00 00 00 02 15 A1
				39 00 00 00 00 00 02 16 00
				39 00 00 00 00 00 02 17 B1
				39 00 00 00 00 00 02 18 00
				39 00 00 00 00 00 02 19 C0
				39 00 00 00 00 00 02 1A 00
				39 00 00 00 00 00 02 1B CF
				39 00 00 00 00 00 02 1C 00
				39 00 00 00 00 00 02 1D DF
				39 00 00 00 00 00 02 1E 00
				39 00 00 00 00 00 02 1F F1
				39 00 00 00 00 00 02 20 01
				39 00 00 00 00 00 02 21 02
				39 00 00 00 00 00 02 22 01
				39 00 00 00 00 00 02 23 12
				39 00 00 00 00 00 02 24 01
				39 00 00 00 00 00 02 25 21
				39 00 00 00 00 00 02 26 01
				39 00 00 00 00 00 02 27 2F
				39 00 00 00 00 00 02 28 01
				39 00 00 00 00 00 02 29 3E
				39 00 00 00 00 00 02 2A 01
				39 00 00 00 00 00 02 2B 4D
				39 00 00 00 00 00 02 2C 01
				39 00 00 00 00 00 02 2D 5E
				39 00 00 00 00 00 02 2E 01
				39 00 00 00 00 00 02 2F 6E
				39 00 00 00 00 00 02 30 01
				39 00 00 00 00 00 02 31 7D
				39 00 00 00 00 00 02 32 01
				39 00 00 00 00 00 02 33 8D
				39 00 00 00 00 00 02 34 01
				39 00 00 00 00 00 02 35 9C
				39 00 00 00 00 00 02 36 01
				39 00 00 00 00 00 02 37 BB
				39 00 00 00 00 00 02 38 01
				39 00 00 00 00 00 02 39 DA
				39 00 00 00 00 00 02 3A 01
				39 00 00 00 00 00 02 3B FB
				39 00 00 00 00 00 02 3C 02
				39 00 00 00 00 00 02 3D 1B
				39 00 00 00 00 00 02 3E 02
				39 00 00 00 00 00 02 3F 3C
				39 00 00 00 00 00 02 40 02
				39 00 00 00 00 00 02 41 5A
				39 00 00 00 00 00 02 42 02
				39 00 00 00 00 00 02 43 79
				39 00 00 00 00 00 02 44 02
				39 00 00 00 00 00 02 45 99
				39 00 00 00 00 00 02 46 02
				39 00 00 00 00 00 02 47 BB
				39 00 00 00 00 00 02 48 02
				39 00 00 00 00 00 02 49 D8
				39 00 00 00 00 00 02 4A 02
				39 00 00 00 00 00 02 4B F8
				39 00 00 00 00 00 02 4C 03
				39 00 00 00 00 00 02 4D 1A
				39 00 00 00 00 00 02 4E 03
				39 00 00 00 00 00 02 4F 3B
				39 00 00 00 00 00 02 50 03
				39 00 00 00 00 00 02 51 5A
				39 00 00 00 00 00 02 52 03
				39 00 00 00 00 00 02 53 78
				39 00 00 00 00 00 02 54 03
				39 00 00 00 00 00 02 55 99
				39 00 00 00 00 00 02 56 03
				39 00 00 00 00 00 02 57 BA
				39 00 00 00 00 00 02 58 03
				39 00 00 00 00 00 02 59 DB
				39 00 00 00 00 00 02 5A 03
				39 01 00 00 00 00 02 5B F6
				39 00 00 00 00 00 04 FF 98 81 07
				39 00 00 00 00 00 04 FF 98 81 07
				39 00 00 00 00 00 02 00 00
				39 00 00 00 00 00 02 01 00
				39 00 00 00 00 00 02 02 00
				39 00 00 00 00 00 02 03 0A
				39 00 00 00 00 00 02 04 00
				39 00 00 00 00 00 02 05 1B
				39 00 00 00 00 00 02 06 00
				39 00 00 00 00 00 02 07 2D
				39 00 00 00 00 00 02 08 00
				39 00 00 00 00 00 02 09 3B
				39 00 00 00 00 00 02 0A 00
				39 00 00 00 00 00 02 0B 47
				39 00 00 00 00 00 02 0C 00
				39 00 00 00 00 00 02 0D 51
				39 00 00 00 00 00 02 0E 00
				39 00 00 00 00 00 02 0F 5F
				39 00 00 00 00 00 02 10 00
				39 00 00 00 00 00 02 11 70
				39 00 00 00 00 00 02 12 00
				39 00 00 00 00 00 02 13 7F
				39 00 00 00 00 00 02 14 00
				39 00 00 00 00 00 02 15 8E
				39 00 00 00 00 00 02 16 00
				39 00 00 00 00 00 02 17 9E
				39 00 00 00 00 00 02 18 00
				39 00 00 00 00 00 02 19 AD
				39 00 00 00 00 00 02 1A 00
				39 00 00 00 00 00 02 1B BB
				39 00 00 00 00 00 02 1C 00
				39 00 00 00 00 00 02 1D C9
				39 00 00 00 00 00 02 1E 00
				39 00 00 00 00 00 02 1F D7
				39 00 00 00 00 00 02 20 00
				39 00 00 00 00 00 02 21 E7
				39 00 00 00 00 00 02 22 00
				39 00 00 00 00 00 02 23 F7
				39 00 00 00 00 00 02 24 01
				39 00 00 00 00 00 02 25 06
				39 00 00 00 00 00 02 26 01
				39 00 00 00 00 00 02 27 15
				39 00 00 00 00 00 02 28 01
				39 00 00 00 00 00 02 29 22
				39 00 00 00 00 00 02 2A 01
				39 00 00 00 00 00 02 2B 2F
				39 00 00 00 00 00 02 2C 01
				39 00 00 00 00 00 02 2D 3D
				39 00 00 00 00 00 02 2E 01
				39 00 00 00 00 00 02 2F 4C
				39 00 00 00 00 00 02 30 01
				39 00 00 00 00 00 02 31 5B
				39 00 00 00 00 00 02 32 01
				39 00 00 00 00 00 02 33 69
				39 00 00 00 00 00 02 34 01
				39 00 00 00 00 00 02 35 78
				39 00 00 00 00 00 02 36 01
				39 00 00 00 00 00 02 37 94
				39 00 00 00 00 00 02 38 01
				39 00 00 00 00 00 02 39 B0
				39 00 00 00 00 00 02 3A 01
				39 00 00 00 00 00 02 3B CC
				39 00 00 00 00 00 02 3C 01
				39 00 00 00 00 00 02 3D E9
				39 00 00 00 00 00 02 3E 02
				39 00 00 00 00 00 02 3F 07
				39 00 00 00 00 00 02 40 02
				39 00 00 00 00 00 02 41 26
				39 00 00 00 00 00 02 42 02
				39 00 00 00 00 00 02 43 44
				39 00 00 00 00 00 02 44 02
				39 00 00 00 00 00 02 45 5F
				39 00 00 00 00 00 02 46 02
				39 00 00 00 00 00 02 47 7B
				39 00 00 00 00 00 02 48 02
				39 00 00 00 00 00 02 49 99
				39 00 00 00 00 00 02 4A 02
				39 00 00 00 00 00 02 4B B8
				39 00 00 00 00 00 02 4C 02
				39 00 00 00 00 00 02 4D D3
				39 00 00 00 00 00 02 4E 02
				39 00 00 00 00 00 02 4F EF
				39 00 00 00 00 00 02 50 03
				39 00 00 00 00 00 02 51 0E
				39 00 00 00 00 00 02 52 03
				39 00 00 00 00 00 02 53 2C
				39 00 00 00 00 00 02 54 03
				39 00 00 00 00 00 02 55 47
				39 00 00 00 00 00 02 56 03
				39 00 00 00 00 00 02 57 64
				39 00 00 00 00 00 02 58 03
				39 00 00 00 00 00 02 59 7F
				39 00 00 00 00 00 02 5A 03
				39 00 00 00 00 00 02 5B 9D
				39 00 00 00 00 00 04 FF 98 81 00
				39 01 00 00 00 00 04 FF 98 81 00
		];

		qcom,mdss-dsi-cold-command = [
				39 00 00 00 00 00 04 FF 98 81 01
				39 00 00 00 00 00 04 FF 98 81 01
				39 00 00 00 00 00 02 A0 04
				39 00 00 00 00 00 02 A1 31
				39 00 00 00 00 00 02 A2 41
				39 00 00 00 00 00 02 A3 14
				39 00 00 00 00 00 02 A4 18
				39 00 00 00 00 00 02 A5 2B
				39 00 00 00 00 00 02 A6 1F
				39 00 00 00 00 00 02 A7 21
				39 00 00 00 00 00 02 A8 B6
				39 00 00 00 00 00 02 A9 1C
				39 00 00 00 00 00 02 AA 28
				39 00 00 00 00 00 02 AB 9F
				39 00 00 00 00 00 02 AC 1E
				39 00 00 00 00 00 02 AD 1F
				39 00 00 00 00 00 02 AE 53
				39 00 00 00 00 00 02 AF 27
				39 00 00 00 00 00 02 B0 2B
				39 00 00 00 00 00 02 B1 59
				39 00 00 00 00 00 02 B2 66
				39 00 00 00 00 00 02 B3 32
				39 00 00 00 00 00 02 C0 04
				39 00 00 00 00 00 02 C1 31
				39 00 00 00 00 00 02 C2 41
				39 00 00 00 00 00 02 C3 14
				39 00 00 00 00 00 02 C4 18
				39 00 00 00 00 00 02 C5 2B
				39 00 00 00 00 00 02 C6 1F
				39 00 00 00 00 00 02 C7 21
				39 00 00 00 00 00 02 C8 B6
				39 00 00 00 00 00 02 C9 1C
				39 00 00 00 00 00 02 CA 28
				39 00 00 00 00 00 02 CB 9F
				39 00 00 00 00 00 02 CC 1E
				39 00 00 00 00 00 02 CD 1F
				39 00 00 00 00 00 02 CE 53
				39 00 00 00 00 00 02 CF 27
				39 00 00 00 00 00 02 D0 2B
				39 00 00 00 00 00 02 D1 59
				39 00 00 00 00 00 02 D2 66
				39 01 00 00 00 00 02 D3 32
				39 00 00 00 00 00 04 FF 98 81 05
				39 00 00 00 00 00 04 FF 98 81 05
				39 00 00 00 00 00 02 85 48
				39 00 00 00 00 00 02 00 00
				39 00 00 00 00 00 02 01 00
				39 00 00 00 00 00 02 02 00
				39 00 00 00 00 00 02 03 0F
				39 00 00 00 00 00 02 04 00
				39 00 00 00 00 00 02 05 1F
				39 00 00 00 00 00 02 06 00
				39 00 00 00 00 00 02 07 2E
				39 00 00 00 00 00 02 08 00
				39 00 00 00 00 00 02 09 3D
				39 00 00 00 00 00 02 0A 00
				39 00 00 00 00 00 02 0B 4C
				39 00 00 00 00 00 02 0C 00
				39 00 00 00 00 00 02 0D 5B
				39 00 00 00 00 00 02 0E 00
				39 00 00 00 00 00 02 0F 6B
				39 00 00 00 00 00 02 10 00
				39 00 00 00 00 00 02 11 7B
				39 00 00 00 00 00 02 12 00
				39 00 00 00 00 00 02 13 89
				39 00 00 00 00 00 02 14 00
				39 00 00 00 00 00 02 15 9A
				39 00 00 00 00 00 02 16 00
				39 00 00 00 00 00 02 17 A8
				39 00 00 00 00 00 02 18 00
				39 00 00 00 00 00 02 19 B7
				39 00 00 00 00 00 02 1A 00
				39 00 00 00 00 00 02 1B C5
				39 00 00 00 00 00 02 1C 00
				39 00 00 00 00 00 02 1D D4
				39 00 00 00 00 00 02 1E 00
				39 00 00 00 00 00 02 1F E4
				39 00 00 00 00 00 02 20 00
				39 00 00 00 00 00 02 21 F5
				39 00 00 00 00 00 02 22 01
				39 00 00 00 00 00 02 23 06
				39 00 00 00 00 00 02 24 01
				39 00 00 00 00 00 02 25 15
				39 00 00 00 00 00 02 26 01
				39 00 00 00 00 00 02 27 23
				39 00 00 00 00 00 02 28 01
				39 00 00 00 00 00 02 29 31
				39 00 00 00 00 00 02 2A 01
				39 00 00 00 00 00 02 2B 3E
				39 00 00 00 00 00 02 2C 01
				39 00 00 00 00 00 02 2D 4D
				39 00 00 00 00 00 02 2E 01
				39 00 00 00 00 00 02 2F 5C
				39 00 00 00 00 00 02 30 01
				39 00 00 00 00 00 02 31 6C
				39 00 00 00 00 00 02 32 01
				39 00 00 00 00 00 02 33 7B
				39 00 00 00 00 00 02 34 01
				39 00 00 00 00 00 02 35 8A
				39 00 00 00 00 00 02 36 01
				39 00 00 00 00 00 02 37 A7
				39 00 00 00 00 00 02 38 01
				39 00 00 00 00 00 02 39 C5
				39 00 00 00 00 00 02 3A 01
				39 00 00 00 00 00 02 3B E3
				39 00 00 00 00 00 02 3C 01
				39 00 00 00 00 00 02 3D FD
				39 00 00 00 00 00 02 3E 02
				39 00 00 00 00 00 02 3F 1E
				39 00 00 00 00 00 02 40 02
				39 00 00 00 00 00 02 41 3E
				39 00 00 00 00 00 02 42 02
				39 00 00 00 00 00 02 43 5A
				39 00 00 00 00 00 02 44 02
				39 00 00 00 00 00 02 45 77
				39 00 00 00 00 00 02 46 02
				39 00 00 00 00 00 02 47 96
				39 00 00 00 00 00 02 48 02
				39 00 00 00 00 00 02 49 B6
				39 00 00 00 00 00 02 4A 02
				39 00 00 00 00 00 02 4B D3
				39 00 00 00 00 00 02 4C 02
				39 00 00 00 00 00 02 4D F0
				39 00 00 00 00 00 02 4E 03
				39 00 00 00 00 00 02 4F 10
				39 00 00 00 00 00 02 50 03
				39 00 00 00 00 00 02 51 2E
				39 00 00 00 00 00 02 52 03
				39 00 00 00 00 00 02 53 4A
				39 00 00 00 00 00 02 54 03
				39 00 00 00 00 00 02 55 69
				39 00 00 00 00 00 02 56 03
				39 00 00 00 00 00 02 57 8B
				39 00 00 00 00 00 02 58 03
				39 00 00 00 00 00 02 59 AB
				39 00 00 00 00 00 02 5A 03
				39 01 00 00 00 00 02 5B C7
				39 00 00 00 00 00 04 FF 98 81 06
				39 00 00 00 00 00 04 FF 98 81 06
				39 00 00 00 00 00 02 00 00
				39 00 00 00 00 00 02 01 00
				39 00 00 00 00 00 02 02 00
				39 00 00 00 00 00 02 03 10
				39 00 00 00 00 00 02 04 00
				39 00 00 00 00 00 02 05 1F
				39 00 00 00 00 00 02 06 00
				39 00 00 00 00 00 02 07 30
				39 00 00 00 00 00 02 08 00
				39 00 00 00 00 00 02 09 3F
				39 00 00 00 00 00 02 0A 00
				39 00 00 00 00 00 02 0B 50
				39 00 00 00 00 00 02 0C 00
				39 00 00 00 00 00 02 0D 61
				39 00 00 00 00 00 02 0E 00
				39 00 00 00 00 00 02 0F 72
				39 00 00 00 00 00 02 10 00
				39 00 00 00 00 00 02 11 80
				39 00 00 00 00 00 02 12 00
				39 00 00 00 00 00 02 13 91
				39 00 00 00 00 00 02 14 00
				39 00 00 00 00 00 02 15 A3
				39 00 00 00 00 00 02 16 00
				39 00 00 00 00 00 02 17 B2
				39 00 00 00 00 00 02 18 00
				39 00 00 00 00 00 02 19 C1
				39 00 00 00 00 00 02 1A 00
				39 00 00 00 00 00 02 1B D0
				39 00 00 00 00 00 02 1C 00
				39 00 00 00 00 00 02 1D E1
				39 00 00 00 00 00 02 1E 00
				39 00 00 00 00 00 02 1F F3
				39 00 00 00 00 00 02 20 01
				39 00 00 00 00 00 02 21 03
				39 00 00 00 00 00 02 22 01
				39 00 00 00 00 00 02 23 13
				39 00 00 00 00 00 02 24 01
				39 00 00 00 00 00 02 25 22
				39 00 00 00 00 00 02 26 01
				39 00 00 00 00 00 02 27 31
				39 00 00 00 00 00 02 28 01
				39 00 00 00 00 00 02 29 3F
				39 00 00 00 00 00 02 2A 01
				39 00 00 00 00 00 02 2B 50
				39 00 00 00 00 00 02 2C 01
				39 00 00 00 00 00 02 2D 5F
				39 00 00 00 00 00 02 2E 01
				39 00 00 00 00 00 02 2F 6F
				39 00 00 00 00 00 02 30 01
				39 00 00 00 00 00 02 31 7F
				39 00 00 00 00 00 02 32 01
				39 00 00 00 00 00 02 33 8F
				39 00 00 00 00 00 02 34 01
				39 00 00 00 00 00 02 35 9E
				39 00 00 00 00 00 02 36 01
				39 00 00 00 00 00 02 37 BD
				39 00 00 00 00 00 02 38 01
				39 00 00 00 00 00 02 39 DC
				39 00 00 00 00 00 02 3A 01
				39 00 00 00 00 00 02 3B FD
				39 00 00 00 00 00 02 3C 02
				39 00 00 00 00 00 02 3D 1D
				39 00 00 00 00 00 02 3E 02
				39 00 00 00 00 00 02 3F 3F
				39 00 00 00 00 00 02 40 02
				39 00 00 00 00 00 02 41 5D
				39 00 00 00 00 00 02 42 02
				39 00 00 00 00 00 02 43 7C
				39 00 00 00 00 00 02 44 02
				39 00 00 00 00 00 02 45 9C
				39 00 00 00 00 00 02 46 02
				39 00 00 00 00 00 02 47 BE
				39 00 00 00 00 00 02 48 02
				39 00 00 00 00 00 02 49 DB
				39 00 00 00 00 00 02 4A 02
				39 00 00 00 00 00 02 4B FB
				39 00 00 00 00 00 02 4C 03
				39 00 00 00 00 00 02 4D 1F
				39 00 00 00 00 00 02 4E 03
				39 00 00 00 00 00 02 4F 3F
				39 00 00 00 00 00 02 50 03
				39 00 00 00 00 00 02 51 5F
				39 00 00 00 00 00 02 52 03
				39 00 00 00 00 00 02 53 7C
				39 00 00 00 00 00 02 54 03
				39 00 00 00 00 00 02 55 9D
				39 00 00 00 00 00 02 56 03
				39 00 00 00 00 00 02 57 BE
				39 00 00 00 00 00 02 58 03
				39 00 00 00 00 00 02 59 DF
				39 00 00 00 00 00 02 5A 03
				39 01 00 00 00 00 02 5B FB
				39 00 00 00 00 00 04 FF 98 81 07
				39 00 00 00 00 00 04 FF 98 81 07
				39 00 00 00 00 00 02 00 00
				39 00 00 00 00 00 02 01 00
				39 00 00 00 00 00 02 02 00
				39 00 00 00 00 00 02 03 0A
				39 00 00 00 00 00 02 04 00
				39 00 00 00 00 00 02 05 1E
				39 00 00 00 00 00 02 06 00
				39 00 00 00 00 00 02 07 31
				39 00 00 00 00 00 02 08 00
				39 00 00 00 00 00 02 09 40
				39 00 00 00 00 00 02 0A 00
				39 00 00 00 00 00 02 0B 4D
				39 00 00 00 00 00 02 0C 00
				39 00 00 00 00 00 02 0D 59
				39 00 00 00 00 00 02 0E 00
				39 00 00 00 00 00 02 0F 69
				39 00 00 00 00 00 02 10 00
				39 00 00 00 00 00 02 11 7A
				39 00 00 00 00 00 02 12 00
				39 00 00 00 00 00 02 13 8A
				39 00 00 00 00 00 02 14 00
				39 00 00 00 00 00 02 15 9A
				39 00 00 00 00 00 02 16 00
				39 00 00 00 00 00 02 17 AB
				39 00 00 00 00 00 02 18 00
				39 00 00 00 00 00 02 19 BA
				39 00 00 00 00 00 02 1A 00
				39 00 00 00 00 00 02 1B C9
				39 00 00 00 00 00 02 1C 00
				39 00 00 00 00 00 02 1D D9
				39 00 00 00 00 00 02 1E 00
				39 00 00 00 00 00 02 1F EA
				39 00 00 00 00 00 02 20 00
				39 00 00 00 00 00 02 21 FB
				39 00 00 00 00 00 02 22 01
				39 00 00 00 00 00 02 23 0B
				39 00 00 00 00 00 02 24 01
				39 00 00 00 00 00 02 25 1A
				39 00 00 00 00 00 02 26 01
				39 00 00 00 00 00 02 27 29
				39 00 00 00 00 00 02 28 01
				39 00 00 00 00 00 02 29 37
				39 00 00 00 00 00 02 2A 01
				39 00 00 00 00 00 02 2B 47
				39 00 00 00 00 00 02 2C 01
				39 00 00 00 00 00 02 2D 56
				39 00 00 00 00 00 02 2E 01
				39 00 00 00 00 00 02 2F 66
				39 00 00 00 00 00 02 30 01
				39 00 00 00 00 00 02 31 76
				39 00 00 00 00 00 02 32 01
				39 00 00 00 00 00 02 33 85
				39 00 00 00 00 00 02 34 01
				39 00 00 00 00 00 02 35 94
				39 00 00 00 00 00 02 36 01
				39 00 00 00 00 00 02 37 B3
				39 00 00 00 00 00 02 38 01
				39 00 00 00 00 00 02 39 D1
				39 00 00 00 00 00 02 3A 01
				39 00 00 00 00 00 02 3B F0
				39 00 00 00 00 00 02 3C 02
				39 00 00 00 00 00 02 3D 10
				39 00 00 00 00 00 02 3E 02
				39 00 00 00 00 00 02 3F 32
				39 00 00 00 00 00 02 40 02
				39 00 00 00 00 00 02 41 51
				39 00 00 00 00 00 02 42 02
				39 00 00 00 00 00 02 43 6E
				39 00 00 00 00 00 02 44 02
				39 00 00 00 00 00 02 45 8D
				39 00 00 00 00 00 02 46 02
				39 00 00 00 00 00 02 47 AE
				39 00 00 00 00 00 02 48 02
				39 00 00 00 00 00 02 49 CD
				39 00 00 00 00 00 02 4A 02
				39 00 00 00 00 00 02 4B EB
				39 00 00 00 00 00 02 4C 03
				39 00 00 00 00 00 02 4D 0B
				39 00 00 00 00 00 02 4E 03
				39 00 00 00 00 00 02 4F 2C
				39 00 00 00 00 00 02 50 03
				39 00 00 00 00 00 02 51 49
				39 00 00 00 00 00 02 52 03
				39 00 00 00 00 00 02 53 69
				39 00 00 00 00 00 02 54 03
				39 00 00 00 00 00 02 55 85
				39 00 00 00 00 00 02 56 03
				39 00 00 00 00 00 02 57 A5
				39 00 00 00 00 00 02 58 03
				39 00 00 00 00 00 02 59 C3
				39 00 00 00 00 00 02 5A 03
				39 00 00 00 00 00 02 5B E2
				39 00 00 00 00 00 04 FF 98 81 00
				39 01 00 00 00 00 04 FF 98 81 00];

		qcom,mdss-dsi-default-command = [
				39 01 00 00 00 00 04 FF 98 81 04
				39 00 00 00 00 00 04 FF 98 81 04
				39 00 00 00 00 00 02 E5 02
				39 00 00 00 00 00 04 FF 98 81 00
				39 01 00 00 00 00 04 FF 98 81 00
				39 01 00 00 0A 00 02 11 00
				39 01 00 00 00 00 04 FF 98 81 03
				39 01 00 00 00 00 04 FF 98 81 03
				39 01 00 00 00 00 02 2C 0A
				39 01 00 00 00 00 04 FF 98 81 00
				39 01 00 00 00 00 04 FF 98 81 00];

		qcom,mdss-dsi-level1-command = [39 00 00 00 00 00 04 FF 98 81 01
				39 00 00 00 00 00 04 FF 98 81 01
				39 00 00 00 00 00 02 A0 1B
				39 00 00 00 00 00 02 A1 35
				39 00 00 00 00 00 02 A2 44
				39 00 00 00 00 00 02 A3 13
				39 00 00 00 00 00 02 A4 16
				39 00 00 00 00 00 02 A5 2A
				39 00 00 00 00 00 02 A6 1E
				39 00 00 00 00 00 02 A7 1E
				39 00 00 00 00 00 02 A8 B7
				39 00 00 00 00 00 02 A9 1C
				39 00 00 00 00 00 02 AA 28
				39 00 00 00 00 00 02 AB 9F
				39 00 00 00 00 00 02 AC 1F
				39 00 00 00 00 00 02 AD 1E
				39 00 00 00 00 00 02 AE 53
				39 00 00 00 00 00 02 AF 27
				39 00 00 00 00 00 02 B0 2A
				39 00 00 00 00 00 02 B1 59
				39 00 00 00 00 00 02 B2 65
				39 00 00 00 00 00 02 B3 32
				39 00 00 00 00 00 02 C0 1B
				39 00 00 00 00 00 02 C1 35
				39 00 00 00 00 00 02 C2 44
				39 00 00 00 00 00 02 C3 13
				39 00 00 00 00 00 02 C4 16
				39 00 00 00 00 00 02 C5 2A
				39 00 00 00 00 00 02 C6 1E
				39 00 00 00 00 00 02 C7 1E
				39 00 00 00 00 00 02 C8 B7
				39 00 00 00 00 00 02 C9 1C
				39 00 00 00 00 00 02 CA 28
				39 00 00 00 00 00 02 CB 9F
				39 00 00 00 00 00 02 CC 1F
				39 00 00 00 00 00 02 CD 1E
				39 00 00 00 00 00 02 CE 53
				39 00 00 00 00 00 02 CF 27
				39 00 00 00 00 00 02 D0 2A
				39 00 00 00 00 00 02 D1 59
				39 00 00 00 00 00 02 D2 65
				39 01 00 00 00 00 02 D3 32
				39 00 00 00 00 00 04 FF 98 81 05
				39 00 00 00 00 00 04 FF 98 81 05
				39 00 00 00 00 00 02 85 48
				39 00 00 00 00 00 02 00 00
				39 00 00 00 00 00 02 01 00
				39 00 00 00 00 00 02 02 00
				39 00 00 00 00 00 02 03 10
				39 00 00 00 00 00 02 04 00
				39 00 00 00 00 00 02 05 20
				39 00 00 00 00 00 02 06 00
				39 00 00 00 00 00 02 07 31
				39 00 00 00 00 00 02 08 00
				39 00 00 00 00 00 02 09 3F
				39 00 00 00 00 00 02 0A 00
				39 00 00 00 00 00 02 0B 4F
				39 00 00 00 00 00 02 0C 00
				39 00 00 00 00 00 02 0D 5F
				39 00 00 00 00 00 02 0E 00
				39 00 00 00 00 00 02 0F 70
				39 00 00 00 00 00 02 10 00
				39 00 00 00 00 00 02 11 80
				39 00 00 00 00 00 02 12 00
				39 00 00 00 00 00 02 13 90
				39 00 00 00 00 00 02 14 00
				39 00 00 00 00 00 02 15 A0
				39 00 00 00 00 00 02 16 00
				39 00 00 00 00 00 02 17 B0
				39 00 00 00 00 00 02 18 00
				39 00 00 00 00 00 02 19 C0
				39 00 00 00 00 00 02 1A 00
				39 00 00 00 00 00 02 1B CF
				39 00 00 00 00 00 02 1C 00
				39 00 00 00 00 00 02 1D E1
				39 00 00 00 00 00 02 1E 00
				39 00 00 00 00 00 02 1F F1
				39 00 00 00 00 00 02 20 01
				39 00 00 00 00 00 02 21 02
				39 00 00 00 00 00 02 22 01
				39 00 00 00 00 00 02 23 12
				39 00 00 00 00 00 02 24 01
				39 00 00 00 00 00 02 25 22
				39 00 00 00 00 00 02 26 01
				39 00 00 00 00 00 02 27 31
				39 00 00 00 00 00 02 28 01
				39 00 00 00 00 00 02 29 3F
				39 00 00 00 00 00 02 2A 01
				39 00 00 00 00 00 02 2B 4F
				39 00 00 00 00 00 02 2C 01
				39 00 00 00 00 00 02 2D 5F
				39 00 00 00 00 00 02 2E 01
				39 00 00 00 00 00 02 2F 6F
				39 00 00 00 00 00 02 30 01
				39 00 00 00 00 00 02 31 7F
				39 00 00 00 00 00 02 32 01
				39 00 00 00 00 00 02 33 8E
				39 00 00 00 00 00 02 34 01
				39 00 00 00 00 00 02 35 9E
				39 00 00 00 00 00 02 36 01
				39 00 00 00 00 00 02 37 BB
				39 00 00 00 00 00 02 38 01
				39 00 00 00 00 00 02 39 D9
				39 00 00 00 00 00 02 3A 01
				39 00 00 00 00 00 02 3B F9
				39 00 00 00 00 00 02 3C 02
				39 00 00 00 00 00 02 3D 19
				39 00 00 00 00 00 02 3E 02
				39 00 00 00 00 00 02 3F 3A
				39 00 00 00 00 00 02 40 02
				39 00 00 00 00 00 02 41 58
				39 00 00 00 00 00 02 42 02
				39 00 00 00 00 00 02 43 77
				39 00 00 00 00 00 02 44 02
				39 00 00 00 00 00 02 45 97
				39 00 00 00 00 00 02 46 02
				39 00 00 00 00 00 02 47 B8
				39 00 00 00 00 00 02 48 02
				39 00 00 00 00 00 02 49 D5
				39 00 00 00 00 00 02 4A 02
				39 00 00 00 00 00 02 4B F3
				39 00 00 00 00 00 02 4C 03
				39 00 00 00 00 00 02 4D 13
				39 00 00 00 00 00 02 4E 03
				39 00 00 00 00 00 02 4F 34
				39 00 00 00 00 00 02 50 03
				39 00 00 00 00 00 02 51 50
				39 00 00 00 00 00 02 52 03
				39 00 00 00 00 00 02 53 71
				39 00 00 00 00 00 02 54 03
				39 00 00 00 00 00 02 55 90
				39 00 00 00 00 00 02 56 03
				39 00 00 00 00 00 02 57 B6
				39 00 00 00 00 00 02 58 03
				39 00 00 00 00 00 02 59 D2
				39 00 00 00 00 00 02 5A 03
				39 01 00 00 00 00 02 5B F1
				39 00 00 00 00 00 04 FF 98 81 06
				39 00 00 00 00 00 04 FF 98 81 06
				39 00 00 00 00 00 02 00 00
				39 00 00 00 00 00 02 01 00
				39 00 00 00 00 00 02 02 00
				39 00 00 00 00 00 02 03 10
				39 00 00 00 00 00 02 04 00
				39 00 00 00 00 00 02 05 20
				39 00 00 00 00 00 02 06 00
				39 00 00 00 00 00 02 07 30
				39 00 00 00 00 00 02 08 00
				39 00 00 00 00 00 02 09 40
				39 00 00 00 00 00 02 0A 00
				39 00 00 00 00 00 02 0B 50
				39 00 00 00 00 00 02 0C 00
				39 00 00 00 00 00 02 0D 61
				39 00 00 00 00 00 02 0E 00
				39 00 00 00 00 00 02 0F 72
				39 00 00 00 00 00 02 10 00
				39 00 00 00 00 00 02 11 82
				39 00 00 00 00 00 02 12 00
				39 00 00 00 00 00 02 13 91
				39 00 00 00 00 00 02 14 00
				39 00 00 00 00 00 02 15 A2
				39 00 00 00 00 00 02 16 00
				39 00 00 00 00 00 02 17 B3
				39 00 00 00 00 00 02 18 00
				39 00 00 00 00 00 02 19 C2
				39 00 00 00 00 00 02 1A 00
				39 00 00 00 00 00 02 1B D2
				39 00 00 00 00 00 02 1C 00
				39 00 00 00 00 00 02 1D E2
				39 00 00 00 00 00 02 1E 00
				39 00 00 00 00 00 02 1F F4
				39 00 00 00 00 00 02 20 01
				39 00 00 00 00 00 02 21 05
				39 00 00 00 00 00 02 22 01
				39 00 00 00 00 00 02 23 15
				39 00 00 00 00 00 02 24 01
				39 00 00 00 00 00 02 25 24
				39 00 00 00 00 00 02 26 01
				39 00 00 00 00 00 02 27 33
				39 00 00 00 00 00 02 28 01
				39 00 00 00 00 00 02 29 42
				39 00 00 00 00 00 02 2A 01
				39 00 00 00 00 00 02 2B 52
				39 00 00 00 00 00 02 2C 01
				39 00 00 00 00 00 02 2D 62
				39 00 00 00 00 00 02 2E 01
				39 00 00 00 00 00 02 2F 72
				39 00 00 00 00 00 02 30 01
				39 00 00 00 00 00 02 31 82
				39 00 00 00 00 00 02 32 01
				39 00 00 00 00 00 02 33 92
				39 00 00 00 00 00 02 34 01
				39 00 00 00 00 00 02 35 A1
				39 00 00 00 00 00 02 36 01
				39 00 00 00 00 00 02 37 C0
				39 00 00 00 00 00 02 38 01
				39 00 00 00 00 00 02 39 E0
				39 00 00 00 00 00 02 3A 01
				39 00 00 00 00 00 02 3B FF
				39 00 00 00 00 00 02 3C 02
				39 00 00 00 00 00 02 3D 20
				39 00 00 00 00 00 02 3E 02
				39 00 00 00 00 00 02 3F 41
				39 00 00 00 00 00 02 40 02
				39 00 00 00 00 00 02 41 5F
				39 00 00 00 00 00 02 42 02
				39 00 00 00 00 00 02 43 7F
				39 00 00 00 00 00 02 44 02
				39 00 00 00 00 00 02 45 9F
				39 00 00 00 00 00 02 46 02
				39 00 00 00 00 00 02 47 C1
				39 00 00 00 00 00 02 48 02
				39 00 00 00 00 00 02 49 DD
				39 00 00 00 00 00 02 4A 02
				39 00 00 00 00 00 02 4B FC
				39 00 00 00 00 00 02 4C 03
				39 00 00 00 00 00 02 4D 1E
				39 00 00 00 00 00 02 4E 03
				39 00 00 00 00 00 02 4F 3F
				39 00 00 00 00 00 02 50 03
				39 00 00 00 00 00 02 51 60
				39 00 00 00 00 00 02 52 03
				39 00 00 00 00 00 02 53 80
				39 00 00 00 00 00 02 54 03
				39 00 00 00 00 00 02 55 A1
				39 00 00 00 00 00 02 56 03
				39 00 00 00 00 00 02 57 BF
				39 00 00 00 00 00 02 58 03
				39 00 00 00 00 00 02 59 E0
				39 00 00 00 00 00 02 5A 00
				39 00 00 00 00 00 02 5B 00
				39 00 00 00 00 00 04 FF 98 81 07
				39 00 00 00 00 00 04 FF 98 81 07
				39 00 00 00 00 00 02 00 00
				39 00 00 00 00 00 02 01 00
				39 00 00 00 00 00 02 02 00
				39 00 00 00 00 00 02 03 0C
				39 00 00 00 00 00 02 04 00
				39 00 00 00 00 00 02 05 1E
				39 00 00 00 00 00 02 06 00
				39 00 00 00 00 00 02 07 30
				39 00 00 00 00 00 02 08 00
				39 00 00 00 00 00 02 09 3D
				39 00 00 00 00 00 02 0A 00
				39 00 00 00 00 00 02 0B 4A
				39 00 00 00 00 00 02 0C 00
				39 00 00 00 00 00 02 0D 55
				39 00 00 00 00 00 02 0E 00
				39 00 00 00 00 00 02 0F 64
				39 00 00 00 00 00 02 10 00
				39 00 00 00 00 00 02 11 75
				39 00 00 00 00 00 02 12 00
				39 00 00 00 00 00 02 13 84
				39 00 00 00 00 00 02 14 00
				39 00 00 00 00 00 02 15 94
				39 00 00 00 00 00 02 16 00
				39 00 00 00 00 00 02 17 A4
				39 00 00 00 00 00 02 18 00
				39 00 00 00 00 00 02 19 B4
				39 00 00 00 00 00 02 1A 00
				39 00 00 00 00 00 02 1B C3
				39 00 00 00 00 00 02 1C 00
				39 00 00 00 00 00 02 1D D2
				39 00 00 00 00 00 02 1E 00
				39 00 00 00 00 00 02 1F E3
				39 00 00 00 00 00 02 20 00
				39 00 00 00 00 00 02 21 F3
				39 00 00 00 00 00 02 22 01
				39 00 00 00 00 00 02 23 03
				39 00 00 00 00 00 02 24 01
				39 00 00 00 00 00 02 25 12
				39 00 00 00 00 00 02 26 01
				39 00 00 00 00 00 02 27 22
				39 00 00 00 00 00 02 28 01
				39 00 00 00 00 00 02 29 30
				39 00 00 00 00 00 02 2A 01
				39 00 00 00 00 00 02 2B 3D
				39 00 00 00 00 00 02 2C 01
				39 00 00 00 00 00 02 2D 4C
				39 00 00 00 00 00 02 2E 01
				39 00 00 00 00 00 02 2F 5C
				39 00 00 00 00 00 02 30 01
				39 00 00 00 00 00 02 31 6B
				39 00 00 00 00 00 02 32 01
				39 00 00 00 00 00 02 33 79
				39 00 00 00 00 00 02 34 01
				39 00 00 00 00 00 02 35 88
				39 00 00 00 00 00 02 36 01
				39 00 00 00 00 00 02 37 A5
				39 00 00 00 00 00 02 38 01
				39 00 00 00 00 00 02 39 C4
				39 00 00 00 00 00 02 3A 01
				39 00 00 00 00 00 02 3B E2
				39 00 00 00 00 00 02 3C 02
				39 00 00 00 00 00 02 3D 00
				39 00 00 00 00 00 02 3E 02
				39 00 00 00 00 00 02 3F 1F
				39 00 00 00 00 00 02 40 02
				39 00 00 00 00 00 02 41 3E
				39 00 00 00 00 00 02 42 02
				39 00 00 00 00 00 02 43 5B
				39 00 00 00 00 00 02 44 02
				39 00 00 00 00 00 02 45 78
				39 00 00 00 00 00 02 46 02
				39 00 00 00 00 00 02 47 96
				39 00 00 00 00 00 02 48 02
				39 00 00 00 00 00 02 49 B6
				39 00 00 00 00 00 02 4A 02
				39 00 00 00 00 00 02 4B D2
				39 00 00 00 00 00 02 4C 02
				39 00 00 00 00 00 02 4D EE
				39 00 00 00 00 00 02 4E 03
				39 00 00 00 00 00 02 4F 0C
				39 00 00 00 00 00 02 50 03
				39 00 00 00 00 00 02 51 2D
				39 00 00 00 00 00 02 52 03
				39 00 00 00 00 00 02 53 47
				39 00 00 00 00 00 02 54 03
				39 00 00 00 00 00 02 55 67
				39 00 00 00 00 00 02 56 03
				39 00 00 00 00 00 02 57 84
				39 00 00 00 00 00 02 58 03
				39 00 00 00 00 00 02 59 A3
				39 00 00 00 00 00 02 5A 03
				39 00 00 00 00 00 02 5B C0
				39 00 00 00 00 00 04 FF 98 81 00
				39 01 00 00 00 00 04 FF 98 81 00];

		qcom,mdss-dsi-level2-command = [39 00 00 00 00 00 04 FF 98 81 01
				39 00 00 00 00 00 04 FF 98 81 01
				39 00 00 00 00 00 02 A0 1B
				39 00 00 00 00 00 02 A1 35
				39 00 00 00 00 00 02 A2 44
				39 00 00 00 00 00 02 A3 13
				39 00 00 00 00 00 02 A4 16
				39 00 00 00 00 00 02 A5 2A
				39 00 00 00 00 00 02 A6 1E
				39 00 00 00 00 00 02 A7 1E
				39 00 00 00 00 00 02 A8 B7
				39 00 00 00 00 00 02 A9 1C
				39 00 00 00 00 00 02 AA 28
				39 00 00 00 00 00 02 AB 9F
				39 00 00 00 00 00 02 AC 1F
				39 00 00 00 00 00 02 AD 1E
				39 00 00 00 00 00 02 AE 53
				39 00 00 00 00 00 02 AF 27
				39 00 00 00 00 00 02 B0 2A
				39 00 00 00 00 00 02 B1 59
				39 00 00 00 00 00 02 B2 65
				39 00 00 00 00 00 02 B3 32
				39 00 00 00 00 00 02 C0 1B
				39 00 00 00 00 00 02 C1 35
				39 00 00 00 00 00 02 C2 44
				39 00 00 00 00 00 02 C3 13
				39 00 00 00 00 00 02 C4 16
				39 00 00 00 00 00 02 C5 2A
				39 00 00 00 00 00 02 C6 1E
				39 00 00 00 00 00 02 C7 1E
				39 00 00 00 00 00 02 C8 B7
				39 00 00 00 00 00 02 C9 1C
				39 00 00 00 00 00 02 CA 28
				39 00 00 00 00 00 02 CB 9F
				39 00 00 00 00 00 02 CC 1F
				39 00 00 00 00 00 02 CD 1E
				39 00 00 00 00 00 02 CE 53
				39 00 00 00 00 00 02 CF 27
				39 00 00 00 00 00 02 D0 2A
				39 00 00 00 00 00 02 D1 59
				39 00 00 00 00 00 02 D2 65
				39 00 00 00 00 00 02 D3 32
				39 00 00 00 00 00 04 FF 98 81 05
				39 00 00 00 00 00 04 FF 98 81 05
				39 00 00 00 00 00 02 85 48
				39 00 00 00 00 00 02 00 00
				39 00 00 00 00 00 02 01 00
				39 00 00 00 00 00 02 02 00
				39 00 00 00 00 00 02 03 11
				39 00 00 00 00 00 02 04 00
				39 00 00 00 00 00 02 05 20
				39 00 00 00 00 00 02 06 00
				39 00 00 00 00 00 02 07 31
				39 00 00 00 00 00 02 08 00
				39 00 00 00 00 00 02 09 40
				39 00 00 00 00 00 02 0A 00
				39 00 00 00 00 00 02 0B 50
				39 00 00 00 00 00 02 0C 00
				39 00 00 00 00 00 02 0D 61
				39 00 00 00 00 00 02 0E 00
				39 00 00 00 00 00 02 0F 71
				39 00 00 00 00 00 02 10 00
				39 00 00 00 00 00 02 11 81
				39 00 00 00 00 00 02 12 00
				39 00 00 00 00 00 02 13 91
				39 00 00 00 00 00 02 14 00
				39 00 00 00 00 00 02 15 A2
				39 00 00 00 00 00 02 16 00
				39 00 00 00 00 00 02 17 B2
				39 00 00 00 00 00 02 18 00
				39 00 00 00 00 00 02 19 C2
				39 00 00 00 00 00 02 1A 00
				39 00 00 00 00 00 02 1B D2
				39 00 00 00 00 00 02 1C 00
				39 00 00 00 00 00 02 1D E4
				39 00 00 00 00 00 02 1E 00
				39 00 00 00 00 00 02 1F F4
				39 00 00 00 00 00 02 20 01
				39 00 00 00 00 00 02 21 04
				39 00 00 00 00 00 02 22 01
				39 00 00 00 00 00 02 23 14
				39 00 00 00 00 00 02 24 01
				39 00 00 00 00 00 02 25 25
				39 00 00 00 00 00 02 26 01
				39 00 00 00 00 00 02 27 33
				39 00 00 00 00 00 02 28 01
				39 00 00 00 00 00 02 29 43
				39 00 00 00 00 00 02 2A 01
				39 00 00 00 00 00 02 2B 53
				39 00 00 00 00 00 02 2C 01
				39 00 00 00 00 00 02 2D 63
				39 00 00 00 00 00 02 2E 01
				39 00 00 00 00 00 02 2F 73
				39 00 00 00 00 00 02 30 01
				39 00 00 00 00 00 02 31 83
				39 00 00 00 00 00 02 32 01
				39 00 00 00 00 00 02 33 92
				39 00 00 00 00 00 02 34 01
				39 00 00 00 00 00 02 35 A2
				39 00 00 00 00 00 02 36 01
				39 00 00 00 00 00 02 37 BF
				39 00 00 00 00 00 02 38 01
				39 00 00 00 00 00 02 39 DE
				39 00 00 00 00 00 02 3A 01
				39 00 00 00 00 00 02 3B FE
				39 00 00 00 00 00 02 3C 02
				39 00 00 00 00 00 02 3D 1F
				39 00 00 00 00 00 02 3E 02
				39 00 00 00 00 00 02 3F 40
				39 00 00 00 00 00 02 40 02
				39 00 00 00 00 00 02 41 5E
				39 00 00 00 00 00 02 42 02
				39 00 00 00 00 00 02 43 7D
				39 00 00 00 00 00 02 44 02
				39 00 00 00 00 00 02 45 9E
				39 00 00 00 00 00 02 46 02
				39 00 00 00 00 00 02 47 BF
				39 00 00 00 00 00 02 48 02
				39 00 00 00 00 00 02 49 DC
				39 00 00 00 00 00 02 4A 02
				39 00 00 00 00 00 02 4B FA
				39 00 00 00 00 00 02 4C 03
				39 00 00 00 00 00 02 4D 1C
				39 00 00 00 00 00 02 4E 03
				39 00 00 00 00 00 02 4F 3C
				39 00 00 00 00 00 02 50 03
				39 00 00 00 00 00 02 51 59
				39 00 00 00 00 00 02 52 03
				39 00 00 00 00 00 02 53 7A
				39 00 00 00 00 00 02 54 03
				39 00 00 00 00 00 02 55 9B
				39 00 00 00 00 00 02 56 03
				39 00 00 00 00 00 02 57 C0
				39 00 00 00 00 00 02 58 03
				39 00 00 00 00 00 02 59 DD
				39 00 00 00 00 00 02 5A 03
				39 01 00 00 00 00 02 5B F7
				39 00 00 00 00 00 04 FF 98 81 06
				39 00 00 00 00 00 04 FF 98 81 06
				39 00 00 00 00 00 02 00 00
				39 00 00 00 00 00 02 01 00
				39 00 00 00 00 00 02 02 00
				39 00 00 00 00 00 02 03 10
				39 00 00 00 00 00 02 04 00
				39 00 00 00 00 00 02 05 1F
				39 00 00 00 00 00 02 06 00
				39 00 00 00 00 00 02 07 30
				39 00 00 00 00 00 02 08 00
				39 00 00 00 00 00 02 09 3F
				39 00 00 00 00 00 02 0A 00
				39 00 00 00 00 00 02 0B 4F
				39 00 00 00 00 00 02 0C 00
				39 00 00 00 00 00 02 0D 5F
				39 00 00 00 00 00 02 0E 00
				39 00 00 00 00 00 02 0F 70
				39 00 00 00 00 00 02 10 00
				39 00 00 00 00 00 02 11 80
				39 00 00 00 00 00 02 12 00
				39 00 00 00 00 00 02 13 8F
				39 00 00 00 00 00 02 14 00
				39 00 00 00 00 00 02 15 A0
				39 00 00 00 00 00 02 16 00
				39 00 00 00 00 00 02 17 B0
				39 00 00 00 00 00 02 18 00
				39 00 00 00 00 00 02 19 C0
				39 00 00 00 00 00 02 1A 00
				39 00 00 00 00 00 02 1B CF
				39 00 00 00 00 00 02 1C 00
				39 00 00 00 00 00 02 1D DF
				39 00 00 00 00 00 02 1E 00
				39 00 00 00 00 00 02 1F F1
				39 00 00 00 00 00 02 20 01
				39 00 00 00 00 00 02 21 02
				39 00 00 00 00 00 02 22 01
				39 00 00 00 00 00 02 23 12
				39 00 00 00 00 00 02 24 01
				39 00 00 00 00 00 02 25 21
				39 00 00 00 00 00 02 26 01
				39 00 00 00 00 00 02 27 30
				39 00 00 00 00 00 02 28 01
				39 00 00 00 00 00 02 29 3E
				39 00 00 00 00 00 02 2A 01
				39 00 00 00 00 00 02 2B 4E
				39 00 00 00 00 00 02 2C 01
				39 00 00 00 00 00 02 2D 5E
				39 00 00 00 00 00 02 2E 01
				39 00 00 00 00 00 02 2F 6E
				39 00 00 00 00 00 02 30 01
				39 00 00 00 00 00 02 31 7D
				39 00 00 00 00 00 02 32 01
				39 00 00 00 00 00 02 33 8D
				39 00 00 00 00 00 02 34 01
				39 00 00 00 00 00 02 35 9C
				39 00 00 00 00 00 02 36 01
				39 00 00 00 00 00 02 37 BB
				39 00 00 00 00 00 02 38 01
				39 00 00 00 00 00 02 39 D9
				39 00 00 00 00 00 02 3A 01
				39 00 00 00 00 00 02 3B F9
				39 00 00 00 00 00 02 3C 02
				39 00 00 00 00 00 02 3D 19
				39 00 00 00 00 00 02 3E 02
				39 00 00 00 00 00 02 3F 3A
				39 00 00 00 00 00 02 40 02
				39 00 00 00 00 00 02 41 58
				39 00 00 00 00 00 02 42 02
				39 00 00 00 00 00 02 43 77
				39 00 00 00 00 00 02 44 02
				39 00 00 00 00 00 02 45 96
				39 00 00 00 00 00 02 46 02
				39 00 00 00 00 00 02 47 B8
				39 00 00 00 00 00 02 48 02
				39 00 00 00 00 00 02 49 D5
				39 00 00 00 00 00 02 4A 02
				39 00 00 00 00 00 02 4B F3
				39 00 00 00 00 00 02 4C 03
				39 00 00 00 00 00 02 4D 13
				39 00 00 00 00 00 02 4E 03
				39 00 00 00 00 00 02 4F 34
				39 00 00 00 00 00 02 50 03
				39 00 00 00 00 00 02 51 54
				39 00 00 00 00 00 02 52 03
				39 00 00 00 00 00 02 53 75
				39 00 00 00 00 00 02 54 03
				39 00 00 00 00 00 02 55 95
				39 00 00 00 00 00 02 56 03
				39 00 00 00 00 00 02 57 B2
				39 00 00 00 00 00 02 58 03
				39 00 00 00 00 00 02 59 D4
				39 00 00 00 00 00 02 5A 03
				39 01 00 00 00 00 02 5B F4
				39 00 00 00 00 00 04 FF 98 81 07
				39 00 00 00 00 00 04 FF 98 81 07
				39 00 00 00 00 00 02 00 00
				39 00 00 00 00 00 02 01 00
				39 00 00 00 00 00 02 02 00
				39 00 00 00 00 00 02 03 0B
				39 00 00 00 00 00 02 04 00
				39 00 00 00 00 00 02 05 1C
				39 00 00 00 00 00 02 06 00
				39 00 00 00 00 00 02 07 2E
				39 00 00 00 00 00 02 08 00
				39 00 00 00 00 00 02 09 3B
				39 00 00 00 00 00 02 0A 00
				39 00 00 00 00 00 02 0B 47
				39 00 00 00 00 00 02 0C 00
				39 00 00 00 00 00 02 0D 52
				39 00 00 00 00 00 02 0E 00
				39 00 00 00 00 00 02 0F 60
				39 00 00 00 00 00 02 10 00
				39 00 00 00 00 00 02 11 70
				39 00 00 00 00 00 02 12 00
				39 00 00 00 00 00 02 13 80
				39 00 00 00 00 00 02 14 00
				39 00 00 00 00 00 02 15 8F
				39 00 00 00 00 00 02 16 00
				39 00 00 00 00 00 02 17 9E
				39 00 00 00 00 00 02 18 00
				39 00 00 00 00 00 02 19 AE
				39 00 00 00 00 00 02 1A 00
				39 00 00 00 00 00 02 1B BD
				39 00 00 00 00 00 02 1C 00
				39 00 00 00 00 00 02 1D CB
				39 00 00 00 00 00 02 1E 00
				39 00 00 00 00 00 02 1F DA
				39 00 00 00 00 00 02 20 00
				39 00 00 00 00 00 02 21 EB
				39 00 00 00 00 00 02 22 00
				39 00 00 00 00 00 02 23 FB
				39 00 00 00 00 00 02 24 01
				39 00 00 00 00 00 02 25 0A
				39 00 00 00 00 00 02 26 01
				39 00 00 00 00 00 02 27 18
				39 00 00 00 00 00 02 28 01
				39 00 00 00 00 00 02 29 27
				39 00 00 00 00 00 02 2A 01
				39 00 00 00 00 00 02 2B 34
				39 00 00 00 00 00 02 2C 01
				39 00 00 00 00 00 02 2D 42
				39 00 00 00 00 00 02 2E 01
				39 00 00 00 00 00 02 2F 50
				39 00 00 00 00 00 02 30 01
				39 00 00 00 00 00 02 31 5F
				39 00 00 00 00 00 02 32 01
				39 00 00 00 00 00 02 33 6E
				39 00 00 00 00 00 02 34 01
				39 00 00 00 00 00 02 35 7C
				39 00 00 00 00 00 02 36 01
				39 00 00 00 00 00 02 37 98
				39 00 00 00 00 00 02 38 01
				39 00 00 00 00 00 02 39 B4
				39 00 00 00 00 00 02 3A 01
				39 00 00 00 00 00 02 3B D3
				39 00 00 00 00 00 02 3C 01
				39 00 00 00 00 00 02 3D EF
				39 00 00 00 00 00 02 3E 02
				39 00 00 00 00 00 02 3F 0D
				39 00 00 00 00 00 02 40 02
				39 00 00 00 00 00 02 41 2B
				39 00 00 00 00 00 02 42 02
				39 00 00 00 00 00 02 43 49
				39 00 00 00 00 00 02 44 02
				39 00 00 00 00 00 02 45 64
				39 00 00 00 00 00 02 46 02
				39 00 00 00 00 00 02 47 81
				39 00 00 00 00 00 02 48 02
				39 00 00 00 00 00 02 49 9F
				39 00 00 00 00 00 02 4A 02
				39 00 00 00 00 00 02 4B BE
				39 00 00 00 00 00 02 4C 02
				39 00 00 00 00 00 02 4D D7
				39 00 00 00 00 00 02 4E 02
				39 00 00 00 00 00 02 4F F3
				39 00 00 00 00 00 02 50 03
				39 00 00 00 00 00 02 51 11
				39 00 00 00 00 00 02 52 03
				39 00 00 00 00 00 02 53 30
				39 00 00 00 00 00 02 54 03
				39 00 00 00 00 00 02 55 4A
				39 00 00 00 00 00 02 56 03
				39 00 00 00 00 00 02 57 69
				39 00 00 00 00 00 02 58 03
				39 00 00 00 00 00 02 59 85
				39 00 00 00 00 00 02 5A 03
				39 00 00 00 00 00 02 5B A3
				39 00 00 00 00 00 04 FF 98 81 00
				39 01 00 00 00 00 04 FF 98 81 00];


		qcom,mdss-dsi-level3-command = [39 00 00 00 00 00 04 FF 98 81 01
				39 00 00 00 00 00 04 FF 98 81 01
				39 00 00 00 00 00 02 A0 1B
				39 00 00 00 00 00 02 A1 35
				39 00 00 00 00 00 02 A2 44
				39 00 00 00 00 00 02 A3 13
				39 00 00 00 00 00 02 A4 16
				39 00 00 00 00 00 02 A5 2A
				39 00 00 00 00 00 02 A6 1E
				39 00 00 00 00 00 02 A7 1E
				39 00 00 00 00 00 02 A8 B7
				39 00 00 00 00 00 02 A9 1C
				39 00 00 00 00 00 02 AA 28
				39 00 00 00 00 00 02 AB 9F
				39 00 00 00 00 00 02 AC 1F
				39 00 00 00 00 00 02 AD 1E
				39 00 00 00 00 00 02 AE 53
				39 00 00 00 00 00 02 AF 27
				39 00 00 00 00 00 02 B0 2A
				39 00 00 00 00 00 02 B1 59
				39 00 00 00 00 00 02 B2 65
				39 00 00 00 00 00 02 B3 32
				39 00 00 00 00 00 02 C0 1B
				39 00 00 00 00 00 02 C1 35
				39 00 00 00 00 00 02 C2 44
				39 00 00 00 00 00 02 C3 13
				39 00 00 00 00 00 02 C4 16
				39 00 00 00 00 00 02 C5 2A
				39 00 00 00 00 00 02 C6 1E
				39 00 00 00 00 00 02 C7 1E
				39 00 00 00 00 00 02 C8 B7
				39 00 00 00 00 00 02 C9 1C
				39 00 00 00 00 00 02 CA 28
				39 00 00 00 00 00 02 CB 9F
				39 00 00 00 00 00 02 CC 1F
				39 00 00 00 00 00 02 CD 1E
				39 00 00 00 00 00 02 CE 53
				39 00 00 00 00 00 02 CF 27
				39 00 00 00 00 00 02 D0 2A
				39 00 00 00 00 00 02 D1 59
				39 00 00 00 00 00 02 D2 65
				39 01 00 00 00 00 02 D3 32
				39 00 00 00 00 00 04 FF 98 81 05
				39 00 00 00 00 00 04 FF 98 81 05
				39 00 00 00 00 00 02 85 48
				39 00 00 00 00 00 02 00 00
				39 00 00 00 00 00 02 01 00
				39 00 00 00 00 00 02 02 00
				39 00 00 00 00 00 02 03 11
				39 00 00 00 00 00 02 04 00
				39 00 00 00 00 00 02 05 20
				39 00 00 00 00 00 02 06 00
				39 00 00 00 00 00 02 07 31
				39 00 00 00 00 00 02 08 00
				39 00 00 00 00 00 02 09 40
				39 00 00 00 00 00 02 0A 00
				39 00 00 00 00 00 02 0B 50
				39 00 00 00 00 00 02 0C 00
				39 00 00 00 00 00 02 0D 61
				39 00 00 00 00 00 02 0E 00
				39 00 00 00 00 00 02 0F 72
				39 00 00 00 00 00 02 10 00
				39 00 00 00 00 00 02 11 82
				39 00 00 00 00 00 02 12 00
				39 00 00 00 00 00 02 13 92
				39 00 00 00 00 00 02 14 00
				39 00 00 00 00 00 02 15 A2
				39 00 00 00 00 00 02 16 00
				39 00 00 00 00 00 02 17 B2
				39 00 00 00 00 00 02 18 00
				39 00 00 00 00 00 02 19 C2
				39 00 00 00 00 00 02 1A 00
				39 00 00 00 00 00 02 1B D2
				39 00 00 00 00 00 02 1C 00
				39 00 00 00 00 00 02 1D E4
				39 00 00 00 00 00 02 1E 00
				39 00 00 00 00 00 02 1F F4
				39 00 00 00 00 00 02 20 01
				39 00 00 00 00 00 02 21 05
				39 00 00 00 00 00 02 22 01
				39 00 00 00 00 00 02 23 14
				39 00 00 00 00 00 02 24 01
				39 00 00 00 00 00 02 25 25
				39 00 00 00 00 00 02 26 01
				39 00 00 00 00 00 02 27 33
				39 00 00 00 00 00 02 28 01
				39 00 00 00 00 00 02 29 43
				39 00 00 00 00 00 02 2A 01
				39 00 00 00 00 00 02 2B 53
				39 00 00 00 00 00 02 2C 01
				39 00 00 00 00 00 02 2D 63
				39 00 00 00 00 00 02 2E 01
				39 00 00 00 00 00 02 2F 73
				39 00 00 00 00 00 02 30 01
				39 00 00 00 00 00 02 31 83
				39 00 00 00 00 00 02 32 01
				39 00 00 00 00 00 02 33 92
				39 00 00 00 00 00 02 34 01
				39 00 00 00 00 00 02 35 A2
				39 00 00 00 00 00 02 36 01
				39 00 00 00 00 00 02 37 BF
				39 00 00 00 00 00 02 38 01
				39 00 00 00 00 00 02 39 DE
				39 00 00 00 00 00 02 3A 01
				39 00 00 00 00 00 02 3B FE
				39 00 00 00 00 00 02 3C 02
				39 00 00 00 00 00 02 3D 1F
				39 00 00 00 00 00 02 3E 02
				39 00 00 00 00 00 02 3F 40
				39 00 00 00 00 00 02 40 02
				39 00 00 00 00 00 02 41 5E
				39 00 00 00 00 00 02 42 02
				39 00 00 00 00 00 02 43 7D
				39 00 00 00 00 00 02 44 02
				39 00 00 00 00 00 02 45 9E
				39 00 00 00 00 00 02 46 02
				39 00 00 00 00 00 02 47 BF
				39 00 00 00 00 00 02 48 02
				39 00 00 00 00 00 02 49 DC
				39 00 00 00 00 00 02 4A 02
				39 00 00 00 00 00 02 4B FA
				39 00 00 00 00 00 02 4C 03
				39 00 00 00 00 00 02 4D 1C
				39 00 00 00 00 00 02 4E 03
				39 00 00 00 00 00 02 4F 3C
				39 00 00 00 00 00 02 50 03
				39 00 00 00 00 00 02 51 59
				39 00 00 00 00 00 02 52 03
				39 00 00 00 00 00 02 53 7A
				39 00 00 00 00 00 02 54 03
				39 00 00 00 00 00 02 55 9B
				39 00 00 00 00 00 02 56 03
				39 00 00 00 00 00 02 57 C0
				39 00 00 00 00 00 02 58 03
				39 00 00 00 00 00 02 59 DD
				39 00 00 00 00 00 02 5A 03
				39 01 00 00 00 00 02 5B F7
				39 00 00 00 00 00 04 FF 98 81 06
				39 00 00 00 00 00 04 FF 98 81 06
				39 00 00 00 00 00 02 00 00
				39 00 00 00 00 00 02 01 00
				39 00 00 00 00 00 02 02 00
				39 00 00 00 00 00 02 03 10
				39 00 00 00 00 00 02 04 00
				39 00 00 00 00 00 02 05 1F
				39 00 00 00 00 00 02 06 00
				39 00 00 00 00 00 02 07 2F
				39 00 00 00 00 00 02 08 00
				39 00 00 00 00 00 02 09 3D
				39 00 00 00 00 00 02 0A 00
				39 00 00 00 00 00 02 0B 4D
				39 00 00 00 00 00 02 0C 00
				39 00 00 00 00 00 02 0D 5D
				39 00 00 00 00 00 02 0E 00
				39 00 00 00 00 00 02 0F 6D
				39 00 00 00 00 00 02 10 00
				39 00 00 00 00 00 02 11 7D
				39 00 00 00 00 00 02 12 00
				39 00 00 00 00 00 02 13 8B
				39 00 00 00 00 00 02 14 00
				39 00 00 00 00 00 02 15 9C
				39 00 00 00 00 00 02 16 00
				39 00 00 00 00 00 02 17 AC
				39 00 00 00 00 00 02 18 00
				39 00 00 00 00 00 02 19 BB
				39 00 00 00 00 00 02 1A 00
				39 00 00 00 00 00 02 1B C9
				39 00 00 00 00 00 02 1C 00
				39 00 00 00 00 00 02 1D DA
				39 00 00 00 00 00 02 1E 00
				39 00 00 00 00 00 02 1F EB
				39 00 00 00 00 00 02 20 00
				39 00 00 00 00 00 02 21 FB
				39 00 00 00 00 00 02 22 01
				39 00 00 00 00 00 02 23 0B
				39 00 00 00 00 00 02 24 01
				39 00 00 00 00 00 02 25 1A
				39 00 00 00 00 00 02 26 01
				39 00 00 00 00 00 02 27 29
				39 00 00 00 00 00 02 28 01
				39 00 00 00 00 00 02 29 37
				39 00 00 00 00 00 02 2A 01
				39 00 00 00 00 00 02 2B 46
				39 00 00 00 00 00 02 2C 01
				39 00 00 00 00 00 02 2D 56
				39 00 00 00 00 00 02 2E 01
				39 00 00 00 00 00 02 2F 65
				39 00 00 00 00 00 02 30 01
				39 00 00 00 00 00 02 31 74
				39 00 00 00 00 00 02 32 01
				39 00 00 00 00 00 02 33 83
				39 00 00 00 00 00 02 34 01
				39 00 00 00 00 00 02 35 92
				39 00 00 00 00 00 02 36 01
				39 00 00 00 00 00 02 37 B0
				39 00 00 00 00 00 02 38 01
				39 00 00 00 00 00 02 39 CE
				39 00 00 00 00 00 02 3A 01
				39 00 00 00 00 00 02 3B EC
				39 00 00 00 00 00 02 3C 02
				39 00 00 00 00 00 02 3D 0B
				39 00 00 00 00 00 02 3E 02
				39 00 00 00 00 00 02 3F 2C
				39 00 00 00 00 00 02 40 02
				39 00 00 00 00 00 02 41 4B
				39 00 00 00 00 00 02 42 02
				39 00 00 00 00 00 02 43 68
				39 00 00 00 00 00 02 44 02
				39 00 00 00 00 00 02 45 86
				39 00 00 00 00 00 02 46 02
				39 00 00 00 00 00 02 47 A6
				39 00 00 00 00 00 02 48 02
				39 00 00 00 00 00 02 49 C5
				39 00 00 00 00 00 02 4A 02
				39 00 00 00 00 00 02 4B E1
				39 00 00 00 00 00 02 4C 02
				39 00 00 00 00 00 02 4D FF
				39 00 00 00 00 00 02 4E 03
				39 00 00 00 00 00 02 4F 1F
				39 00 00 00 00 00 02 50 03
				39 00 00 00 00 00 02 51 3F
				39 00 00 00 00 00 02 52 03
				39 00 00 00 00 00 02 53 5F
				39 00 00 00 00 00 02 54 03
				39 00 00 00 00 00 02 55 7E
				39 00 00 00 00 00 02 56 03
				39 00 00 00 00 00 02 57 9E
				39 00 00 00 00 00 02 58 03
				39 00 00 00 00 00 02 59 BA
				39 00 00 00 00 00 02 5A 03
				39 01 00 00 00 00 02 5B DB
				39 00 00 00 00 00 04 FF 98 81 07
				39 00 00 00 00 00 04 FF 98 81 07
				39 00 00 00 00 00 02 00 00
				39 00 00 00 00 00 02 01 00
				39 00 00 00 00 00 02 02 00
				39 00 00 00 00 00 02 03 09
				39 00 00 00 00 00 02 04 00
				39 00 00 00 00 00 02 05 1A
				39 00 00 00 00 00 02 06 00
				39 00 00 00 00 00 02 07 2B
				39 00 00 00 00 00 02 08 00
				39 00 00 00 00 00 02 09 39
				39 00 00 00 00 00 02 0A 00
				39 00 00 00 00 00 02 0B 43
				39 00 00 00 00 00 02 0C 00
				39 00 00 00 00 00 02 0D 4C
				39 00 00 00 00 00 02 0E 00
				39 00 00 00 00 00 02 0F 5A
				39 00 00 00 00 00 02 10 00
				39 00 00 00 00 00 02 11 6A
				39 00 00 00 00 00 02 12 00
				39 00 00 00 00 00 02 13 79
				39 00 00 00 00 00 02 14 00
				39 00 00 00 00 00 02 15 87
				39 00 00 00 00 00 02 16 00
				39 00 00 00 00 00 02 17 96
				39 00 00 00 00 00 02 18 00
				39 00 00 00 00 00 02 19 A5
				39 00 00 00 00 00 02 1A 00
				39 00 00 00 00 00 02 1B B4
				39 00 00 00 00 00 02 1C 00
				39 00 00 00 00 00 02 1D C2
				39 00 00 00 00 00 02 1E 00
				39 00 00 00 00 00 02 1F CF
				39 00 00 00 00 00 02 20 00
				39 00 00 00 00 00 02 21 DE
				39 00 00 00 00 00 02 22 00
				39 00 00 00 00 00 02 23 EE
				39 00 00 00 00 00 02 24 00
				39 00 00 00 00 00 02 25 FD
				39 00 00 00 00 00 02 26 01
				39 00 00 00 00 00 02 27 0B
				39 00 00 00 00 00 02 28 01
				39 00 00 00 00 00 02 29 19
				39 00 00 00 00 00 02 2A 01
				39 00 00 00 00 00 02 2B 26
				39 00 00 00 00 00 02 2C 01
				39 00 00 00 00 00 02 2D 33
				39 00 00 00 00 00 02 2E 01
				39 00 00 00 00 00 02 2F 40
				39 00 00 00 00 00 02 30 01
				39 00 00 00 00 00 02 31 4E
				39 00 00 00 00 00 02 32 01
				39 00 00 00 00 00 02 33 5C
				39 00 00 00 00 00 02 34 01
				39 00 00 00 00 00 02 35 6A
				39 00 00 00 00 00 02 36 01
				39 00 00 00 00 00 02 37 85
				39 00 00 00 00 00 02 38 01
				39 00 00 00 00 00 02 39 A1
				39 00 00 00 00 00 02 3A 01
				39 00 00 00 00 00 02 3B BD
				39 00 00 00 00 00 02 3C 01
				39 00 00 00 00 00 02 3D D8
				39 00 00 00 00 00 02 3E 01
				39 00 00 00 00 00 02 3F F3
				39 00 00 00 00 00 02 40 02
				39 00 00 00 00 00 02 41 0F
				39 00 00 00 00 00 02 42 02
				39 00 00 00 00 00 02 43 2C
				39 00 00 00 00 00 02 44 02
				39 00 00 00 00 00 02 45 48
				39 00 00 00 00 00 02 46 02
				39 00 00 00 00 00 02 47 63
				39 00 00 00 00 00 02 48 02
				39 00 00 00 00 00 02 49 7E
				39 00 00 00 00 00 02 4A 02
				39 00 00 00 00 00 02 4B 9A
				39 00 00 00 00 00 02 4C 02
				39 00 00 00 00 00 02 4D B8
				39 00 00 00 00 00 02 4E 02
				39 00 00 00 00 00 02 4F D1
				39 00 00 00 00 00 02 50 02
				39 00 00 00 00 00 02 51 EB
				39 00 00 00 00 00 02 52 03
				39 00 00 00 00 00 02 53 06
				39 00 00 00 00 00 02 54 03
				39 00 00 00 00 00 02 55 24
				39 00 00 00 00 00 02 56 03
				39 00 00 00 00 00 02 57 3E
				39 00 00 00 00 00 02 58 03
				39 00 00 00 00 00 02 59 59
				39 00 00 00 00 00 02 5A 03
				39 00 00 00 00 00 02 5B 76
				39 00 00 00 00 00 04 FF 98 81 00
				39 01 00 00 00 00 04 FF 98 81 00];

		qcom,mdss-dsi-level4-command = [39 00 00 00 00 00 04 FF 98 81 01
				39 00 00 00 00 00 04 FF 98 81 01
				39 00 00 00 00 00 02 A0 1B
				39 00 00 00 00 00 02 A1 35
				39 00 00 00 00 00 02 A2 44
				39 00 00 00 00 00 02 A3 13
				39 00 00 00 00 00 02 A4 16
				39 00 00 00 00 00 02 A5 2A
				39 00 00 00 00 00 02 A6 1E
				39 00 00 00 00 00 02 A7 1E
				39 00 00 00 00 00 02 A8 B7
				39 00 00 00 00 00 02 A9 1C
				39 00 00 00 00 00 02 AA 28
				39 00 00 00 00 00 02 AB 9F
				39 00 00 00 00 00 02 AC 1F
				39 00 00 00 00 00 02 AD 1E
				39 00 00 00 00 00 02 AE 53
				39 00 00 00 00 00 02 AF 27
				39 00 00 00 00 00 02 B0 2A
				39 00 00 00 00 00 02 B1 59
				39 00 00 00 00 00 02 B2 65
				39 00 00 00 00 00 02 B3 32
				39 00 00 00 00 00 02 C0 1B
				39 00 00 00 00 00 02 C1 35
				39 00 00 00 00 00 02 C2 44
				39 00 00 00 00 00 02 C3 13
				39 00 00 00 00 00 02 C4 16
				39 00 00 00 00 00 02 C5 2A
				39 00 00 00 00 00 02 C6 1E
				39 00 00 00 00 00 02 C7 1E
				39 00 00 00 00 00 02 C8 B7
				39 00 00 00 00 00 02 C9 1C
				39 00 00 00 00 00 02 CA 28
				39 00 00 00 00 00 02 CB 9F
				39 00 00 00 00 00 02 CC 1F
				39 00 00 00 00 00 02 CD 1E
				39 00 00 00 00 00 02 CE 53
				39 00 00 00 00 00 02 CF 27
				39 00 00 00 00 00 02 D0 2A
				39 00 00 00 00 00 02 D1 59
				39 00 00 00 00 00 02 D2 65
				39 01 00 00 00 00 02 D3 32
				39 00 00 00 00 00 04 FF 98 81 05
				39 00 00 00 00 00 04 FF 98 81 05
				39 00 00 00 00 00 02 85 48
				39 00 00 00 00 00 02 00 00
				39 00 00 00 00 00 02 01 00
				39 00 00 00 00 00 02 02 00
				39 00 00 00 00 00 02 03 11
				39 00 00 00 00 00 02 04 00
				39 00 00 00 00 00 02 05 20
				39 00 00 00 00 00 02 06 00
				39 00 00 00 00 00 02 07 31
				39 00 00 00 00 00 02 08 00
				39 00 00 00 00 00 02 09 40
				39 00 00 00 00 00 02 0A 00
				39 00 00 00 00 00 02 0B 50
				39 00 00 00 00 00 02 0C 00
				39 00 00 00 00 00 02 0D 61
				39 00 00 00 00 00 02 0E 00
				39 00 00 00 00 00 02 0F 72
				39 00 00 00 00 00 02 10 00
				39 00 00 00 00 00 02 11 82
				39 00 00 00 00 00 02 12 00
				39 00 00 00 00 00 02 13 92
				39 00 00 00 00 00 02 14 00
				39 00 00 00 00 00 02 15 A2
				39 00 00 00 00 00 02 16 00
				39 00 00 00 00 00 02 17 B2
				39 00 00 00 00 00 02 18 00
				39 00 00 00 00 00 02 19 C2
				39 00 00 00 00 00 02 1A 00
				39 00 00 00 00 00 02 1B D2
				39 00 00 00 00 00 02 1C 00
				39 00 00 00 00 00 02 1D E4
				39 00 00 00 00 00 02 1E 00
				39 00 00 00 00 00 02 1F F4
				39 00 00 00 00 00 02 20 01
				39 00 00 00 00 00 02 21 05
				39 00 00 00 00 00 02 22 01
				39 00 00 00 00 00 02 23 15
				39 00 00 00 00 00 02 24 01
				39 00 00 00 00 00 02 25 25
				39 00 00 00 00 00 02 26 01
				39 00 00 00 00 00 02 27 33
				39 00 00 00 00 00 02 28 01
				39 00 00 00 00 00 02 29 43
				39 00 00 00 00 00 02 2A 01
				39 00 00 00 00 00 02 2B 53
				39 00 00 00 00 00 02 2C 01
				39 00 00 00 00 00 02 2D 63
				39 00 00 00 00 00 02 2E 01
				39 00 00 00 00 00 02 2F 73
				39 00 00 00 00 00 02 30 01
				39 00 00 00 00 00 02 31 83
				39 00 00 00 00 00 02 32 01
				39 00 00 00 00 00 02 33 92
				39 00 00 00 00 00 02 34 01
				39 00 00 00 00 00 02 35 A2
				39 00 00 00 00 00 02 36 01
				39 00 00 00 00 00 02 37 BF
				39 00 00 00 00 00 02 38 01
				39 00 00 00 00 00 02 39 DF
				39 00 00 00 00 00 02 3A 01
				39 00 00 00 00 00 02 3B FE
				39 00 00 00 00 00 02 3C 02
				39 00 00 00 00 00 02 3D 1F
				39 00 00 00 00 00 02 3E 02
				39 00 00 00 00 00 02 3F 40
				39 00 00 00 00 00 02 40 02
				39 00 00 00 00 00 02 41 5E
				39 00 00 00 00 00 02 42 02
				39 00 00 00 00 00 02 43 7D
				39 00 00 00 00 00 02 44 02
				39 00 00 00 00 00 02 45 9E
				39 00 00 00 00 00 02 46 02
				39 00 00 00 00 00 02 47 BF
				39 00 00 00 00 00 02 48 02
				39 00 00 00 00 00 02 49 DC
				39 00 00 00 00 00 02 4A 02
				39 00 00 00 00 00 02 4B FA
				39 00 00 00 00 00 02 4C 03
				39 00 00 00 00 00 02 4D 1C
				39 00 00 00 00 00 02 4E 03
				39 00 00 00 00 00 02 4F 3C
				39 00 00 00 00 00 02 50 03
				39 00 00 00 00 00 02 51 5A
				39 00 00 00 00 00 02 52 03
				39 00 00 00 00 00 02 53 7A
				39 00 00 00 00 00 02 54 03
				39 00 00 00 00 00 02 55 9B
				39 00 00 00 00 00 02 56 03
				39 00 00 00 00 00 02 57 C0
				39 00 00 00 00 00 02 58 03
				39 00 00 00 00 00 02 59 DD
				39 00 00 00 00 00 02 5A 03
				39 01 00 00 00 00 02 5B F7
				39 00 00 00 00 00 04 FF 98 81 06
				39 00 00 00 00 00 04 FF 98 81 06
				39 00 00 00 00 00 02 00 00
				39 00 00 00 00 00 02 01 00
				39 00 00 00 00 00 02 02 00
				39 00 00 00 00 00 02 03 0F
				39 00 00 00 00 00 02 04 00
				39 00 00 00 00 00 02 05 1E
				39 00 00 00 00 00 02 06 00
				39 00 00 00 00 00 02 07 2E
				39 00 00 00 00 00 02 08 00
				39 00 00 00 00 00 02 09 3C
				39 00 00 00 00 00 02 0A 00
				39 00 00 00 00 00 02 0B 4C
				39 00 00 00 00 00 02 0C 00
				39 00 00 00 00 00 02 0D 5B
				39 00 00 00 00 00 02 0E 00
				39 00 00 00 00 00 02 0F 6B
				39 00 00 00 00 00 02 10 00
				39 00 00 00 00 00 02 11 7B
				39 00 00 00 00 00 02 12 00
				39 00 00 00 00 00 02 13 89
				39 00 00 00 00 00 02 14 00
				39 00 00 00 00 00 02 15 99
				39 00 00 00 00 00 02 16 00
				39 00 00 00 00 00 02 17 A9
				39 00 00 00 00 00 02 18 00
				39 00 00 00 00 00 02 19 B8
				39 00 00 00 00 00 02 1A 00
				39 00 00 00 00 00 02 1B C6
				39 00 00 00 00 00 02 1C 00
				39 00 00 00 00 00 02 1D D6
				39 00 00 00 00 00 02 1E 00
				39 00 00 00 00 00 02 1F E6
				39 00 00 00 00 00 02 20 00
				39 00 00 00 00 00 02 21 F7
				39 00 00 00 00 00 02 22 01
				39 00 00 00 00 00 02 23 06
				39 00 00 00 00 00 02 24 01
				39 00 00 00 00 00 02 25 16
				39 00 00 00 00 00 02 26 01
				39 00 00 00 00 00 02 27 24
				39 00 00 00 00 00 02 28 01
				39 00 00 00 00 00 02 29 32
				39 00 00 00 00 00 02 2A 01
				39 00 00 00 00 00 02 2B 40
				39 00 00 00 00 00 02 2C 01
				39 00 00 00 00 00 02 2D 4F
				39 00 00 00 00 00 02 2E 01
				39 00 00 00 00 00 02 2F 5E
				39 00 00 00 00 00 02 30 01
				39 00 00 00 00 00 02 31 6D
				39 00 00 00 00 00 02 32 01
				39 00 00 00 00 00 02 33 7C
				39 00 00 00 00 00 02 34 01
				39 00 00 00 00 00 02 35 8B
				39 00 00 00 00 00 02 36 01
				39 00 00 00 00 00 02 37 A9
				39 00 00 00 00 00 02 38 01
				39 00 00 00 00 00 02 39 C6
				39 00 00 00 00 00 02 3A 01
				39 00 00 00 00 00 02 3B E3
				39 00 00 00 00 00 02 3C 02
				39 00 00 00 00 00 02 3D 02
				39 00 00 00 00 00 02 3E 02
				39 00 00 00 00 00 02 3F 21
				39 00 00 00 00 00 02 40 02
				39 00 00 00 00 00 02 41 40
				39 00 00 00 00 00 02 42 02
				39 00 00 00 00 00 02 43 5D
				39 00 00 00 00 00 02 44 02
				39 00 00 00 00 00 02 45 7A
				39 00 00 00 00 00 02 46 02
				39 00 00 00 00 00 02 47 99
				39 00 00 00 00 00 02 48 02
				39 00 00 00 00 00 02 49 B9
				39 00 00 00 00 00 02 4A 02
				39 00 00 00 00 00 02 4B D4
				39 00 00 00 00 00 02 4C 02
				39 00 00 00 00 00 02 4D F1
				39 00 00 00 00 00 02 4E 03
				39 00 00 00 00 00 02 4F 0F
				39 00 00 00 00 00 02 50 03
				39 00 00 00 00 00 02 51 30
				39 00 00 00 00 00 02 52 03
				39 00 00 00 00 00 02 53 4E
				39 00 00 00 00 00 02 54 03
				39 00 00 00 00 00 02 55 6E
				39 00 00 00 00 00 02 56 03
				39 00 00 00 00 00 02 57 8B
				39 00 00 00 00 00 02 58 03
				39 00 00 00 00 00 02 59 AA
				39 00 00 00 00 00 02 5A 03
				39 01 00 00 00 00 02 5B C8
				39 00 00 00 00 00 04 FF 98 81 07
				39 00 00 00 00 00 04 FF 98 81 07
				39 00 00 00 00 00 02 00 00
				39 00 00 00 00 00 02 01 00
				39 00 00 00 00 00 02 02 00
				39 00 00 00 00 00 02 03 0A
				39 00 00 00 00 00 02 04 00
				39 00 00 00 00 00 02 05 18
				39 00 00 00 00 00 02 06 00
				39 00 00 00 00 00 02 07 29
				39 00 00 00 00 00 02 08 00
				39 00 00 00 00 00 02 09 35
				39 00 00 00 00 00 02 0A 00
				39 00 00 00 00 00 02 0B 3F
				39 00 00 00 00 00 02 0C 00
				39 00 00 00 00 00 02 0D 47
				39 00 00 00 00 00 02 0E 00
				39 00 00 00 00 00 02 0F 55
				39 00 00 00 00 00 02 10 00
				39 00 00 00 00 00 02 11 64
				39 00 00 00 00 00 02 12 00
				39 00 00 00 00 00 02 13 73
				39 00 00 00 00 00 02 14 00
				39 00 00 00 00 00 02 15 81
				39 00 00 00 00 00 02 16 00
				39 00 00 00 00 00 02 17 8E
				39 00 00 00 00 00 02 18 00
				39 00 00 00 00 00 02 19 9C
				39 00 00 00 00 00 02 1A 00
				39 00 00 00 00 00 02 1B AB
				39 00 00 00 00 00 02 1C 00
				39 00 00 00 00 00 02 1D B8
				39 00 00 00 00 00 02 1E 00
				39 00 00 00 00 00 02 1F C5
				39 00 00 00 00 00 02 20 00
				39 00 00 00 00 00 02 21 D2
				39 00 00 00 00 00 02 22 00
				39 00 00 00 00 00 02 23 E1
				39 00 00 00 00 00 02 24 00
				39 00 00 00 00 00 02 25 F0
				39 00 00 00 00 00 02 26 00
				39 00 00 00 00 00 02 27 FE
				39 00 00 00 00 00 02 28 01
				39 00 00 00 00 00 02 29 0C
				39 00 00 00 00 00 02 2A 01
				39 00 00 00 00 00 02 2B 19
				39 00 00 00 00 00 02 2C 01
				39 00 00 00 00 00 02 2D 26
				39 00 00 00 00 00 02 2E 01
				39 00 00 00 00 00 02 2F 32
				39 00 00 00 00 00 02 30 01
				39 00 00 00 00 00 02 31 3E
				39 00 00 00 00 00 02 32 01
				39 00 00 00 00 00 02 33 4B
				39 00 00 00 00 00 02 34 01
				39 00 00 00 00 00 02 35 59
				39 00 00 00 00 00 02 36 01
				39 00 00 00 00 00 02 37 73
				39 00 00 00 00 00 02 38 01
				39 00 00 00 00 00 02 39 8D
				39 00 00 00 00 00 02 3A 01
				39 00 00 00 00 00 02 3B A7
				39 00 00 00 00 00 02 3C 01
				39 00 00 00 00 00 02 3D C2
				39 00 00 00 00 00 02 3E 01
				39 00 00 00 00 00 02 3F DC
				39 00 00 00 00 00 02 40 01
				39 00 00 00 00 00 02 41 F6
				39 00 00 00 00 00 02 42 02
				39 00 00 00 00 00 02 43 11
				39 00 00 00 00 00 02 44 02
				39 00 00 00 00 00 02 45 2D
				39 00 00 00 00 00 02 46 02
				39 00 00 00 00 00 02 47 47
				39 00 00 00 00 00 02 48 02
				39 00 00 00 00 00 02 49 60
				39 00 00 00 00 00 02 4A 02
				39 00 00 00 00 00 02 4B 7A
				39 00 00 00 00 00 02 4C 02
				39 00 00 00 00 00 02 4D 95
				39 00 00 00 00 00 02 4E 02
				39 00 00 00 00 00 02 4F B1
				39 00 00 00 00 00 02 50 02
				39 00 00 00 00 00 02 51 CA
				39 00 00 00 00 00 02 52 02
				39 00 00 00 00 00 02 53 E3
				39 00 00 00 00 00 02 54 02
				39 00 00 00 00 00 02 55 FC
				39 00 00 00 00 00 02 56 03
				39 00 00 00 00 00 02 57 18
				39 00 00 00 00 00 02 58 03
				39 00 00 00 00 00 02 59 34
				39 00 00 00 00 00 02 5A 03
				39 00 00 00 00 00 02 5B 4A
				39 00 00 00 00 00 04 FF 98 81 00
				39 01 00 00 00 00 04 FF 98 81 00];



		qcom,mdss-dsi-level5-command = [39 00 00 00 00 00 04 FF 98 81 01
				39 00 00 00 00 00 04 FF 98 81 01
				39 00 00 00 00 00 02 A0 1B
				39 00 00 00 00 00 02 A1 35
				39 00 00 00 00 00 02 A2 44
				39 00 00 00 00 00 02 A3 13
				39 00 00 00 00 00 02 A4 16
				39 00 00 00 00 00 02 A5 2A
				39 00 00 00 00 00 02 A6 1E
				39 00 00 00 00 00 02 A7 1E
				39 00 00 00 00 00 02 A8 B7
				39 00 00 00 00 00 02 A9 1C
				39 00 00 00 00 00 02 AA 28
				39 00 00 00 00 00 02 AB 9F
				39 00 00 00 00 00 02 AC 1F
				39 00 00 00 00 00 02 AD 1E
				39 00 00 00 00 00 02 AE 53
				39 00 00 00 00 00 02 AF 27
				39 00 00 00 00 00 02 B0 2A
				39 00 00 00 00 00 02 B1 59
				39 00 00 00 00 00 02 B2 65
				39 00 00 00 00 00 02 B3 32
				39 00 00 00 00 00 02 C0 1B
				39 00 00 00 00 00 02 C1 35
				39 00 00 00 00 00 02 C2 44
				39 00 00 00 00 00 02 C3 13
				39 00 00 00 00 00 02 C4 16
				39 00 00 00 00 00 02 C5 2A
				39 00 00 00 00 00 02 C6 1E
				39 00 00 00 00 00 02 C7 1E
				39 00 00 00 00 00 02 C8 B7
				39 00 00 00 00 00 02 C9 1C
				39 00 00 00 00 00 02 CA 28
				39 00 00 00 00 00 02 CB 9F
				39 00 00 00 00 00 02 CC 1F
				39 00 00 00 00 00 02 CD 1E
				39 00 00 00 00 00 02 CE 53
				39 00 00 00 00 00 02 CF 27
				39 00 00 00 00 00 02 D0 2A
				39 00 00 00 00 00 02 D1 59
				39 00 00 00 00 00 02 D2 65
				39 01 00 00 00 00 02 D3 32
				39 00 00 00 00 00 04 FF 98 81 05
				39 00 00 00 00 00 04 FF 98 81 05
				39 00 00 00 00 00 02 85 48
				39 00 00 00 00 00 02 00 00
				39 00 00 00 00 00 02 01 00
				39 00 00 00 00 00 02 02 00
				39 00 00 00 00 00 02 03 12
				39 00 00 00 00 00 02 04 00
				39 00 00 00 00 00 02 05 20
				39 00 00 00 00 00 02 06 00
				39 00 00 00 00 00 02 07 31
				39 00 00 00 00 00 02 08 00
				39 00 00 00 00 00 02 09 40
				39 00 00 00 00 00 02 0A 00
				39 00 00 00 00 00 02 0B 50
				39 00 00 00 00 00 02 0C 00
				39 00 00 00 00 00 02 0D 61
				39 00 00 00 00 00 02 0E 00
				39 00 00 00 00 00 02 0F 72
				39 00 00 00 00 00 02 10 00
				39 00 00 00 00 00 02 11 82
				39 00 00 00 00 00 02 12 00
				39 00 00 00 00 00 02 13 92
				39 00 00 00 00 00 02 14 00
				39 00 00 00 00 00 02 15 A2
				39 00 00 00 00 00 02 16 00
				39 00 00 00 00 00 02 17 B2
				39 00 00 00 00 00 02 18 00
				39 00 00 00 00 00 02 19 C2
				39 00 00 00 00 00 02 1A 00
				39 00 00 00 00 00 02 1B D2
				39 00 00 00 00 00 02 1C 00
				39 00 00 00 00 00 02 1D E4
				39 00 00 00 00 00 02 1E 00
				39 00 00 00 00 00 02 1F F4
				39 00 00 00 00 00 02 20 01
				39 00 00 00 00 00 02 21 05
				39 00 00 00 00 00 02 22 01
				39 00 00 00 00 00 02 23 15
				39 00 00 00 00 00 02 24 01
				39 00 00 00 00 00 02 25 25
				39 00 00 00 00 00 02 26 01
				39 00 00 00 00 00 02 27 34
				39 00 00 00 00 00 02 28 01
				39 00 00 00 00 00 02 29 43
				39 00 00 00 00 00 02 2A 01
				39 00 00 00 00 00 02 2B 53
				39 00 00 00 00 00 02 2C 01
				39 00 00 00 00 00 02 2D 63
				39 00 00 00 00 00 02 2E 01
				39 00 00 00 00 00 02 2F 73
				39 00 00 00 00 00 02 30 01
				39 00 00 00 00 00 02 31 83
				39 00 00 00 00 00 02 32 01
				39 00 00 00 00 00 02 33 92
				39 00 00 00 00 00 02 34 01
				39 00 00 00 00 00 02 35 A2
				39 00 00 00 00 00 02 36 01
				39 00 00 00 00 00 02 37 BF
				39 00 00 00 00 00 02 38 01
				39 00 00 00 00 00 02 39 DF
				39 00 00 00 00 00 02 3A 01
				39 00 00 00 00 00 02 3B FE
				39 00 00 00 00 00 02 3C 02
				39 00 00 00 00 00 02 3D 1F
				39 00 00 00 00 00 02 3E 02
				39 00 00 00 00 00 02 3F 40
				39 00 00 00 00 00 02 40 02
				39 00 00 00 00 00 02 41 5E
				39 00 00 00 00 00 02 42 02
				39 00 00 00 00 00 02 43 7D
				39 00 00 00 00 00 02 44 02
				39 00 00 00 00 00 02 45 9E
				39 00 00 00 00 00 02 46 02
				39 00 00 00 00 00 02 47 BF
				39 00 00 00 00 00 02 48 02
				39 00 00 00 00 00 02 49 DC
				39 00 00 00 00 00 02 4A 02
				39 00 00 00 00 00 02 4B FA
				39 00 00 00 00 00 02 4C 03
				39 00 00 00 00 00 02 4D 1C
				39 00 00 00 00 00 02 4E 03
				39 00 00 00 00 00 02 4F 3C
				39 00 00 00 00 00 02 50 03
				39 00 00 00 00 00 02 51 5A
				39 00 00 00 00 00 02 52 03
				39 00 00 00 00 00 02 53 7A
				39 00 00 00 00 00 02 54 03
				39 00 00 00 00 00 02 55 9B
				39 00 00 00 00 00 02 56 03
				39 00 00 00 00 00 02 57 C0
				39 00 00 00 00 00 02 58 03
				39 00 00 00 00 00 02 59 DD
				39 00 00 00 00 00 02 5A 03
				39 01 00 00 00 00 02 5B F7
				39 00 00 00 00 00 04 FF 98 81 06
				39 00 00 00 00 00 04 FF 98 81 06
				39 00 00 00 00 00 02 00 00
				39 00 00 00 00 00 02 01 00
				39 00 00 00 00 00 02 02 00
				39 00 00 00 00 00 02 03 0F
				39 00 00 00 00 00 02 04 00
				39 00 00 00 00 00 02 05 1D
				39 00 00 00 00 00 02 06 00
				39 00 00 00 00 00 02 07 2D
				39 00 00 00 00 00 02 08 00
				39 00 00 00 00 00 02 09 3B
				39 00 00 00 00 00 02 0A 00
				39 00 00 00 00 00 02 0B 4A
				39 00 00 00 00 00 02 0C 00
				39 00 00 00 00 00 02 0D 59
				39 00 00 00 00 00 02 0E 00
				39 00 00 00 00 00 02 0F 68
				39 00 00 00 00 00 02 10 00
				39 00 00 00 00 00 02 11 78
				39 00 00 00 00 00 02 12 00
				39 00 00 00 00 00 02 13 86
				39 00 00 00 00 00 02 14 00
				39 00 00 00 00 00 02 15 95
				39 00 00 00 00 00 02 16 00
				39 00 00 00 00 00 02 17 A5
				39 00 00 00 00 00 02 18 00
				39 00 00 00 00 00 02 19 B4
				39 00 00 00 00 00 02 1A 00
				39 00 00 00 00 00 02 1B C2
				39 00 00 00 00 00 02 1C 00
				39 00 00 00 00 00 02 1D D0
				39 00 00 00 00 00 02 1E 00
				39 00 00 00 00 00 02 1F E0
				39 00 00 00 00 00 02 20 00
				39 00 00 00 00 00 02 21 F0
				39 00 00 00 00 00 02 22 01
				39 00 00 00 00 00 02 23 00
				39 00 00 00 00 00 02 24 01
				39 00 00 00 00 00 02 25 0F
				39 00 00 00 00 00 02 26 01
				39 00 00 00 00 00 02 27 1D
				39 00 00 00 00 00 02 28 01
				39 00 00 00 00 00 02 29 2B
				39 00 00 00 00 00 02 2A 01
				39 00 00 00 00 00 02 2B 39
				39 00 00 00 00 00 02 2C 01
				39 00 00 00 00 00 02 2D 47
				39 00 00 00 00 00 02 2E 01
				39 00 00 00 00 00 02 2F 56
				39 00 00 00 00 00 02 30 01
				39 00 00 00 00 00 02 31 65
				39 00 00 00 00 00 02 32 01
				39 00 00 00 00 00 02 33 74
				39 00 00 00 00 00 02 34 01
				39 00 00 00 00 00 02 35 82
				39 00 00 00 00 00 02 36 01
				39 00 00 00 00 00 02 37 9F
				39 00 00 00 00 00 02 38 01
				39 00 00 00 00 00 02 39 BC
				39 00 00 00 00 00 02 3A 01
				39 00 00 00 00 00 02 3B D8
				39 00 00 00 00 00 02 3C 01
				39 00 00 00 00 00 02 3D F5
				39 00 00 00 00 00 02 3E 02
				39 00 00 00 00 00 02 3F 13
				39 00 00 00 00 00 02 40 02
				39 00 00 00 00 00 02 41 32
				39 00 00 00 00 00 02 42 02
				39 00 00 00 00 00 02 43 4F
				39 00 00 00 00 00 02 44 02
				39 00 00 00 00 00 02 45 6C
				39 00 00 00 00 00 02 46 02
				39 00 00 00 00 00 02 47 89
				39 00 00 00 00 00 02 48 02
				39 00 00 00 00 00 02 49 A7
				39 00 00 00 00 00 02 4A 02
				39 00 00 00 00 00 02 4B C5
				39 00 00 00 00 00 02 4C 02
				39 00 00 00 00 00 02 4D E0
				39 00 00 00 00 00 02 4E 02
				39 00 00 00 00 00 02 4F FC
				39 00 00 00 00 00 02 50 03
				39 00 00 00 00 00 02 51 1B
				39 00 00 00 00 00 02 52 03
				39 00 00 00 00 00 02 53 39
				39 00 00 00 00 00 02 54 03
				39 00 00 00 00 00 02 55 58
				39 00 00 00 00 00 02 56 03
				39 00 00 00 00 00 02 57 77
				39 00 00 00 00 00 02 58 03
				39 00 00 00 00 00 02 59 94
				39 00 00 00 00 00 02 5A 03
				39 01 00 00 00 00 02 5B B1
				39 00 00 00 00 00 04 FF 98 81 07
				39 00 00 00 00 00 04 FF 98 81 07
				39 00 00 00 00 00 02 00 00
				39 00 00 00 00 00 02 01 00
				39 00 00 00 00 00 02 02 00
				39 00 00 00 00 00 02 03 07
				39 00 00 00 00 00 02 04 00
				39 00 00 00 00 00 02 05 15
				39 00 00 00 00 00 02 06 00
				39 00 00 00 00 00 02 07 25
				39 00 00 00 00 00 02 08 00
				39 00 00 00 00 00 02 09 32
				39 00 00 00 00 00 02 0A 00
				39 00 00 00 00 00 02 0B 3B
				39 00 00 00 00 00 02 0C 00
				39 00 00 00 00 00 02 0D 42
				39 00 00 00 00 00 02 0E 00
				39 00 00 00 00 00 02 0F 4F
				39 00 00 00 00 00 02 10 00
				39 00 00 00 00 00 02 11 5D
				39 00 00 00 00 00 02 12 00
				39 00 00 00 00 00 02 13 6B
				39 00 00 00 00 00 02 14 00
				39 00 00 00 00 00 02 15 79
				39 00 00 00 00 00 02 16 00
				39 00 00 00 00 00 02 17 86
				39 00 00 00 00 00 02 18 00
				39 00 00 00 00 00 02 19 93
				39 00 00 00 00 00 02 1A 00
				39 00 00 00 00 00 02 1B A1
				39 00 00 00 00 00 02 1C 00
				39 00 00 00 00 00 02 1D AE
				39 00 00 00 00 00 02 1E 00
				39 00 00 00 00 00 02 1F BB
				39 00 00 00 00 00 02 20 00
				39 00 00 00 00 00 02 21 C7
				39 00 00 00 00 00 02 22 00
				39 00 00 00 00 00 02 23 D4
				39 00 00 00 00 00 02 24 00
				39 00 00 00 00 00 02 25 E2
				39 00 00 00 00 00 02 26 00
				39 00 00 00 00 00 02 27 F0
				39 00 00 00 00 00 02 28 00
				39 00 00 00 00 00 02 29 FD
				39 00 00 00 00 00 02 2A 01
				39 00 00 00 00 00 02 2B 0A
				39 00 00 00 00 00 02 2C 01
				39 00 00 00 00 00 02 2D 16
				39 00 00 00 00 00 02 2E 01
				39 00 00 00 00 00 02 2F 23
				39 00 00 00 00 00 02 30 01
				39 00 00 00 00 00 02 31 2F
				39 00 00 00 00 00 02 32 01
				39 00 00 00 00 00 02 33 3A
				39 00 00 00 00 00 02 34 01
				39 00 00 00 00 00 02 35 46
				39 00 00 00 00 00 02 36 01
				39 00 00 00 00 00 02 37 60
				39 00 00 00 00 00 02 38 01
				39 00 00 00 00 00 02 39 79
				39 00 00 00 00 00 02 3A 01
				39 00 00 00 00 00 02 3B 91
				39 00 00 00 00 00 02 3C 01
				39 00 00 00 00 00 02 3D A9
				39 00 00 00 00 00 02 3E 01
				39 00 00 00 00 00 02 3F C3
				39 00 00 00 00 00 02 40 01
				39 00 00 00 00 00 02 41 DC
				39 00 00 00 00 00 02 42 01
				39 00 00 00 00 00 02 43 F4
				39 00 00 00 00 00 02 44 02
				39 00 00 00 00 00 02 45 0E
				39 00 00 00 00 00 02 46 02
				39 00 00 00 00 00 02 47 28
				39 00 00 00 00 00 02 48 02
				39 00 00 00 00 00 02 49 42
				39 00 00 00 00 00 02 4A 02
				39 00 00 00 00 00 02 4B 5A
				39 00 00 00 00 00 02 4C 02
				39 00 00 00 00 00 02 4D 72
				39 00 00 00 00 00 02 4E 02
				39 00 00 00 00 00 02 4F 8B
				39 00 00 00 00 00 02 50 02
				39 00 00 00 00 00 02 51 A5
				39 00 00 00 00 00 02 52 02
				39 00 00 00 00 00 02 53 BF
				39 00 00 00 00 00 02 54 02
				39 00 00 00 00 00 02 55 D5
				39 00 00 00 00 00 02 56 02
				39 00 00 00 00 00 02 57 ED
				39 00 00 00 00 00 02 58 03
				39 00 00 00 00 00 02 59 06
				39 00 00 00 00 00 02 5A 03
				39 00 00 00 00 00 02 5B 20
				39 00 00 00 00 00 04 FF 98 81 00
				39 01 00 00 00 00 04 FF 98 81 00];

		qcom,mdss-dsi-level6-command = [39 00 00 00 00 00 04 FF 98 81 01
				39 00 00 00 00 00 04 FF 98 81 01
				39 00 00 00 00 00 02 A0 1B
				39 00 00 00 00 00 02 A1 35
				39 00 00 00 00 00 02 A2 44
				39 00 00 00 00 00 02 A3 13
				39 00 00 00 00 00 02 A4 16
				39 00 00 00 00 00 02 A5 2A
				39 00 00 00 00 00 02 A6 1E
				39 00 00 00 00 00 02 A7 1E
				39 00 00 00 00 00 02 A8 B7
				39 00 00 00 00 00 02 A9 1C
				39 00 00 00 00 00 02 AA 28
				39 00 00 00 00 00 02 AB 9F
				39 00 00 00 00 00 02 AC 1F
				39 00 00 00 00 00 02 AD 1E
				39 00 00 00 00 00 02 AE 53
				39 00 00 00 00 00 02 AF 27
				39 00 00 00 00 00 02 B0 2A
				39 00 00 00 00 00 02 B1 59
				39 00 00 00 00 00 02 B2 65
				39 00 00 00 00 00 02 B3 32
				39 00 00 00 00 00 02 C0 1B
				39 00 00 00 00 00 02 C1 35
				39 00 00 00 00 00 02 C2 44
				39 00 00 00 00 00 02 C3 13
				39 00 00 00 00 00 02 C4 16
				39 00 00 00 00 00 02 C5 2A
				39 00 00 00 00 00 02 C6 1E
				39 00 00 00 00 00 02 C7 1E
				39 00 00 00 00 00 02 C8 B7
				39 00 00 00 00 00 02 C9 1C
				39 00 00 00 00 00 02 CA 28
				39 00 00 00 00 00 02 CB 9F
				39 00 00 00 00 00 02 CC 1F
				39 00 00 00 00 00 02 CD 1E
				39 00 00 00 00 00 02 CE 53
				39 00 00 00 00 00 02 CF 27
				39 00 00 00 00 00 02 D0 2A
				39 00 00 00 00 00 02 D1 59
				39 00 00 00 00 00 02 D2 65
				39 01 00 00 00 00 02 D3 32
				39 00 00 00 00 00 04 FF 98 81 05
				39 00 00 00 00 00 04 FF 98 81 05
				39 00 00 00 00 00 02 85 48
				39 00 00 00 00 00 02 00 00
				39 00 00 00 00 00 02 01 00
				39 00 00 00 00 00 02 02 00
				39 00 00 00 00 00 02 03 12
				39 00 00 00 00 00 02 04 00
				39 00 00 00 00 00 02 05 21
				39 00 00 00 00 00 02 06 00
				39 00 00 00 00 00 02 07 31
				39 00 00 00 00 00 02 08 00
				39 00 00 00 00 00 02 09 40
				39 00 00 00 00 00 02 0A 00
				39 00 00 00 00 00 02 0B 51
				39 00 00 00 00 00 02 0C 00
				39 00 00 00 00 00 02 0D 62
				39 00 00 00 00 00 02 0E 00
				39 00 00 00 00 00 02 0F 73
				39 00 00 00 00 00 02 10 00
				39 00 00 00 00 00 02 11 82
				39 00 00 00 00 00 02 12 00
				39 00 00 00 00 00 02 13 92
				39 00 00 00 00 00 02 14 00
				39 00 00 00 00 00 02 15 A2
				39 00 00 00 00 00 02 16 00
				39 00 00 00 00 00 02 17 B2
				39 00 00 00 00 00 02 18 00
				39 00 00 00 00 00 02 19 C2
				39 00 00 00 00 00 02 1A 00
				39 00 00 00 00 00 02 1B D2
				39 00 00 00 00 00 02 1C 00
				39 00 00 00 00 00 02 1D E4
				39 00 00 00 00 00 02 1E 00
				39 00 00 00 00 00 02 1F F4
				39 00 00 00 00 00 02 20 01
				39 00 00 00 00 00 02 21 05
				39 00 00 00 00 00 02 22 01
				39 00 00 00 00 00 02 23 15
				39 00 00 00 00 00 02 24 01
				39 00 00 00 00 00 02 25 25
				39 00 00 00 00 00 02 26 01
				39 00 00 00 00 00 02 27 34
				39 00 00 00 00 00 02 28 01
				39 00 00 00 00 00 02 29 43
				39 00 00 00 00 00 02 2A 01
				39 00 00 00 00 00 02 2B 53
				39 00 00 00 00 00 02 2C 01
				39 00 00 00 00 00 02 2D 63
				39 00 00 00 00 00 02 2E 01
				39 00 00 00 00 00 02 2F 73
				39 00 00 00 00 00 02 30 01
				39 00 00 00 00 00 02 31 83
				39 00 00 00 00 00 02 32 01
				39 00 00 00 00 00 02 33 92
				39 00 00 00 00 00 02 34 01
				39 00 00 00 00 00 02 35 A2
				39 00 00 00 00 00 02 36 01
				39 00 00 00 00 00 02 37 BF
				39 00 00 00 00 00 02 38 01
				39 00 00 00 00 00 02 39 DF
				39 00 00 00 00 00 02 3A 01
				39 00 00 00 00 00 02 3B FE
				39 00 00 00 00 00 02 3C 02
				39 00 00 00 00 00 02 3D 1F
				39 00 00 00 00 00 02 3E 02
				39 00 00 00 00 00 02 3F 40
				39 00 00 00 00 00 02 40 02
				39 00 00 00 00 00 02 41 5E
				39 00 00 00 00 00 02 42 02
				39 00 00 00 00 00 02 43 7D
				39 00 00 00 00 00 02 44 02
				39 00 00 00 00 00 02 45 9E
				39 00 00 00 00 00 02 46 02
				39 00 00 00 00 00 02 47 BF
				39 00 00 00 00 00 02 48 02
				39 00 00 00 00 00 02 49 DC
				39 00 00 00 00 00 02 4A 02
				39 00 00 00 00 00 02 4B FA
				39 00 00 00 00 00 02 4C 03
				39 00 00 00 00 00 02 4D 1C
				39 00 00 00 00 00 02 4E 03
				39 00 00 00 00 00 02 4F 3C
				39 00 00 00 00 00 02 50 03
				39 00 00 00 00 00 02 51 5A
				39 00 00 00 00 00 02 52 03
				39 00 00 00 00 00 02 53 7A
				39 00 00 00 00 00 02 54 03
				39 00 00 00 00 00 02 55 9B
				39 00 00 00 00 00 02 56 03
				39 00 00 00 00 00 02 57 C0
				39 00 00 00 00 00 02 58 03
				39 00 00 00 00 00 02 59 DD
				39 00 00 00 00 00 02 5A 03
				39 01 00 00 00 00 02 5B F7
				39 00 00 00 00 00 04 FF 98 81 06
				39 00 00 00 00 00 04 FF 98 81 06
				39 00 00 00 00 00 02 00 00
				39 00 00 00 00 00 02 01 00
				39 00 00 00 00 00 02 02 00
				39 00 00 00 00 00 02 03 0E
				39 00 00 00 00 00 02 04 00
				39 00 00 00 00 00 02 05 1D
				39 00 00 00 00 00 02 06 00
				39 00 00 00 00 00 02 07 2C
				39 00 00 00 00 00 02 08 00
				39 00 00 00 00 00 02 09 39
				39 00 00 00 00 00 02 0A 00
				39 00 00 00 00 00 02 0B 48
				39 00 00 00 00 00 02 0C 00
				39 00 00 00 00 00 02 0D 56
				39 00 00 00 00 00 02 0E 00
				39 00 00 00 00 00 02 0F 65
				39 00 00 00 00 00 02 10 00
				39 00 00 00 00 00 02 11 74
				39 00 00 00 00 00 02 12 00
				39 00 00 00 00 00 02 13 83
				39 00 00 00 00 00 02 14 00
				39 00 00 00 00 00 02 15 90
				39 00 00 00 00 00 02 16 00
				39 00 00 00 00 00 02 17 9F
				39 00 00 00 00 00 02 18 00
				39 00 00 00 00 00 02 19 AE
				39 00 00 00 00 00 02 1A 00
				39 00 00 00 00 00 02 1B BD
				39 00 00 00 00 00 02 1C 00
				39 00 00 00 00 00 02 1D CA
				39 00 00 00 00 00 02 1E 00
				39 00 00 00 00 00 02 1F D9
				39 00 00 00 00 00 02 20 00
				39 00 00 00 00 00 02 21 E8
				39 00 00 00 00 00 02 22 00
				39 00 00 00 00 00 02 23 F8
				39 00 00 00 00 00 02 24 01
				39 00 00 00 00 00 02 25 07
				39 00 00 00 00 00 02 26 01
				39 00 00 00 00 00 02 27 16
				39 00 00 00 00 00 02 28 01
				39 00 00 00 00 00 02 29 23
				39 00 00 00 00 00 02 2A 01
				39 00 00 00 00 00 02 2B 30
				39 00 00 00 00 00 02 2C 01
				39 00 00 00 00 00 02 2D 3E
				39 00 00 00 00 00 02 2E 01
				39 00 00 00 00 00 02 2F 4C
				39 00 00 00 00 00 02 30 01
				39 00 00 00 00 00 02 31 5B
				39 00 00 00 00 00 02 32 01
				39 00 00 00 00 00 02 33 69
				39 00 00 00 00 00 02 34 01
				39 00 00 00 00 00 02 35 77
				39 00 00 00 00 00 02 36 01
				39 00 00 00 00 00 02 37 93
				39 00 00 00 00 00 02 38 01
				39 00 00 00 00 00 02 39 AF
				39 00 00 00 00 00 02 3A 01
				39 00 00 00 00 00 02 3B CB
				39 00 00 00 00 00 02 3C 01
				39 00 00 00 00 00 02 3D E7
				39 00 00 00 00 00 02 3E 02
				39 00 00 00 00 00 02 3F 04
				39 00 00 00 00 00 02 40 02
				39 00 00 00 00 00 02 41 21
				39 00 00 00 00 00 02 42 02
				39 00 00 00 00 00 02 43 3F
				39 00 00 00 00 00 02 44 02
				39 00 00 00 00 00 02 45 5A
				39 00 00 00 00 00 02 46 02
				39 00 00 00 00 00 02 47 76
				39 00 00 00 00 00 02 48 02
				39 00 00 00 00 00 02 49 93
				39 00 00 00 00 00 02 4A 02
				39 00 00 00 00 00 02 4B B1
				39 00 00 00 00 00 02 4C 02
				39 00 00 00 00 00 02 4D CC
				39 00 00 00 00 00 02 4E 02
				39 00 00 00 00 00 02 4F E7
				39 00 00 00 00 00 02 50 03
				39 00 00 00 00 00 02 51 03
				39 00 00 00 00 00 02 52 03
				39 00 00 00 00 00 02 53 21
				39 00 00 00 00 00 02 54 03
				39 00 00 00 00 00 02 55 3F
				39 00 00 00 00 00 02 56 03
				39 00 00 00 00 00 02 57 5C
				39 00 00 00 00 00 02 58 03
				39 00 00 00 00 00 02 59 79
				39 00 00 00 00 00 02 5A 03
				39 01 00 00 00 00 02 5B 96
				39 00 00 00 00 00 04 FF 98 81 07
				39 00 00 00 00 00 04 FF 98 81 07
				39 00 00 00 00 00 02 00 00
				39 00 00 00 00 00 02 01 00
				39 00 00 00 00 00 02 02 00
				39 00 00 00 00 00 02 03 08
				39 00 00 00 00 00 02 04 00
				39 00 00 00 00 00 02 05 11
				39 00 00 00 00 00 02 06 00
				39 00 00 00 00 00 02 07 22
				39 00 00 00 00 00 02 08 00
				39 00 00 00 00 00 02 09 2E
				39 00 00 00 00 00 02 0A 00
				39 00 00 00 00 00 02 0B 37
				39 00 00 00 00 00 02 0C 00
				39 00 00 00 00 00 02 0D 3C
				39 00 00 00 00 00 02 0E 00
				39 00 00 00 00 00 02 0F 49
				39 00 00 00 00 00 02 10 00
				39 00 00 00 00 00 02 11 57
				39 00 00 00 00 00 02 12 00
				39 00 00 00 00 00 02 13 64
				39 00 00 00 00 00 02 14 00
				39 00 00 00 00 00 02 15 72
				39 00 00 00 00 00 02 16 00
				39 00 00 00 00 00 02 17 7F
				39 00 00 00 00 00 02 18 00
				39 00 00 00 00 00 02 19 8A
				39 00 00 00 00 00 02 1A 00
				39 00 00 00 00 00 02 1B 97
				39 00 00 00 00 00 02 1C 00
				39 00 00 00 00 00 02 1D A4
				39 00 00 00 00 00 02 1E 00
				39 00 00 00 00 00 02 1F B1
				39 00 00 00 00 00 02 20 00
				39 00 00 00 00 00 02 21 BD
				39 00 00 00 00 00 02 22 00
				39 00 00 00 00 00 02 23 C8
				39 00 00 00 00 00 02 24 00
				39 00 00 00 00 00 02 25 D4
				39 00 00 00 00 00 02 26 00
				39 00 00 00 00 00 02 27 E2
				39 00 00 00 00 00 02 28 00
				39 00 00 00 00 00 02 29 EF
				39 00 00 00 00 00 02 2A 00
				39 00 00 00 00 00 02 2B FC
				39 00 00 00 00 00 02 2C 01
				39 00 00 00 00 00 02 2D 08
				39 00 00 00 00 00 02 2E 01
				39 00 00 00 00 00 02 2F 14
				39 00 00 00 00 00 02 30 01
				39 00 00 00 00 00 02 31 20
				39 00 00 00 00 00 02 32 01
				39 00 00 00 00 00 02 33 2B
				39 00 00 00 00 00 02 34 01
				39 00 00 00 00 00 02 35 36
				39 00 00 00 00 00 02 36 01
				39 00 00 00 00 00 02 37 4D
				39 00 00 00 00 00 02 38 01
				39 00 00 00 00 00 02 39 65
				39 00 00 00 00 00 02 3A 01
				39 00 00 00 00 00 02 3B 7D
				39 00 00 00 00 00 02 3C 01
				39 00 00 00 00 00 02 3D 94
				39 00 00 00 00 00 02 3E 01
				39 00 00 00 00 00 02 3F AB
				39 00 00 00 00 00 02 40 01
				39 00 00 00 00 00 02 41 C3
				39 00 00 00 00 00 02 42 01
				39 00 00 00 00 00 02 43 DB
				39 00 00 00 00 00 02 44 01
				39 00 00 00 00 00 02 45 F2
				39 00 00 00 00 00 02 46 02
				39 00 00 00 00 00 02 47 0A
				39 00 00 00 00 00 02 48 02
				39 00 00 00 00 00 02 49 23
				39 00 00 00 00 00 02 4A 02
				39 00 00 00 00 00 02 4B 3C
				39 00 00 00 00 00 02 4C 02
				39 00 00 00 00 00 02 4D 53
				39 00 00 00 00 00 02 4E 02
				39 00 00 00 00 00 02 4F 69
				39 00 00 00 00 00 02 50 02
				39 00 00 00 00 00 02 51 81
				39 00 00 00 00 00 02 52 02
				39 00 00 00 00 00 02 53 99
				39 00 00 00 00 00 02 54 02
				39 00 00 00 00 00 02 55 B2
				39 00 00 00 00 00 02 56 02
				39 00 00 00 00 00 02 57 C9
				39 00 00 00 00 00 02 58 02
				39 00 00 00 00 00 02 59 DF
				39 00 00 00 00 00 02 5A 02
				39 00 00 00 00 00 02 5B F5
				39 00 00 00 00 00 04 FF 98 81 00
				39 01 00 00 00 00 04 FF 98 81 00];


		qcom,mdss-dsi-level7-command = [39 00 00 00 00 00 04 FF 98 81 01
				39 00 00 00 00 00 04 FF 98 81 01
				39 00 00 00 00 00 02 A0 1B
				39 00 00 00 00 00 02 A1 35
				39 00 00 00 00 00 02 A2 44
				39 00 00 00 00 00 02 A3 13
				39 00 00 00 00 00 02 A4 16
				39 00 00 00 00 00 02 A5 2A
				39 00 00 00 00 00 02 A6 1E
				39 00 00 00 00 00 02 A7 1E
				39 00 00 00 00 00 02 A8 B7
				39 00 00 00 00 00 02 A9 1C
				39 00 00 00 00 00 02 AA 28
				39 00 00 00 00 00 02 AB 9F
				39 00 00 00 00 00 02 AC 1F
				39 00 00 00 00 00 02 AD 1E
				39 00 00 00 00 00 02 AE 53
				39 00 00 00 00 00 02 AF 27
				39 00 00 00 00 00 02 B0 2A
				39 00 00 00 00 00 02 B1 59
				39 00 00 00 00 00 02 B2 65
				39 00 00 00 00 00 02 B3 32
				39 00 00 00 00 00 02 C0 1B
				39 00 00 00 00 00 02 C1 35
				39 00 00 00 00 00 02 C2 44
				39 00 00 00 00 00 02 C3 13
				39 00 00 00 00 00 02 C4 16
				39 00 00 00 00 00 02 C5 2A
				39 00 00 00 00 00 02 C6 1E
				39 00 00 00 00 00 02 C7 1E
				39 00 00 00 00 00 02 C8 B7
				39 00 00 00 00 00 02 C9 1C
				39 00 00 00 00 00 02 CA 28
				39 00 00 00 00 00 02 CB 9F
				39 00 00 00 00 00 02 CC 1F
				39 00 00 00 00 00 02 CD 1E
				39 00 00 00 00 00 02 CE 53
				39 00 00 00 00 00 02 CF 27
				39 00 00 00 00 00 02 D0 2A
				39 00 00 00 00 00 02 D1 59
				39 00 00 00 00 00 02 D2 65
				39 01 00 00 00 00 02 D3 32
				39 00 00 00 00 00 04 FF 98 81 05
				39 00 00 00 00 00 04 FF 98 81 05
				39 00 00 00 00 00 02 85 48
				39 00 00 00 00 00 02 00 00
				39 00 00 00 00 00 02 01 00
				39 00 00 00 00 00 02 02 00
				39 00 00 00 00 00 02 03 13
				39 00 00 00 00 00 02 04 00
				39 00 00 00 00 00 02 05 21
				39 00 00 00 00 00 02 06 00
				39 00 00 00 00 00 02 07 31
				39 00 00 00 00 00 02 08 00
				39 00 00 00 00 00 02 09 40
				39 00 00 00 00 00 02 0A 00
				39 00 00 00 00 00 02 0B 51
				39 00 00 00 00 00 02 0C 00
				39 00 00 00 00 00 02 0D 62
				39 00 00 00 00 00 02 0E 00
				39 00 00 00 00 00 02 0F 73
				39 00 00 00 00 00 02 10 00
				39 00 00 00 00 00 02 11 82
				39 00 00 00 00 00 02 12 00
				39 00 00 00 00 00 02 13 92
				39 00 00 00 00 00 02 14 00
				39 00 00 00 00 00 02 15 A3
				39 00 00 00 00 00 02 16 00
				39 00 00 00 00 00 02 17 B2
				39 00 00 00 00 00 02 18 00
				39 00 00 00 00 00 02 19 C2
				39 00 00 00 00 00 02 1A 00
				39 00 00 00 00 00 02 1B D2
				39 00 00 00 00 00 02 1C 00
				39 00 00 00 00 00 02 1D E4
				39 00 00 00 00 00 02 1E 00
				39 00 00 00 00 00 02 1F F4
				39 00 00 00 00 00 02 20 01
				39 00 00 00 00 00 02 21 05
				39 00 00 00 00 00 02 22 01
				39 00 00 00 00 00 02 23 15
				39 00 00 00 00 00 02 24 01
				39 00 00 00 00 00 02 25 25
				39 00 00 00 00 00 02 26 01
				39 00 00 00 00 00 02 27 34
				39 00 00 00 00 00 02 28 01
				39 00 00 00 00 00 02 29 43
				39 00 00 00 00 00 02 2A 01
				39 00 00 00 00 00 02 2B 53
				39 00 00 00 00 00 02 2C 01
				39 00 00 00 00 00 02 2D 63
				39 00 00 00 00 00 02 2E 01
				39 00 00 00 00 00 02 2F 73
				39 00 00 00 00 00 02 30 01
				39 00 00 00 00 00 02 31 83
				39 00 00 00 00 00 02 32 01
				39 00 00 00 00 00 02 33 92
				39 00 00 00 00 00 02 34 01
				39 00 00 00 00 00 02 35 A2
				39 00 00 00 00 00 02 36 01
				39 00 00 00 00 00 02 37 BF
				39 00 00 00 00 00 02 38 01
				39 00 00 00 00 00 02 39 DF
				39 00 00 00 00 00 02 3A 01
				39 00 00 00 00 00 02 3B FE
				39 00 00 00 00 00 02 3C 02
				39 00 00 00 00 00 02 3D 1F
				39 00 00 00 00 00 02 3E 02
				39 00 00 00 00 00 02 3F 40
				39 00 00 00 00 00 02 40 02
				39 00 00 00 00 00 02 41 5E
				39 00 00 00 00 00 02 42 02
				39 00 00 00 00 00 02 43 7D
				39 00 00 00 00 00 02 44 02
				39 00 00 00 00 00 02 45 9E
				39 00 00 00 00 00 02 46 02
				39 00 00 00 00 00 02 47 BF
				39 00 00 00 00 00 02 48 02
				39 00 00 00 00 00 02 49 DC
				39 00 00 00 00 00 02 4A 02
				39 00 00 00 00 00 02 4B FA
				39 00 00 00 00 00 02 4C 03
				39 00 00 00 00 00 02 4D 1C
				39 00 00 00 00 00 02 4E 03
				39 00 00 00 00 00 02 4F 3C
				39 00 00 00 00 00 02 50 03
				39 00 00 00 00 00 02 51 5A
				39 00 00 00 00 00 02 52 03
				39 00 00 00 00 00 02 53 7A
				39 00 00 00 00 00 02 54 03
				39 00 00 00 00 00 02 55 9B
				39 00 00 00 00 00 02 56 03
				39 00 00 00 00 00 02 57 C0
				39 00 00 00 00 00 02 58 03
				39 00 00 00 00 00 02 59 DD
				39 00 00 00 00 00 02 5A 03
				39 01 00 00 00 00 02 5B F7
				39 00 00 00 00 00 04 FF 98 81 06
				39 00 00 00 00 00 04 FF 98 81 06
				39 00 00 00 00 00 02 00 00
				39 00 00 00 00 00 02 01 00
				39 00 00 00 00 00 02 02 00
				39 00 00 00 00 00 02 03 0E
				39 00 00 00 00 00 02 04 00
				39 00 00 00 00 00 02 05 1C
				39 00 00 00 00 00 02 06 00
				39 00 00 00 00 00 02 07 2B
				39 00 00 00 00 00 02 08 00
				39 00 00 00 00 00 02 09 38
				39 00 00 00 00 00 02 0A 00
				39 00 00 00 00 00 02 0B 46
				39 00 00 00 00 00 02 0C 00
				39 00 00 00 00 00 02 0D 55
				39 00 00 00 00 00 02 0E 00
				39 00 00 00 00 00 02 0F 63
				39 00 00 00 00 00 02 10 00
				39 00 00 00 00 00 02 11 72
				39 00 00 00 00 00 02 12 00
				39 00 00 00 00 00 02 13 80
				39 00 00 00 00 00 02 14 00
				39 00 00 00 00 00 02 15 8D
				39 00 00 00 00 00 02 16 00
				39 00 00 00 00 00 02 17 9C
				39 00 00 00 00 00 02 18 00
				39 00 00 00 00 00 02 19 AA
				39 00 00 00 00 00 02 1A 00
				39 00 00 00 00 00 02 1B B9
				39 00 00 00 00 00 02 1C 00
				39 00 00 00 00 00 02 1D C6
				39 00 00 00 00 00 02 1E 00
				39 00 00 00 00 00 02 1F D4
				39 00 00 00 00 00 02 20 00
				39 00 00 00 00 00 02 21 E3
				39 00 00 00 00 00 02 22 00
				39 00 00 00 00 00 02 23 F3
				39 00 00 00 00 00 02 24 01
				39 00 00 00 00 00 02 25 02
				39 00 00 00 00 00 02 26 01
				39 00 00 00 00 00 02 27 10
				39 00 00 00 00 00 02 28 01
				39 00 00 00 00 00 02 29 1D
				39 00 00 00 00 00 02 2A 01
				39 00 00 00 00 00 02 2B 2A
				39 00 00 00 00 00 02 2C 01
				39 00 00 00 00 00 02 2D 37
				39 00 00 00 00 00 02 2E 01
				39 00 00 00 00 00 02 2F 45
				39 00 00 00 00 00 02 30 01
				39 00 00 00 00 00 02 31 53
				39 00 00 00 00 00 02 32 01
				39 00 00 00 00 00 02 33 61
				39 00 00 00 00 00 02 34 01
				39 00 00 00 00 00 02 35 6F
				39 00 00 00 00 00 02 36 01
				39 00 00 00 00 00 02 37 8A
				39 00 00 00 00 00 02 38 01
				39 00 00 00 00 00 02 39 A6
				39 00 00 00 00 00 02 3A 01
				39 00 00 00 00 00 02 3B C1
				39 00 00 00 00 00 02 3C 01
				39 00 00 00 00 00 02 3D DC
				39 00 00 00 00 00 02 3E 01
				39 00 00 00 00 00 02 3F F8
				39 00 00 00 00 00 02 40 02
				39 00 00 00 00 00 02 41 15
				39 00 00 00 00 00 02 42 02
				39 00 00 00 00 00 02 43 32
				39 00 00 00 00 00 02 44 02
				39 00 00 00 00 00 02 45 4E
				39 00 00 00 00 00 02 46 02
				39 00 00 00 00 00 02 47 68
				39 00 00 00 00 00 02 48 02
				39 00 00 00 00 00 02 49 84
				39 00 00 00 00 00 02 4A 02
				39 00 00 00 00 00 02 4B A1
				39 00 00 00 00 00 02 4C 02
				39 00 00 00 00 00 02 4D BE
				39 00 00 00 00 00 02 4E 02
				39 00 00 00 00 00 02 4F D7
				39 00 00 00 00 00 02 50 02
				39 00 00 00 00 00 02 51 F2
				39 00 00 00 00 00 02 52 03
				39 00 00 00 00 00 02 53 0E
				39 00 00 00 00 00 02 54 03
				39 00 00 00 00 00 02 55 2D
				39 00 00 00 00 00 02 56 03
				39 00 00 00 00 00 02 57 48
				39 00 00 00 00 00 02 58 03
				39 00 00 00 00 00 02 59 66
				39 00 00 00 00 00 02 5A 03
				39 01 00 00 00 00 02 5B 81
				39 00 00 00 00 00 04 FF 98 81 07
				39 00 00 00 00 00 04 FF 98 81 07
				39 00 00 00 00 00 02 00 00
				39 00 00 00 00 00 02 01 00
				39 00 00 00 00 00 02 02 00
				39 00 00 00 00 00 02 03 07
				39 00 00 00 00 00 02 04 00
				39 00 00 00 00 00 02 05 11
				39 00 00 00 00 00 02 06 00
				39 00 00 00 00 00 02 07 1E
				39 00 00 00 00 00 02 08 00
				39 00 00 00 00 00 02 09 2A
				39 00 00 00 00 00 02 0A 00
				39 00 00 00 00 00 02 0B 32
				39 00 00 00 00 00 02 0C 00
				39 00 00 00 00 00 02 0D 37
				39 00 00 00 00 00 02 0E 00
				39 00 00 00 00 00 02 0F 42
				39 00 00 00 00 00 02 10 00
				39 00 00 00 00 00 02 11 50
				39 00 00 00 00 00 02 12 00
				39 00 00 00 00 00 02 13 5C
				39 00 00 00 00 00 02 14 00
				39 00 00 00 00 00 02 15 6A
				39 00 00 00 00 00 02 16 00
				39 00 00 00 00 00 02 17 76
				39 00 00 00 00 00 02 18 00
				39 00 00 00 00 00 02 19 82
				39 00 00 00 00 00 02 1A 00
				39 00 00 00 00 00 02 1B 8D
				39 00 00 00 00 00 02 1C 00
				39 00 00 00 00 00 02 1D 99
				39 00 00 00 00 00 02 1E 00
				39 00 00 00 00 00 02 1F A5
				39 00 00 00 00 00 02 20 00
				39 00 00 00 00 00 02 21 B2
				39 00 00 00 00 00 02 22 00
				39 00 00 00 00 00 02 23 BC
				39 00 00 00 00 00 02 24 00
				39 00 00 00 00 00 02 25 C7
				39 00 00 00 00 00 02 26 00
				39 00 00 00 00 00 02 27 D3
				39 00 00 00 00 00 02 28 00
				39 00 00 00 00 00 02 29 DF
				39 00 00 00 00 00 02 2A 00
				39 00 00 00 00 00 02 2B EC
				39 00 00 00 00 00 02 2C 00
				39 00 00 00 00 00 02 2D F8
				39 00 00 00 00 00 02 2E 01
				39 00 00 00 00 00 02 2F 04
				39 00 00 00 00 00 02 30 01
				39 00 00 00 00 00 02 31 0F
				39 00 00 00 00 00 02 32 01
				39 00 00 00 00 00 02 33 1A
				39 00 00 00 00 00 02 34 01
				39 00 00 00 00 00 02 35 25
				39 00 00 00 00 00 02 36 01
				39 00 00 00 00 00 02 37 3A
				39 00 00 00 00 00 02 38 01
				39 00 00 00 00 00 02 39 50
				39 00 00 00 00 00 02 3A 01
				39 00 00 00 00 00 02 3B 67
				39 00 00 00 00 00 02 3C 01
				39 00 00 00 00 00 02 3D 7D
				39 00 00 00 00 00 02 3E 01
				39 00 00 00 00 00 02 3F 92
				39 00 00 00 00 00 02 40 01
				39 00 00 00 00 00 02 41 A8
				39 00 00 00 00 00 02 42 01
				39 00 00 00 00 00 02 43 BF
				39 00 00 00 00 00 02 44 01
				39 00 00 00 00 00 02 45 D5
				39 00 00 00 00 00 02 46 01
				39 00 00 00 00 00 02 47 EB
				39 00 00 00 00 00 02 48 02
				39 00 00 00 00 00 02 49 02
				39 00 00 00 00 00 02 4A 02
				39 00 00 00 00 00 02 4B 19
				39 00 00 00 00 00 02 4C 02
				39 00 00 00 00 00 02 4D 30
				39 00 00 00 00 00 02 4E 02
				39 00 00 00 00 00 02 4F 47
				39 00 00 00 00 00 02 50 02
				39 00 00 00 00 00 02 51 5C
				39 00 00 00 00 00 02 52 02
				39 00 00 00 00 00 02 53 71
				39 00 00 00 00 00 02 54 02
				39 00 00 00 00 00 02 55 87
				39 00 00 00 00 00 02 56 02
				39 00 00 00 00 00 02 57 9E
				39 00 00 00 00 00 02 58 02
				39 00 00 00 00 00 02 59 B6
				39 00 00 00 00 00 02 5A 02
				39 00 00 00 00 00 02 5B CB
				39 00 00 00 00 00 04 FF 98 81 00
				39 01 00 00 00 00 04 FF 98 81 00];

		qcom,mdss-dsi-level8-command = [
				39 00 00 00 00 00 04 FF 98 81 01
				39 00 00 00 00 00 04 FF 98 81 01
				39 00 00 00 00 00 02 A0 1B
				39 00 00 00 00 00 02 A1 35
				39 00 00 00 00 00 02 A2 44
				39 00 00 00 00 00 02 A3 13
				39 00 00 00 00 00 02 A4 16
				39 00 00 00 00 00 02 A5 2A
				39 00 00 00 00 00 02 A6 1E
				39 00 00 00 00 00 02 A7 1E
				39 00 00 00 00 00 02 A8 B7
				39 00 00 00 00 00 02 A9 1C
				39 00 00 00 00 00 02 AA 28
				39 00 00 00 00 00 02 AB 9F
				39 00 00 00 00 00 02 AC 1F
				39 00 00 00 00 00 02 AD 1E
				39 00 00 00 00 00 02 AE 53
				39 00 00 00 00 00 02 AF 27
				39 00 00 00 00 00 02 B0 2A
				39 00 00 00 00 00 02 B1 59
				39 00 00 00 00 00 02 B2 65
				39 00 00 00 00 00 02 B3 32
				39 00 00 00 00 00 02 C0 1B
				39 00 00 00 00 00 02 C1 35
				39 00 00 00 00 00 02 C2 44
				39 00 00 00 00 00 02 C3 13
				39 00 00 00 00 00 02 C4 16
				39 00 00 00 00 00 02 C5 2A
				39 00 00 00 00 00 02 C6 1E
				39 00 00 00 00 00 02 C7 1E
				39 00 00 00 00 00 02 C8 B7
				39 00 00 00 00 00 02 C9 1C
				39 00 00 00 00 00 02 CA 28
				39 00 00 00 00 00 02 CB 9F
				39 00 00 00 00 00 02 CC 1F
				39 00 00 00 00 00 02 CD 1E
				39 00 00 00 00 00 02 CE 53
				39 00 00 00 00 00 02 CF 27
				39 00 00 00 00 00 02 D0 2A
				39 00 00 00 00 00 02 D1 59
				39 00 00 00 00 00 02 D2 65
				39 01 00 00 00 00 02 D3 32
				39 00 00 00 00 00 04 FF 98 81 05
				39 00 00 00 00 00 04 FF 98 81 05
				39 00 00 00 00 00 02 85 48
				39 00 00 00 00 00 02 00 00
				39 00 00 00 00 00 02 01 00
				39 00 00 00 00 00 02 02 00
				39 00 00 00 00 00 02 03 14
				39 00 00 00 00 00 02 04 00
				39 00 00 00 00 00 02 05 22
				39 00 00 00 00 00 02 06 00
				39 00 00 00 00 00 02 07 32
				39 00 00 00 00 00 02 08 00
				39 00 00 00 00 00 02 09 41
				39 00 00 00 00 00 02 0A 00
				39 00 00 00 00 00 02 0B 51
				39 00 00 00 00 00 02 0C 00
				39 00 00 00 00 00 02 0D 63
				39 00 00 00 00 00 02 0E 00
				39 00 00 00 00 00 02 0F 73
				39 00 00 00 00 00 02 10 00
				39 00 00 00 00 00 02 11 83
				39 00 00 00 00 00 02 12 00
				39 00 00 00 00 00 02 13 93
				39 00 00 00 00 00 02 14 00
				39 00 00 00 00 00 02 15 A3
				39 00 00 00 00 00 02 16 00
				39 00 00 00 00 00 02 17 B3
				39 00 00 00 00 00 02 18 00
				39 00 00 00 00 00 02 19 C3
				39 00 00 00 00 00 02 1A 00
				39 00 00 00 00 00 02 1B D2
				39 00 00 00 00 00 02 1C 00
				39 00 00 00 00 00 02 1D E4
				39 00 00 00 00 00 02 1E 00
				39 00 00 00 00 00 02 1F F4
				39 00 00 00 00 00 02 20 01
				39 00 00 00 00 00 02 21 05
				39 00 00 00 00 00 02 22 01
				39 00 00 00 00 00 02 23 15
				39 00 00 00 00 00 02 24 01
				39 00 00 00 00 00 02 25 25
				39 00 00 00 00 00 02 26 01
				39 00 00 00 00 00 02 27 34
				39 00 00 00 00 00 02 28 01
				39 00 00 00 00 00 02 29 43
				39 00 00 00 00 00 02 2A 01
				39 00 00 00 00 00 02 2B 53
				39 00 00 00 00 00 02 2C 01
				39 00 00 00 00 00 02 2D 63
				39 00 00 00 00 00 02 2E 01
				39 00 00 00 00 00 02 2F 73
				39 00 00 00 00 00 02 30 01
				39 00 00 00 00 00 02 31 83
				39 00 00 00 00 00 02 32 01
				39 00 00 00 00 00 02 33 92
				39 00 00 00 00 00 02 34 01
				39 00 00 00 00 00 02 35 A2
				39 00 00 00 00 00 02 36 01
				39 00 00 00 00 00 02 37 BF
				39 00 00 00 00 00 02 38 01
				39 00 00 00 00 00 02 39 DF
				39 00 00 00 00 00 02 3A 01
				39 00 00 00 00 00 02 3B FF
				39 00 00 00 00 00 02 3C 02
				39 00 00 00 00 00 02 3D 1F
				39 00 00 00 00 00 02 3E 02
				39 00 00 00 00 00 02 3F 40
				39 00 00 00 00 00 02 40 02
				39 00 00 00 00 00 02 41 5E
				39 00 00 00 00 00 02 42 02
				39 00 00 00 00 00 02 43 7D
				39 00 00 00 00 00 02 44 02
				39 00 00 00 00 00 02 45 9E
				39 00 00 00 00 00 02 46 02
				39 00 00 00 00 00 02 47 BF
				39 00 00 00 00 00 02 48 02
				39 00 00 00 00 00 02 49 DC
				39 00 00 00 00 00 02 4A 02
				39 00 00 00 00 00 02 4B FA
				39 00 00 00 00 00 02 4C 03
				39 00 00 00 00 00 02 4D 1C
				39 00 00 00 00 00 02 4E 03
				39 00 00 00 00 00 02 4F 3C
				39 00 00 00 00 00 02 50 03
				39 00 00 00 00 00 02 51 5A
				39 00 00 00 00 00 02 52 03
				39 00 00 00 00 00 02 53 7A
				39 00 00 00 00 00 02 54 03
				39 00 00 00 00 00 02 55 9B
				39 00 00 00 00 00 02 56 03
				39 00 00 00 00 00 02 57 C0
				39 00 00 00 00 00 02 58 03
				39 00 00 00 00 00 02 59 DD
				39 00 00 00 00 00 02 5A 03
				39 01 00 00 00 00 02 5B F7
				39 00 00 00 00 00 04 FF 98 81 06
				39 00 00 00 00 00 04 FF 98 81 06
				39 00 00 00 00 00 02 00 00
				39 00 00 00 00 00 02 01 00
				39 00 00 00 00 00 02 02 00
				39 00 00 00 00 00 02 03 0D
				39 00 00 00 00 00 02 04 00
				39 00 00 00 00 00 02 05 1B
				39 00 00 00 00 00 02 06 00
				39 00 00 00 00 00 02 07 28
				39 00 00 00 00 00 02 08 00
				39 00 00 00 00 00 02 09 35
				39 00 00 00 00 00 02 0A 00
				39 00 00 00 00 00 02 0B 42
				39 00 00 00 00 00 02 0C 00
				39 00 00 00 00 00 02 0D 50
				39 00 00 00 00 00 02 0E 00
				39 00 00 00 00 00 02 0F 5C
				39 00 00 00 00 00 02 10 00
				39 00 00 00 00 00 02 11 6A
				39 00 00 00 00 00 02 12 00
				39 00 00 00 00 00 02 13 78
				39 00 00 00 00 00 02 14 00
				39 00 00 00 00 00 02 15 85
				39 00 00 00 00 00 02 16 00
				39 00 00 00 00 00 02 17 92
				39 00 00 00 00 00 02 18 00
				39 00 00 00 00 00 02 19 A0
				39 00 00 00 00 00 02 1A 00
				39 00 00 00 00 00 02 1B AE
				39 00 00 00 00 00 02 1C 00
				39 00 00 00 00 00 02 1D BB
				39 00 00 00 00 00 02 1E 00
				39 00 00 00 00 00 02 1F C7
				39 00 00 00 00 00 02 20 00
				39 00 00 00 00 00 02 21 D5
				39 00 00 00 00 00 02 22 00
				39 00 00 00 00 00 02 23 E3
				39 00 00 00 00 00 02 24 00
				39 00 00 00 00 00 02 25 F2
				39 00 00 00 00 00 02 26 01
				39 00 00 00 00 00 02 27 00
				39 00 00 00 00 00 02 28 01
				39 00 00 00 00 00 02 29 0D
				39 00 00 00 00 00 02 2A 01
				39 00 00 00 00 00 02 2B 1A
				39 00 00 00 00 00 02 2C 01
				39 00 00 00 00 00 02 2D 26
				39 00 00 00 00 00 02 2E 01
				39 00 00 00 00 00 02 2F 33
				39 00 00 00 00 00 02 30 01
				39 00 00 00 00 00 02 31 3F
				39 00 00 00 00 00 02 32 01
				39 00 00 00 00 00 02 33 4C
				39 00 00 00 00 00 02 34 01
				39 00 00 00 00 00 02 35 5A
				39 00 00 00 00 00 02 36 01
				39 00 00 00 00 00 02 37 74
				39 00 00 00 00 00 02 38 01
				39 00 00 00 00 00 02 39 8E
				39 00 00 00 00 00 02 3A 01
				39 00 00 00 00 00 02 3B A8
				39 00 00 00 00 00 02 3C 01
				39 00 00 00 00 00 02 3D C1
				39 00 00 00 00 00 02 3E 01
				39 00 00 00 00 00 02 3F DB
				39 00 00 00 00 00 02 40 01
				39 00 00 00 00 00 02 41 F5
				39 00 00 00 00 00 02 42 02
				39 00 00 00 00 00 02 43 10
				39 00 00 00 00 00 02 44 02
				39 00 00 00 00 00 02 45 2B
				39 00 00 00 00 00 02 46 02
				39 00 00 00 00 00 02 47 46
				39 00 00 00 00 00 02 48 02
				39 00 00 00 00 00 02 49 5F
				39 00 00 00 00 00 02 4A 02
				39 00 00 00 00 00 02 4B 79
				39 00 00 00 00 00 02 4C 02
				39 00 00 00 00 00 02 4D 93
				39 00 00 00 00 00 02 4E 02
				39 00 00 00 00 00 02 4F AF
				39 00 00 00 00 00 02 50 02
				39 00 00 00 00 00 02 51 C9
				39 00 00 00 00 00 02 52 02
				39 00 00 00 00 00 02 53 E1
				39 00 00 00 00 00 02 54 02
				39 00 00 00 00 00 02 55 FA
				39 00 00 00 00 00 02 56 03
				39 00 00 00 00 00 02 57 15
				39 00 00 00 00 00 02 58 03
				39 00 00 00 00 00 02 59 32
				39 00 00 00 00 00 02 5A 03
				39 01 00 00 00 00 02 5B 4C
				39 00 00 00 00 00 04 FF 98 81 07
				39 00 00 00 00 00 04 FF 98 81 07
				39 00 00 00 00 00 02 00 00
				39 00 00 00 00 00 02 01 00
				39 00 00 00 00 00 02 02 00
				39 00 00 00 00 00 02 03 04
				39 00 00 00 00 00 02 04 00
				39 00 00 00 00 00 02 05 0B
				39 00 00 00 00 00 02 06 00
				39 00 00 00 00 00 02 07 18
				39 00 00 00 00 00 02 08 00
				39 00 00 00 00 00 02 09 22
				39 00 00 00 00 00 02 0A 00
				39 00 00 00 00 00 02 0B 2A
				39 00 00 00 00 00 02 0C 00
				39 00 00 00 00 00 02 0D 2D
				39 00 00 00 00 00 02 0E 00
				39 00 00 00 00 00 02 0F 38
				39 00 00 00 00 00 02 10 00
				39 00 00 00 00 00 02 11 44
				39 00 00 00 00 00 02 12 00
				39 00 00 00 00 00 02 13 51
				39 00 00 00 00 00 02 14 00
				39 00 00 00 00 00 02 15 5C
				39 00 00 00 00 00 02 16 00
				39 00 00 00 00 00 02 17 68
				39 00 00 00 00 00 02 18 00
				39 00 00 00 00 00 02 19 73
				39 00 00 00 00 00 02 1A 00
				39 00 00 00 00 00 02 1B 7E
				39 00 00 00 00 00 02 1C 00
				39 00 00 00 00 00 02 1D 88
				39 00 00 00 00 00 02 1E 00
				39 00 00 00 00 00 02 1F 93
				39 00 00 00 00 00 02 20 00
				39 00 00 00 00 00 02 21 9E
				39 00 00 00 00 00 02 22 00
				39 00 00 00 00 00 02 23 A9
				39 00 00 00 00 00 02 24 00
				39 00 00 00 00 00 02 25 B4
				39 00 00 00 00 00 02 26 00
				39 00 00 00 00 00 02 27 BD
				39 00 00 00 00 00 02 28 00
				39 00 00 00 00 00 02 29 C7
				39 00 00 00 00 00 02 2A 00
				39 00 00 00 00 00 02 2B D1
				39 00 00 00 00 00 02 2C 00
				39 00 00 00 00 00 02 2D DC
				39 00 00 00 00 00 02 2E 00
				39 00 00 00 00 00 02 2F E8
				39 00 00 00 00 00 02 30 00
				39 00 00 00 00 00 02 31 F3
				39 00 00 00 00 00 02 32 00
				39 00 00 00 00 00 02 33 FE
				39 00 00 00 00 00 02 34 01
				39 00 00 00 00 00 02 35 08
				39 00 00 00 00 00 02 36 01
				39 00 00 00 00 00 02 37 1D
				39 00 00 00 00 00 02 38 01
				39 00 00 00 00 00 02 39 30
				39 00 00 00 00 00 02 3A 01
				39 00 00 00 00 00 02 3B 43
				39 00 00 00 00 00 02 3C 01
				39 00 00 00 00 00 02 3D 57
				39 00 00 00 00 00 02 3E 01
				39 00 00 00 00 00 02 3F 6B
				39 00 00 00 00 00 02 40 01
				39 00 00 00 00 00 02 41 7F
				39 00 00 00 00 00 02 42 01
				39 00 00 00 00 00 02 43 92
				39 00 00 00 00 00 02 44 01
				39 00 00 00 00 00 02 45 A6
				39 00 00 00 00 00 02 46 01
				39 00 00 00 00 00 02 47 BB
				39 00 00 00 00 00 02 48 01
				39 00 00 00 00 00 02 49 CE
				39 00 00 00 00 00 02 4A 01
				39 00 00 00 00 00 02 4B E2
				39 00 00 00 00 00 02 4C 01
				39 00 00 00 00 00 02 4D F6
				39 00 00 00 00 00 02 4E 02
				39 00 00 00 00 00 02 4F 0B
				39 00 00 00 00 00 02 50 02
				39 00 00 00 00 00 02 51 1F
				39 00 00 00 00 00 02 52 02
				39 00 00 00 00 00 02 53 35
				39 00 00 00 00 00 02 54 02
				39 00 00 00 00 00 02 55 49
				39 00 00 00 00 00 02 56 02
				39 00 00 00 00 00 02 57 5C
				39 00 00 00 00 00 02 58 02
				39 00 00 00 00 00 02 59 6F
				39 00 00 00 00 00 02 5A 02
				39 00 00 00 00 00 02 5B 83
				39 00 00 00 00 00 04 FF 98 81 00
				39 01 00 00 00 00 04 FF 98 81 00
		];
		qcom,mdss-dsi-china-ce-on-command = [
				39 00 00 00 00 00 04 FF 98 81 02
				39 00 00 00 00 00 04 FF 98 81 02
				39 00 00 00 00 00 02 10 16
				39 00 00 00 00 00 02 68 03
				39 00 00 00 00 00 02 69 03
				39 00 00 00 00 00 02 6A 03
				39 00 00 00 00 00 02 6B 03
				39 00 00 00 00 00 02 6C 03
				39 00 00 00 00 00 02 6D 03
				39 00 00 00 00 00 02 6E 03
				39 00 00 00 00 00 02 6F 03
				39 00 00 00 00 00 02 70 03
				39 00 00 00 00 00 02 71 03
				39 00 00 00 00 00 02 72 03
				39 00 00 00 00 00 02 73 03
				39 00 00 00 00 00 02 74 03
				39 00 00 00 00 00 02 75 03
				39 00 00 00 00 00 02 76 03
				39 00 00 00 00 00 02 77 03
				39 00 00 00 00 00 02 78 03
				39 00 00 00 00 00 02 79 03
				39 00 00 00 00 00 02 7A 03
				39 00 00 00 00 00 02 7B 03
				39 00 00 00 00 00 02 7C 03
				39 00 00 00 00 00 02 7D 03
				39 00 00 00 00 00 02 7E 03
				39 00 00 00 00 00 02 7F 03
				39 00 00 00 00 00 04 FF 98 81 00
				39 01 00 00 00 00 04 FF 98 81 00
	];

		qcom,mdss-dsi-india-ce-on-command = [
				39 00 00 00 00 00 04 FF 98 81 02
				39 00 00 00 00 00 04 FF 98 81 02
				39 00 00 00 00 00 02 10 16
				39 00 00 00 00 00 02 68 06
				39 00 00 00 00 00 02 69 06
				39 00 00 00 00 00 02 6A 06
				39 00 00 00 00 00 02 6B 06
				39 00 00 00 00 00 02 6C 06
				39 00 00 00 00 00 02 6D 06
				39 00 00 00 00 00 02 6E 06
				39 00 00 00 00 00 02 6F 06
				39 00 00 00 00 00 02 70 06
				39 00 00 00 00 00 02 71 06
				39 00 00 00 00 00 02 72 06
				39 00 00 00 00 00 02 73 06
				39 00 00 00 00 00 02 74 06
				39 00 00 00 00 00 02 75 06
				39 00 00 00 00 00 02 76 06
				39 00 00 00 00 00 02 77 06
				39 00 00 00 00 00 02 78 06
				39 00 00 00 00 00 02 79 06
				39 00 00 00 00 00 02 7A 06
				39 00 00 00 00 00 02 7B 06
				39 00 00 00 00 00 02 7C 06
				39 00 00 00 00 00 02 7D 06
				39 00 00 00 00 00 02 7E 06
				39 00 00 00 00 00 02 7F 06
				39 00 00 00 00 00 04 FF 98 81 00
				39 01 00 00 00 00 04 FF 98 81 00
];

		qcom,mdss-dsi-ce-off-command = [
				39 01 00 00 00 00 04 FF 98 81 02
				39 01 00 00 00 00 04 FF 98 81 02
				39 01 00 00 00 00 02 10 06
				39 01 00 00 00 00 04 FF 98 81 00
				39 01 00 00 00 00 04 FF 98 81 00
];
		qcom,mdss-dsi-on-command-state = "dsi_lp_mode";
		qcom,mdss-dsi-off-command-state = "dsi_hs_mode";
		qcom,mdss-dsi-warm-command-state = "dsi_hs_mode";
		qcom,mdss-dsi-cold-command-state = "dsi_hs_mode";
		qcom,mdss-dsi-default-command-state = "dsi_hs_mode";
		qcom,mdss-dsi-level1-command-state = "dsi_hs_mode";
		qcom,mdss-dsi-level2-command-state = "dsi_hs_mode";
		qcom,mdss-dsi-level3-command-state = "dsi_hs_mode";
		qcom,mdss-dsi-level4-command-state = "dsi_hs_mode";
		qcom,mdss-dsi-level5-command-state = "dsi_hs_mode";
		qcom,mdss-dsi-level6-command-state = "dsi_hs_mode";
		qcom,mdss-dsi-level7-command-state = "dsi_hs_mode";
		qcom,mdss-dsi-level8-command-state = "dsi_hs_mode";
		qcom,mdss-dsi-ce-on-command-state = "dsi_hs_mode";
		qcom,mdss-dsi-ce-off-command-state = "dsi_hs_mode";
		qcom,mdss-dsi-h-sync-pulse = <1>;
		qcom,mdss-dsi-traffic-mode = "burst_mode";
		qcom,mdss-dsi-lane-map = "lane_map_0123";
		qcom,mdss-dsi-bllp-eof-power-mode;
		qcom,mdss-dsi-bllp-power-mode;
		qcom,cont-splash-enabled;
		qcom,mdss-dsi-lane-0-state;
		qcom,mdss-dsi-lane-1-state;
		qcom,mdss-dsi-lane-2-state;
		qcom,mdss-dsi-lane-3-state;
		qcom,mdss-dsi-panel-timings = [87 1C 12 00 42 44 18 20 17 03 04 00];
		qcom,mdss-dsi-t-clk-post = <0x04>;
		qcom,mdss-dsi-t-clk-pre = <0x27>;
		qcom,mdss-dsi-dma-trigger = "trigger_sw";
		qcom,mdss-dsi-mdp-trigger = "none";
		qcom,mdss-dsi-bl-pmic-control-type = "bl_ctrl_dcs";
		qcom,mdss-dsi-bl-min-level = <1>;
		qcom,mdss-dsi-bl-max-level = <255>;
		qcom,mdss-pan-physical-width-dimension = <68>;
		qcom,mdss-pan-physical-height-dimension = <121>;
		qcom,mdss-dsi-reset-sequence = <1 10>, <0 1>, <1 20>;
		qcom,mdss-dsi-tx-eot-append;
		qcom,esd-check-enabled;
		qcom,mdss-dsi-panel-status-command = [06 01 00 01 05 00 02 0A];
		qcom,mdss-dsi-panel-status-command-state = "dsi_lp_mode";
		qcom,mdss-dsi-panel-status-check-mode = "reg_read";
		qcom,mdss-dsi-panel-status-read-length = <1>;
		qcom,mdss-dsi-panel-status-valid-params = <1>;
		qcom,mdss-dsi-panel-max-error-count = <3>;
		qcom,mdss-dsi-panel-status-value = <0x9c>;
	};
};

