/* Copyright (c) 2014, The Linux Foundation. All rights reserved.
 *
 * This program is free software; you can redistribute it and/or modify
 * it under the terms of the GNU General Public License version 2 and
 * only version 2 as published by the Free Software Foundation.
 *
 * This program is distributed in the hope that it will be useful,
 * but WITHOUT ANY WARRANTY; without even the implied warranty of
 * MERCHANTABILITY or FITNESS FOR A PARTICULAR PURPOSE.  See the
 * GNU General Public License for more details.
 */

/ {

	qcom,rmtfs_sharedmem@0fd80000 {
		compatible = "qcom,sharedmem-uio";
		reg = <0x0fd80000 0x00180000>;
		reg-names = "rmtfs";
		qcom,client-id = <0x00000001>;
	};

	qcom,dsp_sharedmem@0fd60000 {
		compatible = "qcom,sharedmem-uio";
		reg = <0x0fd60000 0x00020000>;
		reg-names = "rfsa_dsp";
		qcom,client-id = <0x011013ec>;
	};

	qcom,mdm_sharedmem@0fd60000 {
		compatible = "qcom,sharedmem-uio";
		reg = <0x0fd60000 0x00020000>;
		reg-names = "rfsa_mdm";
		qcom,client-id = <0x011013ed>;
	};
};
