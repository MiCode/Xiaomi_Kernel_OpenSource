/* Copyright (c) 2015, The Linux Foundation. All rights reserved.
 *
 * This program is free software; you can redistribute it and/or modify
 * it under the terms of the GNU General Public License version 2 and
 * only version 2 as published by the Free Software Foundation.
 *
 * This program is distributed in the hope that it will be useful,
 * but WITHOUT ANY WARRANTY; without even the implied warranty of
 * MERCHANTABILITY or FITNESS FOR A PARTICULAR PURPOSE.  See the
 * GNU General Public License for more details.
 */

/dts-v1/;

#include "msm8996-v3.dtsi"
#include "msm8996-pm8994-pm8004.dtsi"
#include "msm8996-agave-adp.dtsi"

/ {
	model = "Qualcomm Technologies, Inc. MSM 8996 v3 + PM8004 ADP";
	compatible = "qcom,msm8996-adp", "qcom,msm8996", "qcom,adp";
	qcom,board-id = <0x00010019 0>;
};

&spi_9 {
	status = "ok";
	can-controller@0 {
		compatible = "renesas,rh850";
		reg = <0>;
		interrupt-parent = <&tlmm>;
		interrupts = <122 0>;
		spi-max-frequency = <5000000>;
	};
};
