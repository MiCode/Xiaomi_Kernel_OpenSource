/* Copyright (c) 2012-2015, The Linux Foundation. All rights reserved.
 * Copyright (C) 2019 XiaoMi, Inc.
 *
 * This program is free software; you can redistribute it and/or modify
 * it under the terms of the GNU General Public License version 2 and
 * only version 2 as published by the Free Software Foundation.
 *
 * This program is distributed in the hope that it will be useful,
 * but WITHOUT ANY WARRANTY; without even the implied warranty of
 * MERCHANTABILITY or FITNESS FOR A PARTICULAR PURPOSE.  See the
 * GNU General Public License for more details.
 */

&mdss_mdp {
	dsi_ili7807_fhd_vid: qcom,mdss_dsi_ili7807_fhd_video {
		qcom,mdss-dsi-panel-name = "ili7807 fhd video mode dsi panel";
		qcom,mdss-dsi-panel-type = "dsi_video_mode";
		qcom,mdss-dsi-panel-framerate = <60>;
		qcom,mdss-dsi-virtual-channel-id = <0>;
		qcom,mdss-dsi-stream = <0>;
		qcom,mdss-dsi-panel-width = <1080>;
		qcom,mdss-dsi-panel-height = <1920>;
		qcom,mdss-dsi-h-front-porch = <84>;
		qcom,mdss-dsi-h-back-porch = <80>;
		qcom,mdss-dsi-h-pulse-width = <24>;
		qcom,mdss-dsi-h-sync-skew = <0>;
		qcom,mdss-dsi-v-back-porch = <16>;
		qcom,mdss-dsi-v-front-porch = <22>;
		qcom,mdss-dsi-v-pulse-width = <8>;
		qcom,mdss-dsi-h-left-border = <0>;
		qcom,mdss-dsi-h-right-border = <0>;
		qcom,mdss-dsi-v-top-border = <0>;
		qcom,mdss-dsi-v-bottom-border = <0>;
		qcom,mdss-dsi-bpp = <24>;
		qcom,mdss-dsi-underflow-color = <0xff>;
		qcom,mdss-dsi-border-color = <0>;
		qcom,mdss-dsi-on-command = [39 01 00 00 00 00 04 ff 78 07 05
					    39 01 00 00 00 00 02 03 60
					    39 01 00 00 00 00 02 04 03
					    39 01 00 00 00 00 02 00 34
					    39 01 00 00 00 00 04 ff 78 07 00
					    39 01 00 00 00 00 02 35 00
					    39 01 00 00 00 00 03 51 0f ff
					    39 01 00 00 00 00 02 53 2c
					    39 01 00 00 00 00 02 55 00
					    39 01 00 00 78 00 02 11 00
					    39 01 00 00 00 00 04 ff 78 07 06
					    39 01 00 00 00 00 02 B2 22
					    39 01 00 00 00 00 02 A2 07
					    39 01 00 00 00 00 02 A3 1E
					    //39 01 00 00 00 00 02 10 02
					    //39 01 00 00 00 00 02 12 02
					    39 01 00 00 00 00 04 ff 78 07 01
					    39 01 00 00 00 00 02 65 04
					    39 01 00 00 00 00 02 66 04
					    39 01 00 00 00 00 02 6d 04
					    //39 01 00 00 00 00 02 28 81
					    39 01 00 00 00 00 04 ff 78 07 00
					    39 01 00 00 14 00 02 29 00];
		qcom,mdss-dsi-off-command = [39 01 00 00 14 00 02 28 00
					     39 01 00 00 78 00 02 10 00];
                qcom,mdss-dsi-CE_on-command = [29 00 00 00 00 00 04 FF 78 07 05
						29 00 00 00 00 00 02 30 06
						29 00 00 00 00 00 02 31 10
						29 00 00 00 00 00 02 38 07
						29 00 00 00 00 00 02 39 09
						29 00 00 00 00 00 02 3A 0C
						29 00 00 00 00 00 02 40 02
						29 00 00 00 00 00 02 41 02
						29 00 00 00 00 00 02 42 02
						29 00 00 00 00 00 02 43 02
						29 00 00 00 00 00 02 44 02
						29 00 00 00 00 00 02 45 03
						29 00 00 00 00 00 02 46 03
						29 00 00 00 00 00 02 47 03
						29 00 00 00 00 00 02 48 03
						29 00 00 00 00 00 02 49 03
						29 00 00 00 00 00 02 4A 03
						29 00 00 00 00 00 02 4B 03
						29 00 00 00 00 00 02 4C 03
						29 00 00 00 00 00 02 4D 03
						29 00 00 00 00 00 02 4E 02
						29 00 00 00 00 00 02 4F 02
						29 00 00 00 00 00 02 50 02
						29 00 00 00 00 00 02 51 02
						29 00 00 00 00 00 02 52 02
						29 00 00 00 00 00 02 53 02
						29 00 00 00 00 00 02 54 02
						29 00 00 00 00 00 02 55 02
						29 00 00 00 00 00 02 56 02
						29 00 00 00 00 00 02 57 02
						29 01 00 00 00 00 04 FF 78 07 00];

                qcom,mdss-dsi-CE_off-command = [
						29 01 00 00 00 00 04 FF 78 07 05
						29 01 00 00 00 00 02 31 00
						29 01 00 00 00 00 04 FF 78 07 00];

                qcom,mdss-dsi-CABC_on-command = [
						29 00 00 00 00 00 04 FF 78 07 00  //Page0
						29 00 00 00 00 00 03 51 0F FF
						29 00 00 00 00 00 02 53 2C
						29 00 00 00 00 00 02 55 01

						29 00 00 00 00 00 04 FF 78 07 05  //Page5
						29 00 00 00 00 00 02 10 0A
						29 01 00 00 00 00 04 FF 78 07 00];

                qcom,mdss-dsi-CABC_off-command = [
						29 00 00 00 00 00 04 FF 78 07 00  //Page0
						29 00 00 00 00 00 03 51 0F FF
						29 00 00 00 00 00 02 53 2C
						29 00 00 00 00 00 02 55 00
						29 00 00 00 00 00 04 FF 78 07 05  //Page5
						29 00 00 00 00 00 02 10 14

						29 01 00 00 00 00 04 FF 78 07 00];

                qcom,mdss-dsi-default_gamma-command = [
						29 00 00 00 00 00 04 FF 78 07 07
						29 00 00 00 00 00 02 37 00
						29 01 00 00 00 00 02 50 08
						29 00 00 00 00 00 04 FF 78 07 00
						29 01 00 00 0A 00 02 11 00
						29 00 00 00 00 00 04 FF 78 07 07
						29 00 00 00 00 00 02 37 01
						29 01 00 00 00 00 02 50 09
						29 00 00 00 00 00 04 ff 78 07 06
					  29 00 00 00 00 00 02 B2 22
					  29 00 00 00 00 00 02 A2 07
					  29 00 00 00 00 00 02 A3 1E
					    29 00 00 00 00 00 04 ff 78 07 01
					    29 00 00 00 00 00 02 65 04
					    29 00 00 00 00 00 02 66 04
					    29 00 00 00 00 00 02 6d 04
					  29 00 00 00 00 00 04 ff 78 07 00
					  29 00 00 00 14 00 02 29 00];

                 qcom,mdss-dsi-cold_gamma-command = [

29 00 00 00 00 00 04 FF 78 07 02
29 00 00 00 00 00 02 00 00
29 00 00 00 00 00 02 01 B4
29 00 00 00 00 00 02 02 00
29 00 00 00 00 00 02 03 BD
29 00 00 00 00 00 02 04 00
29 00 00 00 00 00 02 05 CC
29 00 00 00 00 00 02 06 00
29 00 00 00 00 00 02 07 DD
29 00 00 00 00 00 02 08 00
29 00 00 00 00 00 02 09 E7
29 00 00 00 00 00 02 0A 00
29 00 00 00 00 00 02 0B F1
29 00 00 00 00 00 02 0C 00
29 00 00 00 00 00 02 0D FD
29 00 00 00 00 00 02 0E 01
29 00 00 00 00 00 02 0F 0C
29 00 00 00 00 00 02 10 01
29 00 00 00 00 00 02 11 16
29 00 00 00 00 00 02 12 01
29 00 00 00 00 00 02 13 38
29 00 00 00 00 00 02 14 01
29 00 00 00 00 00 02 15 56
29 00 00 00 00 00 02 16 01
29 00 00 00 00 00 02 17 88
29 00 00 00 00 00 02 18 01
29 00 00 00 00 00 02 19 AE
29 00 00 00 00 00 02 1A 01
29 00 00 00 00 00 02 1B EE
29 00 00 00 00 00 02 1C 02
29 00 00 00 00 00 02 1D 24
29 00 00 00 00 00 02 1E 02
29 00 00 00 00 00 02 1F 25
29 00 00 00 00 00 02 20 02
29 00 00 00 00 00 02 21 5C
29 00 00 00 00 00 02 22 02
29 00 00 00 00 00 02 23 9A
29 00 00 00 00 00 02 24 02
29 00 00 00 00 00 02 25 C3
29 00 00 00 00 00 02 26 02
29 00 00 00 00 00 02 27 F8
29 00 00 00 00 00 02 28 03
29 00 00 00 00 00 02 29 1B
29 00 00 00 00 00 02 2A 03
29 00 00 00 00 00 02 2B 49
29 00 00 00 00 00 02 2C 03
29 00 00 00 00 00 02 2D 56
29 00 00 00 00 00 02 2E 03
29 00 00 00 00 00 02 2F 65
29 00 00 00 00 00 02 30 03
29 00 00 00 00 00 02 31 74
29 00 00 00 00 00 02 32 03
29 00 00 00 00 00 02 33 87
29 00 00 00 00 00 02 34 03
29 00 00 00 00 00 02 35 9E
29 00 00 00 00 00 02 36 03
29 00 00 00 00 00 02 37 B1
29 00 00 00 00 00 02 38 03
29 00 00 00 00 00 02 39 D9
29 00 00 00 00 00 02 3A 03
29 00 00 00 00 00 02 3B DC
29 00 00 00 00 00 02 3C 00
29 00 00 00 00 00 02 3D B4
29 00 00 00 00 00 02 3E 00
29 00 00 00 00 00 02 3F BD
29 00 00 00 00 00 02 78 01
29 00 00 00 00 00 02 79 01
29 01 00 00 00 00 04 FF 78 07 00

29 00 00 00 00 00 04 FF 78 07 02
29 00 00 00 00 00 02 40 00
29 00 00 00 00 00 02 41 CC
29 00 00 00 00 00 02 42 00
29 00 00 00 00 00 02 43 DD
29 00 00 00 00 00 02 44 00
29 00 00 00 00 00 02 45 E7
29 00 00 00 00 00 02 46 00
29 00 00 00 00 00 02 47 F1
29 00 00 00 00 00 02 48 00
29 00 00 00 00 00 02 49 FD
29 00 00 00 00 00 02 4A 01
29 00 00 00 00 00 02 4B 0C
29 00 00 00 00 00 02 4C 01
29 00 00 00 00 00 02 4D 16
29 00 00 00 00 00 02 4E 01
29 00 00 00 00 00 02 4F 38
29 00 00 00 00 00 02 50 01
29 00 00 00 00 00 02 51 56
29 00 00 00 00 00 02 52 01
29 00 00 00 00 00 02 53 88
29 00 00 00 00 00 02 54 01
29 00 00 00 00 00 02 55 AE
29 00 00 00 00 00 02 56 01
29 00 00 00 00 00 02 57 EE
29 00 00 00 00 00 02 58 02
29 00 00 00 00 00 02 59 24
29 00 00 00 00 00 02 5A 02
29 00 00 00 00 00 02 5B 25
29 00 00 00 00 00 02 5C 02
29 00 00 00 00 00 02 5D 5C
29 00 00 00 00 00 02 5E 02
29 00 00 00 00 00 02 5F 9A
29 00 00 00 00 00 02 60 02
29 00 00 00 00 00 02 61 C3
29 00 00 00 00 00 02 62 02
29 00 00 00 00 00 02 63 F8
29 00 00 00 00 00 02 64 03
29 00 00 00 00 00 02 65 1B
29 00 00 00 00 00 02 66 03
29 00 00 00 00 00 02 67 49
29 00 00 00 00 00 02 68 03
29 00 00 00 00 00 02 69 56
29 00 00 00 00 00 02 6A 03
29 00 00 00 00 00 02 6B 65
29 00 00 00 00 00 02 6C 03
29 00 00 00 00 00 02 6D 74
29 00 00 00 00 00 02 6E 03
29 00 00 00 00 00 02 6F 87
29 00 00 00 00 00 02 70 03
29 00 00 00 00 00 02 71 9E
29 00 00 00 00 00 02 72 03
29 00 00 00 00 00 02 73 B1
29 00 00 00 00 00 02 74 03
29 00 00 00 00 00 02 75 D9
29 00 00 00 00 00 02 76 03
29 00 00 00 00 00 02 77 DC
29 00 00 00 00 00 02 78 01
29 00 00 00 00 00 02 79 01
29 01 00 00 00 00 04 FF 78 07 00

29 00 00 00 00 00 04 FF 78 07 03
29 00 00 00 00 00 02 00 00
29 00 00 00 00 00 02 01 91
29 00 00 00 00 00 02 02 00
29 00 00 00 00 00 02 03 99
29 00 00 00 00 00 02 04 00
29 00 00 00 00 00 02 05 AC
29 00 00 00 00 00 02 06 00
29 00 00 00 00 00 02 07 BF
29 00 00 00 00 00 02 08 00
29 00 00 00 00 00 02 09 CD
29 00 00 00 00 00 02 0A 00
29 00 00 00 00 00 02 0B DB
29 00 00 00 00 00 02 0C 00
29 00 00 00 00 00 02 0D E7
29 00 00 00 00 00 02 0E 00
29 00 00 00 00 00 02 0F F2
29 00 00 00 00 00 02 10 00
29 00 00 00 00 00 02 11 FD
29 00 00 00 00 00 02 12 01
29 00 00 00 00 00 02 13 24
29 00 00 00 00 00 02 14 01
29 00 00 00 00 00 02 15 45
29 00 00 00 00 00 02 16 01
29 00 00 00 00 00 02 17 79
29 00 00 00 00 00 02 18 01
29 00 00 00 00 00 02 19 A3
29 00 00 00 00 00 02 1A 01
29 00 00 00 00 00 02 1B E6
29 00 00 00 00 00 02 1C 02
29 00 00 00 00 00 02 1D 1D
29 00 00 00 00 00 02 1E 02
29 00 00 00 00 00 02 1F 1F
29 00 00 00 00 00 02 20 02
29 00 00 00 00 00 02 21 56
29 00 00 00 00 00 02 22 02
29 00 00 00 00 00 02 23 97
29 00 00 00 00 00 02 24 02
29 00 00 00 00 00 02 25 C0
29 00 00 00 00 00 02 26 02
29 00 00 00 00 00 02 27 F6
29 00 00 00 00 00 02 28 03
29 00 00 00 00 00 02 29 18
29 00 00 00 00 00 02 2A 03
29 00 00 00 00 00 02 2B 44
29 00 00 00 00 00 02 2C 03
29 00 00 00 00 00 02 2D 52
29 00 00 00 00 00 02 2E 03
29 00 00 00 00 00 02 2F 62
29 00 00 00 00 00 02 30 03
29 00 00 00 00 00 02 31 74
29 00 00 00 00 00 02 32 03
29 00 00 00 00 00 02 33 89
29 00 00 00 00 00 02 34 03
29 00 00 00 00 00 02 35 A2
29 00 00 00 00 00 02 36 03
29 00 00 00 00 00 02 37 C2
29 00 00 00 00 00 02 38 03
29 00 00 00 00 00 02 39 DB
29 00 00 00 00 00 02 3A 03
29 00 00 00 00 00 02 3B DC
29 00 00 00 00 00 02 3C 00
29 00 00 00 00 00 02 3D 91
29 00 00 00 00 00 02 3E 00
29 00 00 00 00 00 02 3F 99
29 00 00 00 00 00 02 78 01
29 00 00 00 00 00 02 79 01
29 01 00 00 00 00 04 FF 78 07 00

29 00 00 00 00 00 04 FF 78 07 03
29 00 00 00 00 00 02 40 00
29 00 00 00 00 00 02 41 AC
29 00 00 00 00 00 02 42 00
29 00 00 00 00 00 02 43 BF
29 00 00 00 00 00 02 44 00
29 00 00 00 00 00 02 45 CD
29 00 00 00 00 00 02 46 00
29 00 00 00 00 00 02 47 DB
29 00 00 00 00 00 02 48 00
29 00 00 00 00 00 02 49 E7
29 00 00 00 00 00 02 4A 00
29 00 00 00 00 00 02 4B F2
29 00 00 00 00 00 02 4C 00
29 00 00 00 00 00 02 4D FD
29 00 00 00 00 00 02 4E 01
29 00 00 00 00 00 02 4F 24
29 00 00 00 00 00 02 50 01
29 00 00 00 00 00 02 51 45
29 00 00 00 00 00 02 52 01
29 00 00 00 00 00 02 53 79
29 00 00 00 00 00 02 54 01
29 00 00 00 00 00 02 55 A3
29 00 00 00 00 00 02 56 01
29 00 00 00 00 00 02 57 E6
29 00 00 00 00 00 02 58 02
29 00 00 00 00 00 02 59 1D
29 00 00 00 00 00 02 5A 02
29 00 00 00 00 00 02 5B 1F
29 00 00 00 00 00 02 5C 02
29 00 00 00 00 00 02 5D 56
29 00 00 00 00 00 02 5E 02
29 00 00 00 00 00 02 5F 97
29 00 00 00 00 00 02 60 02
29 00 00 00 00 00 02 61 C0
29 00 00 00 00 00 02 62 02
29 00 00 00 00 00 02 63 F6
29 00 00 00 00 00 02 64 03
29 00 00 00 00 00 02 65 18
29 00 00 00 00 00 02 66 03
29 00 00 00 00 00 02 67 44
29 00 00 00 00 00 02 68 03
29 00 00 00 00 00 02 69 52
29 00 00 00 00 00 02 6A 03
29 00 00 00 00 00 02 6B 62
29 00 00 00 00 00 02 6C 03
29 00 00 00 00 00 02 6D 74
29 00 00 00 00 00 02 6E 03
29 00 00 00 00 00 02 6F 89
29 00 00 00 00 00 02 70 03
29 00 00 00 00 00 02 71 A2
29 00 00 00 00 00 02 72 03
29 00 00 00 00 00 02 73 C2
29 00 00 00 00 00 02 74 03
29 00 00 00 00 00 02 75 DB
29 00 00 00 00 00 02 76 03
29 00 00 00 00 00 02 77 DC
29 00 00 00 00 00 02 78 01
29 00 00 00 00 00 02 79 01
29 01 00 00 00 00 04 FF 78 07 00

29 00 00 00 00 00 04 FF 78 07 04
29 00 00 00 00 00 02 00 00
29 00 00 00 00 00 02 01 00
29 00 00 00 00 00 02 02 00
29 00 00 00 00 00 02 03 18
29 00 00 00 00 00 02 04 00
29 00 00 00 00 00 02 05 40
29 00 00 00 00 00 02 06 00
29 00 00 00 00 00 02 07 60
29 00 00 00 00 00 02 08 00
29 00 00 00 00 00 02 09 7C
29 00 00 00 00 00 02 0A 00
29 00 00 00 00 00 02 0B 92
29 00 00 00 00 00 02 0C 00
29 00 00 00 00 00 02 0D A8
29 00 00 00 00 00 02 0E 00
29 00 00 00 00 00 02 0F BE
29 00 00 00 00 00 02 10 00
29 00 00 00 00 00 02 11 CE
29 00 00 00 00 00 02 12 01
29 00 00 00 00 00 02 13 02
29 00 00 00 00 00 02 14 01
29 00 00 00 00 00 02 15 2B
29 00 00 00 00 00 02 16 01
29 00 00 00 00 00 02 17 6A
29 00 00 00 00 00 02 18 01
29 00 00 00 00 00 02 19 98 //error
29 00 00 00 00 00 02 1A 01
29 00 00 00 00 00 02 1B E0
29 00 00 00 00 00 02 1C 02
29 00 00 00 00 00 02 1D 19
29 00 00 00 00 00 02 1E 02
29 00 00 00 00 00 02 1F 1B
29 00 00 00 00 00 02 20 02
29 00 00 00 00 00 02 21 53
29 00 00 00 00 00 02 22 02
29 00 00 00 00 00 02 23 94
29 00 00 00 00 00 02 24 02
29 00 00 00 00 00 02 25 BE
29 00 00 00 00 00 02 26 02
29 00 00 00 00 00 02 27 F7
29 00 00 00 00 00 02 28 03
29 00 00 00 00 00 02 29 1E
29 00 00 00 00 00 02 2A 03
29 00 00 00 00 00 02 2B 58
29 00 00 00 00 00 02 2C 03
29 00 00 00 00 00 02 2D 70
29 00 00 00 00 00 02 2E 03
29 00 00 00 00 00 02 2F 72
29 00 00 00 00 00 02 30 03
29 00 00 00 00 00 02 31 73
29 00 00 00 00 00 02 32 03
29 00 00 00 00 00 02 33 86
29 00 00 00 00 00 02 34 03
29 00 00 00 00 00 02 35 9E
29 00 00 00 00 00 02 36 03
29 00 00 00 00 00 02 37 C0
29 00 00 00 00 00 02 38 03
29 00 00 00 00 00 02 39 DA
29 00 00 00 00 00 02 3A 03
29 00 00 00 00 00 02 3B DC
29 00 00 00 00 00 02 3C 00
29 00 00 00 00 00 02 3D 00
29 00 00 00 00 00 02 3E 00
29 00 00 00 00 00 02 3F 18
29 00 00 00 00 00 02 78 01
29 00 00 00 00 00 02 79 01
29 01 00 00 00 00 04 FF 78 07 00

29 00 00 00 00 00 04 FF 78 07 04
29 00 00 00 00 00 02 40 00
29 00 00 00 00 00 02 41 40
29 00 00 00 00 00 02 42 00
29 00 00 00 00 00 02 43 60
29 00 00 00 00 00 02 44 00
29 00 00 00 00 00 02 45 7C
29 00 00 00 00 00 02 46 00
29 00 00 00 00 00 02 47 92
29 00 00 00 00 00 02 48 00
29 00 00 00 00 00 02 49 A8
29 00 00 00 00 00 02 4A 00
29 00 00 00 00 00 02 4B BE
29 00 00 00 00 00 02 4C 00
29 00 00 00 00 00 02 4D CE
29 00 00 00 00 00 02 4E 01
29 00 00 00 00 00 02 4F 02
29 00 00 00 00 00 02 50 01
29 00 00 00 00 00 02 51 2B
29 00 00 00 00 00 02 52 01
29 00 00 00 00 00 02 53 6A
29 00 00 00 00 00 02 54 01
29 00 00 00 00 00 02 55 98
29 00 00 00 00 00 02 56 01
29 00 00 00 00 00 02 57 E0
29 00 00 00 00 00 02 58 02
29 00 00 00 00 00 02 59 19
29 00 00 00 00 00 02 5A 02
29 00 00 00 00 00 02 5B 1B
29 00 00 00 00 00 02 5C 02
29 00 00 00 00 00 02 5D 53
29 00 00 00 00 00 02 5E 02
29 00 00 00 00 00 02 5F 94
29 00 00 00 00 00 02 60 02
29 00 00 00 00 00 02 61 BE
29 00 00 00 00 00 02 62 02
29 00 00 00 00 00 02 63 F7
29 00 00 00 00 00 02 64 03
29 00 00 00 00 00 02 65 1E
29 00 00 00 00 00 02 66 03
29 00 00 00 00 00 02 67 58
29 00 00 00 00 00 02 68 03
29 00 00 00 00 00 02 69 70
29 00 00 00 00 00 02 6A 03
29 00 00 00 00 00 02 6B 72
29 00 00 00 00 00 02 6C 03
29 00 00 00 00 00 02 6D 73
29 00 00 00 00 00 02 6E 03
29 00 00 00 00 00 02 6F 86
29 00 00 00 00 00 02 70 03
29 00 00 00 00 00 02 71 9E
29 00 00 00 00 00 02 72 03
29 00 00 00 00 00 02 73 C0
29 00 00 00 00 00 02 74 03
29 00 00 00 00 00 02 75 DA
29 00 00 00 00 00 02 76 03
29 00 00 00 00 00 02 77 DC
29 00 00 00 00 00 02 78 01
29 00 00 00 00 00 02 79 01
29 01 00 00 00 00 04 FF 78 07 00];

qcom,mdss-dsi-warm_gamma-command = [
29 00 00 00 00 00 04 FF 78 07 02
29 00 00 00 00 00 02 00 00
29 00 00 00 00 00 02 01 00
29 00 00 00 00 00 02 02 00
29 00 00 00 00 00 02 03 11
29 00 00 00 00 00 02 04 00
29 00 00 00 00 00 02 05 2B
29 00 00 00 00 00 02 06 00
29 00 00 00 00 00 02 07 46
29 00 00 00 00 00 02 08 00
29 00 00 00 00 00 02 09 67
29 00 00 00 00 00 02 0A 00
29 00 00 00 00 00 02 0B 7E
29 00 00 00 00 00 02 0C 00
29 00 00 00 00 00 02 0D 91
29 00 00 00 00 00 02 0E 00
29 00 00 00 00 00 02 0F A4
29 00 00 00 00 00 02 10 00
29 00 00 00 00 00 02 11 B3
29 00 00 00 00 00 02 12 00
29 00 00 00 00 00 02 13 EE
29 00 00 00 00 00 02 14 01
29 00 00 00 00 00 02 15 1D
29 00 00 00 00 00 02 16 01
29 00 00 00 00 00 02 17 61
29 00 00 00 00 00 02 18 01
29 00 00 00 00 00 02 19 91
29 00 00 00 00 00 02 1A 01
29 00 00 00 00 00 02 1B DC
29 00 00 00 00 00 02 1C 02
29 00 00 00 00 00 02 1D 16
29 00 00 00 00 00 02 1E 02
29 00 00 00 00 00 02 1F 18
29 00 00 00 00 00 02 20 02
29 00 00 00 00 00 02 21 52
29 00 00 00 00 00 02 22 02
29 00 00 00 00 00 02 23 92
29 00 00 00 00 00 02 24 02
29 00 00 00 00 00 02 25 BA
29 00 00 00 00 00 02 26 02
29 00 00 00 00 00 02 27 F0
29 00 00 00 00 00 02 28 03
29 00 00 00 00 00 02 29 13
29 00 00 00 00 00 02 2A 03
29 00 00 00 00 00 02 2B 45
29 00 00 00 00 00 02 2C 03
29 00 00 00 00 00 02 2D 53
29 00 00 00 00 00 02 2E 03
29 00 00 00 00 00 02 2F 62
29 00 00 00 00 00 02 30 03
29 00 00 00 00 00 02 31 74
29 00 00 00 00 00 02 32 03
29 00 00 00 00 00 02 33 86
29 00 00 00 00 00 02 34 03
29 00 00 00 00 00 02 35 9D
29 00 00 00 00 00 02 36 03
29 00 00 00 00 00 02 37 B0
29 00 00 00 00 00 02 38 03
29 00 00 00 00 00 02 39 D9
29 00 00 00 00 00 02 3A 03
29 00 00 00 00 00 02 3B DC
29 00 00 00 00 00 02 3C 00
29 00 00 00 00 00 02 3D 00
29 00 00 00 00 00 02 3E 00
29 00 00 00 00 00 02 3F 11
29 00 00 00 00 00 02 78 01
29 00 00 00 00 00 02 79 01
29 01 00 00 00 00 04 FF 78 07 00

29 00 00 00 00 00 04 FF 78 07 02
29 00 00 00 00 00 02 40 00
29 00 00 00 00 00 02 41 2B
29 00 00 00 00 00 02 42 00
29 00 00 00 00 00 02 43 46
29 00 00 00 00 00 02 44 00
29 00 00 00 00 00 02 45 67
29 00 00 00 00 00 02 46 00
29 00 00 00 00 00 02 47 7E
29 00 00 00 00 00 02 48 00
29 00 00 00 00 00 02 49 91
29 00 00 00 00 00 02 4A 00
29 00 00 00 00 00 02 4B A4
29 00 00 00 00 00 02 4C 00
29 00 00 00 00 00 02 4D B3
29 00 00 00 00 00 02 4E 00
29 00 00 00 00 00 02 4F EE
29 00 00 00 00 00 02 50 01
29 00 00 00 00 00 02 51 1D
29 00 00 00 00 00 02 52 01
29 00 00 00 00 00 02 53 61
29 00 00 00 00 00 02 54 01
29 00 00 00 00 00 02 55 91
29 00 00 00 00 00 02 56 01
29 00 00 00 00 00 02 57 DC
29 00 00 00 00 00 02 58 02
29 00 00 00 00 00 02 59 16
29 00 00 00 00 00 02 5A 02
29 00 00 00 00 00 02 5B 18
29 00 00 00 00 00 02 5C 02
29 00 00 00 00 00 02 5D 52
29 00 00 00 00 00 02 5E 02
29 00 00 00 00 00 02 5F 92
29 00 00 00 00 00 02 60 02
29 00 00 00 00 00 02 61 BA
29 00 00 00 00 00 02 62 02
29 00 00 00 00 00 02 63 F0
29 00 00 00 00 00 02 64 03
29 00 00 00 00 00 02 65 13
29 00 00 00 00 00 02 66 03
29 00 00 00 00 00 02 67 45
29 00 00 00 00 00 02 68 03
29 00 00 00 00 00 02 69 53
29 00 00 00 00 00 02 6A 03
29 00 00 00 00 00 02 6B 62
29 00 00 00 00 00 02 6C 03
29 00 00 00 00 00 02 6D 74
29 00 00 00 00 00 02 6E 03
29 00 00 00 00 00 02 6F 86
29 00 00 00 00 00 02 70 03
29 00 00 00 00 00 02 71 9D
29 00 00 00 00 00 02 72 03
29 00 00 00 00 00 02 73 B0
29 00 00 00 00 00 02 74 03
29 00 00 00 00 00 02 75 D9
29 00 00 00 00 00 02 76 03
29 00 00 00 00 00 02 77 DC
29 00 00 00 00 00 02 78 01
29 00 00 00 00 00 02 79 01
29 01 00 00 00 00 04 FF 78 07 00

29 00 00 00 00 00 04 FF 78 07 03
29 00 00 00 00 00 02 00 00
29 00 00 00 00 00 02 01 86
29 00 00 00 00 00 02 02 00
29 00 00 00 00 00 02 03 8E
29 00 00 00 00 00 02 04 00
29 00 00 00 00 00 02 05 A1
29 00 00 00 00 00 02 06 00
29 00 00 00 00 00 02 07 B4
29 00 00 00 00 00 02 08 00
29 00 00 00 00 00 02 09 C5
29 00 00 00 00 00 02 0A 00
29 00 00 00 00 00 02 0B D3
29 00 00 00 00 00 02 0C 00
29 00 00 00 00 00 02 0D E1
29 00 00 00 00 00 02 0E 00
29 00 00 00 00 00 02 0F EE
29 00 00 00 00 00 02 10 00
29 00 00 00 00 00 02 11 FA
29 00 00 00 00 00 02 12 01
29 00 00 00 00 00 02 13 21
29 00 00 00 00 00 02 14 01
29 00 00 00 00 00 02 15 42
29 00 00 00 00 00 02 16 01
29 00 00 00 00 00 02 17 77
29 00 00 00 00 00 02 18 01
29 00 00 00 00 00 02 19 A2
29 00 00 00 00 00 02 1A 01
29 00 00 00 00 00 02 1B E5
29 00 00 00 00 00 02 1C 02
29 00 00 00 00 00 02 1D 1D
29 00 00 00 00 00 02 1E 02
29 00 00 00 00 00 02 1F 1E
29 00 00 00 00 00 02 20 02
29 00 00 00 00 00 02 21 56
29 00 00 00 00 00 02 22 02
29 00 00 00 00 00 02 23 96
29 00 00 00 00 00 02 24 02
29 00 00 00 00 00 02 25 BF
29 00 00 00 00 00 02 26 02
29 00 00 00 00 00 02 27 F5
29 00 00 00 00 00 02 28 03
29 00 00 00 00 00 02 29 18
29 00 00 00 00 00 02 2A 03
29 00 00 00 00 00 02 2B 45
29 00 00 00 00 00 02 2C 03
29 00 00 00 00 00 02 2D 53
29 00 00 00 00 00 02 2E 03
29 00 00 00 00 00 02 2F 62
29 00 00 00 00 00 02 30 03
29 00 00 00 00 00 02 31 74
29 00 00 00 00 00 02 32 03
29 00 00 00 00 00 02 33 88
29 00 00 00 00 00 02 34 03
29 00 00 00 00 00 02 35 A1
29 00 00 00 00 00 02 36 03
29 00 00 00 00 00 02 37 C2
29 00 00 00 00 00 02 38 03
29 00 00 00 00 00 02 39 DB
29 00 00 00 00 00 02 3A 03
29 00 00 00 00 00 02 3B DC
29 00 00 00 00 00 02 3C 00
29 00 00 00 00 00 02 3D 86
29 00 00 00 00 00 02 3E 00
29 00 00 00 00 00 02 3F 8E
29 00 00 00 00 00 02 78 01
29 00 00 00 00 00 02 79 01
29 01 00 00 00 00 04 FF 78 07 00

29 00 00 00 00 00 04 FF 78 07 03
29 00 00 00 00 00 02 40 00
29 00 00 00 00 00 02 41 A1
29 00 00 00 00 00 02 42 00
29 00 00 00 00 00 02 43 B4
29 00 00 00 00 00 02 44 00
29 00 00 00 00 00 02 45 C5
29 00 00 00 00 00 02 46 00
29 00 00 00 00 00 02 47 D3
29 00 00 00 00 00 02 48 00
29 00 00 00 00 00 02 49 E1
29 00 00 00 00 00 02 4A 00
29 00 00 00 00 00 02 4B EE
29 00 00 00 00 00 02 4C 00
29 00 00 00 00 00 02 4D FA
29 00 00 00 00 00 02 4E 01
29 00 00 00 00 00 02 4F 21
29 00 00 00 00 00 02 50 01
29 00 00 00 00 00 02 51 42
29 00 00 00 00 00 02 52 01
29 00 00 00 00 00 02 53 77
29 00 00 00 00 00 02 54 01
29 00 00 00 00 00 02 55 A2
29 00 00 00 00 00 02 56 01
29 00 00 00 00 00 02 57 E5
29 00 00 00 00 00 02 58 02
29 00 00 00 00 00 02 59 1D
29 00 00 00 00 00 02 5A 02
29 00 00 00 00 00 02 5B 1E
29 00 00 00 00 00 02 5C 02
29 00 00 00 00 00 02 5D 56
29 00 00 00 00 00 02 5E 02
29 00 00 00 00 00 02 5F 96
29 00 00 00 00 00 02 60 02
29 00 00 00 00 00 02 61 BF
29 00 00 00 00 00 02 62 02
29 00 00 00 00 00 02 63 F5
29 00 00 00 00 00 02 64 03
29 00 00 00 00 00 02 65 18
29 00 00 00 00 00 02 66 03
29 00 00 00 00 00 02 67 45
29 00 00 00 00 00 02 68 03
29 00 00 00 00 00 02 69 53
29 00 00 00 00 00 02 6A 03
29 00 00 00 00 00 02 6B 62
29 00 00 00 00 00 02 6C 03
29 00 00 00 00 00 02 6D 74
29 00 00 00 00 00 02 6E 03
29 00 00 00 00 00 02 6F 88
29 00 00 00 00 00 02 70 03
29 00 00 00 00 00 02 71 A1
29 00 00 00 00 00 02 72 03
29 00 00 00 00 00 02 73 C2
29 00 00 00 00 00 02 74 03
29 00 00 00 00 00 02 75 DB
29 00 00 00 00 00 02 76 03
29 00 00 00 00 00 02 77 DC
29 00 00 00 00 00 02 78 01
29 00 00 00 00 00 02 79 01
29 01 00 00 00 00 04 FF 78 07 00

29 00 00 00 00 00 04 FF 78 07 04
29 00 00 00 00 00 02 00 00
29 00 00 00 00 00 02 01 E8
29 00 00 00 00 00 02 02 00
29 00 00 00 00 00 02 03 EE
29 00 00 00 00 00 02 04 00
29 00 00 00 00 00 02 05 FA
29 00 00 00 00 00 02 06 01
29 00 00 00 00 00 02 07 06
29 00 00 00 00 00 02 08 01
29 00 00 00 00 00 02 09 11
29 00 00 00 00 00 02 0A 01
29 00 00 00 00 00 02 0B 1A
29 00 00 00 00 00 02 0C 01
29 00 00 00 00 00 02 0D 24
29 00 00 00 00 00 02 0E 01
29 00 00 00 00 00 02 0F 2C
29 00 00 00 00 00 02 10 01
29 00 00 00 00 00 02 11 35
29 00 00 00 00 00 02 12 01
29 00 00 00 00 00 02 13 52
29 00 00 00 00 00 02 14 01
29 00 00 00 00 00 02 15 6D
29 00 00 00 00 00 02 16 01
29 00 00 00 00 00 02 17 97
29 00 00 00 00 00 02 18 01
29 00 00 00 00 00 02 19 BC
29 00 00 00 00 00 02 1A 01
29 00 00 00 00 00 02 1B F6
29 00 00 00 00 00 02 1C 02
29 00 00 00 00 00 02 1D 2A
29 00 00 00 00 00 02 1E 02
29 00 00 00 00 00 02 1F 2B
29 00 00 00 00 00 02 20 02
29 00 00 00 00 00 02 21 61
29 00 00 00 00 00 02 22 02
29 00 00 00 00 00 02 23 A0
29 00 00 00 00 00 02 24 02
29 00 00 00 00 00 02 25 C9
29 00 00 00 00 00 02 26 03
29 00 00 00 00 00 02 27 02
29 00 00 00 00 00 02 28 03
29 00 00 00 00 00 02 29 29
29 00 00 00 00 00 02 2A 03
29 00 00 00 00 00 02 2B 45
29 00 00 00 00 00 02 2C 03
29 00 00 00 00 00 02 2D 53
29 00 00 00 00 00 02 2E 03
29 00 00 00 00 00 02 2F 62
29 00 00 00 00 00 02 30 03
29 00 00 00 00 00 02 31 72
29 00 00 00 00 00 02 32 03
29 00 00 00 00 00 02 33 84
29 00 00 00 00 00 02 34 03
29 00 00 00 00 00 02 35 9D
29 00 00 00 00 00 02 36 03
29 00 00 00 00 00 02 37 BE
29 00 00 00 00 00 02 38 03
29 00 00 00 00 00 02 39 DA
29 00 00 00 00 00 02 3A 03
29 00 00 00 00 00 02 3B DC
29 00 00 00 00 00 02 3C 00
29 00 00 00 00 00 02 3D E8
29 00 00 00 00 00 02 3E 00
29 00 00 00 00 00 02 3F EE
29 00 00 00 00 00 02 78 01
29 00 00 00 00 00 02 79 01
29 01 00 00 00 00 04 FF 78 07 00

29 00 00 00 00 00 04 FF 78 07 04
29 00 00 00 00 00 02 40 00
29 00 00 00 00 00 02 41 FA
29 00 00 00 00 00 02 42 01
29 00 00 00 00 00 02 43 06
29 00 00 00 00 00 02 44 01
29 00 00 00 00 00 02 45 11
29 00 00 00 00 00 02 46 01
29 00 00 00 00 00 02 47 1A
29 00 00 00 00 00 02 48 01
29 00 00 00 00 00 02 49 24
29 00 00 00 00 00 02 4A 01
29 00 00 00 00 00 02 4B 2C
29 00 00 00 00 00 02 4C 01
29 00 00 00 00 00 02 4D 35
29 00 00 00 00 00 02 4E 01
29 00 00 00 00 00 02 4F 52
29 00 00 00 00 00 02 50 01
29 00 00 00 00 00 02 51 6D
29 00 00 00 00 00 02 52 01
29 00 00 00 00 00 02 53 97
29 00 00 00 00 00 02 54 01
29 00 00 00 00 00 02 55 BC
29 00 00 00 00 00 02 56 01
29 00 00 00 00 00 02 57 F6
29 00 00 00 00 00 02 58 02
29 00 00 00 00 00 02 59 2A
29 00 00 00 00 00 02 5A 02
29 00 00 00 00 00 02 5B 2B
29 00 00 00 00 00 02 5C 02
29 00 00 00 00 00 02 5D 61
29 00 00 00 00 00 02 5E 02
29 00 00 00 00 00 02 5F A0
29 00 00 00 00 00 02 60 02
29 00 00 00 00 00 02 61 C9
29 00 00 00 00 00 02 62 03
29 00 00 00 00 00 02 63 02
29 00 00 00 00 00 02 64 03
29 00 00 00 00 00 02 65 29
29 00 00 00 00 00 02 66 03
29 00 00 00 00 00 02 67 45
29 00 00 00 00 00 02 68 03
29 00 00 00 00 00 02 69 53
29 00 00 00 00 00 02 6A 03
29 00 00 00 00 00 02 6B 62
29 00 00 00 00 00 02 6C 03
29 00 00 00 00 00 02 6D 72
29 00 00 00 00 00 02 6E 03
29 00 00 00 00 00 02 6F 84
29 00 00 00 00 00 02 70 03
29 00 00 00 00 00 02 71 9D
29 00 00 00 00 00 02 72 03
29 00 00 00 00 00 02 73 BE
29 00 00 00 00 00 02 74 03
29 00 00 00 00 00 02 75 DA
29 00 00 00 00 00 02 76 03
29 00 00 00 00 00 02 77 DC
29 00 00 00 00 00 02 78 01
29 00 00 00 00 00 02 79 01
29 01 00 00 00 00 04 FF 78 07 00
];


		qcom,mdss-dsi-on-command-state = "dsi_lp_mode";
		qcom,mdss-dsi-off-command-state = "dsi_lp_mode";
		qcom,mdss-dsi-CABC_on-command-state = "dsi_hs_mode";
		qcom,mdss-dsi-CABC_off-command-state = "dsi_hs_mode";
		qcom,mdss-dsi-CE_on-command-state = "dsi_hs_mode";
		qcom,mdss-dsi-CE_off-command-state = "dsi_hs_mode";
		qcom,mdss-dsi-cold_gamma-command-state = "dsi_hs_mode";
		qcom,mdss-dsi-warm_gamma-command-state = "dsi_hs_mode";
		qcom,mdss-dsi-default_gamma-command-state = "dsi_hs_mode";
		qcom,mdss-dsi-h-sync-pulse = <1>;
		qcom,mdss-dsi-traffic-mode = "burst_mode";
		qcom,mdss-dsi-bllp-eof-power-mode;
		qcom,mdss-dsi-bllp-power-mode;
		qcom,mdss-dsi-lane-0-state;
		qcom,mdss-dsi-lane-1-state;
		qcom,mdss-dsi-lane-2-state;
		qcom,mdss-dsi-lane-3-state;
		qcom,mdss-dsi-panel-timings = [7d 25 1d 00 37 33
			22 27 1e 03 04 00];
		qcom,mdss-dsi-t-clk-post = <0x0d>;
		qcom,mdss-dsi-t-clk-pre = <0x30>;
		qcom,mdss-dsi-bl-min-level = <1>;
		qcom,mdss-dsi-bl-max-level = <4095>;
                qcom,mdss-brightness-max-level = <4095>;
		qcom,mdss-dsi-dma-trigger = "trigger_sw";
		qcom,mdss-dsi-mdp-trigger = "none";
		qcom,mdss-dsi-bl-pmic-control-type = "bl_ctrl_wled";
		qcom,mdss-dsi-reset-sequence = <1 10>, <0 10>, <1 10>;
                //qcom,mdss-dsi-tx-eot-append;
	        //qcom,esd-check-enabled;
		qcom,mdss-dsi-panel-status-command = [06 01 00 01 05 00 01 0A];
		qcom,mdss-dsi-panel-status-command-mode = "dsi_lp_mode";
		qcom,mdss-dsi-panel-status-check-mode = "TE_check_NT35596";
		qcom,mdss-dsi-panel-status-read-length = <1>;
		qcom,mdss-dsi-panel-status-value = <0x9C>;
		qcom,mdss-dsi-panel-max-error-count = <3>;
		qcom,mdss-pan-physical-width-dimension = <69>;
		qcom,mdss-pan-physical-height-dimension = <122>;
	};
};
