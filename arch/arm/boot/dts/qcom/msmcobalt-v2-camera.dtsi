/*
 * Copyright (c) 2016, The Linux Foundation. All rights reserved.
 *
 * This program is free software; you can redistribute it and/or modify
 * it under the terms of the GNU General Public License version 2 and
 * only version 2 as published by the Free Software Foundation.
 *
 * This program is distributed in the hope that it will be useful,
 * but WITHOUT ANY WARRANTY; without even the implied warranty of
 * MERCHANTABILITY or FITNESS FOR A PARTICULAR PURPOSE.  See the
 * GNU General Public License for more details.
 */

&soc {
	qcom,csiphy@ca34000 {
		cell-index = <0>;
		compatible = "qcom,csiphy-v5.01", "qcom,csiphy";
		reg = <0xca34000 0x1000>;
		reg-names = "csiphy";
		interrupts = <0 78 0>;
		interrupt-names = "csiphy";
		clocks = <&clock_mmss clk_mmss_mnoc_maxi_clk>,
			<&clock_mmss clk_mmss_mnoc_ahb_clk>,
			<&clock_mmss clk_mmss_bimc_smmu_ahb_clk>,
			<&clock_mmss clk_mmss_bimc_smmu_axi_clk>,
			<&clock_mmss clk_mmss_camss_ahb_clk>,
			<&clock_mmss clk_mmss_camss_top_ahb_clk>,
			<&clock_mmss clk_csi0_clk_src>,
			<&clock_mmss clk_mmss_camss_csi0_clk>,
			<&clock_mmss clk_mmss_camss_cphy_csid0_clk>,
			<&clock_mmss clk_csi0phytimer_clk_src>,
			<&clock_mmss clk_mmss_camss_csi0phytimer_clk>,
			<&clock_mmss clk_mmss_camss_ispif_ahb_clk>,
			<&clock_mmss clk_csiphy_clk_src>,
			<&clock_mmss clk_mmss_camss_csiphy0_clk>;
		clock-names = "mnoc_maxi", "mnoc_ahb",
			"bmic_smmu_ahb", "bmic_smmu_axi",
			"camss_ahb_clk", "camss_top_ahb_clk",
			"csi_src_clk", "csi_clk", "cphy_csid_clk",
			"csiphy_timer_src_clk", "csiphy_timer_clk",
			"camss_ispif_ahb_clk", "csiphy_clk_src", "csiphy_clk";
		qcom,clock-rates = <0 0 0 0 0 0 256000000 0 0 269333333 0
			0 256000000 0>;
		status = "ok";
	};

	qcom,csiphy@ca35000 {
		cell-index = <1>;
		compatible = "qcom,csiphy-v5.01", "qcom,csiphy";
		reg = <0xca35000 0x1000>;
		reg-names = "csiphy";
		interrupts = <0 79 0>;
		interrupt-names = "csiphy";
		clocks = <&clock_mmss clk_mmss_mnoc_maxi_clk>,
			<&clock_mmss clk_mmss_mnoc_ahb_clk>,
			<&clock_mmss clk_mmss_bimc_smmu_ahb_clk>,
			<&clock_mmss clk_mmss_bimc_smmu_axi_clk>,
			<&clock_mmss clk_mmss_camss_ahb_clk>,
			<&clock_mmss clk_mmss_camss_top_ahb_clk>,
			<&clock_mmss clk_csi1_clk_src>,
			<&clock_mmss clk_mmss_camss_csi1_clk>,
			<&clock_mmss clk_mmss_camss_cphy_csid1_clk>,
			<&clock_mmss clk_csi1phytimer_clk_src>,
			<&clock_mmss clk_mmss_camss_csi1phytimer_clk>,
			<&clock_mmss clk_mmss_camss_ispif_ahb_clk>,
			<&clock_mmss clk_csiphy_clk_src>,
			<&clock_mmss clk_mmss_camss_csiphy1_clk>;
		clock-names = "mnoc_maxi", "mnoc_ahb",
			"bmic_smmu_ahb", "bmic_smmu_axi",
			"camss_ahb_clk", "camss_top_ahb_clk",
			"csi_src_clk", "csi_clk", "cphy_csid_clk",
			"csiphy_timer_src_clk", "csiphy_timer_clk",
			"camss_ispif_ahb_clk", "csiphy_clk_src", "csiphy_clk";
		qcom,clock-rates = <0 0 0 0 0 0 256000000 0 0 269333333 0
			0 256000000 0>;
		status = "ok";
	};

	qcom,csiphy@ca36000 {
		cell-index = <2>;
		compatible = "qcom,csiphy-v5.01", "qcom,csiphy";
		reg = <0xca36000 0x1000>;
		reg-names = "csiphy";
		interrupts = <0 80 0>;
		interrupt-names = "csiphy";
		clocks = <&clock_mmss clk_mmss_mnoc_maxi_clk>,
			<&clock_mmss clk_mmss_mnoc_ahb_clk>,
			<&clock_mmss clk_mmss_bimc_smmu_ahb_clk>,
			<&clock_mmss clk_mmss_bimc_smmu_axi_clk>,
			<&clock_mmss clk_mmss_camss_ahb_clk>,
			<&clock_mmss clk_mmss_camss_top_ahb_clk>,
			<&clock_mmss clk_csi2_clk_src>,
			<&clock_mmss clk_mmss_camss_csi2_clk>,
			<&clock_mmss clk_mmss_camss_cphy_csid2_clk>,
			<&clock_mmss clk_csi2phytimer_clk_src>,
			<&clock_mmss clk_mmss_camss_csi2phytimer_clk>,
			<&clock_mmss clk_mmss_camss_ispif_ahb_clk>,
			<&clock_mmss clk_csiphy_clk_src>,
			<&clock_mmss clk_mmss_camss_csiphy2_clk>;
		clock-names = "mnoc_maxi", "mnoc_ahb",
			"bmic_smmu_ahb", "bmic_smmu_axi",
			"camss_ahb_clk", "camss_top_ahb_clk",
			"csi_src_clk", "csi_clk", "cphy_csid_clk",
			"csiphy_timer_src_clk", "csiphy_timer_clk",
			"camss_ispif_ahb_clk", "csiphy_clk_src", "csiphy_clk";
		qcom,clock-rates = <0 0 0 0 0 0 256000000 0 0 269333333 0
			0 256000000 0>;
		status = "ok";
	};
};

