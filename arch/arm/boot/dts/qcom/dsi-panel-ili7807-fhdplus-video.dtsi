/* Copyright (c) 2012-2015, The Linux Foundation. All rights reserved.
 * Copyright (C) 2018 XiaoMi, Inc.
 *
 * This program is free software; you can redistribute it and/or modify
 * it under the terms of the GNU General Public License version 2 and
 * only version 2 as published by the Free Software Foundation.
 *
 * This program is distributed in the hope that it will be useful,
 * but WITHOUT ANY WARRANTY; without even the implied warranty of
 * MERCHANTABILITY or FITNESS FOR A PARTICULAR PURPOSE.  See the
 * GNU General Public License for more details.
 */

&mdss_mdp {
	dsi_ili7807_fhdplus_vid: qcom,mdss_dsi_ili7807_fhdplus_video {
		qcom,mdss-dsi-panel-name = "ili7807 fhdplus video mode dsi panel";
		qcom,mdss-dsi-panel-type = "dsi_video_mode";
		qcom,mdss-dsi-panel-framerate = <60>;
		qcom,mdss-dsi-virtual-channel-id = <0>;
		qcom,mdss-dsi-stream = <0>;
		qcom,mdss-dsi-panel-width = <1080>;
		qcom,mdss-dsi-panel-height = <2280>;
		qcom,mdss-dsi-h-front-porch = <72>;
		qcom,mdss-dsi-h-back-porch = <64>;
		qcom,mdss-dsi-h-pulse-width = <8>;
		qcom,mdss-dsi-h-sync-skew = <0>;
		qcom,mdss-dsi-v-back-porch = <10>;
		qcom,mdss-dsi-v-front-porch = <10>;
		qcom,mdss-dsi-v-pulse-width = <8>;
		qcom,mdss-dsi-h-left-border = <0>;
		qcom,mdss-dsi-h-right-border = <0>;
		qcom,mdss-dsi-v-top-border = <0>;
		qcom,mdss-dsi-v-bottom-border = <0>;
		qcom,mdss-dsi-bpp = <24>;
		qcom,mdss-dsi-underflow-color = <0xff>;
		qcom,mdss-dsi-border-color = <0>;

		qcom,mdss-dsi-h-sync-pulse = <1>;
		qcom,mdss-dsi-traffic-mode = "burst_mode";
		qcom,mdss-dsi-bllp-eof-power-mode;
		qcom,mdss-dsi-bllp-power-mode;
		qcom,mdss-dsi-lane-0-state;
		qcom,mdss-dsi-lane-1-state;
		qcom,mdss-dsi-lane-2-state;
		qcom,mdss-dsi-lane-3-state;
		qcom,mdss-dsi-bl-min-level = <1>;
		qcom,mdss-dsi-bl-max-level = <4095>;
		qcom,mdss-brightness-max-level-global = <255>;
		qcom,mdss-dsi-dma-trigger = "trigger_sw";
		qcom,mdss-dsi-mdp-trigger = "none";
		qcom,mdss-dsi-bl-pmic-control-type = "bl_ctrl_wled";
		qcom,mdss-dsi-reset-sequence = <1 2>, <0 2>, <1 10>;
		qcom,mdss-dsi-lp11-init;
		qcom,mdss-dsi-tx-eot-append;
		qcom,esd-check-enabled;
		qcom,mdss-dsi-panel-status-command = [06 01 00 01 05 00 01 0A
			06 01 00 01 05 00 01 0B
			06 01 00 01 05 00 01 0D];
		qcom,mdss-dsi-panel-status-read-length = <1 1 1>;
		qcom,mdss-dsi-panel-status-valid-params = <1 1 1>;
		qcom,mdss-dsi-panel-status-command-state = "dsi_hs_mode";
		qcom,mdss-dsi-panel-status-check-mode = "TE_check_NT35596";
		qcom,mdss-dsi-panel-status-value = <0x9C 0x00 0x00>;

		qcom,mdss-dsi-panel-max-error-count = <3>;
		qcom,mdss-pan-physical-width-dimension = <69>;
		qcom,mdss-pan-physical-height-dimension = <122>;

		qcom,mdss-dsi-on-command-state = "dsi_lp_mode";
		qcom,mdss-dsi-on-command = [
					39 01 00 00 00 00 04 ff 78 07 00
					39 01 00 00 78 00 02 11 00
					39 01 00 00 00 00 04 ff 78 07 07
					39 01 00 00 00 00 02 12 22
					39 01 00 00 00 00 02 31 0F
					39 01 00 00 00 00 02 44 07
					39 01 00 00 00 00 04 FF 78 07 05
					39 01 00 00 00 00 02 00 25
					39 01 00 00 00 00 02 03 40
					39 01 00 00 00 00 02 04 00
					39 01 00 00 00 00 04 ff 78 07 00
					39 01 00 00 00 00 03 51 0F FC
					39 01 00 00 00 00 02 53 2C
					39 01 00 00 00 00 02 55 00
					39 01 00 00 00 00 02 35 00
					39 01 00 00 14 00 02 29 00];

		qcom,mdss-dsi-off-command = [
						39 01 00 00 00 00 04 ff 78 07 00
						39 01 00 00 14 00 02 28 00
						39 01 00 00 78 00 02 10 00];

		qcom,mdss-dsi-panel-timings = [29 40 2c 01 76 7a
			30 44 34 03 04 00];
		qcom,mdss-dsi-panel-timings-phy-v2 = [25 20 09 0c 06 03 04 a0
			25 20 09 0c 06 03 04 a0
			25 20 09 0c 06 03 04 a0
			25 20 09 0c 06 03 04 a0
			25 1e 09 0a 06 03 04 a0];
		qcom,mdss-dsi-t-clk-post = <0x0e>;
		qcom,mdss-dsi-t-clk-pre = <0x35>;

		qcom,mdss-dsi-CE_on-command-state = "dsi_hs_mode";
		qcom,mdss-dsi-CE_off-command-state = "dsi_hs_mode";
		qcom,mdss-dsi-CABC_on-command-state = "dsi_hs_mode";
		qcom,mdss-dsi-CABC_off-command-state = "dsi_hs_mode";

		qcom,mdss-dsi-CE_on-command = [
						29 01 00 00 00 00 04 ff 78 07 07
						29 01 00 00 00 00 02 31 1F
						29 01 00 00 00 00 04 FF 78 07 05
						29 00 00 00 00 00 02 30 06
						29 00 00 00 00 00 02 31 10
						29 00 00 00 00 00 02 38 07
						29 00 00 00 00 00 02 39 09
						29 00 00 00 00 00 02 3A 0C
						29 00 00 00 00 00 02 40 02
						29 00 00 00 00 00 02 41 02
						29 00 00 00 00 00 02 42 02
						29 00 00 00 00 00 02 43 02
						29 00 00 00 00 00 02 44 02
						29 00 00 00 00 00 02 45 02
						29 00 00 00 00 00 02 46 02
						29 00 00 00 00 00 02 47 02
						29 00 00 00 00 00 02 48 02
						29 00 00 00 00 00 02 49 02
						29 00 00 00 00 00 02 4A 02
						29 00 00 00 00 00 02 4B 02
						29 00 00 00 00 00 02 4C 02
						29 00 00 00 00 00 02 4D 02
						29 00 00 00 00 00 02 4E 02
						29 00 00 00 00 00 02 4F 02
						29 00 00 00 00 00 02 50 02
						29 00 00 00 00 00 02 51 02
						29 00 00 00 00 00 02 52 02
						29 00 00 00 00 00 02 53 02
						29 00 00 00 00 00 02 54 02
						29 00 00 00 00 00 02 55 02
						29 00 00 00 00 00 02 56 02
						29 00 00 00 00 00 02 57 02
						29 01 00 00 00 00 04 ff 78 07 07
						29 01 00 00 00 00 02 31 0F
						29 01 00 00 00 00 04 FF 78 07 00];

		qcom,mdss-dsi-CE_off-command = [
						29 00 00 00 00 00 04 FF 78 07 07
						29 00 00 00 00 00 02 3D 30
						29 00 00 00 00 00 04 FF 78 07 05
						29 01 00 00 00 00 02 31 00
						29 00 00 00 00 00 04 FF 78 07 07
						29 01 00 00 00 00 02 3d 00
						29 01 00 00 00 00 04 FF 78 07 00];

		qcom,mdss-dsi-CABC_on-command = [
						29 01 00 00 00 00 04 FF 78 07 05
						29 00 00 00 00 00 02 00 25
						29 00 00 00 00 00 02 01 14
						29 00 00 00 00 00 02 02 16
						29 00 00 00 00 00 02 03 40
						29 00 00 00 00 00 02 04 00
						29 00 00 00 00 00 02 07 90
						29 00 00 00 00 00 02 08 08
						29 00 00 00 00 00 02 28 16
						29 00 00 00 00 00 02 29 15
						29 00 00 00 00 00 02 2A 14
						29 00 00 00 00 00 02 2B 0D
						29 01 00 00 00 00 04 FF 78 07 00
						29 00 00 00 00 00 03 51 0F FC
						29 00 00 00 00 00 02 53 2C
						29 00 00 00 00 00 02 55 01
						29 00 00 00 00 00 03 68 05 00
						29 01 00 00 00 00 04 FF 78 07 00
						];

		qcom,mdss-dsi-CABC_off-command = [
						29 01 00 00 00 00 04 FF 78 07 00
						29 00 00 00 00 00 03 51 0F FC
						29 00 00 00 00 00 02 53 2C
						29 00 00 00 00 00 02 55 00
						29 01 00 00 00 00 04 FF 78 07 05
						29 00 00 00 00 00 02 2B 08
						29 01 00 00 00 00 04 FF 78 07 00
						];
	};
};
