/*
 * Synaptics DSX touchscreen driver
 *
 * Copyright (C) 2012-2016 Synaptics Incorporated. All rights reserved.
 * Copyright (C) 2018 XiaoMi, Inc.
 *
 * Copyright (C) 2012 Alexandra Chin <alexandra.chin@tw.synaptics.com>
 * Copyright (C) 2012 Scott Lin <scott.lin@tw.synaptics.com>
 *
 * This program is free software; you can redistribute it and/or modify
 * it under the terms of the GNU General Public License as published by
 * the Free Software Foundation; either version 2 of the License, or
 * (at your option) any later version.
 *
 * This program is distributed in the hope that it will be useful,
 * but WITHOUT ANY WARRANTY; without even the implied warranty of
 * MERCHANTABILITY or FITNESS FOR A PARTICULAR PURPOSE. See the
 * GNU General Public License for more details.
 *
 * INFORMATION CONTAINED IN THIS DOCUMENT IS PROVIDED "AS-IS," AND SYNAPTICS
 * EXPRESSLY DISCLAIMS ALL EXPRESS AND IMPLIED WARRANTIES, INCLUDING ANY
 * IMPLIED WARRANTIES OF MERCHANTABILITY AND FITNESS FOR A PARTICULAR PURPOSE,
 * AND ANY WARRANTIES OF NON-INFRINGEMENT OF ANY INTELLECTUAL PROPERTY RIGHTS.
 * IN NO EVENT SHALL SYNAPTICS BE LIABLE FOR ANY DIRECT, INDIRECT, INCIDENTAL,
 * SPECIAL, PUNITIVE, OR CONSEQUENTIAL DAMAGES ARISING OUT OF OR IN CONNECTION
 * WITH THE USE OF THE INFORMATION CONTAINED IN THIS DOCUMENT, HOWEVER CAUSED
 * AND BASED ON ANY THEORY OF LIABILITY, WHETHER IN AN ACTION OF CONTRACT,
 * NEGLIGENCE OR OTHER TORTIOUS ACTION, AND EVEN IF SYNAPTICS WAS ADVISED OF
 * THE POSSIBILITY OF SUCH DAMAGE. IF A TRIBUNAL OF COMPETENT JURISDICTION DOES
 * NOT PERMIT THE DISCLAIMER OF DIRECT DAMAGES OR ANY OTHER DAMAGES, SYNAPTICS'
 * TOTAL CUMULATIVE LIABILITY TO ANY PARTY SHALL NOT EXCEED ONE HUNDRED U.S.
 * DOLLARS.
 */

&i2c_1{
	/* Novatek device tree node */
	status = "ok";
	novatek@62 {
		compatible = "novatek,NVT-ts";
		reg = <0x62>;
        	interrupt-parent = <&tlmm>;
                interrupts = <67 0x2008>;
                //vdd-supply = <&pm8994_lvs2>;
                //avdd-supply = <&pm8994_l22>;
                vcc_i2c-supply=<&pm660_l11>;
                pinctrl-names = "pmx_ts_active", "pmx_ts_suspend";
                pinctrl-0 = <&ts_active>;
                pinctrl-1 = <&ts_int_suspend &ts_reset_suspend>;
		novatek,reset-gpio = <&tlmm 66 0x00>;
		novatek,irq-gpio = <&tlmm 67 0x2001>;

		/* MP */
		novatek,mp-support-dt;
//#if NVT_TOUCH_MP


		novatek-mp-criteria-5906@0 {
			#address-cells = <1>;
			#size-cells = <0>;
			compatible = "novatek-mp-criteria-5906";

			/* MP Config*/
			IC_X_CFG_SIZE = <18>;
			IC_Y_CFG_SIZE = <32>;
			IC_KEY_CFG_SIZE = <4>;
			X_Channel = <18>;
			Y_Channel = <32>;
			AIN_X = <17 16 15 14 13 12 11 10 9 8 7 6 5 4 3 2 1 0>;
			AIN_Y = <31 30 29 28 27 26 25 24 23 22 21 20 19 18 17 16 15
							14 13 12 11 10 9 8 7 6 5 4 3 2 1 0>;
			AIN_KEY = <0 1 2 0xFF>;

			/* MP Criteria */
		        PS_Config_Lmt_Short_Rawdata_P = <14000>;
			PS_Config_Lmt_Short_Rawdata_N = <11000>;
			PS_Config_Lmt_Key_Short_Rawdata_P = <14000>;
			PS_Config_Lmt_Key_Short_Rawdata_N = <11000>;
			PS_Config_Lmt_Short_Diff_P = <6300>;
			PS_Config_Lmt_Short_Diff_N = <0>;
			PS_Config_Lmt_Key_Short_Diff_P = <6300>;
			PS_Config_Lmt_Key_Short_Diff_N = <0>;
			PS_Config_Lmt_Short_Base_P = <2000>;
			PS_Config_Lmt_Short_Base_N = <(-2000)>;
			PS_Config_Lmt_Key_Short_Base_P = <2000>;
			PS_Config_Lmt_Key_Short_Base_N = <(-2000)>;

			PS_Config_Lmt_Open_Rawdata_P = <
	7345 7376 7389 7403 7418 7442 7453 7432 7406 7365 7395 7412 7435 7452 7435 7420 7406 7392
	7342 7378 7393 7407 7425 7450 7458 7436 7407 7365 7393 7412 7437 7450 7433 7418 7402 7380
	7331 7365 7379 7394 7411 7438 7442 7420 7392 7377 7405 7425 7451 7462 7445 7428 7412 7387
	7333 7371 7387 7402 7420 7446 7448 7426 7397 7362 7389 7408 7434 7444 7425 7409 7393 7367
	7346 7385 7404 7420 7438 7464 7465 7442 7413 7379 7406 7427 7453 7459 7441 7425 7408 7376
	7334 7370 7390 7405 7423 7451 7447 7425 7395 7389 7417 7438 7466 7469 7450 7434 7417 7382
	7343 7380 7404 7420 7438 7466 7460 7437 7407 7381 7408 7429 7455 7458 7438 7422 7403 7367
	7351 7387 7413 7429 7448 7477 7467 7444 7413 7384 7412 7433 7460 7458 7440 7424 7403 7366
	7343 7377 7407 7424 7442 7470 7459 7435 7406 7408 7437 7459 7488 7483 7464 7447 7420 7381
	7351 7386 7417 7437 7456 7486 7470 7446 7416 7394 7423 7443 7472 7467 7446 7429 7399 7363
	7360 7396 7429 7452 7470 7502 7483 7459 7427 7412 7441 7464 7493 7482 7463 7444 7412 7374
	7348 7384 7416 7440 7460 7489 7466 7444 7413 7422 7453 7475 7506 7492 7473 7450 7416 7378
	7358 7396 7428 7458 7478 7509 7484 7459 7428 7417 7447 7470 7500 7486 7464 7437 7404 7366
	7372 7410 7443 7477 7497 7528 7500 7474 7441 7428 7459 7483 7515 7495 7474 7443 7410 7371
	7359 7397 7430 7463 7489 7515 7486 7461 7429 7451 7484 7509 7542 7517 7494 7459 7425 7385
	7373 7411 7445 7480 7507 7534 7503 7477 7443 7440 7472 7497 7530 7505 7476 7442 7408 7369
	7387 7427 7462 7499 7530 7556 7524 7496 7461 7462 7495 7522 7554 7525 7493 7457 7422 7381
	7369 7407 7441 7476 7516 7553 7525 7497 7462 7493 7530 7559 7582 7533 7495 7459 7423 7382
	7385 7425 7461 7497 7538 7574 7550 7520 7483 7493 7530 7559 7576 7529 7488 7452 7417 7375
	7403 7445 7482 7522 7564 7599 7577 7544 7505 7514 7553 7585 7594 7543 7502 7464 7427 7384
	7400 7441 7478 7517 7562 7591 7572 7540 7502 7548 7590 7621 7627 7573 7531 7489 7450 7406
	7421 7464 7504 7546 7592 7621 7600 7569 7526 7545 7587 7613 7615 7564 7519 7479 7440 7395
	7444 7490 7531 7575 7623 7650 7630 7598 7553 7577 7621 7647 7646 7589 7544 7502 7461 7413
	7442 7489 7531 7575 7626 7647 7626 7598 7553 7615 7664 7686 7682 7621 7572 7527 7485 7435
	7469 7518 7563 7611 7664 7684 7661 7636 7587 7624 7668 7690 7681 7620 7570 7525 7483 7432
	7501 7554 7602 7653 7711 7729 7702 7678 7625 7664 7706 7731 7717 7653 7599 7552 7507 7452
	7496 7549 7597 7650 7710 7721 7694 7671 7622 7714 7756 7784 7764 7694 7637 7586 7538 7479
	7325 7362 7392 7425 7461 7466 7454 7445 7416 7453 7471 7481 7460 7418 7384 7354 7325 7285
	7379 7422 7458 7497 7541 7545 7529 7516 7485 7527 7549 7564 7540 7490 7450 7414 7380 7334
	7419 7467 7508 7552 7604 7604 7583 7568 7537 7612 7641 7662 7633 7573 7526 7483 7444 7391
	7492 7549 7597 7652 7714 7714 7686 7665 7630 7678 7712 7738 7706 7636 7582 7534 7490 7432
	7652 7728 7798 7877 7968 7965 7917 7879 7823 7890 7941 7985 7944 7848 7770 7702 7641 7558>;

			PS_Config_Lmt_Open_Rawdata_N = <
	6834 6852 6860 6867 6876 6890 6896 6884 6869 6846 6863 6873 6886 6896 6886 6878 6869 6861
	6833 6853 6862 6870 6880 6895 6900 6887 6870 6846 6862 6873 6887 6895 6885 6876 6867 6854
	6826 6846 6854 6863 6872 6888 6890 6878 6861 6853 6869 6880 6895 6902 6892 6882 6873 6858
	6828 6849 6858 6867 6877 6892 6894 6881 6864 6844 6860 6871 6885 6891 6880 6871 6862 6847
	6835 6858 6868 6878 6888 6903 6903 6890 6873 6854 6870 6881 6897 6900 6890 6880 6870 6852
	6828 6848 6860 6869 6879 6895 6893 6880 6863 6859 6876 6888 6904 6905 6895 6886 6875 6855
	6833 6854 6868 6878 6888 6904 6900 6887 6870 6855 6871 6882 6898 6899 6888 6879 6868 6847
	6838 6858 6874 6883 6894 6910 6905 6891 6874 6857 6873 6885 6901 6899 6889 6880 6868 6847
	6833 6853 6870 6880 6890 6906 6900 6886 6869 6871 6887 6900 6916 6913 6903 6893 6877 6855
	6838 6858 6876 6887 6898 6915 6906 6892 6875 6863 6879 6891 6907 6904 6892 6883 6866 6845
	6843 6864 6882 6896 6906 6924 6914 6900 6882 6873 6890 6902 6919 6913 6902 6891 6873 6851
	6836 6857 6875 6889 6901 6917 6904 6891 6874 6879 6896 6909 6927 6919 6908 6895 6875 6853
	6842 6863 6882 6899 6911 6929 6914 6900 6882 6876 6893 6906 6924 6915 6903 6887 6868 6847
	6850 6872 6891 6910 6921 6939 6923 6909 6890 6882 6900 6914 6932 6921 6909 6891 6871 6849
	6843 6864 6883 6902 6917 6932 6916 6901 6883 6895 6914 6929 6948 6933 6920 6900 6880 6857
	6850 6872 6892 6912 6928 6943 6925 6910 6891 6889 6907 6922 6941 6926 6910 6890 6871 6848
	6859 6882 6902 6923 6941 6955 6937 6921 6901 6901 6921 6936 6955 6938 6920 6899 6879 6855
	6848 6870 6889 6910 6933 6954 6938 6922 6902 6919 6940 6957 6971 6943 6920 6900 6879 6855
	6858 6880 6901 6922 6945 6966 6952 6935 6914 6920 6941 6958 6967 6940 6917 6896 6875 6852
	6868 6892 6913 6936 6960 6981 6967 6949 6926 6931 6954 6972 6978 6948 6925 6903 6882 6857
	6866 6890 6911 6933 6959 6976 6965 6947 6925 6951 6975 6993 6997 6965 6941 6917 6895 6869
	6878 6903 6926 6950 6976 6993 6981 6963 6939 6949 6974 6988 6990 6960 6934 6912 6889 6863
	6891 6917 6941 6967 6994 7010 6998 6980 6954 6967 6993 7008 7007 6975 6949 6924 6901 6873
	6890 6917 6941 6966 6996 7008 6996 6980 6954 6990 7017 7030 7028 6993 6965 6939 6915 6886
	6905 6934 6959 6987 7018 7029 7016 7002 6974 6995 7020 7033 7027 6992 6964 6938 6914 6884
	6924 6954 6982 7012 7045 7055 7039 7026 6995 7018 7042 7056 7048 7011 6981 6953 6927 6896
	6921 6952 6979 7009 7044 7050 7035 7022 6994 7046 7070 7087 7075 7035 7002 6973 6945 6911
	6823 6844 6862 6880 6901 6904 6897 6892 6875 6896 6907 6912 6900 6876 6857 6840 6823 6800
	6854 6879 6899 6922 6947 6949 6940 6932 6915 6939 6952 6960 6946 6918 6895 6874 6855 6828
	6877 6905 6928 6953 6983 6983 6971 6962 6944 6988 7005 7016 7000 6965 6938 6914 6891 6861
	6919 6951 6979 7011 7046 7046 7031 7018 6998 7026 7045 7060 7042 7002 6971 6943 6917 6884
	7011 7055 7095 7140 7192 7191 7163 7141 7109 7148 7177 7202 7178 7123 7079 7040 7004 6957>;

			PS_Config_Lmt_FW_Rawdata_P = <
	1300 1300 1300 1300 1300 1300 1300 1300 1300 1300 1300 1300 1300 1300 1300 1300 1300 1300
	1300 1300 1300 1300 1300 1300 1300 1300 1300 1300 1300 1300 1300 1300 1300 1300 1300 1300
	1300 1300 1300 1300 1300 1300 1300 1300 1300 1300 1300 1300 1300 1300 1300 1300 1300 1300
	1300 1300 1300 1300 1300 1300 1300 1300 1300 1300 1300 1300 1300 1300 1300 1300 1300 1300
	1300 1300 1300 1300 1300 1300 1300 1300 1300 1300 1300 1300 1300 1300 1300 1300 1300 1300
	1300 1300 1300 1300 1300 1300 1300 1300 1300 1300 1300 1300 1300 1300 1300 1300 1300 1300
	1300 1300 1300 1300 1300 1300 1300 1300 1300 1300 1300 1300 1300 1300 1300 1300 1300 1300
	1300 1300 1300 1300 1300 1300 1300 1300 1300 1300 1300 1300 1300 1300 1300 1300 1300 1300
	1300 1300 1300 1300 1300 1300 1300 1300 1300 1300 1300 1300 1300 1300 1300 1300 1300 1300
	1300 1300 1300 1300 1300 1300 1300 1300 1300 1300 1300 1300 1300 1300 1300 1300 1300 1300
	1300 1300 1300 1300 1300 1300 1300 1300 1300 1300 1300 1300 1300 1300 1300 1300 1300 1300
	1300 1300 1300 1300 1300 1300 1300 1300 1300 1300 1300 1300 1300 1300 1300 1300 1300 1300
	1300 1300 1300 1300 1300 1300 1300 1300 1300 1300 1300 1300 1300 1300 1300 1300 1300 1300
	1300 1300 1300 1300 1300 1300 1300 1300 1300 1300 1300 1300 1300 1300 1300 1300 1300 1300
	1300 1300 1300 1300 1300 1300 1300 1300 1300 1300 1300 1300 1300 1300 1300 1300 1300 1300
	1300 1300 1300 1300 1300 1300 1300 1300 1300 1300 1300 1300 1300 1300 1300 1300 1300 1300
	1300 1300 1300 1300 1300 1300 1300 1300 1300 1300 1300 1300 1300 1300 1300 1300 1300 1300
	1300 1300 1300 1300 1300 1300 1300 1300 1300 1300 1300 1300 1300 1300 1300 1300 1300 1300
	1300 1300 1300 1300 1300 1300 1300 1300 1300 1300 1300 1300 1300 1300 1300 1300 1300 1300
	1300 1300 1300 1300 1300 1300 1300 1300 1300 1300 1300 1300 1300 1300 1300 1300 1300 1300
	1300 1300 1300 1300 1300 1300 1300 1300 1300 1300 1300 1300 1300 1300 1300 1300 1300 1300
	1300 1300 1300 1300 1300 1300 1300 1300 1300 1300 1300 1300 1300 1300 1300 1300 1300 1300
	1300 1300 1300 1300 1300 1300 1300 1300 1300 1300 1300 1300 1300 1300 1300 1300 1300 1300
	1300 1300 1300 1300 1300 1300 1300 1300 1300 1300 1300 1300 1300 1300 1300 1300 1300 1300
	1300 1300 1300 1300 1300 1300 1300 1300 1300 1300 1300 1300 1300 1300 1300 1300 1300 1300
	1300 1300 1300 1300 1300 1300 1300 1300 1300 1300 1300 1300 1300 1300 1300 1300 1300 1300
	1300 1300 1300 1300 1300 1300 1300 1300 1300 1300 1300 1300 1300 1300 1300 1300 1300 1300
	1300 1300 1300 1300 1300 1300 1300 1300 1300 1300 1300 1300 1300 1300 1300 1300 1300 1300
	1300 1300 1300 1300 1300 1300 1300 1300 1300 1300 1300 1300 1300 1300 1300 1300 1300 1300
	1300 1300 1300 1300 1300 1300 1300 1300 1300 1300 1300 1300 1300 1300 1300 1300 1300 1300
	1300 1300 1300 1300 1300 1300 1300 1300 1300 1300 1300 1300 1300 1300 1300 1300 1300 1300
	1300 1300 1300 1300 1300 1300 1300 1300 1300 1300 1300 1300 1300 1300 1300 1300 1300 1300>;
			PS_Config_Lmt_FW_Rawdata_N= <
  500 500 500 500 500 500 500 500 500 500 500 500 500 500 500 500 500 500
	500 500 500 500 500 500 500 500 500 500 500 500 500 500 500 500 500 500
	500 500 500 500 500 500 500 500 500 500 500 500 500 500 500 500 500 500
	500 500 500 500 500 500 500 500 500 500 500 500 500 500 500 500 500 500
	500 500 500 500 500 500 500 500 500 500 500 500 500 500 500 500 500 500
	500 500 500 500 500 500 500 500 500 500 500 500 500 500 500 500 500 500
	500 500 500 500 500 500 500 500 500 500 500 500 500 500 500 500 500 500
	500 500 500 500 500 500 500 500 500 500 500 500 500 500 500 500 500 500
	500 500 500 500 500 500 500 500 500 500 500 500 500 500 500 500 500 500
	500 500 500 500 500 500 500 500 500 500 500 500 500 500 500 500 500 500
	500 500 500 500 500 500 500 500 500 500 500 500 500 500 500 500 500 500
	500 500 500 500 500 500 500 500 500 500 500 500 500 500 500 500 500 500
	500 500 500 500 500 500 500 500 500 500 500 500 500 500 500 500 500 500
	500 500 500 500 500 500 500 500 500 500 500 500 500 500 500 500 500 500
	500 500 500 500 500 500 500 500 500 500 500 500 500 500 500 500 500 500
	500 500 500 500 500 500 500 500 500 500 500 500 500 500 500 500 500 500
	500 500 500 500 500 500 500 500 500 500 500 500 500 500 500 500 500 500
	500 500 500 500 500 500 500 500 500 500 500 500 500 500 500 500 500 500
	500 500 500 500 500 500 500 500 500 500 500 500 500 500 500 500 500 500
	500 500 500 500 500 500 500 500 500 500 500 500 500 500 500 500 500 500
	500 500 500 500 500 500 500 500 500 500 500 500 500 500 500 500 500 500
	500 500 500 500 500 500 500 500 500 500 500 500 500 500 500 500 500 500
	500 500 500 500 500 500 500 500 500 500 500 500 500 500 500 500 500 500
	500 500 500 500 500 500 500 500 500 500 500 500 500 500 500 500 500 500
	500 500 500 500 500 500 500 500 500 500 500 500 500 500 500 500 500 500
	500 500 500 500 500 500 500 500 500 500 500 500 500 500 500 500 500 500
	500 500 500 500 500 500 500 500 500 500 500 500 500 500 500 500 500 500
	500 500 500 500 500 500 500 500 500 500 500 500 500 500 500 500 500 500
	500 500 500 500 500 500 500 500 500 500 500 500 500 500 500 500 500 500
	500 500 500 500 500 500 500 500 500 500 500 500 500 500 500 500 500 500
	500 500 500 500 500 500 500 500 500 500 500 500 500 500 500 500 500 500
	500 500 500 500 500 500 500 500 500 500 500 500 500 500 500 500 500 500>;

			PS_Config_Lmt_FW_CC_P =<132>;
			PS_Config_Lmt_FW_CC_N =<74>;
			PS_Config_Lmt_Key_FW_CC_P =<38>;
			PS_Config_Lmt_Key_FW_CC_N =<9>;
			PS_Config_Lmt_FW_CC_I_P =<25>;
			PS_Config_Lmt_FW_CC_I_N =<0>;
			PS_Config_Lmt_FW_CC_Q_P =<25>;
			PS_Config_Lmt_FW_CC_Q_N =<0>;
			PS_Config_Lmt_Key_FW_CC_I_P =<25>;
			PS_Config_Lmt_Key_FW_CC_I_N =<0>;
			PS_Config_Lmt_Key_FW_CC_Q_P =<25>;
			PS_Config_Lmt_Key_FW_CC_Q_N =<0>;

			PS_Config_Lmt_FW_Diff_P =<35>;
			PS_Config_Lmt_FW_Diff_N =<(-35)>;
			PS_Config_Lmt_Key_FW_Diff_P =<35>;
			PS_Config_Lmt_Key_FW_Diff_N =<(-35)>;

		 PS_Config_Diff_Test_Frame =<50>;
		};

		novatek-mp-criteria-5909@1 {
			#address-cells = <1>;
			#size-cells = <0>;
			compatible = "novatek-mp-criteria-5909";

			/* MP Config*/
			IC_X_CFG_SIZE = <18>;
			IC_Y_CFG_SIZE = <32>;
			IC_KEY_CFG_SIZE = <4>;
			X_Channel = <18>;
			Y_Channel = <32>;
			AIN_X = <17 16 15 14 13 12 11 10 9 8 7 6 5 4 3 2 1 0>;
			AIN_Y = <31 30 29 28 27 26 25 24 23 22 21 20 19 18 17 16 15
							14 13 12 11 10 9 8 7 6 5 4 3 2 1 0>;
			AIN_KEY = <0 1 2 0xFF>;

			/* MP Criteria */
				PS_Config_Lmt_Short_Rawdata_P = <14000>;
				PS_Config_Lmt_Short_Rawdata_N = <11000>;
				PS_Config_Lmt_Key_Short_Rawdata_P = <14000>;
				PS_Config_Lmt_Key_Short_Rawdata_N = <11000>;
				PS_Config_Lmt_Short_Diff_P = <6300>;
				PS_Config_Lmt_Short_Diff_N = <0>;
				PS_Config_Lmt_Key_Short_Diff_P = <6300>;
				PS_Config_Lmt_Key_Short_Diff_N = <0>;
				PS_Config_Lmt_Short_Base_P = <2000>;
				PS_Config_Lmt_Short_Base_N = <(-2000)>;
				PS_Config_Lmt_Key_Short_Base_P = <2000>;
				PS_Config_Lmt_Key_Short_Base_N = <(-2000)>;

				PS_Config_Lmt_Open_Rawdata_P = <
	9032 9105 9084 9055 9049 9011 9030 9044 9078 9024 9036 9019 8992 8985 8995 9014 9018 9045
	8898 8951 8933 8904 8903 8864 8886 8896 8929 8874 8877 8863 8838 8831 8839 8854 8852 8871
	8864 8894 8879 8855 8857 8834 8844 8853 8885 8810 8810 8796 8774 8766 8776 8785 8784 8803
	8855 8896 8879 8858 8863 8834 8853 8864 8896 8848 8846 8834 8809 8812 8812 8817 8817 8818
	8809 8857 8828 8809 8813 8783 8805 8816 8847 8794 8791 8779 8754 8750 8755 8760 8768 8756
	8838 8875 8847 8830 8836 8816 8832 8842 8871 8806 8800 8792 8766 8761 8768 8768 8780 8769
	8785 8823 8792 8781 8787 8766 8783 8796 8824 8775 8769 8758 8733 8741 8739 8738 8747 8736
	8793 8817 8796 8784 8789 8771 8788 8801 8830 8783 8776 8764 8740 8739 8742 8741 8741 8736
	8758 8775 8770 8748 8754 8739 8755 8766 8795 8725 8719 8708 8683 8680 8683 8695 8680 8680
	8761 8775 8771 8749 8758 8743 8761 8774 8801 8758 8749 8737 8713 8722 8715 8727 8711 8713
	8711 8722 8717 8697 8700 8692 8709 8721 8748 8696 8686 8676 8652 8654 8652 8664 8649 8649
	8729 8734 8726 8712 8725 8709 8726 8739 8764 8702 8690 8678 8656 8655 8654 8662 8653 8653
	8661 8665 8648 8652 8652 8645 8663 8675 8695 8657 8643 8635 8611 8625 8618 8612 8612 8612
	8657 8661 8646 8654 8645 8641 8660 8671 8686 8650 8637 8627 8604 8608 8615 8603 8606 8601
	8607 8609 8597 8605 8608 8591 8611 8622 8635 8586 8574 8565 8543 8544 8551 8535 8542 8536
	8590 8592 8582 8591 8584 8580 8598 8609 8622 8592 8580 8569 8548 8563 8558 8543 8551 8544
	8524 8530 8522 8519 8521 8521 8540 8550 8564 8521 8509 8498 8478 8485 8476 8475 8485 8478
	8532 8536 8529 8527 8536 8537 8543 8553 8568 8522 8504 8493 8486 8478 8473 8473 8485 8476
	8460 8465 8459 8459 8457 8457 8476 8486 8500 8477 8458 8449 8430 8445 8430 8429 8442 8433
	8447 8453 8450 8449 8443 8446 8477 8476 8488 8458 8439 8441 8411 8418 8411 8412 8426 8412
	8392 8396 8397 8398 8402 8394 8424 8423 8433 8392 8373 8374 8347 8352 8347 8348 8361 8345
	8368 8374 8375 8376 8371 8373 8403 8401 8409 8391 8371 8375 8346 8362 8347 8351 8365 8345
	8297 8305 8308 8309 8299 8304 8325 8333 8339 8315 8296 8290 8271 8281 8272 8278 8291 8267
	8286 8297 8300 8302 8302 8295 8313 8336 8327 8297 8290 8269 8254 8264 8255 8260 8274 8248
	8217 8229 8232 8235 8224 8227 8245 8268 8258 8243 8238 8214 8199 8210 8200 8209 8222 8195
	8195 8208 8212 8213 8200 8206 8223 8247 8235 8218 8213 8190 8173 8186 8176 8187 8200 8170
	8143 8157 8161 8161 8159 8153 8170 8189 8181 8150 8144 8124 8108 8119 8108 8121 8134 8100
	8105 8119 8123 8121 8109 8114 8131 8142 8148 8137 8111 8100 8084 8095 8085 8100 8113 8076
	8047 8060 8065 8060 8046 8053 8070 8081 8091 8076 8045 8033 8017 8027 8018 8034 8049 8008
	8043 8056 8063 8054 8050 8047 8063 8075 8084 8060 8029 8017 7999 8011 8003 8021 8036 7990
	7996 8010 8016 8004 7990 7996 8013 8025 8031 8021 7991 7978 7969 7972 7966 7985 8002 7955
	8047 8060 8063 8047 8025 8039 8057 8070 8057 8047 8037 8022 8003 8016 8016 8037 8055 7985>;


				PS_Config_Lmt_Open_Rawdata_N = <
	7699 7739 7727 7711 7708 7688 7698 7705 7724 7695 7701 7692 7677 7674 7679 7690 7691 7706
	7627 7655 7646 7630 7630 7608 7620 7626 7643 7614 7615 7608 7595 7591 7595 7603 7602 7612
	7609 7625 7617 7604 7605 7593 7598 7602 7620 7580 7580 7572 7560 7556 7561 7566 7566 7576
	7604 7626 7617 7605 7608 7592 7603 7608 7626 7600 7599 7592 7579 7580 7581 7583 7583 7584
	7579 7605 7589 7579 7581 7565 7577 7583 7599 7571 7569 7563 7549 7547 7550 7553 7557 7551
	7595 7615 7599 7590 7594 7583 7591 7597 7612 7578 7574 7570 7556 7553 7557 7557 7564 7558
	7566 7587 7570 7564 7567 7556 7565 7572 7587 7561 7558 7552 7538 7543 7541 7541 7546 7540
	7570 7583 7572 7566 7568 7559 7568 7574 7590 7565 7561 7555 7542 7541 7543 7543 7542 7540
	7552 7560 7558 7546 7550 7541 7550 7556 7572 7534 7531 7524 7511 7510 7511 7518 7509 7509
	7553 7561 7558 7547 7551 7544 7553 7560 7575 7551 7546 7540 7527 7532 7529 7535 7526 7528
	7526 7532 7530 7519 7520 7516 7525 7532 7546 7518 7513 7507 7495 7495 7494 7501 7493 7493
	7536 7539 7534 7527 7534 7525 7534 7541 7555 7521 7515 7509 7496 7496 7495 7500 7495 7495
	7499 7502 7492 7494 7494 7491 7500 7507 7518 7497 7490 7485 7472 7480 7476 7473 7473 7473
	7497 7499 7491 7496 7491 7488 7499 7505 7513 7494 7487 7481 7469 7471 7475 7468 7470 7467
	7470 7471 7465 7469 7471 7462 7472 7478 7485 7459 7452 7448 7436 7436 7440 7432 7435 7432
	7461 7462 7457 7461 7458 7456 7466 7472 7478 7462 7456 7450 7438 7447 7444 7436 7440 7436
	7426 7429 7424 7423 7424 7424 7434 7440 7447 7424 7417 7411 7401 7405 7400 7399 7404 7401
	7430 7432 7428 7427 7432 7433 7436 7441 7449 7425 7415 7409 7405 7401 7398 7398 7404 7400
	7391 7394 7390 7390 7390 7390 7400 7405 7413 7400 7390 7385 7375 7383 7375 7375 7381 7376
	7384 7387 7386 7385 7382 7384 7400 7400 7406 7390 7380 7381 7365 7369 7365 7365 7373 7365
	7355 7357 7357 7358 7360 7355 7372 7371 7377 7355 7344 7345 7330 7333 7330 7331 7338 7329
	7342 7345 7345 7346 7343 7344 7360 7359 7364 7354 7343 7345 7330 7338 7330 7332 7340 7329
	7303 7308 7309 7310 7305 7307 7318 7323 7326 7313 7303 7300 7289 7295 7290 7293 7300 7287
	7297 7303 7305 7306 7306 7302 7312 7324 7319 7303 7300 7288 7280 7285 7281 7284 7291 7277
	7260 7266 7268 7270 7264 7266 7275 7288 7282 7274 7271 7259 7250 7256 7251 7256 7263 7248
	7248 7255 7258 7258 7251 7254 7263 7276 7270 7261 7258 7246 7237 7243 7238 7244 7251 7235
	7220 7228 7230 7230 7229 7226 7235 7245 7241 7224 7221 7210 7201 7207 7201 7209 7216 7197
	7200 7207 7210 7208 7202 7205 7214 7220 7223 7217 7203 7197 7189 7194 7189 7197 7204 7184
	7169 7176 7179 7176 7168 7172 7181 7187 7192 7184 7167 7161 7152 7158 7153 7162 7170 7147
	7167 7174 7177 7172 7170 7169 7177 7184 7189 7176 7159 7153 7143 7149 7145 7155 7163 7138
	7141 7149 7152 7146 7138 7141 7150 7157 7160 7155 7138 7132 7127 7128 7125 7135 7145 7119
	7168 7176 7178 7169 7157 7164 7174 7181 7174 7169 7163 7155 7145 7152 7152 7163 7173 7135>;

				PS_Config_Lmt_FW_Rawdata_P = <
	1600 1600 1600 1600 1600 1600 1600 1600 1600 1600 1600 1600 1600 1600 1600 1600 1600 1600
	1600 1600 1600 1600 1600 1600 1600 1600 1600 1600 1600 1600 1600 1600 1600 1600 1600 1600
	1600 1600 1600 1600 1600 1600 1600 1600 1600 1600 1600 1600 1600 1600 1600 1600 1600 1600
	1600 1600 1600 1600 1600 1600 1600 1600 1600 1600 1600 1600 1600 1600 1600 1600 1600 1600
	1600 1600 1600 1600 1600 1600 1600 1600 1600 1600 1600 1600 1600 1600 1600 1600 1600 1600
	1600 1600 1600 1600 1600 1600 1600 1600 1600 1600 1600 1600 1600 1600 1600 1600 1600 1600
	1600 1600 1600 1600 1600 1600 1600 1600 1600 1600 1600 1600 1600 1600 1600 1600 1600 1600
	1600 1600 1600 1600 1600 1600 1600 1600 1600 1600 1600 1600 1600 1600 1600 1600 1600 1600
	1600 1600 1600 1600 1600 1600 1600 1600 1600 1600 1600 1600 1600 1600 1600 1600 1600 1600
	1600 1600 1600 1600 1600 1600 1600 1600 1600 1600 1600 1600 1600 1600 1600 1600 1600 1600
	1600 1600 1600 1600 1600 1600 1600 1600 1600 1600 1600 1600 1600 1600 1600 1600 1600 1600
	1600 1600 1600 1600 1600 1600 1600 1600 1600 1600 1600 1600 1600 1600 1600 1600 1600 1600
	1600 1600 1600 1600 1600 1600 1600 1600 1600 1600 1600 1600 1600 1600 1600 1600 1600 1600
	1600 1600 1600 1600 1600 1600 1600 1600 1600 1600 1600 1600 1600 1600 1600 1600 1600 1600
	1600 1600 1600 1600 1600 1600 1600 1600 1600 1600 1600 1600 1600 1600 1600 1600 1600 1600
	1600 1600 1600 1600 1600 1600 1600 1600 1600 1600 1600 1600 1600 1600 1600 1600 1600 1600
	1600 1600 1600 1600 1600 1600 1600 1600 1600 1600 1600 1600 1600 1600 1600 1600 1600 1600
	1600 1600 1600 1600 1600 1600 1600 1600 1600 1600 1600 1600 1600 1600 1600 1600 1600 1600
	1600 1600 1600 1600 1600 1600 1600 1600 1600 1600 1600 1600 1600 1600 1600 1600 1600 1600
	1600 1600 1600 1600 1600 1600 1600 1600 1600 1600 1600 1600 1600 1600 1600 1600 1600 1600
	1600 1600 1600 1600 1600 1600 1600 1600 1600 1600 1600 1600 1600 1600 1600 1600 1600 1600
	1600 1600 1600 1600 1600 1600 1600 1600 1600 1600 1600 1600 1600 1600 1600 1600 1600 1600
	1600 1600 1600 1600 1600 1600 1600 1600 1600 1600 1600 1600 1600 1600 1600 1600 1600 1600
	1600 1600 1600 1600 1600 1600 1600 1600 1600 1600 1600 1600 1600 1600 1600 1600 1600 1600
	1600 1600 1600 1600 1600 1600 1600 1600 1600 1600 1600 1600 1600 1600 1600 1600 1600 1600
	1600 1600 1600 1600 1600 1600 1600 1600 1600 1600 1600 1600 1600 1600 1600 1600 1600 1600
	1600 1600 1600 1600 1600 1600 1600 1600 1600 1600 1600 1600 1600 1600 1600 1600 1600 1600
	1600 1600 1600 1600 1600 1600 1600 1600 1600 1600 1600 1600 1600 1600 1600 1600 1600 1600
	1600 1600 1600 1600 1600 1600 1600 1600 1600 1600 1600 1600 1600 1600 1600 1600 1600 1600
	1600 1600 1600 1600 1600 1600 1600 1600 1600 1600 1600 1600 1600 1600 1600 1600 1600 1600
	1600 1600 1600 1600 1600 1600 1600 1600 1600 1600 1600 1600 1600 1600 1600 1600 1600 1600
	1600 1600 1600 1600 1600 1600 1600 1600 1600 1600 1600 1600 1600 1600 1600 1600 1600 1600>;

				PS_Config_Lmt_FW_Rawdata_N= <
	800 800 800 800 800 800 800 800 800 800 800 800 800 800 800 800 800 800
	800 800 800 800 800 800 800 800 800 800 800 800 800 800 800 800 800 800
	800 800 800 800 800 800 800 800 800 800 800 800 800 800 800 800 800 800
	800 800 800 800 800 800 800 800 800 800 800 800 800 800 800 800 800 800
	800 800 800 800 800 800 800 800 800 800 800 800 800 800 800 800 800 800
	800 800 800 800 800 800 800 800 800 800 800 800 800 800 800 800 800 800
	800 800 800 800 800 800 800 800 800 800 800 800 800 800 800 800 800 800
	800 800 800 800 800 800 800 800 800 800 800 800 800 800 800 800 800 800
	800 800 800 800 800 800 800 800 800 800 800 800 800 800 800 800 800 800
	800 800 800 800 800 800 800 800 800 800 800 800 800 800 800 800 800 800
	800 800 800 800 800 800 800 800 800 800 800 800 800 800 800 800 800 800
	800 800 800 800 800 800 800 800 800 800 800 800 800 800 800 800 800 800
	800 800 800 800 800 800 800 800 800 800 800 800 800 800 800 800 800 800
	800 800 800 800 800 800 800 800 800 800 800 800 800 800 800 800 800 800
	800 800 800 800 800 800 800 800 800 800 800 800 800 800 800 800 800 800
	800 800 800 800 800 800 800 800 800 800 800 800 800 800 800 800 800 800
	800 800 800 800 800 800 800 800 800 800 800 800 800 800 800 800 800 800
	800 800 800 800 800 800 800 800 800 800 800 800 800 800 800 800 800 800
	800 800 800 800 800 800 800 800 800 800 800 800 800 800 800 800 800 800
	800 800 800 800 800 800 800 800 800 800 800 800 800 800 800 800 800 800
	800 800 800 800 800 800 800 800 800 800 800 800 800 800 800 800 800 800
	800 800 800 800 800 800 800 800 800 800 800 800 800 800 800 800 800 800
	800 800 800 800 800 800 800 800 800 800 800 800 800 800 800 800 800 800
	800 800 800 800 800 800 800 800 800 800 800 800 800 800 800 800 800 800
	800 800 800 800 800 800 800 800 800 800 800 800 800 800 800 800 800 800
	800 800 800 800 800 800 800 800 800 800 800 800 800 800 800 800 800 800
	800 800 800 800 800 800 800 800 800 800 800 800 800 800 800 800 800 800
	800 800 800 800 800 800 800 800 800 800 800 800 800 800 800 800 800 800
	800 800 800 800 800 800 800 800 800 800 800 800 800 800 800 800 800 800
	800 800 800 800 800 800 800 800 800 800 800 800 800 800 800 800 800 800
	800 800 800 800 800 800 800 800 800 800 800 800 800 800 800 800 800 800
	800 800 800 800 800 800 800 800 800 800 800 800 800 800 800 800 800 800>;

			PS_Config_Lmt_FW_CC_P =<118>;
			PS_Config_Lmt_FW_CC_N = <62>;
			PS_Config_Lmt_Key_FW_CC_P = <38>;
			PS_Config_Lmt_Key_FW_CC_N = <9>;
			PS_Config_Lmt_FW_CC_I_P = <25>;
			PS_Config_Lmt_FW_CC_I_N = <0>;
			PS_Config_Lmt_FW_CC_Q_P = <25>;
			PS_Config_Lmt_FW_CC_Q_N = <0>;
			PS_Config_Lmt_Key_FW_CC_I_P = <25>;
			PS_Config_Lmt_Key_FW_CC_I_N = <0>;
			PS_Config_Lmt_Key_FW_CC_Q_P = <25>;
			PS_Config_Lmt_Key_FW_CC_Q_N = <0>;

			PS_Config_Lmt_FW_Diff_P = <35>;
			PS_Config_Lmt_FW_Diff_N = <(-35)>;
			PS_Config_Lmt_Key_FW_Diff_P = <35>;
			PS_Config_Lmt_Key_FW_Diff_N = <(-35)>;

			PS_Config_Diff_Test_Frame = <50>;

//#endif /* #if NVT_TOUCH_MP */
		};
	};
 };
