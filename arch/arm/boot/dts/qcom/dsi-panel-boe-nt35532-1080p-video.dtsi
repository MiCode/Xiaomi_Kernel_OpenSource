/* Copyright (c) 2015, The Linux Foundation. All rights reserved.
 * Copyright (C) 2016 XiaoMi, Inc.
 *
 * This program is free software; you can redistribute it and/or modify
 * it under the terms of the GNU General Public License version 2 and
 * only version 2 as published by the Free Software Foundation.
 *
 * This program is distributed in the hope that it will be useful,
 * but WITHOUT ANY WARRANTY; without even the implied warranty of
 * MERCHANTABILITY or FITNESS FOR A PARTICULAR PURPOSE.  See the
 * GNU General Public License for more details.
 */
&mdss_mdp {
	dsi_boe_nt35532_1080_vid: qcom,mdss_dsi_boe_nt35532_1080p_video {
		qcom,mdss-dsi-panel-name = "boe nt35532 1080p video mode dsi panel";
		qcom,mdss-dsi-panel-type = "dsi_video_mode";
		qcom,mdss-dsi-panel-framerate = <60>;
		qcom,mdss-dsi-virtual-channel-id = <0>;
		qcom,mdss-dsi-stream = <0>;
		qcom,mdss-dsi-panel-width = <1080>;
		qcom,mdss-dsi-panel-height = <1920>;
		qcom,mdss-dsi-h-front-porch = <98>;
		qcom,mdss-dsi-h-back-porch = <98>;
		qcom,mdss-dsi-h-pulse-width = <8>;
		qcom,mdss-dsi-h-sync-skew = <0>;
		qcom,mdss-dsi-v-back-porch = <8>;
		qcom,mdss-dsi-v-front-porch = <10>;
		qcom,mdss-dsi-v-pulse-width = <2>;
		qcom,mdss-dsi-h-left-border = <0>;
		qcom,mdss-dsi-h-right-border = <0>;
		qcom,mdss-dsi-v-top-border = <0>;
		qcom,mdss-dsi-v-bottom-border = <0>;
		qcom,mdss-dsi-bpp = <24>;
		qcom,mdss-dsi-underflow-color = <0xff>;
		qcom,mdss-dsi-border-color = <0>;
		qcom,mdss-dsi-h-sync-pulse = <0>;
		qcom,mdss-dsi-traffic-mode = "burst_mode";
		qcom,mdss-dsi-bllp-eof-power-mode;
		qcom,mdss-dsi-bllp-power-mode;
		qcom,mdss-dsi-lane-0-state;
		qcom,mdss-dsi-lane-1-state;
		qcom,mdss-dsi-lane-2-state;
		qcom,mdss-dsi-lane-3-state;
		qcom,mdss-dsi-panel-timings = [E6 38 26 00 68 6C 2A 3C 2C 03 04 00];
		qcom,mdss-dsi-t-clk-post = <0x02>;
		qcom,mdss-dsi-t-clk-pre = <0x2d>;
		qcom,mdss-dsi-bl-min-level = <16>;
		qcom,mdss-dsi-bl-max-level = <4095>;
		qcom,mdss-dsi-dma-trigger = "trigger_sw";
		qcom,mdss-dsi-mdp-trigger = "none";
		qcom,mdss-dsi-on-command = [
				23 01 00 00 00 00 02 FF ee
				23 01 00 00 00 00 02 18 40
				23 01 00 00 00 00 02 18 00
				23 01 00 00 00 00 02 FF 01
				23 01 00 00 00 00 02 FB 01
				23 01 00 00 00 00 02 68 13
				23 01 00 00 00 00 02 75 00
				23 01 00 00 00 00 02 76 00
				23 01 00 00 00 00 02 77 00
				23 01 00 00 00 00 02 78 22
				23 01 00 00 00 00 02 79 00
				23 01 00 00 00 00 02 7A 51
				23 01 00 00 00 00 02 7B 00
				23 01 00 00 00 00 02 7C 73
				23 01 00 00 00 00 02 7D 00
				23 01 00 00 00 00 02 7E 8D
				23 01 00 00 00 00 02 7F 00
				23 01 00 00 00 00 02 80 A4
				23 01 00 00 00 00 02 81 00
				23 01 00 00 00 00 02 82 B8
				23 01 00 00 00 00 02 83 00
				23 01 00 00 00 00 02 84 CA
				23 01 00 00 00 00 02 85 00
				23 01 00 00 00 00 02 86 D9
				23 01 00 00 00 00 02 87 01
				23 01 00 00 00 00 02 88 0D
				23 01 00 00 00 00 02 89 01
				23 01 00 00 00 00 02 8A 36
				23 01 00 00 00 00 02 8B 01
				23 01 00 00 00 00 02 8C 75
				23 01 00 00 00 00 02 8D 01
				23 01 00 00 00 00 02 8E A7
				23 01 00 00 00 00 02 8F 01
				23 01 00 00 00 00 02 90 F2
				23 01 00 00 00 00 02 91 02
				23 01 00 00 00 00 02 92 2B
				23 01 00 00 00 00 02 93 02
				23 01 00 00 00 00 02 94 2B
				23 01 00 00 00 00 02 95 02
				23 01 00 00 00 00 02 96 61
				23 01 00 00 00 00 02 97 02
				23 01 00 00 00 00 02 98 9D
				23 01 00 00 00 00 02 99 02
				23 01 00 00 00 00 02 9A C6
				23 01 00 00 00 00 02 9B 03
				23 01 00 00 00 00 02 9C 01
				23 01 00 00 00 00 02 9D 03
				23 01 00 00 00 00 02 9E 27
				23 01 00 00 00 00 02 9F 03
				23 01 00 00 00 00 02 A0 63
				23 01 00 00 00 00 02 A2 03
				23 01 00 00 00 00 02 A3 6B
				23 01 00 00 00 00 02 A4 03
				23 01 00 00 00 00 02 A5 72
				23 01 00 00 00 00 02 A6 03
				23 01 00 00 00 00 02 A7 7E
				23 01 00 00 00 00 02 A9 03
				23 01 00 00 00 00 02 AA 87
				23 01 00 00 00 00 02 AB 03
				23 01 00 00 00 00 02 AC 93
				23 01 00 00 00 00 02 AD 03
				23 01 00 00 00 00 02 AE 9B
				23 01 00 00 00 00 02 AF 03
				23 01 00 00 00 00 02 B0 A2
				23 01 00 00 00 00 02 B1 03
				23 01 00 00 00 00 02 B2 FF
				23 01 00 00 00 00 02 B3 00
				23 01 00 00 00 00 02 B4 00
				23 01 00 00 00 00 02 B5 00
				23 01 00 00 00 00 02 B6 22
				23 01 00 00 00 00 02 B7 00
				23 01 00 00 00 00 02 B8 51
				23 01 00 00 00 00 02 B9 00
				23 01 00 00 00 00 02 BA 73
				23 01 00 00 00 00 02 BB 00
				23 01 00 00 00 00 02 BC 8D
				23 01 00 00 00 00 02 BD 00
				23 01 00 00 00 00 02 BE A4
				23 01 00 00 00 00 02 BF 00
				23 01 00 00 00 00 02 C0 B8
				23 01 00 00 00 00 02 C1 00
				23 01 00 00 00 00 02 C2 CA
				23 01 00 00 00 00 02 C3 00
				23 01 00 00 00 00 02 C4 D9
				23 01 00 00 00 00 02 C5 01
				23 01 00 00 00 00 02 C6 0D
				23 01 00 00 00 00 02 C7 01
				23 01 00 00 00 00 02 C8 36
				23 01 00 00 00 00 02 C9 01
				23 01 00 00 00 00 02 CA 75
				23 01 00 00 00 00 02 CB 01
				23 01 00 00 00 00 02 CC A7
				23 01 00 00 00 00 02 CD 01
				23 01 00 00 00 00 02 CE F2
				23 01 00 00 00 00 02 CF 02
				23 01 00 00 00 00 02 D0 2B
				23 01 00 00 00 00 02 D1 02
				23 01 00 00 00 00 02 D2 2B
				23 01 00 00 00 00 02 D3 02
				23 01 00 00 00 00 02 D4 61
				23 01 00 00 00 00 02 D5 02
				23 01 00 00 00 00 02 D6 9D
				23 01 00 00 00 00 02 D7 02
				23 01 00 00 00 00 02 D8 C6
				23 01 00 00 00 00 02 D9 03
				23 01 00 00 00 00 02 DA 01
				23 01 00 00 00 00 02 DB 03
				23 01 00 00 00 00 02 DC 27
				23 01 00 00 00 00 02 DD 03
				23 01 00 00 00 00 02 DE 63
				23 01 00 00 00 00 02 DF 03
				23 01 00 00 00 00 02 E0 6B
				23 01 00 00 00 00 02 E1 03
				23 01 00 00 00 00 02 E2 72
				23 01 00 00 00 00 02 E3 03
				23 01 00 00 00 00 02 E4 7E
				23 01 00 00 00 00 02 E5 03
				23 01 00 00 00 00 02 E6 87
				23 01 00 00 00 00 02 E7 03
				23 01 00 00 00 00 02 E8 93
				23 01 00 00 00 00 02 E9 03
				23 01 00 00 00 00 02 EA 9B
				23 01 00 00 00 00 02 EB 03
				23 01 00 00 00 00 02 EC A2
				23 01 00 00 00 00 02 ED 03
				23 01 00 00 00 00 02 EE FF
				23 01 00 00 00 00 02 EF 00
				23 01 00 00 00 00 02 F0 D6
				23 01 00 00 00 00 02 F1 00
				23 01 00 00 00 00 02 F2 DD
				23 01 00 00 00 00 02 F3 00
				23 01 00 00 00 00 02 F4 EA
				23 01 00 00 00 00 02 F5 00
				23 01 00 00 00 00 02 F6 F7
				23 01 00 00 00 00 02 F7 01
				23 01 00 00 00 00 02 F8 03
				23 01 00 00 00 00 02 F9 01
				23 01 00 00 00 00 02 FA 0D
				23 01 00 00 00 00 02 FF 02
				23 01 00 00 00 00 02 FB 01
				23 01 00 00 00 00 02 00 01
				23 01 00 00 00 00 02 01 17
				23 01 00 00 00 00 02 02 01
				23 01 00 00 00 00 02 03 21
				23 01 00 00 00 00 02 04 01
				23 01 00 00 00 00 02 05 2A
				23 01 00 00 00 00 02 06 01
				23 01 00 00 00 00 02 07 4B
				23 01 00 00 00 00 02 08 01
				23 01 00 00 00 00 02 09 68
				23 01 00 00 00 00 02 0A 01
				23 01 00 00 00 00 02 0B 98
				23 01 00 00 00 00 02 0C 01
				23 01 00 00 00 00 02 0D C0
				23 01 00 00 00 00 02 0E 02
				23 01 00 00 00 00 02 0F 00
				23 01 00 00 00 00 02 10 02
				23 01 00 00 00 00 02 11 34
				23 01 00 00 00 00 02 12 02
				23 01 00 00 00 00 02 13 35
				23 01 00 00 00 00 02 14 02
				23 01 00 00 00 00 02 15 68
				23 01 00 00 00 00 02 16 02
				23 01 00 00 00 00 02 17 A4
				23 01 00 00 00 00 02 18 02
				23 01 00 00 00 00 02 19 CC
				23 01 00 00 00 00 02 1A 03
				23 01 00 00 00 00 02 1B 07
				23 01 00 00 00 00 02 1C 03
				23 01 00 00 00 00 02 1D 2F
				23 01 00 00 00 00 02 1E 03
				23 01 00 00 00 00 02 1F 6A
				23 01 00 00 00 00 02 20 03
				23 01 00 00 00 00 02 21 71
				23 01 00 00 00 00 02 22 03
				23 01 00 00 00 00 02 23 85
				23 01 00 00 00 00 02 24 03
				23 01 00 00 00 00 02 25 9A
				23 01 00 00 00 00 02 26 03
				23 01 00 00 00 00 02 27 B2
				23 01 00 00 00 00 02 28 03
				23 01 00 00 00 00 02 29 CA
				23 01 00 00 00 00 02 2A 03
				23 01 00 00 00 00 02 2B E2
				23 01 00 00 00 00 02 2D 03
				23 01 00 00 00 00 02 2F F5
				23 01 00 00 00 00 02 30 03
				23 01 00 00 00 00 02 31 FF
				23 01 00 00 00 00 02 32 00
				23 01 00 00 00 00 02 33 D6
				23 01 00 00 00 00 02 34 00
				23 01 00 00 00 00 02 35 DD
				23 01 00 00 00 00 02 36 00
				23 01 00 00 00 00 02 37 EA
				23 01 00 00 00 00 02 38 00
				23 01 00 00 00 00 02 39 F7
				23 01 00 00 00 00 02 3A 01
				23 01 00 00 00 00 02 3B 03
				23 01 00 00 00 00 02 3D 01
				23 01 00 00 00 00 02 3F 0D
				23 01 00 00 00 00 02 40 01
				23 01 00 00 00 00 02 41 17
				23 01 00 00 00 00 02 42 01
				23 01 00 00 00 00 02 43 21
				23 01 00 00 00 00 02 44 01
				23 01 00 00 00 00 02 45 2A
				23 01 00 00 00 00 02 46 01
				23 01 00 00 00 00 02 47 4B
				23 01 00 00 00 00 02 48 01
				23 01 00 00 00 00 02 49 68
				23 01 00 00 00 00 02 4A 01
				23 01 00 00 00 00 02 4B 98
				23 01 00 00 00 00 02 4C 01
				23 01 00 00 00 00 02 4D C0
				23 01 00 00 00 00 02 4E 02
				23 01 00 00 00 00 02 4F 00
				23 01 00 00 00 00 02 50 02
				23 01 00 00 00 00 02 51 34
				23 01 00 00 00 00 02 52 02
				23 01 00 00 00 00 02 53 35
				23 01 00 00 00 00 02 54 02
				23 01 00 00 00 00 02 55 68
				23 01 00 00 00 00 02 56 02
				23 01 00 00 00 00 02 58 A4
				23 01 00 00 00 00 02 59 02
				23 01 00 00 00 00 02 5A CC
				23 01 00 00 00 00 02 5B 03
				23 01 00 00 00 00 02 5C 07
				23 01 00 00 00 00 02 5D 03
				23 01 00 00 00 00 02 5E 2F
				23 01 00 00 00 00 02 5F 03
				23 01 00 00 00 00 02 60 6A
				23 01 00 00 00 00 02 61 03
				23 01 00 00 00 00 02 62 71
				23 01 00 00 00 00 02 63 03
				23 01 00 00 00 00 02 64 85
				23 01 00 00 00 00 02 65 03
				23 01 00 00 00 00 02 66 9A
				23 01 00 00 00 00 02 67 03
				23 01 00 00 00 00 02 68 B2
				23 01 00 00 00 00 02 69 03
				23 01 00 00 00 00 02 6A CA
				23 01 00 00 00 00 02 6B 03
				23 01 00 00 00 00 02 6C E2
				23 01 00 00 00 00 02 6D 03
				23 01 00 00 00 00 02 6E F5
				23 01 00 00 00 00 02 6F 03
				23 01 00 00 00 00 02 70 FF
				23 01 00 00 00 00 02 71 00
				23 01 00 00 00 00 02 72 CD
				23 01 00 00 00 00 02 73 00
				23 01 00 00 00 00 02 74 D5
				23 01 00 00 00 00 02 75 00
				23 01 00 00 00 00 02 76 E3
				23 01 00 00 00 00 02 77 00
				23 01 00 00 00 00 02 78 EF
				23 01 00 00 00 00 02 79 00
				23 01 00 00 00 00 02 7A FB
				23 01 00 00 00 00 02 7B 01
				23 01 00 00 00 00 02 7C 06
				23 01 00 00 00 00 02 7D 01
				23 01 00 00 00 00 02 7E 11
				23 01 00 00 00 00 02 7F 01
				23 01 00 00 00 00 02 80 1B
				23 01 00 00 00 00 02 81 01
				23 01 00 00 00 00 02 82 24
				23 01 00 00 00 00 02 83 01
				23 01 00 00 00 00 02 84 46
				23 01 00 00 00 00 02 85 01
				23 01 00 00 00 00 02 86 63
				23 01 00 00 00 00 02 87 01
				23 01 00 00 00 00 02 88 94
				23 01 00 00 00 00 02 89 01
				23 01 00 00 00 00 02 8A BB
				23 01 00 00 00 00 02 8B 01
				23 01 00 00 00 00 02 8C FC
				23 01 00 00 00 00 02 8D 02
				23 01 00 00 00 00 02 8E 32
				23 01 00 00 00 00 02 8F 02
				23 01 00 00 00 00 02 90 32
				23 01 00 00 00 00 02 91 02
				23 01 00 00 00 00 02 92 66
				23 01 00 00 00 00 02 93 02
				23 01 00 00 00 00 02 94 A3
				23 01 00 00 00 00 02 95 02
				23 01 00 00 00 00 02 96 CC
				23 01 00 00 00 00 02 97 03
				23 01 00 00 00 00 02 98 0B
				23 01 00 00 00 00 02 99 03
				23 01 00 00 00 00 02 9A 38
				23 01 00 00 00 00 02 9B 03
				23 01 00 00 00 00 02 9C 8A
				23 01 00 00 00 00 02 9D 03
				23 01 00 00 00 00 02 9E 97
				23 01 00 00 00 00 02 9F 03
				23 01 00 00 00 00 02 A0 97
				23 01 00 00 00 00 02 A2 03
				23 01 00 00 00 00 02 A3 99
				23 01 00 00 00 00 02 A4 03
				23 01 00 00 00 00 02 A5 9B
				23 01 00 00 00 00 02 A6 03
				23 01 00 00 00 00 02 A7 9D
				23 01 00 00 00 00 02 A9 03
				23 01 00 00 00 00 02 AA 9F
				23 01 00 00 00 00 02 AB 03
				23 01 00 00 00 00 02 AC A1
				23 01 00 00 00 00 02 AD 03
				23 01 00 00 00 00 02 AE A2
				23 01 00 00 00 00 02 AF 00
				23 01 00 00 00 00 02 B0 CD
				23 01 00 00 00 00 02 B1 00
				23 01 00 00 00 00 02 B2 D5
				23 01 00 00 00 00 02 B3 00
				23 01 00 00 00 00 02 B4 E3
				23 01 00 00 00 00 02 B5 00
				23 01 00 00 00 00 02 B6 EF
				23 01 00 00 00 00 02 B7 00
				23 01 00 00 00 00 02 B8 FB
				23 01 00 00 00 00 02 B9 01
				23 01 00 00 00 00 02 BA 06
				23 01 00 00 00 00 02 BB 01
				23 01 00 00 00 00 02 BC 11
				23 01 00 00 00 00 02 BD 01
				23 01 00 00 00 00 02 BE 1B
				23 01 00 00 00 00 02 BF 01
				23 01 00 00 00 00 02 C0 24
				23 01 00 00 00 00 02 C1 01
				23 01 00 00 00 00 02 C2 46
				23 01 00 00 00 00 02 C3 01
				23 01 00 00 00 00 02 C4 63
				23 01 00 00 00 00 02 C5 01
				23 01 00 00 00 00 02 C6 94
				23 01 00 00 00 00 02 C7 01
				23 01 00 00 00 00 02 C8 BB
				23 01 00 00 00 00 02 C9 01
				23 01 00 00 00 00 02 CA FC
				23 01 00 00 00 00 02 CB 02
				23 01 00 00 00 00 02 CC 32
				23 01 00 00 00 00 02 CD 02
				23 01 00 00 00 00 02 CE 32
				23 01 00 00 00 00 02 CF 02
				23 01 00 00 00 00 02 D0 66
				23 01 00 00 00 00 02 D1 02
				23 01 00 00 00 00 02 D2 A3
				23 01 00 00 00 00 02 D3 02
				23 01 00 00 00 00 02 D4 CC
				23 01 00 00 00 00 02 D5 03
				23 01 00 00 00 00 02 D6 0B
				23 01 00 00 00 00 02 D7 03
				23 01 00 00 00 00 02 D8 38
				23 01 00 00 00 00 02 D9 03
				23 01 00 00 00 00 02 DA 8A
				23 01 00 00 00 00 02 DB 03
				23 01 00 00 00 00 02 DC 97
				23 01 00 00 00 00 02 DD 03
				23 01 00 00 00 00 02 DE 97
				23 01 00 00 00 00 02 DF 03
				23 01 00 00 00 00 02 E0 99
				23 01 00 00 00 00 02 E1 03
				23 01 00 00 00 00 02 E2 9B
				23 01 00 00 00 00 02 E3 03
				23 01 00 00 00 00 02 E4 9D
				23 01 00 00 00 00 02 E5 03
				23 01 00 00 00 00 02 E6 9F
				23 01 00 00 00 00 02 E7 03
				23 01 00 00 00 00 02 E8 A1
				23 01 00 00 00 00 02 E9 03
				23 01 00 00 00 00 02 EA A2
				23 01 00 00 00 00 02 FF 00
				23 01 00 00 00 00 02 36 00
				23 01 00 00 00 00 02 35 00
				23 01 00 00 00 00 02 FF 01
				23 01 00 00 00 00 02 FB 01
				23 01 00 00 00 00 02 6E 00
				23 01 00 00 00 00 02 FF 04
				23 01 00 00 00 00 02 FB 01
				23 01 00 00 00 00 02 08 06
				23 01 00 00 00 00 02 FF 00
				23 01 00 00 00 00 02 Fb 01
				23 01 00 00 00 00 02 53 24
				23 01 00 00 00 00 02 55 00
				23 01 00 00 00 00 02 D3 0A
				23 01 00 00 00 00 02 D4 0A
				05 01 00 00 78 00 02 11 00
				05 01 00 00 00 00 02 29 00];
		qcom,mdss-dsi-off-command = [05 01 00 00 96 00 02 28 00
				05 01 00 00 96 00 02 10 00];
		qcom,mdss-dsi-on-command-state = "dsi_lp_mode";
		qcom,mdss-dsi-off-command-state = "dsi_lp_mode";
		qcom,mdss-dsi-bl-pmic-control-type = "bl_ctrl_wled";
		qcom,mdss-dsi-reset-sequence = <1 20>, <0 10>, <1 20>;
		qcom,mdss-dsi-tx-eot-append;
		qcom,cont-splash-enabled;
		qcom,panel-supply-entries = <&dsi_panel_pwr_supply>;
		qcom,mdss-pan-physical-width-dimension = <70>;
		qcom,mdss-pan-physical-height-dimension = <128>;

		qcom,mdss-dsi-panel-status-command = [06 01 00 01 05 00 02 0A 08];
		qcom,mdss-dsi-panel-status-command-state = "dsi_hs_mode";
		qcom,mdss-dsi-panel-status-check-mode = "reg_read";
		qcom,mdss-dsi-panel-status-value = <0x9c>;
		qcom,esd-check-enabled;
	};
};
