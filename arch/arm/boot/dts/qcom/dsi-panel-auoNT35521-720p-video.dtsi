/* Copyright (c) 2013, The Linux Foundation. All rights reserved.
 * Copyright (C) 2016 XiaoMi, Inc.
 *
 * This program is free software; you can redistribute it and/or modify
 * it under the terms of the GNU General Public License version 2 and
 * only version 2 as published by the Free Software Foundation.
 *
 * This program is distributed in the hope that it will be useful,
 * but WITHOUT ANY WARRANTY; without even the implied warranty of
 * MERCHANTABILITY or FITNESS FOR A PARTICULAR PURPOSE.  See the
 * GNU General Public License for more details.
 */

/*---------------------------------------------------------------------------
 * This file is autogenerated file using gcdb parser. Please do not edit it.
 * Update input XML file to add a new entry or update variable in this file
 * VERSION = "1.0"
 *---------------------------------------------------------------------------*/
&mdss_mdp {
	dsi_auont35521_720p_vid: qcom,mdss_dsi_auont35521_720p_video {
	qcom,mdss-dsi-panel-name = "auo nt35521 720p video mode dsi panel";
		qcom,mdss-dsi-panel-controller = <&mdss_dsi0>;
		qcom,mdss-dsi-panel-type = "dsi_video_mode";
		qcom,mdss-dsi-panel-destination = "display_1";
		qcom,cont-splash-enabled;
		qcom,mdss-dsi-panel-framerate = <60>;
		qcom,mdss-dsi-virtual-channel-id = <0>;
		qcom,mdss-dsi-stream = <0>;
		qcom,mdss-dsi-panel-width = <720>;
		qcom,mdss-dsi-panel-height = <1280>;
		qcom,mdss-dsi-h-front-porch = <72>;
		qcom,mdss-dsi-h-back-porch = <72>;
		qcom,mdss-dsi-h-pulse-width = <24>;
		qcom,mdss-dsi-h-sync-skew = <0>;
		qcom,mdss-dsi-v-back-porch = <16>;
		qcom,mdss-dsi-v-front-porch = <16>;
		qcom,mdss-dsi-v-pulse-width = <4>;
		qcom,mdss-dsi-h-left-border = <0>;
		qcom,mdss-dsi-h-right-border = <0>;
		qcom,mdss-dsi-v-top-border = <0>;
		qcom,mdss-dsi-v-bottom-border = <10>;
		qcom,mdss-dsi-bpp = <24>;
		qcom,mdss-dsi-underflow-color = <0xff>;
		qcom,mdss-dsi-border-color = <0>;
		qcom,mdss-dsi-pixel-packing = "tight";
		qcom,mdss-dsi-on-command = [
				29 01 00 00 00 00 06 F0 55 AA 52 08 00
				29 01 00 00 00 00 05 FF AA 55 A5 80
				29 01 00 00 00 00 03 B1 68 21
				29 01 00 00 00 00 06 BD 01 A3 20 10 01
				23 01 00 00 00 00 02 6F 02
				23 01 00 00 00 00 02 B8 08
				29 01 00 00 00 00 03 BB 11 11
				29 01 00 00 00 00 03 BC 05 05
				29 01 00 00 00 00 02 B6 01
				23 01 00 00 00 00 02 C8 83
				29 01 00 00 00 00 06 F0 55 AA 52 08 01
				29 01 00 00 00 00 03 B0 0F 0F
				29 01 00 00 00 00 03 B1 0F 0F
				23 01 00 00 00 00 02 CE 66
				23 01 00 00 00 00 02 C0 0C
				29 01 00 00 00 00 03 B5 04 04
				29 01 00 00 00 00 03 B8 05 05
				29 01 00 00 00 00 03 B3 2B 2B
				29 01 00 00 00 00 03 B4 0F 0F
				29 01 00 00 00 00 03 B9 45 45
				29 01 00 00 00 00 03 BA 25 25
				29 01 00 00 00 00 03 BC A0 03
				29 01 00 00 00 00 03 BD 90 03
				23 01 00 00 00 00 02 CA 00
				29 01 00 00 00 00 06 F0 55 AA 52 08 02
				23 01 00 00 00 00 02 EE 03
				29 01 00 00 00 00 05 EF 0C 08 17 1A
				29 01 00 00 00 00 11 B0 00 23 00 33 00 40 00 47 00 58 00 7A 00 93 00 D0
				29 01 00 00 00 00 11 B1 01 00 01 4F 01 8C 01 F3 02 44 02 46 02 92 02 EA
				29 01 00 00 00 00 11 B2 03 21 03 62 03 8C 03 B0 03 CA 03 DF 03 EB 03 F6
				29 01 00 00 00 00 05 B3 03 FE 03 FF
				29 01 00 00 00 00 11 B4 00 00 00 04 00 22 00 3B 00 4C 00 6B 00 80 00 B6
				29 01 00 00 00 00 11 B5 00 EC 01 3D 01 7F 01 E8 02 3C 02 3E 02 8D 02 E5
				29 01 00 00 00 00 11 B6 03 1D 03 60 03 8C 03 B2 03 C4 03 D9 03 E8 03 F1
				29 01 00 00 00 00 05 B7 03 FE 03 FF
				29 01 00 00 00 00 11 B8 00 00 00 04 00 19 00 2F 00 3D 00 58 00 6F 00 9B
				29 01 00 00 00 00 11 B9 00 D0 01 27 01 6D 01 DA 02 33 02 35 02 86 02 E1
				29 01 00 00 00 00 11 BA 03 1C 03 65 03 9A 03 CF 03 F6 03 F8 03 FA 03 FD
				29 01 00 00 00 00 05 BB 03 FE 03 FF
				29 01 00 00 00 00 06 F0 55 AA 52 08 06
				29 01 00 00 00 00 03 B0 2E 2E
				29 01 00 00 00 00 03 B1 2E 2E
				29 01 00 00 00 00 03 B2 2E 2E
				29 01 00 00 00 00 03 B3 2E 09
				29 01 00 00 00 00 03 B4 0B 11
				29 01 00 00 00 00 03 B5 17 19
				29 01 00 00 00 00 03 B6 23 1D
				29 01 00 00 00 00 03 B7 25 1F
				29 01 00 00 00 00 03 B8 01 03
				29 01 00 00 00 00 03 B9 2E 2E
				29 01 00 00 00 00 03 BA 2E 2E
				29 01 00 00 00 00 03 BB 02 00
				29 01 00 00 00 00 03 BC 1E 24
				29 01 00 00 00 00 03 BD 1C 22
				29 01 00 00 00 00 03 BE 18 16
				29 01 00 00 00 00 03 BF 10 0A
				29 01 00 00 00 00 03 C0 08 2E
				29 01 00 00 00 00 03 C1 2E 2E
				29 01 00 00 00 00 03 C2 2E 2E
				29 01 00 00 00 00 03 C3 2E 2E
				29 01 00 00 00 00 03 E5 13 12
				29 01 00 00 00 00 03 C4 2E 2E
				29 01 00 00 00 00 03 C5 2E 2E
				29 01 00 00 00 00 03 C6 2E 2E
				29 01 00 00 00 00 03 C7 2E 02
				29 01 00 00 00 00 03 C8 00 18
				29 01 00 00 00 00 03 C9 12 10
				29 01 00 00 00 00 03 CA 24 1E
				29 01 00 00 00 00 03 CB 22 1C
				29 01 00 00 00 00 03 CC 0A 08
				29 01 00 00 00 00 03 CD 2E 2E
				29 01 00 00 00 00 03 CE 2E 2E
				29 01 00 00 00 00 03 CF 09 0B
				29 01 00 00 00 00 03 D0 1D 23
				29 01 00 00 00 00 03 D1 1F 25
				29 01 00 00 00 00 03 D2 11 13
				29 01 00 00 00 00 03 D3 19 01
				29 01 00 00 00 00 03 D4 03 2E
				29 01 00 00 00 00 03 D5 2E 2E
				29 01 00 00 00 00 03 D6 2E 2E
				29 01 00 00 00 00 03 D7 2E 2E
				29 01 00 00 00 00 03 E6 16 17
				29 01 00 00 00 00 06 D8 00 00 00 00 00
				29 01 00 00 00 00 06 D9 00 00 00 00 00
				23 01 00 00 00 00 02 E7 00
				29 01 00 00 00 00 06 F0 55 AA 52 08 05
				23 01 00 00 00 00 02 ED 30
				29 01 00 00 00 00 06 F0 55 AA 52 08 03
				29 01 00 00 00 00 03 B0 20 00
				29 01 00 00 00 00 03 B1 20 00
				29 01 00 00 00 00 06 F0 55 AA 52 08 05
				29 01 00 00 00 00 03 B0 17 06
				23 01 00 00 00 00 02 B8 00
				29 01 00 00 00 00 06 BD 0F 03 03 00 03
				29 01 00 00 00 00 03 B1 17 06
				29 01 00 00 00 00 03 B9 00 03
				29 01 00 00 00 00 03 B2 17 06
				29 01 00 00 00 00 03 BA 00 03
				29 01 00 00 00 00 03 B3 17 06
				29 01 00 00 00 00 03 BB 00 00
				29 01 00 00 00 00 03 B4 17 06
				29 01 00 00 00 00 03 B5 17 06
				29 01 00 00 00 00 03 B6 17 06
				29 01 00 00 00 00 03 B7 17 06
				29 01 00 00 00 00 03 BC 00 01
				23 01 00 00 00 00 02 E5 06
				23 01 00 00 00 00 02 E6 06
				23 01 00 00 00 00 02 E7 06
				23 01 00 00 00 00 02 E8 06
				23 01 00 00 00 00 02 E9 0A
				23 01 00 00 00 00 02 EA 06
				23 01 00 00 00 00 02 EB 06
				23 01 00 00 00 00 02 EC 06
				29 01 00 00 00 00 06 F0 55 AA 52 08 05
				23 01 00 00 00 00 02 C0 07
				23 01 00 00 00 00 02 C1 05
				29 01 00 00 00 00 06 F0 55 AA 52 08 03
				29 01 00 00 00 00 06 B2 04 00 52 01 51
				29 01 00 00 00 00 06 B3 04 00 52 01 51
				29 01 00 00 00 00 06 F0 55 AA 52 08 05
				23 01 00 00 00 00 02 C4 82
				23 01 00 00 00 00 02 C5 80
				29 01 00 00 00 00 06 F0 55 AA 52 08 03
				29 01 00 00 00 00 06 B6 04 00 52 01 51
				29 01 00 00 00 00 06 B7 04 00 52 01 51
				29 01 00 00 00 00 06 F0 55 AA 52 08 05
				29 01 00 00 00 00 03 C8 03 20
				29 01 00 00 00 00 03 C9 01 21
				29 01 00 00 00 00 03 CA 03 20
				29 01 00 00 00 00 03 CB 07 20
				29 01 00 00 00 00 06 F0 55 AA 52 08 03
				23 01 00 00 00 00 02 C4 60
				23 01 00 00 00 00 02 C5 40
				29 01 00 00 00 00 06 F0 55 AA 52 08 03
				29 01 00 00 00 00 06 BA 44 00 60 01 72
				29 01 00 00 00 00 06 BB 44 00 60 01 72
				29 01 00 00 00 00 06 BC 53 00 03 00 48
				29 01 00 00 00 00 06 BD 53 00 03 00 48
				29 01 00 00 00 00 06 F0 55 AA 52 08 05
				29 01 00 00 00 00 0C D1 03 05 00 05 00 00 00 00 00 00 00
				29 01 00 00 00 00 0C D2 03 05 00 03 00 00 00 00 00 00 00
				29 01 00 00 00 00 0C D3 00 05 04 05 00 00 00 00 00 00 00
				29 01 00 00 00 00 0C D4 00 05 04 03 00 00 00 00 00 00 00
				29 01 00 00 00 00 06 F0 55 AA 52 08 03
				23 01 00 00 00 00 02 C4 40
				23 01 00 00 00 00 02 C5 40
				29 01 00 00 00 00 06 F0 55 AA 52 08 00
				23 01 00 00 00 00 02 6F 08
				23 01 00 00 00 00 02 F2 70
				23 01 00 00 00 00 02 6F 02
				23 01 00 00 00 00 02 B8 08
				23 01 00 00 00 00 02 6F 07
				23 01 00 00 00 00 02 F4 F0
				29 01 00 00 00 00 04 D9 01 01 00
				23 01 00 00 00 00 02 6F 11
				23 01 00 00 00 00 02 F3 01
				15 01 00 00 00 00 02 51 ff
				15 01 00 00 10 00 02 53 2c
				15 01 00 00 10 00 02 55 01
				05 01 00 00 78 00 02 11 00
				29 01 00 00 00 00 06 F0 55 AA 52 08 01
				29 01 00 00 00 00 03 B9 45 45

				05 01 00 00 14 00 02 29 00

				];
		qcom,mdss-dsi-off-command = [05 01 00 00 00 00 02 28 00
				05 01 00 00 00 00 02 10 00];
		ceon-command = [
				29 00 00 00 00 00 06 F0 55 AA 52 08 00
				29 00 00 00 00 00 11 CC 40 36 87 00 00 00 00 00 00 00 00 00 40 08 A5 05
				29 00 00 00 00 00 11 D1 00 02 0A 0E 12 16 18 18 18 18 16 14 12 0E 08 00
				29 00 00 00 00 00 0D D7 28 30 27 23 23 00 00 00 00 00 00 00
				29 00 00 00 00 00 0E D8 00 00 00 00 00 00 00 00 00 00 23 25 00
				15 01 00 00 10 00 02 55 81
		];
		ceoff-command = [
				15 01 00 00 10 00 02 55 01
		];

		warm-command = [
				29 01 00 00 00 00 06 F0 55 AA 52 08 02
				23 01 00 00 00 00 02 EE 03
				29 01 00 00 00 00 11 B0 00 00 00 08 00 2C 00 45 00 56 00 78 00 93 00 BF
				29 01 00 00 00 00 11 B1 00 F2 01 48 01 88 01 F0 02 41 02 43 02 90 02 E8
				29 01 00 00 00 00 11 B2 03 21 03 62 03 8E 03 B0 03 D6 03 F8 03 FA 03 FD
				29 01 00 00 00 00 05 B3 03 FE 03 FF
				29 01 00 00 00 00 11 B4 00 00 00 04 00 1C 00 35 00 49 00 67 00 7E 00 B8
				29 01 00 00 00 00 11 B5 00 F0 01 41 01 82 01 EA 02 3C 02 3E 02 8D 02 E5
				29 01 00 00 00 00 11 B6 03 1D 03 60 03 8C 03 B2 03 C4 03 D9 03 E8 03 F1
				29 01 00 00 00 00 05 B7 03 FE 03 FF
				29 01 00 00 00 00 11 B8 00 88 00 89 00 94 00 9A 00 A8 00 BD 00 D5 01 03
				29 01 00 00 00 00 11 B9 01 2B 01 6B 01 A2 02 00 02 4B 02 4D 02 98 02 F1
				29 01 00 00 00 00 11 BA 03 2B 03 74 03 A8 03 DF 03 E2 03 E4 03 E9 03 F8
				29 01 00 00 00 00 05 BB 03 FE 03 FF
				];
		default-command = [
				29 01 00 00 00 00 06 F0 55 AA 52 08 02
				23 01 00 00 00 00 02 EE 03
				29 01 00 00 00 00 11 B0 00 23 00 33 00 40 00 47 00 58 00 7A 00 93 00 D0
				29 01 00 00 00 00 11 B1 01 00 01 4F 01 8C 01 F3 02 44 02 46 02 92 02 EA
				29 01 00 00 00 00 11 B2 03 21 03 62 03 8C 03 B0 03 CA 03 DF 03 EB 03 F6
				29 01 00 00 00 00 05 B3 03 FE 03 FF
				29 01 00 00 00 00 11 B4 00 00 00 04 00 22 00 3B 00 4C 00 6B 00 80 00 B6
				29 01 00 00 00 00 11 B5 00 EC 01 3D 01 7F 01 E8 02 3C 02 3E 02 8D 02 E5
				29 01 00 00 00 00 11 B6 03 1D 03 60 03 8C 03 B2 03 C4 03 D9 03 E8 03 F1
				29 01 00 00 00 00 05 B7 03 FE 03 FF
				29 01 00 00 00 00 11 B8 00 00 00 04 00 19 00 2F 00 3D 00 58 00 6F 00 9B
				29 01 00 00 00 00 11 B9 00 D0 01 27 01 6D 01 DA 02 33 02 35 02 86 02 E1
				29 01 00 00 00 00 11 BA 03 1C 03 65 03 9A 03 CF 03 F6 03 F8 03 FA 03 FD
				29 01 00 00 00 00 05 BB 03 FE 03 FF
				];
		cold-command = [
				29 01 00 00 00 00 06 F0 55 AA 52 08 02
				23 01 00 00 00 00 02 EE 03
				29 01 00 00 00 00 06 F0 55 AA 52 08 02
				23 01 00 00 00 00 02 EE 03
				29 01 00 00 00 00 11 B0 00 64 00 66 00 69 00 6F 00 7D 00 88 00 8F 00 9B
				29 01 00 00 00 00 11 B1 01 39 01 77 01 AD 02 08 02 53 02 55 02 9D 02 F3
				29 01 00 00 00 00 11 B2 03 2A 03 6C 03 96 03 B7 03 E2 03 E4 03 E9 03 F8
				29 01 00 00 00 00 05 B3 03 FE 03 FF
				29 00 00 00 00 00 11 B4 00 61 00 68 00 6A 00 6F 00 76 00 79 00 7F 00 B6
				29 01 00 00 00 00 11 B5 00 EC 01 3D 01 7F 01 E8 02 3C 02 3E 02 8D 02 E5
				29 01 00 00 00 00 11 B6 03 1D 03 60 03 8C 03 B2 03 C4 03 D9 03 E8 03 F1
				29 01 00 00 00 00 05 B7 03 FE 03 FF
				29 01 00 00 00 00 11 B8 00 00 00 04 00 19 00 2F 00 3D 00 58 00 6F 00 9B
				29 01 00 00 00 00 11 B9 00 D0 01 27 01 6D 01 DA 02 33 02 35 02 86 02 E1
				29 01 00 00 00 00 11 BA 03 1C 03 65 03 9A 03 CF 03 F6 03 F8 03 FA 03 FD
				29 01 00 00 00 00 05 BB 03 FE 03 FF
				];
		qcom,mdss-dsi-on-command-state = "dsi_lp_mode";
		qcom,mdss-dsi-off-command-state = "dsi_lp_mode";
		qcom,mdss-extra-command-state = "dsi_lp_mode";


		qcom,mdss-dsi-panel-status-command = [06 01 00 01 05 00 02 0A 08];
		qcom,mdss-dsi-panel-status-command-state = "dsi_lp_mode";
		qcom,mdss-dsi-panel-status-check-mode = "reg_read";
		qcom,mdss-dsi-panel-status-value = <0x9c>;
		qcom,esd-check-enabled;
		qcom,mdss-dsi-h-sync-pulse = <1>;
		qcom,mdss-dsi-traffic-mode = "burst_mode";
		qcom,mdss-dsi-bllp-eof-power-mode;
		qcom,mdss-dsi-bllp-power-mode;
		qcom,mdss-dsi-lane-0-state;
		qcom,mdss-dsi-lane-1-state;
		qcom,mdss-dsi-lane-2-state;
		qcom,mdss-dsi-lane-3-state;
		qcom,mdss-dsi-panel-timings = [7b 1a 10 00 3e 40 16 1e 15 03 04 00];
		qcom,mdss-dsi-t-clk-post = <0x20>;
		qcom,mdss-dsi-t-clk-pre = <0x2D>;
		qcom,mdss-dsi-bl-min-level = <1>;
		qcom,mdss-dsi-bl-max-level = <64>;
		qcom,mdss-dsi-dma-trigger = "trigger_sw";
		qcom,mdss-dsi-mdp-trigger = "none";
		qcom,mdss-dsi-bl-pmic-control-type = "bl_ctrl_gpio";
		qcom,mdss-dsi-pulse-gpio = <&msm_gpio 98 0>;
		qcom,mdss-dsi-reset-sequence = <1 20>, <0 20>, <1 120>;
		qcom,mdss-pan-physical-width-dimension = <68>;
		qcom,mdss-pan-physical-height-dimension = <121>;

	};
};

