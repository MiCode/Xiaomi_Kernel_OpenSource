/* Copyright (c) 2013-2014 The Linux Foundation. All rights reserved.
 *
 * This program is free software; you can redistribute it and/or modify
 * it under the terms of the GNU General Public License version 2 and
 * only version 2 as published by the Free Software Foundation.
 *
 * This program is distributed in the hope that it will be useful,
 * but WITHOUT ANY WARRANTY; without even the implied warranty of
 * MERCHANTABILITY or FITNESS FOR A PARTICULAR PURPOSE.  See the
 * GNU General Public License for more details.
 */

/dts-v1/;
#include "msm8226-v2.dtsi"
#include "msm8226-memory.dtsi"
#include "msm8226-qseecom.dtsi"
#include "msm8226-sharedmem.dtsi"
#include "msm8226-1080p-mtp.dtsi"
#include "msm8226-camera-sensor-mtp.dtsi"

/ {
	model = "Qualcomm Technologies, Inc. MSM 8226v2 MTP";
	compatible = "qcom,msm8226-mtp", "qcom,msm8226", "qcom,mtp";
	qcom,board-id = <8 2>;
};
