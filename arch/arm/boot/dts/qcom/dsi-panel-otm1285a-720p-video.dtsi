/* Copyright (c) 2013, The Linux Foundation. All rights reserved.
 * Copyright (C) 2016 XiaoMi, Inc.
 *
 * This program is free software; you can redistribute it and/or modify
 * it under the terms of the GNU General Public License version 2 and
 * only version 2 as published by the Free Software Foundation.
 *
 * This program is distributed in the hope that it will be useful,
 * but WITHOUT ANY WARRANTY; without even the implied warranty of
 * MERCHANTABILITY or FITNESS FOR A PARTICULAR PURPOSE.  See the
 * GNU General Public License for more details.
 */

/*---------------------------------------------------------------------------
 * This file is autogenerated file using gcdb parser. Please do not edit it.
 * Update input XML file to add a new entry or update variable in this file
 * VERSION = "1.0"
 *---------------------------------------------------------------------------*/
&mdss_mdp {
	dsi_otm1285a_720p_video: qcom,mdss_dsi_otm1285a_720p_video {
		qcom,mdss-dsi-panel-name = "otm1285a_HD720p_video_EBBG";
		qcom,mdss-dsi-panel-controller = <&mdss_dsi0>;
		qcom,mdss-dsi-panel-type = "dsi_video_mode";
		qcom,mdss-dsi-panel-destination = "display_1";
		qcom,mdss-dsi-panel-framerate = <60>;
		qcom,mdss-dsi-virtual-channel-id = <0>;
		qcom,mdss-dsi-stream = <0>;
		qcom,mdss-dsi-panel-width = <720>;
		qcom,mdss-dsi-panel-height = <1280>;
		qcom,mdss-pan-physical-width-dimension = <62>;
		qcom,mdss-pan-physical-height-dimension = <114>;
		qcom,mdss-dsi-h-front-porch = <35>;
		qcom,mdss-dsi-h-back-porch = <35>;
		qcom,mdss-dsi-h-pulse-width = <2>;
		qcom,mdss-dsi-h-sync-skew = <0>;
		qcom,mdss-dsi-v-back-porch = <7>;
		qcom,mdss-dsi-v-front-porch = <7>;
		qcom,mdss-dsi-v-pulse-width = <2>;
		qcom,mdss-dsi-h-left-border = <0>;
		qcom,mdss-dsi-h-right-border = <0>;
		qcom,mdss-dsi-v-top-border = <0>;
		qcom,mdss-dsi-v-bottom-border = <0>;
		qcom,mdss-dsi-bpp = <24>;
		qcom,mdss-dsi-color-order = "rgb_swap_rgb";
		qcom,mdss-dsi-underflow-color = <0xff>;
		qcom,mdss-dsi-border-color = <0>;
		qcom,mdss-dsi-on-command = [29 01 00 00 00 00 04 ff 12 85 01
				29 01 00 00 00 00 02 00 80
				29 01 00 00 00 00 03 ff 12 85
				29 01 00 00 00 00 02 00 A2
				29 01 00 00 00 00 02 C1 00
				29 01 00 00 00 00 02 00 91
				29 01 00 00 00 00 03 B3 08 10
				29 01 00 00 00 00 02 00 B3
				29 01 00 00 00 00 02 C0 33
				29 01 00 00 00 00 02 00 B4
				29 01 00 00 00 00 02 C0 50
				29 01 00 00 00 00 02 00 80
				29 01 00 00 00 00 02 C1 19
				29 01 00 00 00 00 02 00 81
				29 01 00 00 00 00 02 C1 19
				29 01 00 00 00 00 02 00 82
				29 01 00 00 00 00 02 C1 19
				29 01 00 00 00 00 02 00 83
				29 01 00 00 00 00 02 C1 19
				29 01 00 00 00 00 02 00 90
				29 01 00 00 00 00 03 C1 66 00
				29 01 00 00 00 00 02 00 80
				29 01 00 00 00 00 0A C0 00 96 00 08 08 00 96 08 08
				29 01 00 00 00 00 02 00 80
				29 01 00 00 00 00 09 C2 82 00 0A 00 83 00 0A 00
				29 01 00 00 00 00 02 00 90
				29 01 00 00 00 00 10 C2 00 08 03 0A 00 01 08 03 0A 00 02 08 03 0A 00
				29 01 00 00 00 00 02 00 A0
				29 01 00 00 00 00 10 C2 03 08 03 0A 00 04 08 03 0A 00 05 08 03 0A 00
				29 01 00 00 00 00 02 00 B0
				29 01 00 00 00 00 0B C2 82 08 03 0A 00 81 08 03 0A 00
				29 01 00 00 00 00 02 00 EA
				29 01 00 00 00 00 04 C2 88 08 33
				29 01 00 00 00 00 02 00 FA
				29 01 00 00 0A 00 04 C2 00 0C 00
				29 01 00 00 00 00 02 00 80
				29 01 00 00 00 00 02 C4 88
				29 01 00 00 00 00 02 00 83
				29 01 00 00 00 00 02 C4 20
				29 01 00 00 00 00 02 00 80
				29 01 00 00 00 00 08 CB 00 00 00 00 00 00 00
				29 01 00 00 00 00 02 00 90
				29 01 00 00 00 00 10 CB 00 00 00 00 00 00 00 00 00 00 00 00 00 00 00
				29 01 00 00 00 00 02 00 A0
				29 01 00 00 00 00 0D CB 00 00 00 00 00 00 00 00 00 00 00 00
				29 01 00 00 00 00 02 00 C0
				29 01 00 00 0A 00 10 CB 01 01 01 01 01 01 01 01 01 01 00 00 00 00 00
				29 01 00 00 00 00 02 00 D0
				29 01 00 00 0A 00 0D CB 00 00 00 00 00 00 01 01 01 00 00 00
				29 01 00 00 00 00 02 00 F0
				29 01 00 00 0A 00 0D CB 00 00 F0 03 30 30 00 00 00 00 00 00
				29 01 00 00 00 00 02 00 80
				29 01 00 00 0A 00 0B CC 01 03 04 05 06 07 08 09 0A 02
				29 01 00 00 00 00 02 00 B0
				29 01 00 00 0A 00 0B CC 02 0A 09 08 07 06 05 04 03 01
				29 01 00 00 00 00 02 00 D0
				29 01 00 00 00 00 10 CD 01 09 07 05 03 2D 2D 2D 2D 2D 2D 2D 2D 2D 2D
				29 01 00 00 00 00 02 00 B0
				29 01 00 00 00 00 10 CD 2D 2D 2D 2D 2D 2D 16 17 18 2D 2D 2D 2D 2D 2D
				29 01 00 00 00 00 02 00 C0
				29 01 00 00 00 00 0B CD 2D 2D 2D 27 28 29 2A 2B 1D 2D
				29 01 00 00 00 00 02 00 A0
				29 01 00 00 00 00 10 CD 0A 08 06 04 02 2D 2D 2D 2D 2D 2D 2D 2D 2D 2D
				29 01 00 00 00 00 02 00 E0
				29 01 00 00 00 00 10 CD 2D 2D 2D 2D 2D 2D 16 17 18 2D 2D 2D 2D 2D 2D
				29 01 00 00 00 00 02 00 F0
				29 01 00 00 00 00 0B CD 2D 2D 2D 27 28 29 2A 2B 1D 2D
				29 01 00 00 00 00 02 00 e0
				29 01 00 00 00 00 05 CC 00 FC 1F 07
				29 01 00 00 00 00 02 00 A0
				29 01 00 00 00 00 0D C0 00 01 15 04 00 15 04 00 00 ff ff 00
				29 01 00 00 00 00 02 00 80
				29 01 00 00 00 00 10 CD 0b 0b 0b 0b 0b 0b 0b 0b 0b 14 13 12 0b 0b 0b
				29 01 00 00 00 00 02 00 00
				29 01 00 00 00 00 02 D9 82
				29 01 00 00 00 00 02 00 00
				29 01 00 00 00 00 03 D8 34 34
				29 01 00 00 00 00 02 00 00
				29 01 00 00 00 00 19 E1 0E 17 27 36 3F 49 55 67 70 81 8B 91 6B 67 61 4F 3E 1F 28 23 1C 17 16 0D
				29 01 00 00 00 00 02 00 00
				29 01 00 00 00 00 19 E2 02 07 15 22 2B 35 41 54 60 75 81 8D 69 5D 53 43 30 2D 1A 15 0E 09 06 0B
				29 01 00 00 00 00 02 00 00
				29 01 00 00 00 00 19 E3 0E 17 27 36 3F 49 55 67 70 81 8B 91 6B 67 61 4F 3E 1F 28 23 1C 17 16 0D
				29 01 00 00 00 00 02 00 00
				29 01 00 00 00 00 19 E4 02 07 15 22 2B 35 41 54 60 75 81 8D 69 5D 53 43 30 2D 1A 15 0E 09 06 0B
				29 01 00 00 00 00 02 00 00
				29 01 00 00 00 00 19 E5 0E 17 27 36 3F 49 55 67 70 81 8B 91 6B 67 61 4F 3E 1F 28 23 1C 17 16 0D
				29 01 00 00 00 00 02 00 00
				29 01 00 00 00 00 19 E6 02 07 15 22 2B 35 41 54 60 75 81 8D 69 5D 53 43 30 2D 1A 15 0E 09 06 0B
				29 01 00 00 00 00 02 00 00
				29 01 00 00 00 00 02 59 03
				29 01 00 00 00 00 02 00 90
				29 01 00 00 00 00 0D CA CC FF A6 FF 80 FF 05 03 05 03 05	03
				29 01 00 00 00 00 02 00 00
				29 01 00 00 00 00 02 C6 10
				29 01 00 00 00 00 02 00 00
				29 01 00 00 00 00 13 C7 90 89 89 88 88 99 88 88 88 88 88 88 87 88 87 87 88 77
				29 01 00 00 00 00 02 51 FF
				29 01 00 00 00 00 02 53 2C
				29 01 00 00 00 00 02 55 01
				29 01 00 00 00 00 02 00 00
				29 01 00 00 00 00 02 C6 10
				29 01 00 00 00 00 02 00 92
				29 01 00 00 00 00 05 C5 C0 17 C0 1B
				29 01 00 00 00 00 02 00 97
				29 01 00 00 00 00 02 C5 16
				29 01 00 00 00 00 02 00 99
				29 01 00 00 00 00 02 C5 1A
				29 01 00 00 00 00 02 00 A2
				29 01 00 00 00 00 05 C5 C0 17 C0 1B
				29 01 00 00 00 00 02 00 A7
				29 01 00 00 00 00 02 C5 16
				29 01 00 00 00 00 02 00 A9
				29 01 00 00 00 00 02 C5 1A
				29 01 00 00 00 00 02 00 00
				29 01 00 00 78 00 01 11
				29 01 00 00 00 00 02 00 00
				29 01 00 00 00 00 01 29];
		qcom,mdss-dsi-off-command = [05 01 00 00 00 00 02 28 00
				05 01 00 00 78 00 02 10 00];
		qcom,mdss-dsi-on-command-state = "dsi_lp_mode";
		qcom,mdss-dsi-off-command-state = "dsi_hs_mode";
		qcom,mdss-dsi-h-sync-pulse = <10>;
		qcom,mdss-dsi-traffic-mode = "non_burst_sync_event";
		qcom,mdss-dsi-bllp-eof-power-mode;
		qcom,mdss-dsi-bllp-power-mode;
		qcom,mdss-dsi-lane-0-state;
		qcom,mdss-dsi-lane-1-state;
		qcom,mdss-dsi-lane-2-state;
		qcom,mdss-dsi-panel-timings = [8b 1e 14 00 44 48 18 22 19 03 04 00];
		qcom,mdss-dsi-t-clk-post = <0x04>;
		qcom,mdss-dsi-t-clk-pre = <0x1c>;
		qcom,mdss-dsi-bl-min-level = <1>;
		qcom,mdss-dsi-bl-max-level = <255>;
		qcom,mdss-dsi-bl-pmic-pwm-frequency = <100>;
		qcom,mdss-dsi-bl-pmic-bank-select = <0>;
		qcom,mdss-dsi-dma-trigger = "trigger_sw";
		qcom,mdss-dsi-mdp-trigger = "none";
		qcom,mdss-dsi-bl-pmic-control-type = "bl_ctrl_pwm";
		qcom,mdss-dsi-reset-sequence = <1 5>, <0 5>, <1 10>;
	};
};
