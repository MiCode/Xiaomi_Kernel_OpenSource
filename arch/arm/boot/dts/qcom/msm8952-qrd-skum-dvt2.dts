/*
 * Copyright (c) 2015, The Linux Foundation. All rights reserved.
 *
 * This program is free software; you can redistribute it and/or modify
 * it under the terms of the GNU General Public License version 2 and
 * only version 2 as published by the Free Software Foundation.
 *
 * This program is distributed in the hope that it will be useful,
 * but WITHOUT ANY WARRANTY; without even the implied warranty of
 * MERCHANTABILITY or FITNESS FOR A PARTICULAR PURPOSE.  See the
 * GNU General Public License for more details.
 */

/dts-v1/;

#include "msm8952-qrd-skum.dtsi"

/ {
	model = "Qualcomm Technologies, Inc. MSM8952 QRD SKUM DVT2";
	compatible = "qcom,msm8952-qrd-skum", "qcom,msm8952-qrd",
		   "qcom,msm8952", "qcom,qrd";
	qcom,board-id= <0x4000b 0>;
};

&mdss_dsi0 {
	qcom,dsi-pref-prim-pan = <&dsi_hx8399a_1080p_video>;
};

&dsi_hx8399a_1080p_video {
	qcom,panel-supply-entries = <&dsi_panel_pwr_supply>;
	qcom,mdss-dsi-bl-pmic-control-type = "bl_ctrl_wled";
	qcom,mdss-dsi-bl-min-level = <1>;
	qcom,mdss-dsi-bl-max-level = <4095>;
	qcom,esd-check-enabled;
};
