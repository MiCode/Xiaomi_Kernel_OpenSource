qcom,hydrogen_coslight {
	qcom,max-voltage-uv = <4400000>;
	qcom,nom-batt-capacity-mah = <4850>;
	qcom,batt-id-kohm = <100>;
	qcom,battery-beta = <3435>;
	qcom,battery-type = "hydrogen_coslight";
	qcom,chg-rslow-comp-c1 = <5063445>;
	qcom,chg-rslow-comp-c2 = <10190950>;
	qcom,chg-rs-to-rslow = <1003298>;
	qcom,chg-rslow-comp-thr = <0xC0>;
	qcom,checksum = <0x3746>;
	qcom,gui-version = "PMI8950GUI - 2.0.0.15";
	qcom,fg-profile-data = [
		 E0 83 C6 7C
		 FD 80 01 77
		 62 83 74 6F
		 1E 89 56 94
		 23 82 26 9A
		 32 BD F4 C9
		 56 0E ED 83
		 A9 7C C0 80
		 56 76 5E 83
		 67 37 EE 82
		 05 8F 49 82
		 D7 99 27 BD
		 27 CA 54 0E
		 57 13 2D 59
		 14 70 4A FC
		 D5 35 E3 45
		 B3 40 00 00
		 5A 44 6C 38
		 06 3D 00 00
		 00 00 00 00
		 00 00 00 00
		 7D 6B F2 69
		 2C 68 0B 8A
		 40 7C 84 71
		 4C 74 C9 79
		 4A 76 C1 6B
		 6C 75 06 A8
		 21 CD 5A 56
		 57 A0 71 0C
		 28 00 FF 36
		 F0 11 30 03
		 00 00 00 0C
	];
};
