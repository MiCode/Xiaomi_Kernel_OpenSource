/* Copyright (c) 2015, The Linux Foundation. All rights reserved.
 * Copyright (C) 2018 XiaoMi, Inc.
 *
 * This program is free software; you can redistribute it and/or modify
 * it under the terms of the GNU General Public License version 2 and
 * only version 2 as published by the Free Software Foundation.
 *
 * This program is distributed in the hope that it will be useful,
 * but WITHOUT ANY WARRANTY; without even the implied warranty of
 * MERCHANTABILITY or FITNESS FOR A PARTICULAR PURPOSE.  See the
 * GNU General Public License for more details.
 */

 /*---------------------------------------------------------------------------
 * This file is autogenerated file using gcdb parser. Please do not edit it.
 * Update input XML file to add a new entry or update variable in this file
 * VERSION = "1.0"
 *---------------------------------------------------------------------------*/
&mdss_mdp {
	dsi_lgd_nt35596_1080_vid: qcom,mdss_dsi_lgd_nt35596_1080p_video {
		qcom,mdss-dsi-panel-name = "lgd nt35596 1080p video mode dsi panel";
		qcom,mdss-dsi-panel-id = <5>;
		qcom,mdss-dsi-panel-controller = <&mdss_dsi0>;
		qcom,mdss-dsi-panel-type = "dsi_video_mode";
		qcom,mdss-dsi-panel-destination = "display_1";
		qcom,mdss-dsi-panel-framerate = <60>;
		qcom,mdss-dsi-virtual-channel-id = <0>;
		qcom,mdss-dsi-stream = <0>;
		qcom,mdss-dsi-panel-width = <1080>;
		qcom,mdss-dsi-panel-height = <1920>;
		qcom,mdss-dsi-h-front-porch = <100>;
		qcom,mdss-dsi-h-back-porch = <24>;
		qcom,mdss-dsi-h-pulse-width = <8>;
		qcom,mdss-dsi-h-sync-skew = <0>;
		qcom,mdss-dsi-v-back-porch = <2>;
		qcom,mdss-dsi-v-front-porch = <12>;
		qcom,mdss-dsi-v-pulse-width = <1>;
		qcom,mdss-dsi-h-left-border = <0>;
		qcom,mdss-dsi-h-right-border = <0>;
		qcom,mdss-dsi-v-top-border = <0>;
		qcom,mdss-dsi-v-bottom-border = <0>;
		qcom,mdss-dsi-bpp = <24>;
		qcom,mdss-dsi-underflow-color = <0xff>;
		qcom,mdss-dsi-border-color = <0>;
		qcom,mdss-dsi-pixel-packing = "tight";
		qcom,mdss-dsi-pan-enable-dynamic-fps;
		qcom,mdss-dsi-pan-fps-update = "dfps_immediate_porch_mode_vfp";
		qcom,mdss-dsi-min-refresh-rate = <45>;
		qcom,mdss-dsi-max-refresh-rate = <60>;
		qcom,mdss-dsi-on-command = [
				15 00 00 00 01 00 02 FF 04
				15 00 00 00 01 00 02 08 06
				15 00 00 00 01 00 02 FB 01

				//LTPS timing
				15 01 00 00 01 00 02 FF 05
				15 00 00 00 01 00 02 FB 01
				15 01 00 00 01 00 02 33 00
				15 00 00 00 01 00 02 34 03
				15 00 00 00 01 00 02 35 74
				15 00 00 00 01 00 02 7B 81
				15 00 00 00 01 00 02 7E 10
				15 00 00 00 01 00 02 7F 16
				15 00 00 00 01 00 02 80 08
				15 00 00 00 01 00 02 81 06
				15 00 00 00 01 00 02 82 00
				15 00 00 00 01 00 02 84 05
				15 00 00 00 01 00 02 85 03
				15 00 00 00 01 00 02 8C 01
				15 00 00 00 01 00 02 A4 07
				15 00 00 00 01 00 02 B5 20
				15 00 00 00 01 00 02 C5 32

				//EQ setting
				15 01 00 00 01 00 02 FF 01
				15 00 00 00 01 00 02 FB 01
				15 00 00 00 01 00 02 58 82
				15 00 00 00 01 00 02 59 02
				15 00 00 00 01 00 02 5A 02
				15 00 00 00 01 00 02 5B 02
				15 00 00 00 01 00 02 5C 82
				15 00 00 00 01 00 02 5D 82
				15 00 00 00 01 00 02 5E 01
				15 00 00 00 01 00 02 5F 01
				15 00 00 00 01 00 02 60 05

				//enhance vcom bias
				15 01 00 00 01 00 02 FF EE
				15 00 00 00 01 00 02 FB 01
				15 00 00 00 01 00 02 2F 00
				15 00 00 00 01 00 02 32 C0

				15 00 00 00 00 00 02 FF 00
				15 00 00 00 01 00 02 FB 01
				15 00 00 00 01 00 02 D3 02
				15 01 00 00 01 00 02 D4 09
				05 01 00 00 64 00 02 11 00
				15 00 00 00 01 00 02 51 ff
				15 00 00 00 01 00 02 53 24
				15 00 00 00 01 00 02 55 01
				05 01 00 00 14 00 02 29 00
		];
		qcom,mdss-dsi-off-command = [
				15 00 00 00 00 00 02 FF 00
				05 01 00 00 20 00 02 28 00
				05 01 00 00 40 00 02 10 00
				23 01 00 00 00 00 02 4F 01
				];
		qcom,mdss-dsi-on-command-state = "dsi_lp_mode";
		qcom,mdss-dsi-off-command-state = "dsi_hs_mode";
		qcom,mdss-dsi-h-sync-pulse = <0>;
		qcom,mdss-dsi-traffic-mode = "non_burst_sync_pulse";
		qcom,mdss-dsi-bllp-eof-power-mode;
		qcom,mdss-dsi-bllp-power-mode;
		qcom,mdss-dsi-lane-0-state;
		qcom,mdss-dsi-lane-1-state;
		qcom,mdss-dsi-lane-2-state;
		qcom,mdss-dsi-lane-3-state;
		qcom,mdss-dsi-lp11-init;
		qcom,mdss-dsi-panel-timings = [E1 4B 37 00 A9 AB 2A 4F 3D 03 04 00];//844.44M
		qcom,mdss-dsi-t-clk-post = <0x19>;
		qcom,mdss-dsi-t-clk-pre = <0x2f>;
		qcom,mdss-dsi-bl-min-level = <1>;
		qcom,mdss-dsi-bl-max-level = <4095>;
		qcom,mdss-brightness-max-level = <4095>;
		qcom,mdss-dsi-dma-trigger = "trigger_sw";
		qcom,mdss-dsi-mdp-trigger = "none";
		qcom,mdss-dsi-bl-pmic-control-type = "bl_ctrl_wled";
		qcom,mdss-dsi-reset-sequence = <1 5>, <0 5>, <1 10>;
		qcom,mdss-pan-physical-width-dimension = <61>;
		qcom,mdss-pan-physical-height-dimension = <109>;
		qcom,cont-splash-enabled;
		qcom,dispparam-enabled;
		qcom,mdss-dsi-dispparam-warm-command = [
				15 01 00 00 01 00 02 FF 01
				15 00 00 00 01 00 02 FB 01
				15 00 00 00 01 00 02 0B D7
				15 00 00 00 01 00 02 0C D7
				15 00 00 00 01 00 02 75 00
				15 00 00 00 01 00 02 76 00
				15 00 00 00 01 00 02 77 00
				15 00 00 00 01 00 02 78 1A
				15 00 00 00 01 00 02 79 00
				15 00 00 00 01 00 02 7A 47
				15 00 00 00 01 00 02 7B 00
				15 00 00 00 01 00 02 7C 6A
				15 00 00 00 01 00 02 7D 00
				15 00 00 00 01 00 02 7E 85
				15 00 00 00 01 00 02 7F 00
				15 00 00 00 01 00 02 80 9B
				15 00 00 00 01 00 02 81 00
				15 00 00 00 01 00 02 82 B0
				15 00 00 00 01 00 02 83 00
				15 00 00 00 01 00 02 84 C3
				15 00 00 00 01 00 02 85 00
				15 00 00 00 01 00 02 86 D4
				15 00 00 00 01 00 02 87 01
				15 00 00 00 01 00 02 88 09
				15 00 00 00 01 00 02 89 01
				15 00 00 00 01 00 02 8A 33
				15 00 00 00 01 00 02 8B 01
				15 00 00 00 01 00 02 8C 6C
				15 00 00 00 01 00 02 8D 01
				15 00 00 00 01 00 02 8E 9B
				15 00 00 00 01 00 02 8F 01
				15 00 00 00 01 00 02 90 DD
				15 00 00 00 01 00 02 91 02
				15 00 00 00 01 00 02 92 11
				15 00 00 00 01 00 02 93 02
				15 00 00 00 01 00 02 94 12
				15 00 00 00 01 00 02 95 02
				15 00 00 00 01 00 02 96 44
				15 00 00 00 01 00 02 97 02
				15 00 00 00 01 00 02 98 7D
				15 00 00 00 01 00 02 99 02
				15 01 00 00 01 00 02 9A A4
				15 00 00 00 01 00 02 9B 02
				15 00 00 00 01 00 02 9C D9
				15 00 00 00 01 00 02 9D 03
				15 00 00 00 01 00 02 9E 00
				15 00 00 00 01 00 02 9F 03
				15 00 00 00 01 00 02 A0 35
				15 00 00 00 01 00 02 A2 03
				15 00 00 00 01 00 02 A3 57
				15 00 00 00 01 00 02 A4 03
				15 00 00 00 01 00 02 A5 6D
				15 00 00 00 01 00 02 A6 03
				15 00 00 00 01 00 02 A7 89
				15 00 00 00 01 00 02 A9 03
				15 00 00 00 01 00 02 AA A3
				15 00 00 00 01 00 02 AB 03
				15 00 00 00 01 00 02 AC C9
				15 00 00 00 01 00 02 AD 03
				15 00 00 00 01 00 02 AE DD
				15 00 00 00 01 00 02 AF 03
				15 00 00 00 01 00 02 B0 F5
				15 00 00 00 01 00 02 B1 03
				15 00 00 00 01 00 02 B2 FF
				15 00 00 00 01 00 02 B3 00
				15 00 00 00 01 00 02 B4 00
				15 00 00 00 01 00 02 B5 00
				15 00 00 00 01 00 02 B6 1A
				15 00 00 00 01 00 02 B7 00
				15 00 00 00 01 00 02 B8 47
				15 00 00 00 01 00 02 B9 00
				15 00 00 00 01 00 02 BA 6A
				15 00 00 00 01 00 02 BB 00
				15 00 00 00 01 00 02 BC 85
				15 00 00 00 01 00 02 BD 00
				15 00 00 00 01 00 02 BE 9B
				15 00 00 00 01 00 02 BF 00
				15 00 00 00 01 00 02 C0 B0
				15 00 00 00 01 00 02 C1 00
				15 00 00 00 01 00 02 C2 C3
				15 00 00 00 01 00 02 C3 00
				15 01 00 00 01 00 02 C4 D4
				15 00 00 00 01 00 02 C5 01
				15 00 00 00 01 00 02 C6 09
				15 00 00 00 01 00 02 C7 01
				15 00 00 00 01 00 02 C8 33
				15 00 00 00 01 00 02 C9 01
				15 00 00 00 01 00 02 CA 6C
				15 00 00 00 01 00 02 CB 01
				15 00 00 00 01 00 02 CC 9B
				15 00 00 00 01 00 02 CD 01
				15 00 00 00 01 00 02 CE DD
				15 00 00 00 01 00 02 CF 02
				15 00 00 00 01 00 02 D0 11
				15 00 00 00 01 00 02 D1 02
				15 00 00 00 01 00 02 D2 12
				15 00 00 00 01 00 02 D3 02
				15 00 00 00 01 00 02 D4 44
				15 00 00 00 01 00 02 D5 02
				15 00 00 00 01 00 02 D6 7D
				15 00 00 00 01 00 02 D7 02
				15 00 00 00 01 00 02 D8 A4
				15 00 00 00 01 00 02 D9 02
				15 00 00 00 01 00 02 DA DA
				15 00 00 00 01 00 02 DB 03
				15 00 00 00 01 00 02 DC 00
				15 00 00 00 01 00 02 DD 03
				15 00 00 00 01 00 02 DE 35
				15 00 00 00 01 00 02 DF 03
				15 00 00 00 01 00 02 E0 57
				15 00 00 00 01 00 02 E1 03
				15 00 00 00 01 00 02 E2 6D
				15 00 00 00 01 00 02 E3 03
				15 00 00 00 01 00 02 E4 89
				15 00 00 00 01 00 02 E5 03
				15 00 00 00 01 00 02 E6 A3
				15 00 00 00 01 00 02 E7 03
				15 00 00 00 01 00 02 E8 C9
				15 00 00 00 01 00 02 E9 03
				15 00 00 00 01 00 02 EA DD
				15 00 00 00 01 00 02 EB 03
				15 01 00 00 01 00 02 EC F5
				15 00 00 00 01 00 02 ED 03
				15 00 00 00 01 00 02 EE FF
				15 00 00 00 01 00 02 EF 00
				15 00 00 00 01 00 02 F0 BD
				15 00 00 00 01 00 02 F1 00
				15 00 00 00 01 00 02 F2 C5
				15 00 00 00 01 00 02 F3 00
				15 00 00 00 01 00 02 F4 D6
				15 00 00 00 01 00 02 F5 00
				15 00 00 00 01 00 02 F6 E5
				15 00 00 00 01 00 02 F7 00
				15 00 00 00 01 00 02 F8 F2
				15 00 00 00 01 00 02 F9 00
				15 00 00 00 01 00 02 FA FE
				15 01 00 00 01 00 02 FF 02
				15 00 00 00 01 00 02 FB 01
				15 00 00 00 01 00 02 00 01
				15 00 00 00 01 00 02 01 09
				15 00 00 00 01 00 02 02 01
				15 00 00 00 01 00 02 03 14
				15 00 00 00 01 00 02 04 01
				15 00 00 00 01 00 02 05 1E
				15 00 00 00 01 00 02 06 01
				15 00 00 00 01 00 02 07 41
				15 00 00 00 01 00 02 08 01
				15 00 00 00 01 00 02 09 5F
				15 00 00 00 01 00 02 0A 01
				15 00 00 00 01 00 02 0B 8C
				15 00 00 00 01 00 02 0C 01
				15 01 00 00 01 00 02 0D B2
				15 00 00 00 01 00 02 0E 01
				15 00 00 00 01 00 02 0F EC
				15 00 00 00 01 00 02 10 02
				15 00 00 00 01 00 02 11 1C
				15 00 00 00 01 00 02 12 02
				15 00 00 00 01 00 02 13 1D
				15 00 00 00 01 00 02 14 02
				15 00 00 00 01 00 02 15 4D
				15 00 00 00 01 00 02 16 02
				15 00 00 00 01 00 02 17 85
				15 00 00 00 01 00 02 18 02
				15 00 00 00 01 00 02 19 AC
				15 00 00 00 01 00 02 1A 02
				15 00 00 00 01 00 02 1B E1
				15 00 00 00 01 00 02 1C 03
				15 00 00 00 01 00 02 1D 08
				15 00 00 00 01 00 02 1E 03
				15 00 00 00 01 00 02 1F 3E
				15 00 00 00 01 00 02 20 03
				15 00 00 00 01 00 02 21 57
				15 00 00 00 01 00 02 22 03
				15 00 00 00 01 00 02 23 6D
				15 00 00 00 01 00 02 24 03
				15 00 00 00 01 00 02 25 89
				15 00 00 00 01 00 02 26 03
				15 00 00 00 01 00 02 27 A3
				15 00 00 00 01 00 02 28 03
				15 00 00 00 01 00 02 29 C9
				15 00 00 00 01 00 02 2A 03
				15 00 00 00 01 00 02 2B DD
				15 00 00 00 01 00 02 2D 03
				15 00 00 00 01 00 02 2F F5
				15 00 00 00 01 00 02 30 03
				15 00 00 00 01 00 02 31 FF
				15 00 00 00 01 00 02 32 00
				15 00 00 00 01 00 02 33 BD
				15 00 00 00 01 00 02 34 00
				15 00 00 00 01 00 02 35 C5
				15 00 00 00 01 00 02 36 00
				15 01 00 00 01 00 02 37 D6
				15 00 00 00 01 00 02 38 00
				15 00 00 00 01 00 02 39 E5
				15 00 00 00 01 00 02 3A 00
				15 00 00 00 01 00 02 3B F2
				15 00 00 00 01 00 02 3D 00
				15 00 00 00 01 00 02 3F FE
				15 00 00 00 01 00 02 40 01
				15 00 00 00 01 00 02 41 09
				15 00 00 00 01 00 02 42 01
				15 00 00 00 01 00 02 43 14
				15 00 00 00 01 00 02 44 01
				15 00 00 00 01 00 02 45 1E
				15 00 00 00 01 00 02 46 01
				15 00 00 00 01 00 02 47 41
				15 00 00 00 01 00 02 48 01
				15 00 00 00 01 00 02 49 5F
				15 00 00 00 01 00 02 4A 01
				15 00 00 00 01 00 02 4B 8C
				15 00 00 00 01 00 02 4C 01
				15 00 00 00 01 00 02 4D B2
				15 00 00 00 01 00 02 4E 01
				15 00 00 00 01 00 02 4F EC
				15 00 00 00 01 00 02 50 02
				15 00 00 00 01 00 02 51 1C
				15 00 00 00 01 00 02 52 02
				15 00 00 00 01 00 02 53 1D
				15 00 00 00 01 00 02 54 02
				15 00 00 00 01 00 02 55 4D
				15 00 00 00 01 00 02 56 02
				15 00 00 00 01 00 02 58 85
				15 00 00 00 01 00 02 59 02
				15 00 00 00 01 00 02 5A AC
				15 00 00 00 01 00 02 5B 02
				15 00 00 00 01 00 02 5C E1
				15 00 00 00 01 00 02 5D 03
				15 00 00 00 01 00 02 5E 08
				15 00 00 00 01 00 02 5F 03
				15 00 00 00 01 00 02 60 3E
				15 00 00 00 01 00 02 61 03
				15 01 00 00 01 00 02 62 57
				15 00 00 00 01 00 02 63 03
				15 00 00 00 01 00 02 64 6D
				15 00 00 00 01 00 02 65 03
				15 00 00 00 01 00 02 66 89
				15 00 00 00 01 00 02 67 03
				15 00 00 00 01 00 02 68 A3
				15 00 00 00 01 00 02 69 03
				15 00 00 00 01 00 02 6A C9
				15 00 00 00 01 00 02 6B 03
				15 00 00 00 01 00 02 6C DD
				15 00 00 00 01 00 02 6D 03
				15 00 00 00 01 00 02 6E F5
				15 00 00 00 01 00 02 6F 03
				15 00 00 00 01 00 02 70 FF
				15 00 00 00 01 00 02 71 01
				15 00 00 00 01 00 02 72 27
				15 00 00 00 01 00 02 73 01
				15 00 00 00 01 00 02 74 2B
				15 00 00 00 01 00 02 75 01
				15 00 00 00 01 00 02 76 34
				15 00 00 00 01 00 02 77 01
				15 00 00 00 01 00 02 78 3C
				15 00 00 00 01 00 02 79 01
				15 00 00 00 01 00 02 7A 43
				15 00 00 00 01 00 02 7B 01
				15 00 00 00 01 00 02 7C 4A
				15 00 00 00 01 00 02 7D 01
				15 00 00 00 01 00 02 7E 51
				15 00 00 00 01 00 02 7F 01
				15 00 00 00 01 00 02 80 58
				15 00 00 00 01 00 02 81 01
				15 00 00 00 01 00 02 82 5E
				15 00 00 00 01 00 02 83 01
				15 00 00 00 01 00 02 84 75
				15 00 00 00 01 00 02 85 01
				15 00 00 00 01 00 02 86 8A
				15 00 00 00 01 00 02 87 01
				15 00 00 00 01 00 02 88 AC
				15 01 00 00 01 00 02 89 01
				15 00 00 00 01 00 02 8A CA
				15 00 00 00 01 00 02 8B 01
				15 00 00 00 01 00 02 8C FB
				15 00 00 00 01 00 02 8D 02
				15 00 00 00 01 00 02 8E 27
				15 00 00 00 01 00 02 8F 02
				15 00 00 00 01 00 02 90 28
				15 00 00 00 01 00 02 91 02
				15 00 00 00 01 00 02 92 56
				15 00 00 00 01 00 02 93 02
				15 00 00 00 01 00 02 94 8D
				15 00 00 00 01 00 02 95 02
				15 00 00 00 01 00 02 96 B5
				15 00 00 00 01 00 02 97 02
				15 00 00 00 01 00 02 98 EC
				15 00 00 00 01 00 02 99 03
				15 00 00 00 01 00 02 9A 18
				15 00 00 00 01 00 02 9B 03
				15 00 00 00 01 00 02 9C 64
				15 00 00 00 01 00 02 9D 03
				15 00 00 00 01 00 02 9E 69
				15 00 00 00 01 00 02 9F 03
				15 00 00 00 01 00 02 A0 6D
				15 00 00 00 01 00 02 A2 03
				15 00 00 00 01 00 02 A3 89
				15 00 00 00 01 00 02 A4 03
				15 00 00 00 01 00 02 A5 A3
				15 00 00 00 01 00 02 A6 03
				15 00 00 00 01 00 02 A7 C9
				15 00 00 00 01 00 02 A9 03
				15 00 00 00 10 00 02 AA DD
				15 00 00 00 01 00 02 AB 03
				15 00 00 00 01 00 02 AC F5
				15 00 00 00 01 00 02 AD 03
				15 00 00 00 01 00 02 AE FF
				15 00 00 00 01 00 02 AF 01
				15 00 00 00 01 00 02 B0 27
				15 00 00 00 01 00 02 B1 01
				15 00 00 00 01 00 02 B2 2B
				15 00 00 00 01 00 02 B3 01
				15 01 00 00 01 00 02 B4 34
				15 00 00 00 01 00 02 B5 01
				15 00 00 00 01 00 02 B6 3C
				15 00 00 00 01 00 02 B7 01
				15 00 00 00 01 00 02 B8 43
				15 00 00 00 01 00 02 B9 01
				15 00 00 00 01 00 02 BA 4A
				15 00 00 00 01 00 02 BB 01
				15 00 00 00 01 00 02 BC 51
				15 00 00 00 01 00 02 BD 01
				15 00 00 00 01 00 02 BE 58
				15 00 00 00 01 00 02 BF 01
				15 00 00 00 01 00 02 C0 5E
				15 00 00 00 01 00 02 C1 01
				15 00 00 00 01 00 02 C2 75
				15 00 00 00 01 00 02 C3 01
				15 00 00 00 01 00 02 C4 8A
				15 00 00 00 01 00 02 C5 01
				15 00 00 00 01 00 02 C6 AC
				15 00 00 00 01 00 02 C7 01
				15 01 00 00 01 00 02 C8 CB
				15 00 00 00 01 00 02 C9 01
				15 00 00 00 01 00 02 CA FC
				15 00 00 00 01 00 02 CB 02
				15 00 00 00 01 00 02 CC 28
				15 00 00 00 01 00 02 CD 02
				15 00 00 00 01 00 02 CE 29
				15 00 00 00 01 00 02 CF 02
				15 00 00 00 01 00 02 D0 56
				15 00 00 00 01 00 02 D1 02
				15 00 00 00 01 00 02 D2 8E
				15 00 00 00 01 00 02 D3 02
				15 00 00 00 01 00 02 D4 B5
				15 00 00 00 01 00 02 D5 02
				15 00 00 00 01 00 02 D6 ED
				15 00 00 00 01 00 02 D7 03
				15 00 00 00 01 00 02 D8 18
				15 00 00 00 01 00 02 D9 03
				15 00 00 00 01 00 02 DA 64
				15 00 00 00 01 00 02 DB 03
				15 00 00 00 01 00 02 DC 69
				15 00 00 00 01 00 02 DD 03
				15 00 00 00 01 00 02 DE 6D
				15 00 00 00 01 00 02 DF 03
				15 00 00 00 01 00 02 E0 89
				15 00 00 00 01 00 02 E1 03
				15 00 00 00 01 00 02 E2 A3
				15 00 00 00 01 00 02 E3 03
				15 00 00 00 01 00 02 E4 C9
				15 00 00 00 01 00 02 E5 03
				15 00 00 00 01 00 02 E6 DD
				15 00 00 00 01 00 02 E7 03
				15 00 00 00 01 00 02 E8 F5
				15 00 00 00 01 00 02 E9 03
				15 00 00 00 01 00 02 EA FF
				15 01 00 00 01 00 02 FF 00
				];
		qcom,mdss-dsi-dispparam-warm-command-state = "dsi_hs_mode";

		qcom,mdss-dsi-dispparam-default-command = [
				15 01 00 00 01 00 02 FF 01
				15 00 00 00 01 00 02 FB 00
				15 01 00 00 01 00 02 FF 02
				15 00 00 00 01 00 02 FB 00
				15 01 00 00 01 00 02 FF 00
				05 01 00 00 10 00 02 11 00
			];
		qcom,mdss-dsi-dispparam-default-command-state = "dsi_hs_mode";

		qcom,mdss-dsi-dispparam-cold-command = [
				15 01 00 00 01 00 02 FF 01
				15 00 00 00 01 00 02 FB 01
				15 00 00 00 01 00 02 0B D7
				15 00 00 00 01 00 02 0C D7
				15 00 00 00 01 00 02 75 00
				15 00 00 00 01 00 02 76 C5
				15 00 00 00 01 00 02 77 00
				15 00 00 00 01 00 02 78 CD
				15 00 00 00 01 00 02 79 00
				15 00 00 00 01 00 02 7A DB
				15 00 00 00 01 00 02 7B 00
				15 00 00 00 01 00 02 7C E9
				15 00 00 00 01 00 02 7D 00
				15 00 00 00 01 00 02 7E F6
				15 00 00 00 01 00 02 7F 01
				15 00 00 00 01 00 02 80 02
				15 00 00 00 01 00 02 81 01
				15 00 00 00 01 00 02 82 0D
				15 00 00 00 01 00 02 83 01
				15 00 00 00 01 00 02 84 18
				15 00 00 00 01 00 02 85 01
				15 00 00 00 01 00 02 86 21
				15 00 00 00 01 00 02 87 01
				15 00 00 00 01 00 02 88 43
				15 00 00 00 01 00 02 89 01
				15 00 00 00 01 00 02 8A 5F
				15 00 00 00 01 00 02 8B 01
				15 00 00 00 01 00 02 8C 8E
				15 00 00 00 01 00 02 8D 01
				15 00 00 00 01 00 02 8E B2
				15 00 00 00 01 00 02 8F 01
				15 00 00 00 01 00 02 90 EC
				15 00 00 00 01 00 02 91 02
				15 00 00 00 01 00 02 92 1C
				15 00 00 00 01 00 02 93 02
				15 00 00 00 01 00 02 94 1D
				15 00 00 00 01 00 02 95 02
				15 00 00 00 01 00 02 96 4D
				15 00 00 00 01 00 02 97 02
				15 00 00 00 01 00 02 98 84
				15 00 00 00 01 00 02 99 02
				15 01 00 00 01 00 02 9A AC
				15 00 00 00 01 00 02 9B 02
				15 00 00 00 01 00 02 9C E1
				15 00 00 00 01 00 02 9D 03
				15 00 00 00 01 00 02 9E 06
				15 00 00 00 01 00 02 9F 03
				15 00 00 00 01 00 02 A0 40
				15 00 00 00 01 00 02 A2 03
				15 00 00 00 01 00 02 A3 57
				15 00 00 00 01 00 02 A4 03
				15 00 00 00 01 00 02 A5 6D
				15 00 00 00 01 00 02 A6 03
				15 00 00 00 01 00 02 A7 89
				15 00 00 00 01 00 02 A9 03
				15 00 00 00 01 00 02 AA A3
				15 00 00 00 01 00 02 AB 03
				15 00 00 00 01 00 02 AC C9
				15 00 00 00 01 00 02 AD 03
				15 00 00 00 01 00 02 AE DD
				15 00 00 00 01 00 02 AF 03
				15 00 00 00 01 00 02 B0 F5
				15 00 00 00 01 00 02 B1 03
				15 00 00 00 01 00 02 B2 FF
				15 00 00 00 01 00 02 B3 00
				15 00 00 00 01 00 02 B4 C5
				15 00 00 00 01 00 02 B5 00
				15 00 00 00 01 00 02 B6 CD
				15 00 00 00 01 00 02 B7 00
				15 00 00 00 01 00 02 B8 DB
				15 00 00 00 01 00 02 B9 00
				15 00 00 00 01 00 02 BA E9
				15 00 00 00 01 00 02 BB 00
				15 00 00 00 01 00 02 BC F6
				15 00 00 00 01 00 02 BD 01
				15 00 00 00 01 00 02 BE 02
				15 00 00 00 01 00 02 BF 01
				15 00 00 00 01 00 02 C0 0D
				15 00 00 00 01 00 02 C1 01
				15 00 00 00 01 00 02 C2 18
				15 00 00 00 01 00 02 C3 01
				15 01 00 00 01 00 02 C4 21
				15 00 00 00 01 00 02 C5 01
				15 00 00 00 01 00 02 C6 43
				15 00 00 00 01 00 02 C7 01
				15 00 00 00 01 00 02 C8 60
				15 00 00 00 01 00 02 C9 01
				15 00 00 00 01 00 02 CA 8E
				15 00 00 00 01 00 02 CB 01
				15 00 00 00 01 00 02 CC B3
				15 00 00 00 01 00 02 CD 01
				15 00 00 00 01 00 02 CE EC
				15 00 00 00 01 00 02 CF 02
				15 00 00 00 01 00 02 D0 1C
				15 00 00 00 01 00 02 D1 02
				15 00 00 00 01 00 02 D2 1D
				15 00 00 00 01 00 02 D3 02
				15 00 00 00 01 00 02 D4 4D
				15 00 00 00 01 00 02 D5 02
				15 00 00 00 01 00 02 D6 84
				15 00 00 00 01 00 02 D7 02
				15 00 00 00 01 00 02 D8 AC
				15 00 00 00 01 00 02 D9 02
				15 00 00 00 01 00 02 DA E1
				15 00 00 00 01 00 02 DB 03
				15 00 00 00 01 00 02 DC 07
				15 00 00 00 01 00 02 DD 03
				15 00 00 00 01 00 02 DE 40
				15 00 00 00 01 00 02 DF 03
				15 00 00 00 01 00 02 E0 57
				15 00 00 00 01 00 02 E1 03
				15 00 00 00 01 00 02 E2 6D
				15 00 00 00 01 00 02 E3 03
				15 00 00 00 01 00 02 E4 89
				15 00 00 00 01 00 02 E5 03
				15 00 00 00 01 00 02 E6 A3
				15 00 00 00 01 00 02 E7 03
				15 00 00 00 01 00 02 E8 C9
				15 00 00 00 01 00 02 E9 03
				15 00 00 00 01 00 02 EA DD
				15 00 00 00 01 00 02 EB 03
				15 01 00 00 01 00 02 EC F5
				15 00 00 00 01 00 02 ED 03
				15 00 00 00 01 00 02 EE FF
				15 00 00 00 01 00 02 EF 00
				15 00 00 00 01 00 02 F0 BD
				15 00 00 00 01 00 02 F1 00
				15 00 00 00 01 00 02 F2 C6
				15 00 00 00 01 00 02 F3 00
				15 00 00 00 01 00 02 F4 D6
				15 00 00 00 01 00 02 F5 00
				15 00 00 00 01 00 02 F6 E4
				15 00 00 00 01 00 02 F7 00
				15 00 00 00 01 00 02 F8 F2
				15 00 00 00 01 00 02 F9 00
				15 00 00 00 01 00 02 FA FE
				15 01 00 00 01 00 02 FF 02
				15 00 00 00 01 00 02 FB 01
				15 00 00 00 01 00 02 00 01
				15 00 00 00 01 00 02 01 0A
				15 00 00 00 01 00 02 02 01
				15 00 00 00 01 00 02 03 15
				15 00 00 00 01 00 02 04 01
				15 00 00 00 01 00 02 05 1F
				15 00 00 00 01 00 02 06 01
				15 00 00 00 01 00 02 07 42
				15 00 00 00 01 00 02 08 01
				15 00 00 00 01 00 02 09 5F
				15 00 00 00 01 00 02 0A 01
				15 00 00 00 01 00 02 0B 8E
				15 00 00 00 01 00 02 0C 01
				15 01 00 00 01 00 02 0D B3
				15 00 00 00 01 00 02 0E 01
				15 00 00 00 01 00 02 0F ED
				15 00 00 00 01 00 02 10 02
				15 00 00 00 01 00 02 11 1D
				15 00 00 00 01 00 02 12 02
				15 00 00 00 01 00 02 13 1E
				15 00 00 00 01 00 02 14 02
				15 00 00 00 01 00 02 15 4E
				15 00 00 00 01 00 02 16 02
				15 00 00 00 01 00 02 17 85
				15 00 00 00 01 00 02 18 02
				15 00 00 00 01 00 02 19 AC
				15 00 00 00 01 00 02 1A 02
				15 00 00 00 01 00 02 1B E2
				15 00 00 00 01 00 02 1C 03
				15 00 00 00 01 00 02 1D 08
				15 00 00 00 01 00 02 1E 03
				15 00 00 00 01 00 02 1F 42
				15 00 00 00 01 00 02 20 03
				15 00 00 00 01 00 02 21 57
				15 00 00 00 01 00 02 22 03
				15 00 00 00 01 00 02 23 6D
				15 00 00 00 01 00 02 24 03
				15 00 00 00 01 00 02 25 89
				15 00 00 00 01 00 02 26 03
				15 00 00 00 01 00 02 27 A3
				15 00 00 00 01 00 02 28 03
				15 00 00 00 01 00 02 29 C9
				15 00 00 00 01 00 02 2A 03
				15 00 00 00 01 00 02 2B DD
				15 00 00 00 01 00 02 2D 03
				15 00 00 00 01 00 02 2F F5
				15 00 00 00 01 00 02 30 03
				15 00 00 00 01 00 02 31 FF
				15 00 00 00 01 00 02 32 00
				15 00 00 00 01 00 02 33 BD
				15 00 00 00 01 00 02 34 00
				15 00 00 00 01 00 02 35 C6
				15 00 00 00 01 00 02 36 00
				15 01 00 00 01 00 02 37 D6
				15 00 00 00 01 00 02 38 00
				15 00 00 00 01 00 02 39 E4
				15 00 00 00 01 00 02 3A 00
				15 00 00 00 01 00 02 3B F2
				15 00 00 00 01 00 02 3D 00
				15 00 00 00 01 00 02 3F FE
				15 00 00 00 01 00 02 40 01
				15 00 00 00 01 00 02 41 0A
				15 00 00 00 01 00 02 42 01
				15 00 00 00 01 00 02 43 15
				15 00 00 00 01 00 02 44 01
				15 00 00 00 01 00 02 45 1F
				15 00 00 00 01 00 02 46 01
				15 00 00 00 01 00 02 47 42
				15 00 00 00 01 00 02 48 01
				15 00 00 00 01 00 02 49 5F
				15 00 00 00 01 00 02 4A 01
				15 00 00 00 01 00 02 4B 8E
				15 00 00 00 01 00 02 4C 01
				15 00 00 00 01 00 02 4D B3
				15 00 00 00 01 00 02 4E 01
				15 00 00 00 01 00 02 4F ED
				15 00 00 00 01 00 02 50 02
				15 00 00 00 01 00 02 51 1D
				15 00 00 00 01 00 02 52 02
				15 00 00 00 01 00 02 53 1E
				15 00 00 00 01 00 02 54 02
				15 00 00 00 01 00 02 55 4E
				15 00 00 00 01 00 02 56 02
				15 00 00 00 01 00 02 58 85
				15 00 00 00 01 00 02 59 02
				15 00 00 00 01 00 02 5A AD
				15 00 00 00 01 00 02 5B 02
				15 00 00 00 01 00 02 5C E2
				15 00 00 00 01 00 02 5D 03
				15 00 00 00 01 00 02 5E 08
				15 00 00 00 01 00 02 5F 03
				15 00 00 00 01 00 02 60 42
				15 00 00 00 01 00 02 61 03
				15 01 00 00 01 00 02 62 57
				15 00 00 00 01 00 02 63 03
				15 00 00 00 01 00 02 64 6D
				15 00 00 00 01 00 02 65 03
				15 00 00 00 01 00 02 66 89
				15 00 00 00 01 00 02 67 03
				15 00 00 00 01 00 02 68 A3
				15 00 00 00 01 00 02 69 03
				15 00 00 00 01 00 02 6A C9
				15 00 00 00 01 00 02 6B 03
				15 00 00 00 01 00 02 6C DD
				15 00 00 00 01 00 02 6D 03
				15 00 00 00 01 00 02 6E F5
				15 00 00 00 01 00 02 6F 03
				15 00 00 00 01 00 02 70 FF
				15 00 00 00 01 00 02 71 00
				15 00 00 00 01 00 02 72 BF
				15 00 00 00 01 00 02 73 00
				15 00 00 00 01 00 02 74 C8
				15 00 00 00 01 00 02 75 00
				15 00 00 00 01 00 02 76 D8
				15 00 00 00 01 00 02 77 00
				15 00 00 00 01 00 02 78 E7
				15 00 00 00 01 00 02 79 00
				15 00 00 00 01 00 02 7A F5
				15 00 00 00 01 00 02 7B 01
				15 00 00 00 01 00 02 7C 01
				15 00 00 00 01 00 02 7D 01
				15 00 00 00 01 00 02 7E 0C
				15 00 00 00 01 00 02 7F 01
				15 00 00 00 01 00 02 80 18
				15 00 00 00 01 00 02 81 01
				15 00 00 00 01 00 02 82 22
				15 00 00 00 01 00 02 83 01
				15 00 00 00 01 00 02 84 45
				15 00 00 00 01 00 02 85 01
				15 00 00 00 01 00 02 86 61
				15 00 00 00 01 00 02 87 01
				15 00 00 00 01 00 02 88 90
				15 01 00 00 01 00 02 89 01
				15 00 00 00 01 00 02 8A B4
				15 00 00 00 01 00 02 8B 01
				15 00 00 00 01 00 02 8C ED
				15 00 00 00 01 00 02 8D 02
				15 00 00 00 01 00 02 8E 1C
				15 00 00 00 01 00 02 8F 02
				15 00 00 00 01 00 02 90 1D
				15 00 00 00 01 00 02 91 02
				15 00 00 00 01 00 02 92 4D
				15 00 00 00 01 00 02 93 02
				15 00 00 00 01 00 02 94 84
				15 00 00 00 01 00 02 95 02
				15 00 00 00 01 00 02 96 AD
				15 00 00 00 01 00 02 97 02
				15 00 00 00 01 00 02 98 E4
				15 00 00 00 01 00 02 99 03
				15 00 00 00 01 00 02 9A 0E
				15 00 00 00 01 00 02 9B 03
				15 00 00 00 01 00 02 9C 5B
				15 00 00 00 01 00 02 9D 03
				15 00 00 00 01 00 02 9E 65
				15 00 00 00 01 00 02 9F 03
				15 00 00 00 01 00 02 A0 6D
				15 00 00 00 01 00 02 A2 03
				15 00 00 00 01 00 02 A3 89
				15 00 00 00 01 00 02 A4 03
				15 00 00 00 01 00 02 A5 A3
				15 00 00 00 01 00 02 A6 03
				15 00 00 00 01 00 02 A7 C9
				15 00 00 00 01 00 02 A9 03
				15 00 00 00 10 00 02 AA DD
				15 00 00 00 01 00 02 AB 03
				15 00 00 00 01 00 02 AC F5
				15 00 00 00 01 00 02 AD 03
				15 00 00 00 01 00 02 AE FF
				15 00 00 00 01 00 02 AF 00
				15 00 00 00 01 00 02 B0 BF
				15 00 00 00 01 00 02 B1 00
				15 00 00 00 01 00 02 B2 C8
				15 00 00 00 01 00 02 B3 00
				15 01 00 00 01 00 02 B4 D8
				15 00 00 00 01 00 02 B5 00
				15 00 00 00 01 00 02 B6 E7
				15 00 00 00 01 00 02 B7 00
				15 00 00 00 01 00 02 B8 F5
				15 00 00 00 01 00 02 B9 01
				15 00 00 00 01 00 02 BA 01
				15 00 00 00 01 00 02 BB 01
				15 00 00 00 01 00 02 BC 0C
				15 00 00 00 01 00 02 BD 01
				15 00 00 00 01 00 02 BE 18
				15 00 00 00 01 00 02 BF 01
				15 00 00 00 01 00 02 C0 22
				15 00 00 00 01 00 02 C1 01
				15 00 00 00 01 00 02 C2 45
				15 00 00 00 01 00 02 C3 01
				15 00 00 00 01 00 02 C4 62
				15 00 00 00 01 00 02 C5 01
				15 00 00 00 01 00 02 C6 90
				15 00 00 00 01 00 02 C7 01
				15 01 00 00 01 00 02 C8 B4
				15 00 00 00 01 00 02 C9 01
				15 00 00 00 01 00 02 CA ED
				15 00 00 00 01 00 02 CB 02
				15 00 00 00 01 00 02 CC 1D
				15 00 00 00 01 00 02 CD 02
				15 00 00 00 01 00 02 CE 1E
				15 00 00 00 01 00 02 CF 02
				15 00 00 00 01 00 02 D0 4E
				15 00 00 00 01 00 02 D1 02
				15 00 00 00 01 00 02 D2 85
				15 00 00 00 01 00 02 D3 02
				15 00 00 00 01 00 02 D4 AD
				15 00 00 00 01 00 02 D5 02
				15 00 00 00 01 00 02 D6 E5
				15 00 00 00 01 00 02 D7 03
				15 00 00 00 01 00 02 D8 0E
				15 00 00 00 01 00 02 D9 03
				15 00 00 00 01 00 02 DA 5C
				15 00 00 00 01 00 02 DB 03
				15 00 00 00 01 00 02 DC 65
				15 00 00 00 01 00 02 DD 03
				15 00 00 00 01 00 02 DE 6D
				15 00 00 00 01 00 02 DF 03
				15 00 00 00 01 00 02 E0 89
				15 00 00 00 01 00 02 E1 03
				15 00 00 00 01 00 02 E2 A3
				15 00 00 00 01 00 02 E3 03
				15 00 00 00 01 00 02 E4 C9
				15 00 00 00 01 00 02 E5 03
				15 00 00 00 01 00 02 E6 DD
				15 00 00 00 01 00 02 E7 03
				15 00 00 00 01 00 02 E8 F5
				15 00 00 00 01 00 02 E9 03
				15 00 00 00 01 00 02 EA FF
				15 01 00 00 01 00 02 FF 00
			];
		qcom,mdss-dsi-dispparam-cold-command-state = "dsi_hs_mode";
		qcom,mdss-dsi-dispparam-cabcon-command = [
				15 01 00 00 01 00 02 FF 00
				15 00 00 00 01 00 02 53 2c
				15 01 00 00 01 00 02 55 01
			];
		qcom,mdss-dsi-dispparam-cabcon-command-state = "dsi_hs_mode";
		qcom,mdss-dsi-dispparam-cabcguion-command = [
				15 01 00 00 01 00 02 FF 00
				15 00 00 00 01 00 02 53 2c
				15 01 00 00 01 00 02 55 01
			];
		qcom,mdss-dsi-dispparam-cabcguion-command-state = "dsi_hs_mode";
		qcom,mdss-dsi-dispparam-cabcstillon-command = [
				15 01 00 00 01 00 02 FF 00
				15 00 00 00 01 00 02 53 2c
				15 01 00 00 01 00 02 55 02
			];
		qcom,mdss-dsi-dispparam-cabcstillon-command-state = "dsi_hs_mode";
		qcom,mdss-dsi-dispparam-cabcmovieon-command = [
				15 01 00 00 01 00 02 FF 00
				15 00 00 00 01 00 02 53 2c
				15 01 00 00 01 00 02 55 03
			];
		qcom,mdss-dsi-dispparam-cabcmovieon-command-state = "dsi_hs_mode";
		qcom,mdss-dsi-dispparam-cabcoff-command = [
				15 01 00 00 01 00 02 FF 00
				15 00 00 00 01 00 02 53 2c
				15 01 00 00 01 00 02 55 00
			];
		qcom,mdss-dsi-dispparam-cabcoff-command-state = "dsi_hs_mode";

		qcom,mdss-dsi-dispparam-papermode-command = [
				15 01 00 00 01 00 02 FF 01
				15 00 00 00 01 00 02 FB 01
				15 00 00 00 01 00 02 75 00
				15 00 00 00 01 00 02 76 00
				15 00 00 00 01 00 02 77 00
				15 00 00 00 01 00 02 78 1F
				15 00 00 00 01 00 02 79 00
				15 00 00 00 01 00 02 7A 46
				15 00 00 00 01 00 02 7B 00
				15 00 00 00 01 00 02 7C 69
				15 00 00 00 01 00 02 7D 00
				15 00 00 00 01 00 02 7E 84
				15 00 00 00 01 00 02 7F 00
				15 00 00 00 01 00 02 80 9B
				15 00 00 00 01 00 02 81 00
				15 00 00 00 01 00 02 82 B0
				15 00 00 00 01 00 02 83 00
				15 00 00 00 01 00 02 84 C3
				15 00 00 00 01 00 02 85 00
				15 00 00 00 01 00 02 86 D3
				15 00 00 00 01 00 02 87 01
				15 00 00 00 01 00 02 88 09
				15 00 00 00 01 00 02 89 01
				15 00 00 00 01 00 02 8A 31
				15 00 00 00 01 00 02 8B 01
				15 00 00 00 01 00 02 8C 6D
				15 00 00 00 01 00 02 8D 01
				15 00 00 00 01 00 02 8E 99
				15 00 00 00 01 00 02 8F 01
				15 00 00 00 01 00 02 90 DB
				15 00 00 00 01 00 02 91 02
				15 00 00 00 01 00 02 92 0F
				15 00 00 00 01 00 02 93 02
				15 00 00 00 01 00 02 94 11
				15 00 00 00 01 00 02 95 02
				15 00 00 00 01 00 02 96 42
				15 00 00 00 01 00 02 97 02
				15 00 00 00 01 00 02 98 7D
				15 00 00 00 01 00 02 99 02
				15 01 00 00 01 00 02 9A A4
				15 00 00 00 01 00 02 9B 02
				15 00 00 00 01 00 02 9C D9
				15 00 00 00 01 00 02 9D 02
				15 00 00 00 01 00 02 9E FF
				15 00 00 00 01 00 02 9F 03
				15 00 00 00 01 00 02 A0 36
				15 00 00 00 01 00 02 A2 03
				15 00 00 00 01 00 02 A3 55
				15 00 00 00 01 00 02 A4 03
				15 00 00 00 01 00 02 A5 6D
				15 00 00 00 01 00 02 A6 03
				15 00 00 00 01 00 02 A7 89
				15 00 00 00 01 00 02 A9 03
				15 00 00 00 01 00 02 AA A3
				15 00 00 00 01 00 02 AB 03
				15 00 00 00 01 00 02 AC C9
				15 00 00 00 01 00 02 AD 03
				15 00 00 00 01 00 02 AE DD
				15 00 00 00 01 00 02 AF 03
				15 00 00 00 01 00 02 B0 F5
				15 00 00 00 01 00 02 B1 03
				15 00 00 00 01 00 02 B2 FF
				15 00 00 00 01 00 02 B3 00
				15 00 00 00 01 00 02 B4 00
				15 00 00 00 01 00 02 B5 00
				15 00 00 00 01 00 02 B6 1F
				15 00 00 00 01 00 02 B7 00
				15 00 00 00 01 00 02 B8 46
				15 00 00 00 01 00 02 B9 00
				15 00 00 00 01 00 02 BA 69
				15 00 00 00 01 00 02 BB 00
				15 00 00 00 01 00 02 BC 84
				15 00 00 00 01 00 02 BD 00
				15 00 00 00 01 00 02 BE 9B
				15 00 00 00 01 00 02 BF 00
				15 00 00 00 01 00 02 C0 B0
				15 00 00 00 01 00 02 C1 00
				15 00 00 00 01 00 02 C2 C3
				15 00 00 00 01 00 02 C3 00
				15 01 00 00 01 00 02 C4 D3
				15 00 00 00 01 00 02 C5 01
				15 00 00 00 01 00 02 C6 09
				15 00 00 00 01 00 02 C7 01
				15 00 00 00 01 00 02 C8 31
				15 00 00 00 01 00 02 C9 01
				15 00 00 00 01 00 02 CA 6D
				15 00 00 00 01 00 02 CB 01
				15 00 00 00 01 00 02 CC 9A
				15 00 00 00 01 00 02 CD 01
				15 00 00 00 01 00 02 CE DC
				15 00 00 00 01 00 02 CF 02
				15 00 00 00 01 00 02 D0 10
				15 00 00 00 01 00 02 D1 02
				15 00 00 00 01 00 02 D2 12
				15 00 00 00 01 00 02 D3 02
				15 00 00 00 01 00 02 D4 43
				15 00 00 00 01 00 02 D5 02
				15 00 00 00 01 00 02 D6 7D
				15 00 00 00 01 00 02 D7 02
				15 00 00 00 01 00 02 D8 A4
				15 00 00 00 01 00 02 D9 02
				15 00 00 00 01 00 02 DA D9
				15 00 00 00 01 00 02 DB 02
				15 00 00 00 01 00 02 DC FF
				15 00 00 00 01 00 02 DD 03
				15 00 00 00 01 00 02 DE 36
				15 00 00 00 01 00 02 DF 03
				15 00 00 00 01 00 02 E0 55
				15 00 00 00 01 00 02 E1 03
				15 00 00 00 01 00 02 E2 6D
				15 00 00 00 01 00 02 E3 03
				15 00 00 00 01 00 02 E4 89
				15 00 00 00 01 00 02 E5 03
				15 00 00 00 01 00 02 E6 A3
				15 00 00 00 01 00 02 E7 03
				15 00 00 00 01 00 02 E8 C9
				15 00 00 00 01 00 02 E9 03
				15 00 00 00 01 00 02 EA DD
				15 00 00 00 01 00 02 EB 03
				15 01 00 00 01 00 02 EC F5
				15 00 00 00 01 00 02 ED 03
				15 00 00 00 01 00 02 EE FF
				15 00 00 00 01 00 02 EF 00
				15 00 00 00 01 00 02 F0 66
				15 00 00 00 01 00 02 F1 00
				15 00 00 00 01 00 02 F2 75
				15 00 00 00 01 00 02 F3 00
				15 00 00 00 01 00 02 F4 90
				15 00 00 00 01 00 02 F5 00
				15 00 00 00 01 00 02 F6 A6
				15 00 00 00 01 00 02 F7 00
				15 00 00 00 01 00 02 F8 BA
				15 00 00 00 01 00 02 F9 00
				15 00 00 00 01 00 02 FA CB
				15 01 00 00 01 00 02 FF 02
				15 00 00 00 01 00 02 FB 01
				15 00 00 00 01 00 02 00 00
				15 00 00 00 01 00 02 01 DB
				15 00 00 00 01 00 02 02 00
				15 00 00 00 01 00 02 03 EA
				15 00 00 00 01 00 02 04 00
				15 00 00 00 01 00 02 05 F7
				15 00 00 00 01 00 02 06 01
				15 00 00 00 01 00 02 07 24
				15 00 00 00 01 00 02 08 01
				15 00 00 00 01 00 02 09 46
				15 00 00 00 01 00 02 0A 01
				15 00 00 00 01 00 02 0B 7C
				15 00 00 00 01 00 02 0C 01
				15 01 00 00 01 00 02 0D A5
				15 00 00 00 01 00 02 0E 01
				15 00 00 00 01 00 02 0F E3
				15 00 00 00 01 00 02 10 02
				15 00 00 00 01 00 02 11 15
				15 00 00 00 01 00 02 12 02
				15 00 00 00 01 00 02 13 17
				15 00 00 00 01 00 02 14 02
				15 00 00 00 01 00 02 15 47
				15 00 00 00 01 00 02 16 02
				15 00 00 00 01 00 02 17 81
				15 00 00 00 01 00 02 18 02
				15 00 00 00 01 00 02 19 A8
				15 00 00 00 01 00 02 1A 02
				15 00 00 00 01 00 02 1B DD
				15 00 00 00 01 00 02 1C 03
				15 00 00 00 01 00 02 1D 03
				15 00 00 00 01 00 02 1E 03
				15 00 00 00 01 00 02 1F 3B
				15 00 00 00 01 00 02 20 03
				15 00 00 00 01 00 02 21 52
				15 00 00 00 01 00 02 22 03
				15 00 00 00 01 00 02 23 6D
				15 00 00 00 01 00 02 24 03
				15 00 00 00 01 00 02 25 89
				15 00 00 00 01 00 02 26 03
				15 00 00 00 01 00 02 27 A3
				15 00 00 00 01 00 02 28 03
				15 00 00 00 01 00 02 29 C9
				15 00 00 00 01 00 02 2A 03
				15 00 00 00 01 00 02 2B DD
				15 00 00 00 01 00 02 2D 03
				15 00 00 00 01 00 02 2F F5
				15 00 00 00 01 00 02 30 03
				15 00 00 00 01 00 02 31 FF
				15 00 00 00 01 00 02 32 00
				15 00 00 00 01 00 02 33 66
				15 00 00 00 01 00 02 34 00
				15 00 00 00 01 00 02 35 75
				15 00 00 00 01 00 02 36 00
				15 01 00 00 01 00 02 37 90
				15 00 00 00 01 00 02 38 00
				15 00 00 00 01 00 02 39 A6
				15 00 00 00 01 00 02 3A 00
				15 00 00 00 01 00 02 3B BA
				15 00 00 00 01 00 02 3D 00
				15 00 00 00 01 00 02 3F CB
				15 00 00 00 01 00 02 40 00
				15 00 00 00 01 00 02 41 DB
				15 00 00 00 01 00 02 42 00
				15 00 00 00 01 00 02 43 EA
				15 00 00 00 01 00 02 44 00
				15 00 00 00 01 00 02 45 F7
				15 00 00 00 01 00 02 46 01
				15 00 00 00 01 00 02 47 24
				15 00 00 00 01 00 02 48 01
				15 00 00 00 01 00 02 49 46
				15 00 00 00 01 00 02 4A 01
				15 00 00 00 01 00 02 4B 7C
				15 00 00 00 01 00 02 4C 01
				15 00 00 00 01 00 02 4D A5
				15 00 00 00 01 00 02 4E 01
				15 00 00 00 01 00 02 4F E3
				15 00 00 00 01 00 02 50 02
				15 00 00 00 01 00 02 51 15
				15 00 00 00 01 00 02 52 02
				15 00 00 00 01 00 02 53 17
				15 00 00 00 01 00 02 54 02
				15 00 00 00 01 00 02 55 47
				15 00 00 00 01 00 02 56 02
				15 00 00 00 01 00 02 58 81
				15 00 00 00 01 00 02 59 02
				15 00 00 00 01 00 02 5A A8
				15 00 00 00 01 00 02 5B 02
				15 00 00 00 01 00 02 5C DD
				15 00 00 00 01 00 02 5D 03
				15 00 00 00 01 00 02 5E 03
				15 00 00 00 01 00 02 5F 03
				15 00 00 00 01 00 02 60 3B
				15 00 00 00 01 00 02 61 03
				15 01 00 00 01 00 02 62 52
				15 00 00 00 01 00 02 63 03
				15 00 00 00 01 00 02 64 6D
				15 00 00 00 01 00 02 65 03
				15 00 00 00 01 00 02 66 89
				15 00 00 00 01 00 02 67 03
				15 00 00 00 01 00 02 68 A3
				15 00 00 00 01 00 02 69 03
				15 00 00 00 01 00 02 6A C9
				15 00 00 00 01 00 02 6B 03
				15 00 00 00 01 00 02 6C DD
				15 00 00 00 01 00 02 6D 03
				15 00 00 00 01 00 02 6E F5
				15 00 00 00 01 00 02 6F 03
				15 00 00 00 01 00 02 70 FF
				15 00 00 00 01 00 02 71 01
				15 00 00 00 01 00 02 72 b6
				15 00 00 00 01 00 02 73 01
				15 00 00 00 01 00 02 74 b8
				15 00 00 00 01 00 02 75 01
				15 00 00 00 01 00 02 76 bb
				15 00 00 00 01 00 02 77 01
				15 00 00 00 01 00 02 78 bd
				15 00 00 00 01 00 02 79 01
				15 00 00 00 01 00 02 7A c0
				15 00 00 00 01 00 02 7B 01
				15 00 00 00 01 00 02 7C c2
				15 00 00 00 01 00 02 7D 01
				15 00 00 00 01 00 02 7E c5
				15 00 00 00 01 00 02 7F 01
				15 00 00 00 01 00 02 80 c8
				15 00 00 00 01 00 02 81 01
				15 00 00 00 01 00 02 82 ca
				15 00 00 00 01 00 02 83 01
				15 00 00 00 01 00 02 84 d5
				15 00 00 00 01 00 02 85 01
				15 00 00 00 01 00 02 86 df
				15 00 00 00 01 00 02 87 01
				15 00 00 00 01 00 02 88 f2
				15 01 00 00 01 00 02 89 02
				15 00 00 00 01 00 02 8A 04
				15 00 00 00 01 00 02 8B 02
				15 00 00 00 01 00 02 8C 26
				15 00 00 00 01 00 02 8D 02
				15 00 00 00 01 00 02 8E 4a
				15 00 00 00 01 00 02 8F 02
				15 00 00 00 01 00 02 90 4b
				15 00 00 00 01 00 02 91 02
				15 00 00 00 01 00 02 92 74
				15 00 00 00 01 00 02 93 02
				15 00 00 00 01 00 02 94 ac
				15 00 00 00 01 00 02 95 02
				15 00 00 00 01 00 02 96 d3
				15 00 00 00 01 00 02 97 03
				15 00 00 00 01 00 02 98 0b
				15 00 00 00 01 00 02 99 03
				15 00 00 00 01 00 02 9A 31
				15 00 00 00 01 00 02 9B 03
				15 00 00 00 01 00 02 9C 7e
				15 00 00 00 01 00 02 9D 03
				15 00 00 00 01 00 02 9E b0
				15 00 00 00 01 00 02 9F 03
				15 00 00 00 01 00 02 A0 DB
				15 00 00 00 01 00 02 A2 03
				15 00 00 00 01 00 02 A3 E3
				15 00 00 00 01 00 02 A4 03
				15 00 00 00 01 00 02 A5 E7
				15 00 00 00 01 00 02 A6 03
				15 00 00 00 01 00 02 A7 ED
				15 00 00 00 01 00 02 A9 03
				15 00 00 00 10 00 02 AA F0
				15 00 00 00 01 00 02 AB 03
				15 00 00 00 01 00 02 AC F5
				15 00 00 00 01 00 02 AD 03
				15 00 00 00 01 00 02 AE FF
				15 00 00 00 01 00 02 AF 01
				15 00 00 00 01 00 02 B0 b6
				15 00 00 00 01 00 02 B1 01
				15 00 00 00 01 00 02 B2 b8
				15 00 00 00 01 00 02 B3 01
				15 01 00 00 01 00 02 B4 bb
				15 00 00 00 01 00 02 B5 01
				15 00 00 00 01 00 02 B6 bd
				15 00 00 00 01 00 02 B7 01
				15 00 00 00 01 00 02 B8 c0
				15 00 00 00 01 00 02 B9 01
				15 00 00 00 01 00 02 BA c2
				15 00 00 00 01 00 02 BB 01
				15 00 00 00 01 00 02 BC c5
				15 00 00 00 01 00 02 BD 01
				15 00 00 00 01 00 02 BE c8
				15 00 00 00 01 00 02 BF 01
				15 00 00 00 01 00 02 C0 ca
				15 00 00 00 01 00 02 C1 01
				15 00 00 00 01 00 02 C2 d5
				15 00 00 00 01 00 02 C3 01
				15 00 00 00 01 00 02 C4 df
				15 00 00 00 01 00 02 C5 01
				15 00 00 00 01 00 02 C6 f2
				15 00 00 00 01 00 02 C7 02
				15 00 00 00 01 00 02 C8 04
				15 00 00 00 01 00 02 C9 02
				15 00 00 00 01 00 02 CA 26
				15 00 00 00 01 00 02 CB 02
				15 00 00 00 01 00 02 CC 4a
				15 00 00 00 01 00 02 CD 02
				15 00 00 00 01 00 02 CE 4c
				15 00 00 00 01 00 02 CF 02
				15 00 00 00 01 00 02 D0 74
				15 00 00 00 01 00 02 D1 02
				15 00 00 00 01 00 02 D2 ac
				15 00 00 00 01 00 02 D3 02
				15 00 00 00 01 00 02 D4 d3
				15 00 00 00 01 00 02 D5 03
				15 00 00 00 01 00 02 D6 0b
				15 00 00 00 01 00 02 D7 03
				15 00 00 00 01 00 02 D8 31
				15 00 00 00 01 00 02 D9 03
				15 00 00 00 01 00 02 DA 7e
				15 00 00 00 01 00 02 DB 03
				15 01 00 00 01 00 02 DC b0
				15 00 00 00 01 00 02 DD 03
				15 00 00 00 01 00 02 DE DB
				15 00 00 00 01 00 02 DF 03
				15 00 00 00 01 00 02 E0 E3
				15 00 00 00 01 00 02 E1 03
				15 00 00 00 01 00 02 E2 E7
				15 00 00 00 01 00 02 E3 03
				15 00 00 00 01 00 02 E4 ED
				15 00 00 00 01 00 02 E5 03
				15 00 00 00 01 00 02 E6 F0
				15 00 00 00 01 00 02 E7 03
				15 00 00 00 01 00 02 E8 F5
				15 00 00 00 01 00 02 E9 03
				15 00 00 00 01 00 02 EA FF
				15 01 00 00 01 00 02 FF 00
			];
		qcom,mdss-dsi-dispparam-papermode-command-state = "dsi_hs_mode";
		qcom,mdss-dsi-dispparam-papermode1-command = [
				15 01 00 00 01 00 02 FF 01
				15 00 00 00 01 00 02 FB 01
				15 00 00 00 01 00 02 75 00
				15 00 00 00 01 00 02 76 00
				15 00 00 00 01 00 02 77 00
				15 00 00 00 01 00 02 78 1F
				15 00 00 00 01 00 02 79 00
				15 00 00 00 01 00 02 7A 46
				15 00 00 00 01 00 02 7B 00
				15 00 00 00 01 00 02 7C 69
				15 00 00 00 01 00 02 7D 00
				15 00 00 00 01 00 02 7E 84
				15 00 00 00 01 00 02 7F 00
				15 00 00 00 01 00 02 80 9B
				15 00 00 00 01 00 02 81 00
				15 00 00 00 01 00 02 82 B0
				15 00 00 00 01 00 02 83 00
				15 00 00 00 01 00 02 84 C3
				15 00 00 00 01 00 02 85 00
				15 00 00 00 01 00 02 86 D3
				15 00 00 00 01 00 02 87 01
				15 00 00 00 01 00 02 88 09
				15 00 00 00 01 00 02 89 01
				15 00 00 00 01 00 02 8A 31
				15 00 00 00 01 00 02 8B 01
				15 00 00 00 01 00 02 8C 6D
				15 00 00 00 01 00 02 8D 01
				15 00 00 00 01 00 02 8E 99
				15 00 00 00 01 00 02 8F 01
				15 00 00 00 01 00 02 90 DB
				15 00 00 00 01 00 02 91 02
				15 00 00 00 01 00 02 92 0F
				15 00 00 00 01 00 02 93 02
				15 00 00 00 01 00 02 94 11
				15 00 00 00 01 00 02 95 02
				15 00 00 00 01 00 02 96 42
				15 00 00 00 01 00 02 97 02
				15 00 00 00 01 00 02 98 7D
				15 00 00 00 01 00 02 99 02
				15 01 00 00 01 00 02 9A A4
				15 00 00 00 01 00 02 9B 02
				15 00 00 00 01 00 02 9C D9
				15 00 00 00 01 00 02 9D 02
				15 00 00 00 01 00 02 9E FF
				15 00 00 00 01 00 02 9F 03
				15 00 00 00 01 00 02 A0 36
				15 00 00 00 01 00 02 A2 03
				15 00 00 00 01 00 02 A3 55
				15 00 00 00 01 00 02 A4 03
				15 00 00 00 01 00 02 A5 6D
				15 00 00 00 01 00 02 A6 03
				15 00 00 00 01 00 02 A7 89
				15 00 00 00 01 00 02 A9 03
				15 00 00 00 01 00 02 AA A3
				15 00 00 00 01 00 02 AB 03
				15 00 00 00 01 00 02 AC C9
				15 00 00 00 01 00 02 AD 03
				15 00 00 00 01 00 02 AE DD
				15 00 00 00 01 00 02 AF 03
				15 00 00 00 01 00 02 B0 F5
				15 00 00 00 01 00 02 B1 03
				15 00 00 00 01 00 02 B2 FF
				15 00 00 00 01 00 02 B3 00
				15 00 00 00 01 00 02 B4 00
				15 00 00 00 01 00 02 B5 00
				15 00 00 00 01 00 02 B6 1F
				15 00 00 00 01 00 02 B7 00
				15 00 00 00 01 00 02 B8 46
				15 00 00 00 01 00 02 B9 00
				15 00 00 00 01 00 02 BA 69
				15 00 00 00 01 00 02 BB 00
				15 00 00 00 01 00 02 BC 84
				15 00 00 00 01 00 02 BD 00
				15 00 00 00 01 00 02 BE 9B
				15 00 00 00 01 00 02 BF 00
				15 00 00 00 01 00 02 C0 B0
				15 00 00 00 01 00 02 C1 00
				15 00 00 00 01 00 02 C2 C3
				15 00 00 00 01 00 02 C3 00
				15 01 00 00 01 00 02 C4 D3
				15 00 00 00 01 00 02 C5 01
				15 00 00 00 01 00 02 C6 09
				15 00 00 00 01 00 02 C7 01
				15 00 00 00 01 00 02 C8 31
				15 00 00 00 01 00 02 C9 01
				15 00 00 00 01 00 02 CA 6D
				15 00 00 00 01 00 02 CB 01
				15 00 00 00 01 00 02 CC 9A
				15 00 00 00 01 00 02 CD 01
				15 00 00 00 01 00 02 CE DC
				15 00 00 00 01 00 02 CF 02
				15 00 00 00 01 00 02 D0 10
				15 00 00 00 01 00 02 D1 02
				15 00 00 00 01 00 02 D2 12
				15 00 00 00 01 00 02 D3 02
				15 00 00 00 01 00 02 D4 43
				15 00 00 00 01 00 02 D5 02
				15 00 00 00 01 00 02 D6 7D
				15 00 00 00 01 00 02 D7 02
				15 00 00 00 01 00 02 D8 A4
				15 00 00 00 01 00 02 D9 02
				15 00 00 00 01 00 02 DA D9
				15 00 00 00 01 00 02 DB 02
				15 00 00 00 01 00 02 DC FF
				15 00 00 00 01 00 02 DD 03
				15 00 00 00 01 00 02 DE 36
				15 00 00 00 01 00 02 DF 03
				15 00 00 00 01 00 02 E0 55
				15 00 00 00 01 00 02 E1 03
				15 00 00 00 01 00 02 E2 6D
				15 00 00 00 01 00 02 E3 03
				15 00 00 00 01 00 02 E4 89
				15 00 00 00 01 00 02 E5 03
				15 00 00 00 01 00 02 E6 A3
				15 00 00 00 01 00 02 E7 03
				15 00 00 00 01 00 02 E8 C9
				15 00 00 00 01 00 02 E9 03
				15 00 00 00 01 00 02 EA DD
				15 00 00 00 01 00 02 EB 03
				15 01 00 00 01 00 02 EC F5
				15 00 00 00 01 00 02 ED 03
				15 00 00 00 01 00 02 EE FF
				15 00 00 00 01 00 02 EF 00
				15 00 00 00 01 00 02 F0 66
				15 00 00 00 01 00 02 F1 00
				15 00 00 00 01 00 02 F2 75
				15 00 00 00 01 00 02 F3 00
				15 00 00 00 01 00 02 F4 90
				15 00 00 00 01 00 02 F5 00
				15 00 00 00 01 00 02 F6 A6
				15 00 00 00 01 00 02 F7 00
				15 00 00 00 01 00 02 F8 BA
				15 00 00 00 01 00 02 F9 00
				15 00 00 00 01 00 02 FA CB
				15 01 00 00 01 00 02 FF 02
				15 00 00 00 01 00 02 FB 01
				15 00 00 00 01 00 02 00 00
				15 00 00 00 01 00 02 01 DB
				15 00 00 00 01 00 02 02 00
				15 00 00 00 01 00 02 03 EA
				15 00 00 00 01 00 02 04 00
				15 00 00 00 01 00 02 05 F7
				15 00 00 00 01 00 02 06 01
				15 00 00 00 01 00 02 07 24
				15 00 00 00 01 00 02 08 01
				15 00 00 00 01 00 02 09 46
				15 00 00 00 01 00 02 0A 01
				15 00 00 00 01 00 02 0B 7C
				15 00 00 00 01 00 02 0C 01
				15 01 00 00 01 00 02 0D A5
				15 00 00 00 01 00 02 0E 01
				15 00 00 00 01 00 02 0F E3
				15 00 00 00 01 00 02 10 02
				15 00 00 00 01 00 02 11 15
				15 00 00 00 01 00 02 12 02
				15 00 00 00 01 00 02 13 17
				15 00 00 00 01 00 02 14 02
				15 00 00 00 01 00 02 15 47
				15 00 00 00 01 00 02 16 02
				15 00 00 00 01 00 02 17 81
				15 00 00 00 01 00 02 18 02
				15 00 00 00 01 00 02 19 A8
				15 00 00 00 01 00 02 1A 02
				15 00 00 00 01 00 02 1B DD
				15 00 00 00 01 00 02 1C 03
				15 00 00 00 01 00 02 1D 03
				15 00 00 00 01 00 02 1E 03
				15 00 00 00 01 00 02 1F 3B
				15 00 00 00 01 00 02 20 03
				15 00 00 00 01 00 02 21 52
				15 00 00 00 01 00 02 22 03
				15 00 00 00 01 00 02 23 6D
				15 00 00 00 01 00 02 24 03
				15 00 00 00 01 00 02 25 89
				15 00 00 00 01 00 02 26 03
				15 00 00 00 01 00 02 27 A3
				15 00 00 00 01 00 02 28 03
				15 00 00 00 01 00 02 29 C9
				15 00 00 00 01 00 02 2A 03
				15 00 00 00 01 00 02 2B DD
				15 00 00 00 01 00 02 2D 03
				15 00 00 00 01 00 02 2F F5
				15 00 00 00 01 00 02 30 03
				15 00 00 00 01 00 02 31 FF
				15 00 00 00 01 00 02 32 00
				15 00 00 00 01 00 02 33 66
				15 00 00 00 01 00 02 34 00
				15 00 00 00 01 00 02 35 75
				15 00 00 00 01 00 02 36 00
				15 01 00 00 01 00 02 37 90
				15 00 00 00 01 00 02 38 00
				15 00 00 00 01 00 02 39 A6
				15 00 00 00 01 00 02 3A 00
				15 00 00 00 01 00 02 3B BA
				15 00 00 00 01 00 02 3D 00
				15 00 00 00 01 00 02 3F CB
				15 00 00 00 01 00 02 40 00
				15 00 00 00 01 00 02 41 DB
				15 00 00 00 01 00 02 42 00
				15 00 00 00 01 00 02 43 EA
				15 00 00 00 01 00 02 44 00
				15 00 00 00 01 00 02 45 F7
				15 00 00 00 01 00 02 46 01
				15 00 00 00 01 00 02 47 24
				15 00 00 00 01 00 02 48 01
				15 00 00 00 01 00 02 49 46
				15 00 00 00 01 00 02 4A 01
				15 00 00 00 01 00 02 4B 7C
				15 00 00 00 01 00 02 4C 01
				15 00 00 00 01 00 02 4D A5
				15 00 00 00 01 00 02 4E 01
				15 00 00 00 01 00 02 4F E3
				15 00 00 00 01 00 02 50 02
				15 00 00 00 01 00 02 51 15
				15 00 00 00 01 00 02 52 02
				15 00 00 00 01 00 02 53 17
				15 00 00 00 01 00 02 54 02
				15 00 00 00 01 00 02 55 47
				15 00 00 00 01 00 02 56 02
				15 00 00 00 01 00 02 58 81
				15 00 00 00 01 00 02 59 02
				15 00 00 00 01 00 02 5A A8
				15 00 00 00 01 00 02 5B 02
				15 00 00 00 01 00 02 5C DD
				15 00 00 00 01 00 02 5D 03
				15 00 00 00 01 00 02 5E 03
				15 00 00 00 01 00 02 5F 03
				15 00 00 00 01 00 02 60 3B
				15 00 00 00 01 00 02 61 03
				15 01 00 00 01 00 02 62 52
				15 00 00 00 01 00 02 63 03
				15 00 00 00 01 00 02 64 6D
				15 00 00 00 01 00 02 65 03
				15 00 00 00 01 00 02 66 89
				15 00 00 00 01 00 02 67 03
				15 00 00 00 01 00 02 68 A3
				15 00 00 00 01 00 02 69 03
				15 00 00 00 01 00 02 6A C9
				15 00 00 00 01 00 02 6B 03
				15 00 00 00 01 00 02 6C DD
				15 00 00 00 01 00 02 6D 03
				15 00 00 00 01 00 02 6E F5
				15 00 00 00 01 00 02 6F 03
				15 00 00 00 01 00 02 70 FF
				15 00 00 00 01 00 02 71 01
				15 00 00 00 01 00 02 72 4F
				15 00 00 00 01 00 02 73 01
				15 00 00 00 01 00 02 74 52
				15 00 00 00 01 00 02 75 01
				15 00 00 00 01 00 02 76 58
				15 00 00 00 01 00 02 77 01
				15 00 00 00 01 00 02 78 5e
				15 00 00 00 01 00 02 79 01
				15 00 00 00 01 00 02 7A 64
				15 00 00 00 01 00 02 7B 01
				15 00 00 00 01 00 02 7C 6a
				15 00 00 00 01 00 02 7D 01
				15 00 00 00 01 00 02 7E 6f
				15 00 00 00 01 00 02 7F 01
				15 00 00 00 01 00 02 80 74
				15 00 00 00 01 00 02 81 01
				15 00 00 00 01 00 02 82 79
				15 00 00 00 01 00 02 83 01
				15 00 00 00 01 00 02 84 8C
				15 00 00 00 01 00 02 85 01
				15 00 00 00 01 00 02 86 9D
				15 00 00 00 01 00 02 87 01
				15 00 00 00 01 00 02 88 bb
				15 01 00 00 01 00 02 89 01
				15 00 00 00 01 00 02 8A d6
				15 00 00 00 01 00 02 8B 02
				15 00 00 00 01 00 02 8C 03
				15 00 00 00 01 00 02 8D 02
				15 00 00 00 01 00 02 8E 2d
				15 00 00 00 01 00 02 8F 02
				15 00 00 00 01 00 02 90 2f
				15 00 00 00 01 00 02 91 02
				15 00 00 00 01 00 02 92 5a
				15 00 00 00 01 00 02 93 02
				15 00 00 00 01 00 02 94 93
				15 00 00 00 01 00 02 95 02
				15 00 00 00 01 00 02 96 bb
				15 00 00 00 01 00 02 97 02
				15 00 00 00 01 00 02 98 f1
				15 00 00 00 01 00 02 99 03
				15 00 00 00 01 00 02 9A 1b
				15 00 00 00 01 00 02 9B 03
				15 00 00 00 01 00 02 9C 6a
				15 00 00 00 01 00 02 9D 03
				15 00 00 00 01 00 02 9E D6
				15 00 00 00 01 00 02 9F 03
				15 00 00 00 01 00 02 A0 DB
				15 00 00 00 01 00 02 A2 03
				15 00 00 00 01 00 02 A3 E3
				15 00 00 00 01 00 02 A4 03
				15 00 00 00 01 00 02 A5 E7
				15 00 00 00 01 00 02 A6 03
				15 00 00 00 01 00 02 A7 ED
				15 00 00 00 01 00 02 A9 03
				15 00 00 00 10 00 02 AA F0
				15 00 00 00 01 00 02 AB 03
				15 00 00 00 01 00 02 AC F5
				15 00 00 00 01 00 02 AD 03
				15 00 00 00 01 00 02 AE FF
				15 00 00 00 01 00 02 AF 01
				15 00 00 00 01 00 02 B0 4F
				15 00 00 00 01 00 02 B1 01
				15 00 00 00 01 00 02 B2 52
				15 00 00 00 01 00 02 B3 01
				15 01 00 00 01 00 02 B4 58
				15 00 00 00 01 00 02 B5 01
				15 00 00 00 01 00 02 B6 5e
				15 00 00 00 01 00 02 B7 01
				15 00 00 00 01 00 02 B8 64
				15 00 00 00 01 00 02 B9 01
				15 00 00 00 01 00 02 BA 6a
				15 00 00 00 01 00 02 BB 01
				15 00 00 00 01 00 02 BC 6f
				15 00 00 00 01 00 02 BD 01
				15 00 00 00 01 00 02 BE 74
				15 00 00 00 01 00 02 BF 01
				15 00 00 00 01 00 02 C0 79
				15 00 00 00 01 00 02 C1 01
				15 00 00 00 01 00 02 C2 8C
				15 00 00 00 01 00 02 C3 01
				15 00 00 00 01 00 02 C4 9D
				15 00 00 00 01 00 02 C5 01
				15 00 00 00 01 00 02 C6 bb
				15 00 00 00 01 00 02 C7 01
				15 00 00 00 01 00 02 C8 d6
				15 00 00 00 01 00 02 C9 02
				15 00 00 00 01 00 02 CA 03
				15 00 00 00 01 00 02 CB 02
				15 00 00 00 01 00 02 CC 2c
				15 00 00 00 01 00 02 CD 02
				15 00 00 00 01 00 02 CE 2e
				15 00 00 00 01 00 02 CF 02
				15 00 00 00 01 00 02 D0 5b
				15 00 00 00 01 00 02 D1 02
				15 00 00 00 01 00 02 D2 94
				15 00 00 00 01 00 02 D3 02
				15 00 00 00 01 00 02 D4 ba
				15 00 00 00 01 00 02 D5 02
				15 00 00 00 01 00 02 D6 f1
				15 00 00 00 01 00 02 D7 03
				15 00 00 00 01 00 02 D8 1b
				15 00 00 00 01 00 02 D9 03
				15 00 00 00 01 00 02 DA 6a
				15 00 00 00 01 00 02 DB 03
				15 01 00 00 01 00 02 DC D6
				15 00 00 00 01 00 02 DD 03
				15 00 00 00 01 00 02 DE DB
				15 00 00 00 01 00 02 DF 03
				15 00 00 00 01 00 02 E0 E3
				15 00 00 00 01 00 02 E1 03
				15 00 00 00 01 00 02 E2 E7
				15 00 00 00 01 00 02 E3 03
				15 00 00 00 01 00 02 E4 ED
				15 00 00 00 01 00 02 E5 03
				15 00 00 00 01 00 02 E6 F0
				15 00 00 00 01 00 02 E7 03
				15 00 00 00 01 00 02 E8 F5
				15 00 00 00 01 00 02 E9 03
				15 00 00 00 01 00 02 EA FF
				15 01 00 00 01 00 02 FF 00
			];
		qcom,mdss-dsi-dispparam-papermode1-command-state = "dsi_hs_mode";
		qcom,mdss-dsi-dispparam-papermode2-command = [
				15 01 00 00 01 00 02 FF 01
				15 00 00 00 01 00 02 FB 01
				15 00 00 00 01 00 02 75 00
				15 00 00 00 01 00 02 76 00
				15 00 00 00 01 00 02 77 00
				15 00 00 00 01 00 02 78 1F
				15 00 00 00 01 00 02 79 00
				15 00 00 00 01 00 02 7A 46
				15 00 00 00 01 00 02 7B 00
				15 00 00 00 01 00 02 7C 69
				15 00 00 00 01 00 02 7D 00
				15 00 00 00 01 00 02 7E 84
				15 00 00 00 01 00 02 7F 00
				15 00 00 00 01 00 02 80 9B
				15 00 00 00 01 00 02 81 00
				15 00 00 00 01 00 02 82 B0
				15 00 00 00 01 00 02 83 00
				15 00 00 00 01 00 02 84 C3
				15 00 00 00 01 00 02 85 00
				15 00 00 00 01 00 02 86 D3
				15 00 00 00 01 00 02 87 01
				15 00 00 00 01 00 02 88 09
				15 00 00 00 01 00 02 89 01
				15 00 00 00 01 00 02 8A 31
				15 00 00 00 01 00 02 8B 01
				15 00 00 00 01 00 02 8C 6D
				15 00 00 00 01 00 02 8D 01
				15 00 00 00 01 00 02 8E 99
				15 00 00 00 01 00 02 8F 01
				15 00 00 00 01 00 02 90 DB
				15 00 00 00 01 00 02 91 02
				15 00 00 00 01 00 02 92 0F
				15 00 00 00 01 00 02 93 02
				15 00 00 00 01 00 02 94 11
				15 00 00 00 01 00 02 95 02
				15 00 00 00 01 00 02 96 42
				15 00 00 00 01 00 02 97 02
				15 00 00 00 01 00 02 98 7D
				15 00 00 00 01 00 02 99 02
				15 01 00 00 01 00 02 9A A4
				15 00 00 00 01 00 02 9B 02
				15 00 00 00 01 00 02 9C D9
				15 00 00 00 01 00 02 9D 02
				15 00 00 00 01 00 02 9E FF
				15 00 00 00 01 00 02 9F 03
				15 00 00 00 01 00 02 A0 36
				15 00 00 00 01 00 02 A2 03
				15 00 00 00 01 00 02 A3 55
				15 00 00 00 01 00 02 A4 03
				15 00 00 00 01 00 02 A5 6D
				15 00 00 00 01 00 02 A6 03
				15 00 00 00 01 00 02 A7 89
				15 00 00 00 01 00 02 A9 03
				15 00 00 00 01 00 02 AA A3
				15 00 00 00 01 00 02 AB 03
				15 00 00 00 01 00 02 AC C9
				15 00 00 00 01 00 02 AD 03
				15 00 00 00 01 00 02 AE DD
				15 00 00 00 01 00 02 AF 03
				15 00 00 00 01 00 02 B0 F5
				15 00 00 00 01 00 02 B1 03
				15 00 00 00 01 00 02 B2 FF
				15 00 00 00 01 00 02 B3 00
				15 00 00 00 01 00 02 B4 00
				15 00 00 00 01 00 02 B5 00
				15 00 00 00 01 00 02 B6 1F
				15 00 00 00 01 00 02 B7 00
				15 00 00 00 01 00 02 B8 46
				15 00 00 00 01 00 02 B9 00
				15 00 00 00 01 00 02 BA 69
				15 00 00 00 01 00 02 BB 00
				15 00 00 00 01 00 02 BC 84
				15 00 00 00 01 00 02 BD 00
				15 00 00 00 01 00 02 BE 9B
				15 00 00 00 01 00 02 BF 00
				15 00 00 00 01 00 02 C0 B0
				15 00 00 00 01 00 02 C1 00
				15 00 00 00 01 00 02 C2 C3
				15 00 00 00 01 00 02 C3 00
				15 01 00 00 01 00 02 C4 D3
				15 00 00 00 01 00 02 C5 01
				15 00 00 00 01 00 02 C6 09
				15 00 00 00 01 00 02 C7 01
				15 00 00 00 01 00 02 C8 31
				15 00 00 00 01 00 02 C9 01
				15 00 00 00 01 00 02 CA 6D
				15 00 00 00 01 00 02 CB 01
				15 00 00 00 01 00 02 CC 9A
				15 00 00 00 01 00 02 CD 01
				15 00 00 00 01 00 02 CE DC
				15 00 00 00 01 00 02 CF 02
				15 00 00 00 01 00 02 D0 10
				15 00 00 00 01 00 02 D1 02
				15 00 00 00 01 00 02 D2 12
				15 00 00 00 01 00 02 D3 02
				15 00 00 00 01 00 02 D4 43
				15 00 00 00 01 00 02 D5 02
				15 00 00 00 01 00 02 D6 7D
				15 00 00 00 01 00 02 D7 02
				15 00 00 00 01 00 02 D8 A4
				15 00 00 00 01 00 02 D9 02
				15 00 00 00 01 00 02 DA D9
				15 00 00 00 01 00 02 DB 02
				15 00 00 00 01 00 02 DC FF
				15 00 00 00 01 00 02 DD 03
				15 00 00 00 01 00 02 DE 36
				15 00 00 00 01 00 02 DF 03
				15 00 00 00 01 00 02 E0 55
				15 00 00 00 01 00 02 E1 03
				15 00 00 00 01 00 02 E2 6D
				15 00 00 00 01 00 02 E3 03
				15 00 00 00 01 00 02 E4 89
				15 00 00 00 01 00 02 E5 03
				15 00 00 00 01 00 02 E6 A3
				15 00 00 00 01 00 02 E7 03
				15 00 00 00 01 00 02 E8 C9
				15 00 00 00 01 00 02 E9 03
				15 00 00 00 01 00 02 EA DD
				15 00 00 00 01 00 02 EB 03
				15 01 00 00 01 00 02 EC F5
				15 00 00 00 01 00 02 ED 03
				15 00 00 00 01 00 02 EE FF
				15 00 00 00 01 00 02 EF 00
				15 00 00 00 01 00 02 F0 66
				15 00 00 00 01 00 02 F1 00
				15 00 00 00 01 00 02 F2 75
				15 00 00 00 01 00 02 F3 00
				15 00 00 00 01 00 02 F4 90
				15 00 00 00 01 00 02 F5 00
				15 00 00 00 01 00 02 F6 A6
				15 00 00 00 01 00 02 F7 00
				15 00 00 00 01 00 02 F8 BA
				15 00 00 00 01 00 02 F9 00
				15 00 00 00 01 00 02 FA CB
				15 01 00 00 01 00 02 FF 02
				15 00 00 00 01 00 02 FB 01
				15 00 00 00 01 00 02 00 00
				15 00 00 00 01 00 02 01 DB
				15 00 00 00 01 00 02 02 00
				15 00 00 00 01 00 02 03 EA
				15 00 00 00 01 00 02 04 00
				15 00 00 00 01 00 02 05 F7
				15 00 00 00 01 00 02 06 01
				15 00 00 00 01 00 02 07 24
				15 00 00 00 01 00 02 08 01
				15 00 00 00 01 00 02 09 46
				15 00 00 00 01 00 02 0A 01
				15 00 00 00 01 00 02 0B 7C
				15 00 00 00 01 00 02 0C 01
				15 01 00 00 01 00 02 0D A5
				15 00 00 00 01 00 02 0E 01
				15 00 00 00 01 00 02 0F E3
				15 00 00 00 01 00 02 10 02
				15 00 00 00 01 00 02 11 15
				15 00 00 00 01 00 02 12 02
				15 00 00 00 01 00 02 13 17
				15 00 00 00 01 00 02 14 02
				15 00 00 00 01 00 02 15 47
				15 00 00 00 01 00 02 16 02
				15 00 00 00 01 00 02 17 81
				15 00 00 00 01 00 02 18 02
				15 00 00 00 01 00 02 19 A8
				15 00 00 00 01 00 02 1A 02
				15 00 00 00 01 00 02 1B DD
				15 00 00 00 01 00 02 1C 03
				15 00 00 00 01 00 02 1D 03
				15 00 00 00 01 00 02 1E 03
				15 00 00 00 01 00 02 1F 3B
				15 00 00 00 01 00 02 20 03
				15 00 00 00 01 00 02 21 52
				15 00 00 00 01 00 02 22 03
				15 00 00 00 01 00 02 23 6D
				15 00 00 00 01 00 02 24 03
				15 00 00 00 01 00 02 25 89
				15 00 00 00 01 00 02 26 03
				15 00 00 00 01 00 02 27 A3
				15 00 00 00 01 00 02 28 03
				15 00 00 00 01 00 02 29 C9
				15 00 00 00 01 00 02 2A 03
				15 00 00 00 01 00 02 2B DD
				15 00 00 00 01 00 02 2D 03
				15 00 00 00 01 00 02 2F F5
				15 00 00 00 01 00 02 30 03
				15 00 00 00 01 00 02 31 FF
				15 00 00 00 01 00 02 32 00
				15 00 00 00 01 00 02 33 66
				15 00 00 00 01 00 02 34 00
				15 00 00 00 01 00 02 35 75
				15 00 00 00 01 00 02 36 00
				15 01 00 00 01 00 02 37 90
				15 00 00 00 01 00 02 38 00
				15 00 00 00 01 00 02 39 A6
				15 00 00 00 01 00 02 3A 00
				15 00 00 00 01 00 02 3B BA
				15 00 00 00 01 00 02 3D 00
				15 00 00 00 01 00 02 3F CB
				15 00 00 00 01 00 02 40 00
				15 00 00 00 01 00 02 41 DB
				15 00 00 00 01 00 02 42 00
				15 00 00 00 01 00 02 43 EA
				15 00 00 00 01 00 02 44 00
				15 00 00 00 01 00 02 45 F7
				15 00 00 00 01 00 02 46 01
				15 00 00 00 01 00 02 47 24
				15 00 00 00 01 00 02 48 01
				15 00 00 00 01 00 02 49 46
				15 00 00 00 01 00 02 4A 01
				15 00 00 00 01 00 02 4B 7C
				15 00 00 00 01 00 02 4C 01
				15 00 00 00 01 00 02 4D A5
				15 00 00 00 01 00 02 4E 01
				15 00 00 00 01 00 02 4F E3
				15 00 00 00 01 00 02 50 02
				15 00 00 00 01 00 02 51 15
				15 00 00 00 01 00 02 52 02
				15 00 00 00 01 00 02 53 17
				15 00 00 00 01 00 02 54 02
				15 00 00 00 01 00 02 55 47
				15 00 00 00 01 00 02 56 02
				15 00 00 00 01 00 02 58 81
				15 00 00 00 01 00 02 59 02
				15 00 00 00 01 00 02 5A A8
				15 00 00 00 01 00 02 5B 02
				15 00 00 00 01 00 02 5C DD
				15 00 00 00 01 00 02 5D 03
				15 00 00 00 01 00 02 5E 03
				15 00 00 00 01 00 02 5F 03
				15 00 00 00 01 00 02 60 3B
				15 00 00 00 01 00 02 61 03
				15 01 00 00 01 00 02 62 52
				15 00 00 00 01 00 02 63 03
				15 00 00 00 01 00 02 64 6D
				15 00 00 00 01 00 02 65 03
				15 00 00 00 01 00 02 66 89
				15 00 00 00 01 00 02 67 03
				15 00 00 00 01 00 02 68 A3
				15 00 00 00 01 00 02 69 03
				15 00 00 00 01 00 02 6A C9
				15 00 00 00 01 00 02 6B 03
				15 00 00 00 01 00 02 6C DD
				15 00 00 00 01 00 02 6D 03
				15 00 00 00 01 00 02 6E F5
				15 00 00 00 01 00 02 6F 03
				15 00 00 00 01 00 02 70 FF
				15 00 00 00 01 00 02 71 01
				15 00 00 00 01 00 02 72 4F
				15 00 00 00 01 00 02 73 01
				15 00 00 00 01 00 02 74 52
				15 00 00 00 01 00 02 75 01
				15 00 00 00 01 00 02 76 58
				15 00 00 00 01 00 02 77 01
				15 00 00 00 01 00 02 78 5e
				15 00 00 00 01 00 02 79 01
				15 00 00 00 01 00 02 7A 64
				15 00 00 00 01 00 02 7B 01
				15 00 00 00 01 00 02 7C 6a
				15 00 00 00 01 00 02 7D 01
				15 00 00 00 01 00 02 7E 6f
				15 00 00 00 01 00 02 7F 01
				15 00 00 00 01 00 02 80 74
				15 00 00 00 01 00 02 81 01
				15 00 00 00 01 00 02 82 79
				15 00 00 00 01 00 02 83 01
				15 00 00 00 01 00 02 84 8C
				15 00 00 00 01 00 02 85 01
				15 00 00 00 01 00 02 86 9D
				15 00 00 00 01 00 02 87 01
				15 00 00 00 01 00 02 88 bb
				15 01 00 00 01 00 02 89 01
				15 00 00 00 01 00 02 8A d6
				15 00 00 00 01 00 02 8B 02
				15 00 00 00 01 00 02 8C 03
				15 00 00 00 01 00 02 8D 02
				15 00 00 00 01 00 02 8E 2d
				15 00 00 00 01 00 02 8F 02
				15 00 00 00 01 00 02 90 2f
				15 00 00 00 01 00 02 91 02
				15 00 00 00 01 00 02 92 5a
				15 00 00 00 01 00 02 93 02
				15 00 00 00 01 00 02 94 93
				15 00 00 00 01 00 02 95 02
				15 00 00 00 01 00 02 96 bb
				15 00 00 00 01 00 02 97 02
				15 00 00 00 01 00 02 98 f1
				15 00 00 00 01 00 02 99 03
				15 00 00 00 01 00 02 9A 1b
				15 00 00 00 01 00 02 9B 03
				15 00 00 00 01 00 02 9C 6a
				15 00 00 00 01 00 02 9D 03
				15 00 00 00 01 00 02 9E D6
				15 00 00 00 01 00 02 9F 03
				15 00 00 00 01 00 02 A0 DB
				15 00 00 00 01 00 02 A2 03
				15 00 00 00 01 00 02 A3 E3
				15 00 00 00 01 00 02 A4 03
				15 00 00 00 01 00 02 A5 E7
				15 00 00 00 01 00 02 A6 03
				15 00 00 00 01 00 02 A7 ED
				15 00 00 00 01 00 02 A9 03
				15 00 00 00 10 00 02 AA F0
				15 00 00 00 01 00 02 AB 03
				15 00 00 00 01 00 02 AC F5
				15 00 00 00 01 00 02 AD 03
				15 00 00 00 01 00 02 AE FF
				15 00 00 00 01 00 02 AF 01
				15 00 00 00 01 00 02 B0 4F
				15 00 00 00 01 00 02 B1 01
				15 00 00 00 01 00 02 B2 52
				15 00 00 00 01 00 02 B3 01
				15 01 00 00 01 00 02 B4 58
				15 00 00 00 01 00 02 B5 01
				15 00 00 00 01 00 02 B6 5e
				15 00 00 00 01 00 02 B7 01
				15 00 00 00 01 00 02 B8 64
				15 00 00 00 01 00 02 B9 01
				15 00 00 00 01 00 02 BA 6a
				15 00 00 00 01 00 02 BB 01
				15 00 00 00 01 00 02 BC 6f
				15 00 00 00 01 00 02 BD 01
				15 00 00 00 01 00 02 BE 74
				15 00 00 00 01 00 02 BF 01
				15 00 00 00 01 00 02 C0 79
				15 00 00 00 01 00 02 C1 01
				15 00 00 00 01 00 02 C2 8C
				15 00 00 00 01 00 02 C3 01
				15 00 00 00 01 00 02 C4 9D
				15 00 00 00 01 00 02 C5 01
				15 00 00 00 01 00 02 C6 bb
				15 00 00 00 01 00 02 C7 01
				15 00 00 00 01 00 02 C8 d6
				15 00 00 00 01 00 02 C9 02
				15 00 00 00 01 00 02 CA 03
				15 00 00 00 01 00 02 CB 02
				15 00 00 00 01 00 02 CC 2c
				15 00 00 00 01 00 02 CD 02
				15 00 00 00 01 00 02 CE 2e
				15 00 00 00 01 00 02 CF 02
				15 00 00 00 01 00 02 D0 5b
				15 00 00 00 01 00 02 D1 02
				15 00 00 00 01 00 02 D2 94
				15 00 00 00 01 00 02 D3 02
				15 00 00 00 01 00 02 D4 ba
				15 00 00 00 01 00 02 D5 02
				15 00 00 00 01 00 02 D6 f1
				15 00 00 00 01 00 02 D7 03
				15 00 00 00 01 00 02 D8 1b
				15 00 00 00 01 00 02 D9 03
				15 00 00 00 01 00 02 DA 6a
				15 00 00 00 01 00 02 DB 03
				15 01 00 00 01 00 02 DC D6
				15 00 00 00 01 00 02 DD 03
				15 00 00 00 01 00 02 DE DB
				15 00 00 00 01 00 02 DF 03
				15 00 00 00 01 00 02 E0 E3
				15 00 00 00 01 00 02 E1 03
				15 00 00 00 01 00 02 E2 E7
				15 00 00 00 01 00 02 E3 03
				15 00 00 00 01 00 02 E4 ED
				15 00 00 00 01 00 02 E5 03
				15 00 00 00 01 00 02 E6 F0
				15 00 00 00 01 00 02 E7 03
				15 00 00 00 01 00 02 E8 F5
				15 00 00 00 01 00 02 E9 03
				15 00 00 00 01 00 02 EA FF
				15 01 00 00 01 00 02 FF 00
			];
		qcom,mdss-dsi-dispparam-papermode2-command-state = "dsi_hs_mode";
		qcom,mdss-dsi-dispparam-papermode3-command = [
				15 01 00 00 01 00 02 FF 01
				15 00 00 00 01 00 02 FB 01
				15 00 00 00 01 00 02 75 00
				15 00 00 00 01 00 02 76 00
				15 00 00 00 01 00 02 77 00
				15 00 00 00 01 00 02 78 1F
				15 00 00 00 01 00 02 79 00
				15 00 00 00 01 00 02 7A 46
				15 00 00 00 01 00 02 7B 00
				15 00 00 00 01 00 02 7C 69
				15 00 00 00 01 00 02 7D 00
				15 00 00 00 01 00 02 7E 84
				15 00 00 00 01 00 02 7F 00
				15 00 00 00 01 00 02 80 9B
				15 00 00 00 01 00 02 81 00
				15 00 00 00 01 00 02 82 B0
				15 00 00 00 01 00 02 83 00
				15 00 00 00 01 00 02 84 C3
				15 00 00 00 01 00 02 85 00
				15 00 00 00 01 00 02 86 D3
				15 00 00 00 01 00 02 87 01
				15 00 00 00 01 00 02 88 09
				15 00 00 00 01 00 02 89 01
				15 00 00 00 01 00 02 8A 31
				15 00 00 00 01 00 02 8B 01
				15 00 00 00 01 00 02 8C 6D
				15 00 00 00 01 00 02 8D 01
				15 00 00 00 01 00 02 8E 99
				15 00 00 00 01 00 02 8F 01
				15 00 00 00 01 00 02 90 DB
				15 00 00 00 01 00 02 91 02
				15 00 00 00 01 00 02 92 0F
				15 00 00 00 01 00 02 93 02
				15 00 00 00 01 00 02 94 11
				15 00 00 00 01 00 02 95 02
				15 00 00 00 01 00 02 96 42
				15 00 00 00 01 00 02 97 02
				15 00 00 00 01 00 02 98 7D
				15 00 00 00 01 00 02 99 02
				15 01 00 00 01 00 02 9A A4
				15 00 00 00 01 00 02 9B 02
				15 00 00 00 01 00 02 9C D9
				15 00 00 00 01 00 02 9D 02
				15 00 00 00 01 00 02 9E FF
				15 00 00 00 01 00 02 9F 03
				15 00 00 00 01 00 02 A0 36
				15 00 00 00 01 00 02 A2 03
				15 00 00 00 01 00 02 A3 55
				15 00 00 00 01 00 02 A4 03
				15 00 00 00 01 00 02 A5 6D
				15 00 00 00 01 00 02 A6 03
				15 00 00 00 01 00 02 A7 89
				15 00 00 00 01 00 02 A9 03
				15 00 00 00 01 00 02 AA A3
				15 00 00 00 01 00 02 AB 03
				15 00 00 00 01 00 02 AC C9
				15 00 00 00 01 00 02 AD 03
				15 00 00 00 01 00 02 AE DD
				15 00 00 00 01 00 02 AF 03
				15 00 00 00 01 00 02 B0 F5
				15 00 00 00 01 00 02 B1 03
				15 00 00 00 01 00 02 B2 FF
				15 00 00 00 01 00 02 B3 00
				15 00 00 00 01 00 02 B4 00
				15 00 00 00 01 00 02 B5 00
				15 00 00 00 01 00 02 B6 1F
				15 00 00 00 01 00 02 B7 00
				15 00 00 00 01 00 02 B8 46
				15 00 00 00 01 00 02 B9 00
				15 00 00 00 01 00 02 BA 69
				15 00 00 00 01 00 02 BB 00
				15 00 00 00 01 00 02 BC 84
				15 00 00 00 01 00 02 BD 00
				15 00 00 00 01 00 02 BE 9B
				15 00 00 00 01 00 02 BF 00
				15 00 00 00 01 00 02 C0 B0
				15 00 00 00 01 00 02 C1 00
				15 00 00 00 01 00 02 C2 C3
				15 00 00 00 01 00 02 C3 00
				15 01 00 00 01 00 02 C4 D3
				15 00 00 00 01 00 02 C5 01
				15 00 00 00 01 00 02 C6 09
				15 00 00 00 01 00 02 C7 01
				15 00 00 00 01 00 02 C8 31
				15 00 00 00 01 00 02 C9 01
				15 00 00 00 01 00 02 CA 6D
				15 00 00 00 01 00 02 CB 01
				15 00 00 00 01 00 02 CC 9A
				15 00 00 00 01 00 02 CD 01
				15 00 00 00 01 00 02 CE DC
				15 00 00 00 01 00 02 CF 02
				15 00 00 00 01 00 02 D0 10
				15 00 00 00 01 00 02 D1 02
				15 00 00 00 01 00 02 D2 12
				15 00 00 00 01 00 02 D3 02
				15 00 00 00 01 00 02 D4 43
				15 00 00 00 01 00 02 D5 02
				15 00 00 00 01 00 02 D6 7D
				15 00 00 00 01 00 02 D7 02
				15 00 00 00 01 00 02 D8 A4
				15 00 00 00 01 00 02 D9 02
				15 00 00 00 01 00 02 DA D9
				15 00 00 00 01 00 02 DB 02
				15 00 00 00 01 00 02 DC FF
				15 00 00 00 01 00 02 DD 03
				15 00 00 00 01 00 02 DE 36
				15 00 00 00 01 00 02 DF 03
				15 00 00 00 01 00 02 E0 55
				15 00 00 00 01 00 02 E1 03
				15 00 00 00 01 00 02 E2 6D
				15 00 00 00 01 00 02 E3 03
				15 00 00 00 01 00 02 E4 89
				15 00 00 00 01 00 02 E5 03
				15 00 00 00 01 00 02 E6 A3
				15 00 00 00 01 00 02 E7 03
				15 00 00 00 01 00 02 E8 C9
				15 00 00 00 01 00 02 E9 03
				15 00 00 00 01 00 02 EA DD
				15 00 00 00 01 00 02 EB 03
				15 01 00 00 01 00 02 EC F5
				15 00 00 00 01 00 02 ED 03
				15 00 00 00 01 00 02 EE FF
				15 00 00 00 01 00 02 EF 00
				15 00 00 00 01 00 02 F0 66
				15 00 00 00 01 00 02 F1 00
				15 00 00 00 01 00 02 F2 75
				15 00 00 00 01 00 02 F3 00
				15 00 00 00 01 00 02 F4 90
				15 00 00 00 01 00 02 F5 00
				15 00 00 00 01 00 02 F6 A6
				15 00 00 00 01 00 02 F7 00
				15 00 00 00 01 00 02 F8 BA
				15 00 00 00 01 00 02 F9 00
				15 00 00 00 01 00 02 FA CB
				15 01 00 00 01 00 02 FF 02
				15 00 00 00 01 00 02 FB 01
				15 00 00 00 01 00 02 00 00
				15 00 00 00 01 00 02 01 DB
				15 00 00 00 01 00 02 02 00
				15 00 00 00 01 00 02 03 EA
				15 00 00 00 01 00 02 04 00
				15 00 00 00 01 00 02 05 F7
				15 00 00 00 01 00 02 06 01
				15 00 00 00 01 00 02 07 24
				15 00 00 00 01 00 02 08 01
				15 00 00 00 01 00 02 09 46
				15 00 00 00 01 00 02 0A 01
				15 00 00 00 01 00 02 0B 7C
				15 00 00 00 01 00 02 0C 01
				15 01 00 00 01 00 02 0D A5
				15 00 00 00 01 00 02 0E 01
				15 00 00 00 01 00 02 0F E3
				15 00 00 00 01 00 02 10 02
				15 00 00 00 01 00 02 11 15
				15 00 00 00 01 00 02 12 02
				15 00 00 00 01 00 02 13 17
				15 00 00 00 01 00 02 14 02
				15 00 00 00 01 00 02 15 47
				15 00 00 00 01 00 02 16 02
				15 00 00 00 01 00 02 17 81
				15 00 00 00 01 00 02 18 02
				15 00 00 00 01 00 02 19 A8
				15 00 00 00 01 00 02 1A 02
				15 00 00 00 01 00 02 1B DD
				15 00 00 00 01 00 02 1C 03
				15 00 00 00 01 00 02 1D 03
				15 00 00 00 01 00 02 1E 03
				15 00 00 00 01 00 02 1F 3B
				15 00 00 00 01 00 02 20 03
				15 00 00 00 01 00 02 21 52
				15 00 00 00 01 00 02 22 03
				15 00 00 00 01 00 02 23 6D
				15 00 00 00 01 00 02 24 03
				15 00 00 00 01 00 02 25 89
				15 00 00 00 01 00 02 26 03
				15 00 00 00 01 00 02 27 A3
				15 00 00 00 01 00 02 28 03
				15 00 00 00 01 00 02 29 C9
				15 00 00 00 01 00 02 2A 03
				15 00 00 00 01 00 02 2B DD
				15 00 00 00 01 00 02 2D 03
				15 00 00 00 01 00 02 2F F5
				15 00 00 00 01 00 02 30 03
				15 00 00 00 01 00 02 31 FF
				15 00 00 00 01 00 02 32 00
				15 00 00 00 01 00 02 33 66
				15 00 00 00 01 00 02 34 00
				15 00 00 00 01 00 02 35 75
				15 00 00 00 01 00 02 36 00
				15 01 00 00 01 00 02 37 90
				15 00 00 00 01 00 02 38 00
				15 00 00 00 01 00 02 39 A6
				15 00 00 00 01 00 02 3A 00
				15 00 00 00 01 00 02 3B BA
				15 00 00 00 01 00 02 3D 00
				15 00 00 00 01 00 02 3F CB
				15 00 00 00 01 00 02 40 00
				15 00 00 00 01 00 02 41 DB
				15 00 00 00 01 00 02 42 00
				15 00 00 00 01 00 02 43 EA
				15 00 00 00 01 00 02 44 00
				15 00 00 00 01 00 02 45 F7
				15 00 00 00 01 00 02 46 01
				15 00 00 00 01 00 02 47 24
				15 00 00 00 01 00 02 48 01
				15 00 00 00 01 00 02 49 46
				15 00 00 00 01 00 02 4A 01
				15 00 00 00 01 00 02 4B 7C
				15 00 00 00 01 00 02 4C 01
				15 00 00 00 01 00 02 4D A5
				15 00 00 00 01 00 02 4E 01
				15 00 00 00 01 00 02 4F E3
				15 00 00 00 01 00 02 50 02
				15 00 00 00 01 00 02 51 15
				15 00 00 00 01 00 02 52 02
				15 00 00 00 01 00 02 53 17
				15 00 00 00 01 00 02 54 02
				15 00 00 00 01 00 02 55 47
				15 00 00 00 01 00 02 56 02
				15 00 00 00 01 00 02 58 81
				15 00 00 00 01 00 02 59 02
				15 00 00 00 01 00 02 5A A8
				15 00 00 00 01 00 02 5B 02
				15 00 00 00 01 00 02 5C DD
				15 00 00 00 01 00 02 5D 03
				15 00 00 00 01 00 02 5E 03
				15 00 00 00 01 00 02 5F 03
				15 00 00 00 01 00 02 60 3B
				15 00 00 00 01 00 02 61 03
				15 01 00 00 01 00 02 62 52
				15 00 00 00 01 00 02 63 03
				15 00 00 00 01 00 02 64 6D
				15 00 00 00 01 00 02 65 03
				15 00 00 00 01 00 02 66 89
				15 00 00 00 01 00 02 67 03
				15 00 00 00 01 00 02 68 A3
				15 00 00 00 01 00 02 69 03
				15 00 00 00 01 00 02 6A C9
				15 00 00 00 01 00 02 6B 03
				15 00 00 00 01 00 02 6C DD
				15 00 00 00 01 00 02 6D 03
				15 00 00 00 01 00 02 6E F5
				15 00 00 00 01 00 02 6F 03
				15 00 00 00 01 00 02 70 FF
				15 00 00 00 01 00 02 71 01
				15 00 00 00 01 00 02 72 77
				15 00 00 00 01 00 02 73 01
				15 00 00 00 01 00 02 74 79
				15 00 00 00 01 00 02 75 01
				15 00 00 00 01 00 02 76 7e
				15 00 00 00 01 00 02 77 01
				15 00 00 00 01 00 02 78 82
				15 00 00 00 01 00 02 79 01
				15 00 00 00 01 00 02 7A 87
				15 00 00 00 01 00 02 7B 01
				15 00 00 00 01 00 02 7C 8b
				15 00 00 00 01 00 02 7D 01
				15 00 00 00 01 00 02 7E 8f
				15 00 00 00 01 00 02 7F 01
				15 00 00 00 01 00 02 80 94
				15 00 00 00 01 00 02 81 01
				15 00 00 00 01 00 02 82 98
				15 00 00 00 01 00 02 83 01
				15 00 00 00 01 00 02 84 a7
				15 00 00 00 01 00 02 85 01
				15 00 00 00 01 00 02 86 b5
				15 00 00 00 01 00 02 87 01
				15 00 00 00 01 00 02 88 cf
				15 01 00 00 01 00 02 89 01
				15 00 00 00 01 00 02 8A e6
				15 00 00 00 01 00 02 8B 02
				15 00 00 00 01 00 02 8C 0e
				15 00 00 00 01 00 02 8D 02
				15 00 00 00 01 00 02 8E 36
				15 00 00 00 01 00 02 8F 02
				15 00 00 00 01 00 02 90 37
				15 00 00 00 01 00 02 91 02
				15 00 00 00 01 00 02 92 62
				15 00 00 00 01 00 02 93 02
				15 00 00 00 01 00 02 94 9b
				15 00 00 00 01 00 02 95 02
				15 00 00 00 01 00 02 96 c2
				15 00 00 00 01 00 02 97 02
				15 00 00 00 01 00 02 98 f9
				15 00 00 00 01 00 02 99 03
				15 00 00 00 01 00 02 9A 24
				15 00 00 00 01 00 02 9B 03
				15 00 00 00 01 00 02 9C 7e
				15 00 00 00 01 00 02 9D 03
				15 00 00 00 01 00 02 9E b0
				15 00 00 00 01 00 02 9F 03
				15 00 00 00 01 00 02 A0 DB
				15 00 00 00 01 00 02 A2 03
				15 00 00 00 01 00 02 A3 E3
				15 00 00 00 01 00 02 A4 03
				15 00 00 00 01 00 02 A5 E7
				15 00 00 00 01 00 02 A6 03
				15 00 00 00 01 00 02 A7 ED
				15 00 00 00 01 00 02 A9 03
				15 00 00 00 10 00 02 AA F0
				15 00 00 00 01 00 02 AB 03
				15 00 00 00 01 00 02 AC F5
				15 00 00 00 01 00 02 AD 03
				15 00 00 00 01 00 02 AE FF
				15 00 00 00 01 00 02 AF 01
				15 00 00 00 01 00 02 B0 77
				15 00 00 00 01 00 02 B1 01
				15 00 00 00 01 00 02 B2 79
				15 00 00 00 01 00 02 B3 01
				15 01 00 00 01 00 02 B4 7e
				15 00 00 00 01 00 02 B5 01
				15 00 00 00 01 00 02 B6 83
				15 00 00 00 01 00 02 B7 01
				15 00 00 00 01 00 02 B8 87
				15 00 00 00 01 00 02 B9 01
				15 00 00 00 01 00 02 BA 8b
				15 00 00 00 01 00 02 BB 01
				15 00 00 00 01 00 02 BC 8f
				15 00 00 00 01 00 02 BD 01
				15 00 00 00 01 00 02 BE 94
				15 00 00 00 01 00 02 BF 01
				15 00 00 00 01 00 02 C0 98
				15 00 00 00 01 00 02 C1 01
				15 00 00 00 01 00 02 C2 a7
				15 00 00 00 01 00 02 C3 01
				15 00 00 00 01 00 02 C4 b5
				15 00 00 00 01 00 02 C5 01
				15 00 00 00 01 00 02 C6 cf
				15 00 00 00 01 00 02 C7 01
				15 00 00 00 01 00 02 C8 e6
				15 00 00 00 01 00 02 C9 02
				15 00 00 00 01 00 02 CA 0e
				15 00 00 00 01 00 02 CB 02
				15 00 00 00 01 00 02 CC 36
				15 00 00 00 01 00 02 CD 02
				15 00 00 00 01 00 02 CE 38
				15 00 00 00 01 00 02 CF 02
				15 00 00 00 01 00 02 D0 62
				15 00 00 00 01 00 02 D1 02
				15 00 00 00 01 00 02 D2 9b
				15 00 00 00 01 00 02 D3 02
				15 00 00 00 01 00 02 D4 c2
				15 00 00 00 01 00 02 D5 02
				15 00 00 00 01 00 02 D6 f9
				15 00 00 00 01 00 02 D7 03
				15 00 00 00 01 00 02 D8 24
				15 00 00 00 01 00 02 D9 03
				15 00 00 00 01 00 02 DA 7e
				15 00 00 00 01 00 02 DB 03
				15 01 00 00 01 00 02 DC b0
				15 00 00 00 01 00 02 DD 03
				15 00 00 00 01 00 02 DE DB
				15 00 00 00 01 00 02 DF 03
				15 00 00 00 01 00 02 E0 E3
				15 00 00 00 01 00 02 E1 03
				15 00 00 00 01 00 02 E2 E7
				15 00 00 00 01 00 02 E3 03
				15 00 00 00 01 00 02 E4 ED
				15 00 00 00 01 00 02 E5 03
				15 00 00 00 01 00 02 E6 F0
				15 00 00 00 01 00 02 E7 03
				15 00 00 00 01 00 02 E8 F5
				15 00 00 00 01 00 02 E9 03
				15 00 00 00 01 00 02 EA FF
				15 01 00 00 01 00 02 FF 00
			];
		qcom,mdss-dsi-dispparam-papermode3-command-state = "dsi_hs_mode";
		qcom,mdss-dsi-dispparam-papermode4-command = [
				15 01 00 00 01 00 02 FF 01
				15 00 00 00 01 00 02 FB 01
				15 00 00 00 01 00 02 75 00
				15 00 00 00 01 00 02 76 00
				15 00 00 00 01 00 02 77 00
				15 00 00 00 01 00 02 78 1F
				15 00 00 00 01 00 02 79 00
				15 00 00 00 01 00 02 7A 46
				15 00 00 00 01 00 02 7B 00
				15 00 00 00 01 00 02 7C 69
				15 00 00 00 01 00 02 7D 00
				15 00 00 00 01 00 02 7E 84
				15 00 00 00 01 00 02 7F 00
				15 00 00 00 01 00 02 80 9B
				15 00 00 00 01 00 02 81 00
				15 00 00 00 01 00 02 82 B0
				15 00 00 00 01 00 02 83 00
				15 00 00 00 01 00 02 84 C3
				15 00 00 00 01 00 02 85 00
				15 00 00 00 01 00 02 86 D3
				15 00 00 00 01 00 02 87 01
				15 00 00 00 01 00 02 88 09
				15 00 00 00 01 00 02 89 01
				15 00 00 00 01 00 02 8A 31
				15 00 00 00 01 00 02 8B 01
				15 00 00 00 01 00 02 8C 6D
				15 00 00 00 01 00 02 8D 01
				15 00 00 00 01 00 02 8E 99
				15 00 00 00 01 00 02 8F 01
				15 00 00 00 01 00 02 90 DB
				15 00 00 00 01 00 02 91 02
				15 00 00 00 01 00 02 92 0F
				15 00 00 00 01 00 02 93 02
				15 00 00 00 01 00 02 94 11
				15 00 00 00 01 00 02 95 02
				15 00 00 00 01 00 02 96 42
				15 00 00 00 01 00 02 97 02
				15 00 00 00 01 00 02 98 7D
				15 00 00 00 01 00 02 99 02
				15 01 00 00 01 00 02 9A A4
				15 00 00 00 01 00 02 9B 02
				15 00 00 00 01 00 02 9C D9
				15 00 00 00 01 00 02 9D 02
				15 00 00 00 01 00 02 9E FF
				15 00 00 00 01 00 02 9F 03
				15 00 00 00 01 00 02 A0 36
				15 00 00 00 01 00 02 A2 03
				15 00 00 00 01 00 02 A3 55
				15 00 00 00 01 00 02 A4 03
				15 00 00 00 01 00 02 A5 6D
				15 00 00 00 01 00 02 A6 03
				15 00 00 00 01 00 02 A7 89
				15 00 00 00 01 00 02 A9 03
				15 00 00 00 01 00 02 AA A3
				15 00 00 00 01 00 02 AB 03
				15 00 00 00 01 00 02 AC C9
				15 00 00 00 01 00 02 AD 03
				15 00 00 00 01 00 02 AE DD
				15 00 00 00 01 00 02 AF 03
				15 00 00 00 01 00 02 B0 F5
				15 00 00 00 01 00 02 B1 03
				15 00 00 00 01 00 02 B2 FF
				15 00 00 00 01 00 02 B3 00
				15 00 00 00 01 00 02 B4 00
				15 00 00 00 01 00 02 B5 00
				15 00 00 00 01 00 02 B6 1F
				15 00 00 00 01 00 02 B7 00
				15 00 00 00 01 00 02 B8 46
				15 00 00 00 01 00 02 B9 00
				15 00 00 00 01 00 02 BA 69
				15 00 00 00 01 00 02 BB 00
				15 00 00 00 01 00 02 BC 84
				15 00 00 00 01 00 02 BD 00
				15 00 00 00 01 00 02 BE 9B
				15 00 00 00 01 00 02 BF 00
				15 00 00 00 01 00 02 C0 B0
				15 00 00 00 01 00 02 C1 00
				15 00 00 00 01 00 02 C2 C3
				15 00 00 00 01 00 02 C3 00
				15 01 00 00 01 00 02 C4 D3
				15 00 00 00 01 00 02 C5 01
				15 00 00 00 01 00 02 C6 09
				15 00 00 00 01 00 02 C7 01
				15 00 00 00 01 00 02 C8 31
				15 00 00 00 01 00 02 C9 01
				15 00 00 00 01 00 02 CA 6D
				15 00 00 00 01 00 02 CB 01
				15 00 00 00 01 00 02 CC 9A
				15 00 00 00 01 00 02 CD 01
				15 00 00 00 01 00 02 CE DC
				15 00 00 00 01 00 02 CF 02
				15 00 00 00 01 00 02 D0 10
				15 00 00 00 01 00 02 D1 02
				15 00 00 00 01 00 02 D2 12
				15 00 00 00 01 00 02 D3 02
				15 00 00 00 01 00 02 D4 43
				15 00 00 00 01 00 02 D5 02
				15 00 00 00 01 00 02 D6 7D
				15 00 00 00 01 00 02 D7 02
				15 00 00 00 01 00 02 D8 A4
				15 00 00 00 01 00 02 D9 02
				15 00 00 00 01 00 02 DA D9
				15 00 00 00 01 00 02 DB 02
				15 00 00 00 01 00 02 DC FF
				15 00 00 00 01 00 02 DD 03
				15 00 00 00 01 00 02 DE 36
				15 00 00 00 01 00 02 DF 03
				15 00 00 00 01 00 02 E0 55
				15 00 00 00 01 00 02 E1 03
				15 00 00 00 01 00 02 E2 6D
				15 00 00 00 01 00 02 E3 03
				15 00 00 00 01 00 02 E4 89
				15 00 00 00 01 00 02 E5 03
				15 00 00 00 01 00 02 E6 A3
				15 00 00 00 01 00 02 E7 03
				15 00 00 00 01 00 02 E8 C9
				15 00 00 00 01 00 02 E9 03
				15 00 00 00 01 00 02 EA DD
				15 00 00 00 01 00 02 EB 03
				15 01 00 00 01 00 02 EC F5
				15 00 00 00 01 00 02 ED 03
				15 00 00 00 01 00 02 EE FF
				15 00 00 00 01 00 02 EF 00
				15 00 00 00 01 00 02 F0 66
				15 00 00 00 01 00 02 F1 00
				15 00 00 00 01 00 02 F2 75
				15 00 00 00 01 00 02 F3 00
				15 00 00 00 01 00 02 F4 90
				15 00 00 00 01 00 02 F5 00
				15 00 00 00 01 00 02 F6 A6
				15 00 00 00 01 00 02 F7 00
				15 00 00 00 01 00 02 F8 BA
				15 00 00 00 01 00 02 F9 00
				15 00 00 00 01 00 02 FA CB
				15 01 00 00 01 00 02 FF 02
				15 00 00 00 01 00 02 FB 01
				15 00 00 00 01 00 02 00 00
				15 00 00 00 01 00 02 01 DB
				15 00 00 00 01 00 02 02 00
				15 00 00 00 01 00 02 03 EA
				15 00 00 00 01 00 02 04 00
				15 00 00 00 01 00 02 05 F7
				15 00 00 00 01 00 02 06 01
				15 00 00 00 01 00 02 07 24
				15 00 00 00 01 00 02 08 01
				15 00 00 00 01 00 02 09 46
				15 00 00 00 01 00 02 0A 01
				15 00 00 00 01 00 02 0B 7C
				15 00 00 00 01 00 02 0C 01
				15 01 00 00 01 00 02 0D A5
				15 00 00 00 01 00 02 0E 01
				15 00 00 00 01 00 02 0F E3
				15 00 00 00 01 00 02 10 02
				15 00 00 00 01 00 02 11 15
				15 00 00 00 01 00 02 12 02
				15 00 00 00 01 00 02 13 17
				15 00 00 00 01 00 02 14 02
				15 00 00 00 01 00 02 15 47
				15 00 00 00 01 00 02 16 02
				15 00 00 00 01 00 02 17 81
				15 00 00 00 01 00 02 18 02
				15 00 00 00 01 00 02 19 A8
				15 00 00 00 01 00 02 1A 02
				15 00 00 00 01 00 02 1B DD
				15 00 00 00 01 00 02 1C 03
				15 00 00 00 01 00 02 1D 03
				15 00 00 00 01 00 02 1E 03
				15 00 00 00 01 00 02 1F 3B
				15 00 00 00 01 00 02 20 03
				15 00 00 00 01 00 02 21 52
				15 00 00 00 01 00 02 22 03
				15 00 00 00 01 00 02 23 6D
				15 00 00 00 01 00 02 24 03
				15 00 00 00 01 00 02 25 89
				15 00 00 00 01 00 02 26 03
				15 00 00 00 01 00 02 27 A3
				15 00 00 00 01 00 02 28 03
				15 00 00 00 01 00 02 29 C9
				15 00 00 00 01 00 02 2A 03
				15 00 00 00 01 00 02 2B DD
				15 00 00 00 01 00 02 2D 03
				15 00 00 00 01 00 02 2F F5
				15 00 00 00 01 00 02 30 03
				15 00 00 00 01 00 02 31 FF
				15 00 00 00 01 00 02 32 00
				15 00 00 00 01 00 02 33 66
				15 00 00 00 01 00 02 34 00
				15 00 00 00 01 00 02 35 75
				15 00 00 00 01 00 02 36 00
				15 01 00 00 01 00 02 37 90
				15 00 00 00 01 00 02 38 00
				15 00 00 00 01 00 02 39 A6
				15 00 00 00 01 00 02 3A 00
				15 00 00 00 01 00 02 3B BA
				15 00 00 00 01 00 02 3D 00
				15 00 00 00 01 00 02 3F CB
				15 00 00 00 01 00 02 40 00
				15 00 00 00 01 00 02 41 DB
				15 00 00 00 01 00 02 42 00
				15 00 00 00 01 00 02 43 EA
				15 00 00 00 01 00 02 44 00
				15 00 00 00 01 00 02 45 F7
				15 00 00 00 01 00 02 46 01
				15 00 00 00 01 00 02 47 24
				15 00 00 00 01 00 02 48 01
				15 00 00 00 01 00 02 49 46
				15 00 00 00 01 00 02 4A 01
				15 00 00 00 01 00 02 4B 7C
				15 00 00 00 01 00 02 4C 01
				15 00 00 00 01 00 02 4D A5
				15 00 00 00 01 00 02 4E 01
				15 00 00 00 01 00 02 4F E3
				15 00 00 00 01 00 02 50 02
				15 00 00 00 01 00 02 51 15
				15 00 00 00 01 00 02 52 02
				15 00 00 00 01 00 02 53 17
				15 00 00 00 01 00 02 54 02
				15 00 00 00 01 00 02 55 47
				15 00 00 00 01 00 02 56 02
				15 00 00 00 01 00 02 58 81
				15 00 00 00 01 00 02 59 02
				15 00 00 00 01 00 02 5A A8
				15 00 00 00 01 00 02 5B 02
				15 00 00 00 01 00 02 5C DD
				15 00 00 00 01 00 02 5D 03
				15 00 00 00 01 00 02 5E 03
				15 00 00 00 01 00 02 5F 03
				15 00 00 00 01 00 02 60 3B
				15 00 00 00 01 00 02 61 03
				15 01 00 00 01 00 02 62 52
				15 00 00 00 01 00 02 63 03
				15 00 00 00 01 00 02 64 6D
				15 00 00 00 01 00 02 65 03
				15 00 00 00 01 00 02 66 89
				15 00 00 00 01 00 02 67 03
				15 00 00 00 01 00 02 68 A3
				15 00 00 00 01 00 02 69 03
				15 00 00 00 01 00 02 6A C9
				15 00 00 00 01 00 02 6B 03
				15 00 00 00 01 00 02 6C DD
				15 00 00 00 01 00 02 6D 03
				15 00 00 00 01 00 02 6E F5
				15 00 00 00 01 00 02 6F 03
				15 00 00 00 01 00 02 70 FF
				15 00 00 00 01 00 02 71 01
				15 00 00 00 01 00 02 72 77
				15 00 00 00 01 00 02 73 01
				15 00 00 00 01 00 02 74 79
				15 00 00 00 01 00 02 75 01
				15 00 00 00 01 00 02 76 7e
				15 00 00 00 01 00 02 77 01
				15 00 00 00 01 00 02 78 82
				15 00 00 00 01 00 02 79 01
				15 00 00 00 01 00 02 7A 87
				15 00 00 00 01 00 02 7B 01
				15 00 00 00 01 00 02 7C 8b
				15 00 00 00 01 00 02 7D 01
				15 00 00 00 01 00 02 7E 8f
				15 00 00 00 01 00 02 7F 01
				15 00 00 00 01 00 02 80 94
				15 00 00 00 01 00 02 81 01
				15 00 00 00 01 00 02 82 98
				15 00 00 00 01 00 02 83 01
				15 00 00 00 01 00 02 84 a7
				15 00 00 00 01 00 02 85 01
				15 00 00 00 01 00 02 86 b5
				15 00 00 00 01 00 02 87 01
				15 00 00 00 01 00 02 88 cf
				15 01 00 00 01 00 02 89 01
				15 00 00 00 01 00 02 8A e6
				15 00 00 00 01 00 02 8B 02
				15 00 00 00 01 00 02 8C 0e
				15 00 00 00 01 00 02 8D 02
				15 00 00 00 01 00 02 8E 36
				15 00 00 00 01 00 02 8F 02
				15 00 00 00 01 00 02 90 37
				15 00 00 00 01 00 02 91 02
				15 00 00 00 01 00 02 92 62
				15 00 00 00 01 00 02 93 02
				15 00 00 00 01 00 02 94 9b
				15 00 00 00 01 00 02 95 02
				15 00 00 00 01 00 02 96 c2
				15 00 00 00 01 00 02 97 02
				15 00 00 00 01 00 02 98 f9
				15 00 00 00 01 00 02 99 03
				15 00 00 00 01 00 02 9A 24
				15 00 00 00 01 00 02 9B 03
				15 00 00 00 01 00 02 9C 7e
				15 00 00 00 01 00 02 9D 03
				15 00 00 00 01 00 02 9E b0
				15 00 00 00 01 00 02 9F 03
				15 00 00 00 01 00 02 A0 DB
				15 00 00 00 01 00 02 A2 03
				15 00 00 00 01 00 02 A3 E3
				15 00 00 00 01 00 02 A4 03
				15 00 00 00 01 00 02 A5 E7
				15 00 00 00 01 00 02 A6 03
				15 00 00 00 01 00 02 A7 ED
				15 00 00 00 01 00 02 A9 03
				15 00 00 00 10 00 02 AA F0
				15 00 00 00 01 00 02 AB 03
				15 00 00 00 01 00 02 AC F5
				15 00 00 00 01 00 02 AD 03
				15 00 00 00 01 00 02 AE FF
				15 00 00 00 01 00 02 AF 01
				15 00 00 00 01 00 02 B0 77
				15 00 00 00 01 00 02 B1 01
				15 00 00 00 01 00 02 B2 79
				15 00 00 00 01 00 02 B3 01
				15 01 00 00 01 00 02 B4 7e
				15 00 00 00 01 00 02 B5 01
				15 00 00 00 01 00 02 B6 83
				15 00 00 00 01 00 02 B7 01
				15 00 00 00 01 00 02 B8 87
				15 00 00 00 01 00 02 B9 01
				15 00 00 00 01 00 02 BA 8b
				15 00 00 00 01 00 02 BB 01
				15 00 00 00 01 00 02 BC 8f
				15 00 00 00 01 00 02 BD 01
				15 00 00 00 01 00 02 BE 94
				15 00 00 00 01 00 02 BF 01
				15 00 00 00 01 00 02 C0 98
				15 00 00 00 01 00 02 C1 01
				15 00 00 00 01 00 02 C2 a7
				15 00 00 00 01 00 02 C3 01
				15 00 00 00 01 00 02 C4 b5
				15 00 00 00 01 00 02 C5 01
				15 00 00 00 01 00 02 C6 cf
				15 00 00 00 01 00 02 C7 01
				15 00 00 00 01 00 02 C8 e6
				15 00 00 00 01 00 02 C9 02
				15 00 00 00 01 00 02 CA 0e
				15 00 00 00 01 00 02 CB 02
				15 00 00 00 01 00 02 CC 36
				15 00 00 00 01 00 02 CD 02
				15 00 00 00 01 00 02 CE 38
				15 00 00 00 01 00 02 CF 02
				15 00 00 00 01 00 02 D0 62
				15 00 00 00 01 00 02 D1 02
				15 00 00 00 01 00 02 D2 9b
				15 00 00 00 01 00 02 D3 02
				15 00 00 00 01 00 02 D4 c2
				15 00 00 00 01 00 02 D5 02
				15 00 00 00 01 00 02 D6 f9
				15 00 00 00 01 00 02 D7 03
				15 00 00 00 01 00 02 D8 24
				15 00 00 00 01 00 02 D9 03
				15 00 00 00 01 00 02 DA 7e
				15 00 00 00 01 00 02 DB 03
				15 01 00 00 01 00 02 DC b0
				15 00 00 00 01 00 02 DD 03
				15 00 00 00 01 00 02 DE DB
				15 00 00 00 01 00 02 DF 03
				15 00 00 00 01 00 02 E0 E3
				15 00 00 00 01 00 02 E1 03
				15 00 00 00 01 00 02 E2 E7
				15 00 00 00 01 00 02 E3 03
				15 00 00 00 01 00 02 E4 ED
				15 00 00 00 01 00 02 E5 03
				15 00 00 00 01 00 02 E6 F0
				15 00 00 00 01 00 02 E7 03
				15 00 00 00 01 00 02 E8 F5
				15 00 00 00 01 00 02 E9 03
				15 00 00 00 01 00 02 EA FF
				15 01 00 00 01 00 02 FF 00
			];
		qcom,mdss-dsi-dispparam-papermode4-command-state = "dsi_hs_mode";
		qcom,mdss-dsi-dispparam-papermode5-command = [
				15 01 00 00 01 00 02 FF 01
				15 00 00 00 01 00 02 FB 01
				15 00 00 00 01 00 02 75 00
				15 00 00 00 01 00 02 76 00
				15 00 00 00 01 00 02 77 00
				15 00 00 00 01 00 02 78 1F
				15 00 00 00 01 00 02 79 00
				15 00 00 00 01 00 02 7A 46
				15 00 00 00 01 00 02 7B 00
				15 00 00 00 01 00 02 7C 69
				15 00 00 00 01 00 02 7D 00
				15 00 00 00 01 00 02 7E 84
				15 00 00 00 01 00 02 7F 00
				15 00 00 00 01 00 02 80 9B
				15 00 00 00 01 00 02 81 00
				15 00 00 00 01 00 02 82 B0
				15 00 00 00 01 00 02 83 00
				15 00 00 00 01 00 02 84 C3
				15 00 00 00 01 00 02 85 00
				15 00 00 00 01 00 02 86 D3
				15 00 00 00 01 00 02 87 01
				15 00 00 00 01 00 02 88 09
				15 00 00 00 01 00 02 89 01
				15 00 00 00 01 00 02 8A 31
				15 00 00 00 01 00 02 8B 01
				15 00 00 00 01 00 02 8C 6D
				15 00 00 00 01 00 02 8D 01
				15 00 00 00 01 00 02 8E 99
				15 00 00 00 01 00 02 8F 01
				15 00 00 00 01 00 02 90 DB
				15 00 00 00 01 00 02 91 02
				15 00 00 00 01 00 02 92 0F
				15 00 00 00 01 00 02 93 02
				15 00 00 00 01 00 02 94 11
				15 00 00 00 01 00 02 95 02
				15 00 00 00 01 00 02 96 42
				15 00 00 00 01 00 02 97 02
				15 00 00 00 01 00 02 98 7D
				15 00 00 00 01 00 02 99 02
				15 01 00 00 01 00 02 9A A4
				15 00 00 00 01 00 02 9B 02
				15 00 00 00 01 00 02 9C D9
				15 00 00 00 01 00 02 9D 02
				15 00 00 00 01 00 02 9E FF
				15 00 00 00 01 00 02 9F 03
				15 00 00 00 01 00 02 A0 36
				15 00 00 00 01 00 02 A2 03
				15 00 00 00 01 00 02 A3 55
				15 00 00 00 01 00 02 A4 03
				15 00 00 00 01 00 02 A5 6D
				15 00 00 00 01 00 02 A6 03
				15 00 00 00 01 00 02 A7 89
				15 00 00 00 01 00 02 A9 03
				15 00 00 00 01 00 02 AA A3
				15 00 00 00 01 00 02 AB 03
				15 00 00 00 01 00 02 AC C9
				15 00 00 00 01 00 02 AD 03
				15 00 00 00 01 00 02 AE DD
				15 00 00 00 01 00 02 AF 03
				15 00 00 00 01 00 02 B0 F5
				15 00 00 00 01 00 02 B1 03
				15 00 00 00 01 00 02 B2 FF
				15 00 00 00 01 00 02 B3 00
				15 00 00 00 01 00 02 B4 00
				15 00 00 00 01 00 02 B5 00
				15 00 00 00 01 00 02 B6 1F
				15 00 00 00 01 00 02 B7 00
				15 00 00 00 01 00 02 B8 46
				15 00 00 00 01 00 02 B9 00
				15 00 00 00 01 00 02 BA 69
				15 00 00 00 01 00 02 BB 00
				15 00 00 00 01 00 02 BC 84
				15 00 00 00 01 00 02 BD 00
				15 00 00 00 01 00 02 BE 9B
				15 00 00 00 01 00 02 BF 00
				15 00 00 00 01 00 02 C0 B0
				15 00 00 00 01 00 02 C1 00
				15 00 00 00 01 00 02 C2 C3
				15 00 00 00 01 00 02 C3 00
				15 01 00 00 01 00 02 C4 D3
				15 00 00 00 01 00 02 C5 01
				15 00 00 00 01 00 02 C6 09
				15 00 00 00 01 00 02 C7 01
				15 00 00 00 01 00 02 C8 31
				15 00 00 00 01 00 02 C9 01
				15 00 00 00 01 00 02 CA 6D
				15 00 00 00 01 00 02 CB 01
				15 00 00 00 01 00 02 CC 9A
				15 00 00 00 01 00 02 CD 01
				15 00 00 00 01 00 02 CE DC
				15 00 00 00 01 00 02 CF 02
				15 00 00 00 01 00 02 D0 10
				15 00 00 00 01 00 02 D1 02
				15 00 00 00 01 00 02 D2 12
				15 00 00 00 01 00 02 D3 02
				15 00 00 00 01 00 02 D4 43
				15 00 00 00 01 00 02 D5 02
				15 00 00 00 01 00 02 D6 7D
				15 00 00 00 01 00 02 D7 02
				15 00 00 00 01 00 02 D8 A4
				15 00 00 00 01 00 02 D9 02
				15 00 00 00 01 00 02 DA D9
				15 00 00 00 01 00 02 DB 02
				15 00 00 00 01 00 02 DC FF
				15 00 00 00 01 00 02 DD 03
				15 00 00 00 01 00 02 DE 36
				15 00 00 00 01 00 02 DF 03
				15 00 00 00 01 00 02 E0 55
				15 00 00 00 01 00 02 E1 03
				15 00 00 00 01 00 02 E2 6D
				15 00 00 00 01 00 02 E3 03
				15 00 00 00 01 00 02 E4 89
				15 00 00 00 01 00 02 E5 03
				15 00 00 00 01 00 02 E6 A3
				15 00 00 00 01 00 02 E7 03
				15 00 00 00 01 00 02 E8 C9
				15 00 00 00 01 00 02 E9 03
				15 00 00 00 01 00 02 EA DD
				15 00 00 00 01 00 02 EB 03
				15 01 00 00 01 00 02 EC F5
				15 00 00 00 01 00 02 ED 03
				15 00 00 00 01 00 02 EE FF
				15 00 00 00 01 00 02 EF 00
				15 00 00 00 01 00 02 F0 66
				15 00 00 00 01 00 02 F1 00
				15 00 00 00 01 00 02 F2 75
				15 00 00 00 01 00 02 F3 00
				15 00 00 00 01 00 02 F4 90
				15 00 00 00 01 00 02 F5 00
				15 00 00 00 01 00 02 F6 A6
				15 00 00 00 01 00 02 F7 00
				15 00 00 00 01 00 02 F8 BA
				15 00 00 00 01 00 02 F9 00
				15 00 00 00 01 00 02 FA CB
				15 01 00 00 01 00 02 FF 02
				15 00 00 00 01 00 02 FB 01
				15 00 00 00 01 00 02 00 00
				15 00 00 00 01 00 02 01 DB
				15 00 00 00 01 00 02 02 00
				15 00 00 00 01 00 02 03 EA
				15 00 00 00 01 00 02 04 00
				15 00 00 00 01 00 02 05 F7
				15 00 00 00 01 00 02 06 01
				15 00 00 00 01 00 02 07 24
				15 00 00 00 01 00 02 08 01
				15 00 00 00 01 00 02 09 46
				15 00 00 00 01 00 02 0A 01
				15 00 00 00 01 00 02 0B 7C
				15 00 00 00 01 00 02 0C 01
				15 01 00 00 01 00 02 0D A5
				15 00 00 00 01 00 02 0E 01
				15 00 00 00 01 00 02 0F E3
				15 00 00 00 01 00 02 10 02
				15 00 00 00 01 00 02 11 15
				15 00 00 00 01 00 02 12 02
				15 00 00 00 01 00 02 13 17
				15 00 00 00 01 00 02 14 02
				15 00 00 00 01 00 02 15 47
				15 00 00 00 01 00 02 16 02
				15 00 00 00 01 00 02 17 81
				15 00 00 00 01 00 02 18 02
				15 00 00 00 01 00 02 19 A8
				15 00 00 00 01 00 02 1A 02
				15 00 00 00 01 00 02 1B DD
				15 00 00 00 01 00 02 1C 03
				15 00 00 00 01 00 02 1D 03
				15 00 00 00 01 00 02 1E 03
				15 00 00 00 01 00 02 1F 3B
				15 00 00 00 01 00 02 20 03
				15 00 00 00 01 00 02 21 52
				15 00 00 00 01 00 02 22 03
				15 00 00 00 01 00 02 23 6D
				15 00 00 00 01 00 02 24 03
				15 00 00 00 01 00 02 25 89
				15 00 00 00 01 00 02 26 03
				15 00 00 00 01 00 02 27 A3
				15 00 00 00 01 00 02 28 03
				15 00 00 00 01 00 02 29 C9
				15 00 00 00 01 00 02 2A 03
				15 00 00 00 01 00 02 2B DD
				15 00 00 00 01 00 02 2D 03
				15 00 00 00 01 00 02 2F F5
				15 00 00 00 01 00 02 30 03
				15 00 00 00 01 00 02 31 FF
				15 00 00 00 01 00 02 32 00
				15 00 00 00 01 00 02 33 66
				15 00 00 00 01 00 02 34 00
				15 00 00 00 01 00 02 35 75
				15 00 00 00 01 00 02 36 00
				15 01 00 00 01 00 02 37 90
				15 00 00 00 01 00 02 38 00
				15 00 00 00 01 00 02 39 A6
				15 00 00 00 01 00 02 3A 00
				15 00 00 00 01 00 02 3B BA
				15 00 00 00 01 00 02 3D 00
				15 00 00 00 01 00 02 3F CB
				15 00 00 00 01 00 02 40 00
				15 00 00 00 01 00 02 41 DB
				15 00 00 00 01 00 02 42 00
				15 00 00 00 01 00 02 43 EA
				15 00 00 00 01 00 02 44 00
				15 00 00 00 01 00 02 45 F7
				15 00 00 00 01 00 02 46 01
				15 00 00 00 01 00 02 47 24
				15 00 00 00 01 00 02 48 01
				15 00 00 00 01 00 02 49 46
				15 00 00 00 01 00 02 4A 01
				15 00 00 00 01 00 02 4B 7C
				15 00 00 00 01 00 02 4C 01
				15 00 00 00 01 00 02 4D A5
				15 00 00 00 01 00 02 4E 01
				15 00 00 00 01 00 02 4F E3
				15 00 00 00 01 00 02 50 02
				15 00 00 00 01 00 02 51 15
				15 00 00 00 01 00 02 52 02
				15 00 00 00 01 00 02 53 17
				15 00 00 00 01 00 02 54 02
				15 00 00 00 01 00 02 55 47
				15 00 00 00 01 00 02 56 02
				15 00 00 00 01 00 02 58 81
				15 00 00 00 01 00 02 59 02
				15 00 00 00 01 00 02 5A A8
				15 00 00 00 01 00 02 5B 02
				15 00 00 00 01 00 02 5C DD
				15 00 00 00 01 00 02 5D 03
				15 00 00 00 01 00 02 5E 03
				15 00 00 00 01 00 02 5F 03
				15 00 00 00 01 00 02 60 3B
				15 00 00 00 01 00 02 61 03
				15 01 00 00 01 00 02 62 52
				15 00 00 00 01 00 02 63 03
				15 00 00 00 01 00 02 64 6D
				15 00 00 00 01 00 02 65 03
				15 00 00 00 01 00 02 66 89
				15 00 00 00 01 00 02 67 03
				15 00 00 00 01 00 02 68 A3
				15 00 00 00 01 00 02 69 03
				15 00 00 00 01 00 02 6A C9
				15 00 00 00 01 00 02 6B 03
				15 00 00 00 01 00 02 6C DD
				15 00 00 00 01 00 02 6D 03
				15 00 00 00 01 00 02 6E F5
				15 00 00 00 01 00 02 6F 03
				15 00 00 00 01 00 02 70 FF
				15 00 00 00 01 00 02 71 01
				15 00 00 00 01 00 02 72 99
				15 00 00 00 01 00 02 73 01
				15 00 00 00 01 00 02 74 9B
				15 00 00 00 01 00 02 75 01
				15 00 00 00 01 00 02 76 9E
				15 00 00 00 01 00 02 77 01
				15 00 00 00 01 00 02 78 A2
				15 00 00 00 01 00 02 79 01
				15 00 00 00 01 00 02 7A A5
				15 00 00 00 01 00 02 7B 01
				15 00 00 00 01 00 02 7C A9
				15 00 00 00 01 00 02 7D 01
				15 00 00 00 01 00 02 7E ac
				15 00 00 00 01 00 02 7F 01
				15 00 00 00 01 00 02 80 af
				15 00 00 00 01 00 02 81 01
				15 00 00 00 01 00 02 82 b2
				15 00 00 00 01 00 02 83 01
				15 00 00 00 01 00 02 84 bf
				15 00 00 00 01 00 02 85 01
				15 00 00 00 01 00 02 86 cb
				15 00 00 00 01 00 02 87 01
				15 00 00 00 01 00 02 88 e1
				15 01 00 00 01 00 02 89 01
				15 00 00 00 01 00 02 8A F4
				15 00 00 00 01 00 02 8B 02
				15 00 00 00 01 00 02 8C 1a
				15 00 00 00 01 00 02 8D 02
				15 00 00 00 01 00 02 8E 3f
				15 00 00 00 01 00 02 8F 02
				15 00 00 00 01 00 02 90 41
				15 00 00 00 01 00 02 91 02
				15 00 00 00 01 00 02 92 6b
				15 00 00 00 01 00 02 93 02
				15 00 00 00 01 00 02 94 a3
				15 00 00 00 01 00 02 95 02
				15 00 00 00 01 00 02 96 ca
				15 00 00 00 01 00 02 97 03
				15 00 00 00 01 00 02 98 02
				15 00 00 00 01 00 02 99 03
				15 00 00 00 01 00 02 9A 2e
				15 00 00 00 01 00 02 9B 03
				15 00 00 00 01 00 02 9C 7e
				15 00 00 00 01 00 02 9D 03
				15 00 00 00 01 00 02 9E b0
				15 00 00 00 01 00 02 9F 03
				15 00 00 00 01 00 02 A0 DB
				15 00 00 00 01 00 02 A2 03
				15 00 00 00 01 00 02 A3 E3
				15 00 00 00 01 00 02 A4 03
				15 00 00 00 01 00 02 A5 E7
				15 00 00 00 01 00 02 A6 03
				15 00 00 00 01 00 02 A7 ED
				15 00 00 00 01 00 02 A9 03
				15 00 00 00 10 00 02 AA F0
				15 00 00 00 01 00 02 AB 03
				15 00 00 00 01 00 02 AC F5
				15 00 00 00 01 00 02 AD 03
				15 00 00 00 01 00 02 AE FF
				15 00 00 00 01 00 02 AF 01
				15 00 00 00 01 00 02 B0 99
				15 00 00 00 01 00 02 B1 01
				15 00 00 00 01 00 02 B2 9B
				15 00 00 00 01 00 02 B3 01
				15 01 00 00 01 00 02 B4 9E
				15 00 00 00 01 00 02 B5 01
				15 00 00 00 01 00 02 B6 A2
				15 00 00 00 01 00 02 B7 01
				15 00 00 00 01 00 02 B8 A5
				15 00 00 00 01 00 02 B9 01
				15 00 00 00 01 00 02 BA A9
				15 00 00 00 01 00 02 BB 01
				15 00 00 00 01 00 02 BC ac
				15 00 00 00 01 00 02 BD 01
				15 00 00 00 01 00 02 BE af
				15 00 00 00 01 00 02 BF 01
				15 00 00 00 01 00 02 C0 b2
				15 00 00 00 01 00 02 C1 01
				15 00 00 00 01 00 02 C2 bf
				15 00 00 00 01 00 02 C3 01
				15 00 00 00 01 00 02 C4 cb
				15 00 00 00 01 00 02 C5 01
				15 00 00 00 01 00 02 C6 e1
				15 00 00 00 01 00 02 C7 01
				15 00 00 00 01 00 02 C8 f5
				15 00 00 00 01 00 02 C9 02
				15 00 00 00 01 00 02 CA 1a
				15 00 00 00 01 00 02 CB 02
				15 00 00 00 01 00 02 CC 40
				15 00 00 00 01 00 02 CD 02
				15 00 00 00 01 00 02 CE 41
				15 00 00 00 01 00 02 CF 02
				15 00 00 00 01 00 02 D0 6b
				15 00 00 00 01 00 02 D1 02
				15 00 00 00 01 00 02 D2 a3
				15 00 00 00 01 00 02 D3 02
				15 00 00 00 01 00 02 D4 ca
				15 00 00 00 01 00 02 D5 03
				15 00 00 00 01 00 02 D6 02
				15 00 00 00 01 00 02 D7 03
				15 00 00 00 01 00 02 D8 2e
				15 00 00 00 01 00 02 D9 03
				15 00 00 00 01 00 02 DA 7e
				15 00 00 00 01 00 02 DB 03
				15 01 00 00 01 00 02 DC b0
				15 00 00 00 01 00 02 DD 03
				15 00 00 00 01 00 02 DE DB
				15 00 00 00 01 00 02 DF 03
				15 00 00 00 01 00 02 E0 E3
				15 00 00 00 01 00 02 E1 03
				15 00 00 00 01 00 02 E2 E7
				15 00 00 00 01 00 02 E3 03
				15 00 00 00 01 00 02 E4 ED
				15 00 00 00 01 00 02 E5 03
				15 00 00 00 01 00 02 E6 F0
				15 00 00 00 01 00 02 E7 03
				15 00 00 00 01 00 02 E8 F5
				15 00 00 00 01 00 02 E9 03
				15 00 00 00 01 00 02 EA FF
				15 01 00 00 01 00 02 FF 00
			];
		qcom,mdss-dsi-dispparam-papermode5-command-state = "dsi_hs_mode";
		qcom,mdss-dsi-dispparam-papermode6-command = [
				15 01 00 00 01 00 02 FF 01
				15 00 00 00 01 00 02 FB 01
				15 00 00 00 01 00 02 75 00
				15 00 00 00 01 00 02 76 00
				15 00 00 00 01 00 02 77 00
				15 00 00 00 01 00 02 78 1F
				15 00 00 00 01 00 02 79 00
				15 00 00 00 01 00 02 7A 46
				15 00 00 00 01 00 02 7B 00
				15 00 00 00 01 00 02 7C 69
				15 00 00 00 01 00 02 7D 00
				15 00 00 00 01 00 02 7E 84
				15 00 00 00 01 00 02 7F 00
				15 00 00 00 01 00 02 80 9B
				15 00 00 00 01 00 02 81 00
				15 00 00 00 01 00 02 82 B0
				15 00 00 00 01 00 02 83 00
				15 00 00 00 01 00 02 84 C3
				15 00 00 00 01 00 02 85 00
				15 00 00 00 01 00 02 86 D3
				15 00 00 00 01 00 02 87 01
				15 00 00 00 01 00 02 88 09
				15 00 00 00 01 00 02 89 01
				15 00 00 00 01 00 02 8A 31
				15 00 00 00 01 00 02 8B 01
				15 00 00 00 01 00 02 8C 6D
				15 00 00 00 01 00 02 8D 01
				15 00 00 00 01 00 02 8E 99
				15 00 00 00 01 00 02 8F 01
				15 00 00 00 01 00 02 90 DB
				15 00 00 00 01 00 02 91 02
				15 00 00 00 01 00 02 92 0F
				15 00 00 00 01 00 02 93 02
				15 00 00 00 01 00 02 94 11
				15 00 00 00 01 00 02 95 02
				15 00 00 00 01 00 02 96 42
				15 00 00 00 01 00 02 97 02
				15 00 00 00 01 00 02 98 7D
				15 00 00 00 01 00 02 99 02
				15 01 00 00 01 00 02 9A A4
				15 00 00 00 01 00 02 9B 02
				15 00 00 00 01 00 02 9C D9
				15 00 00 00 01 00 02 9D 02
				15 00 00 00 01 00 02 9E FF
				15 00 00 00 01 00 02 9F 03
				15 00 00 00 01 00 02 A0 36
				15 00 00 00 01 00 02 A2 03
				15 00 00 00 01 00 02 A3 55
				15 00 00 00 01 00 02 A4 03
				15 00 00 00 01 00 02 A5 6D
				15 00 00 00 01 00 02 A6 03
				15 00 00 00 01 00 02 A7 89
				15 00 00 00 01 00 02 A9 03
				15 00 00 00 01 00 02 AA A3
				15 00 00 00 01 00 02 AB 03
				15 00 00 00 01 00 02 AC C9
				15 00 00 00 01 00 02 AD 03
				15 00 00 00 01 00 02 AE DD
				15 00 00 00 01 00 02 AF 03
				15 00 00 00 01 00 02 B0 F5
				15 00 00 00 01 00 02 B1 03
				15 00 00 00 01 00 02 B2 FF
				15 00 00 00 01 00 02 B3 00
				15 00 00 00 01 00 02 B4 00
				15 00 00 00 01 00 02 B5 00
				15 00 00 00 01 00 02 B6 1F
				15 00 00 00 01 00 02 B7 00
				15 00 00 00 01 00 02 B8 46
				15 00 00 00 01 00 02 B9 00
				15 00 00 00 01 00 02 BA 69
				15 00 00 00 01 00 02 BB 00
				15 00 00 00 01 00 02 BC 84
				15 00 00 00 01 00 02 BD 00
				15 00 00 00 01 00 02 BE 9B
				15 00 00 00 01 00 02 BF 00
				15 00 00 00 01 00 02 C0 B0
				15 00 00 00 01 00 02 C1 00
				15 00 00 00 01 00 02 C2 C3
				15 00 00 00 01 00 02 C3 00
				15 01 00 00 01 00 02 C4 D3
				15 00 00 00 01 00 02 C5 01
				15 00 00 00 01 00 02 C6 09
				15 00 00 00 01 00 02 C7 01
				15 00 00 00 01 00 02 C8 31
				15 00 00 00 01 00 02 C9 01
				15 00 00 00 01 00 02 CA 6D
				15 00 00 00 01 00 02 CB 01
				15 00 00 00 01 00 02 CC 9A
				15 00 00 00 01 00 02 CD 01
				15 00 00 00 01 00 02 CE DC
				15 00 00 00 01 00 02 CF 02
				15 00 00 00 01 00 02 D0 10
				15 00 00 00 01 00 02 D1 02
				15 00 00 00 01 00 02 D2 12
				15 00 00 00 01 00 02 D3 02
				15 00 00 00 01 00 02 D4 43
				15 00 00 00 01 00 02 D5 02
				15 00 00 00 01 00 02 D6 7D
				15 00 00 00 01 00 02 D7 02
				15 00 00 00 01 00 02 D8 A4
				15 00 00 00 01 00 02 D9 02
				15 00 00 00 01 00 02 DA D9
				15 00 00 00 01 00 02 DB 02
				15 00 00 00 01 00 02 DC FF
				15 00 00 00 01 00 02 DD 03
				15 00 00 00 01 00 02 DE 36
				15 00 00 00 01 00 02 DF 03
				15 00 00 00 01 00 02 E0 55
				15 00 00 00 01 00 02 E1 03
				15 00 00 00 01 00 02 E2 6D
				15 00 00 00 01 00 02 E3 03
				15 00 00 00 01 00 02 E4 89
				15 00 00 00 01 00 02 E5 03
				15 00 00 00 01 00 02 E6 A3
				15 00 00 00 01 00 02 E7 03
				15 00 00 00 01 00 02 E8 C9
				15 00 00 00 01 00 02 E9 03
				15 00 00 00 01 00 02 EA DD
				15 00 00 00 01 00 02 EB 03
				15 01 00 00 01 00 02 EC F5
				15 00 00 00 01 00 02 ED 03
				15 00 00 00 01 00 02 EE FF
				15 00 00 00 01 00 02 EF 00
				15 00 00 00 01 00 02 F0 66
				15 00 00 00 01 00 02 F1 00
				15 00 00 00 01 00 02 F2 75
				15 00 00 00 01 00 02 F3 00
				15 00 00 00 01 00 02 F4 90
				15 00 00 00 01 00 02 F5 00
				15 00 00 00 01 00 02 F6 A6
				15 00 00 00 01 00 02 F7 00
				15 00 00 00 01 00 02 F8 BA
				15 00 00 00 01 00 02 F9 00
				15 00 00 00 01 00 02 FA CB
				15 01 00 00 01 00 02 FF 02
				15 00 00 00 01 00 02 FB 01
				15 00 00 00 01 00 02 00 00
				15 00 00 00 01 00 02 01 DB
				15 00 00 00 01 00 02 02 00
				15 00 00 00 01 00 02 03 EA
				15 00 00 00 01 00 02 04 00
				15 00 00 00 01 00 02 05 F7
				15 00 00 00 01 00 02 06 01
				15 00 00 00 01 00 02 07 24
				15 00 00 00 01 00 02 08 01
				15 00 00 00 01 00 02 09 46
				15 00 00 00 01 00 02 0A 01
				15 00 00 00 01 00 02 0B 7C
				15 00 00 00 01 00 02 0C 01
				15 01 00 00 01 00 02 0D A5
				15 00 00 00 01 00 02 0E 01
				15 00 00 00 01 00 02 0F E3
				15 00 00 00 01 00 02 10 02
				15 00 00 00 01 00 02 11 15
				15 00 00 00 01 00 02 12 02
				15 00 00 00 01 00 02 13 17
				15 00 00 00 01 00 02 14 02
				15 00 00 00 01 00 02 15 47
				15 00 00 00 01 00 02 16 02
				15 00 00 00 01 00 02 17 81
				15 00 00 00 01 00 02 18 02
				15 00 00 00 01 00 02 19 A8
				15 00 00 00 01 00 02 1A 02
				15 00 00 00 01 00 02 1B DD
				15 00 00 00 01 00 02 1C 03
				15 00 00 00 01 00 02 1D 03
				15 00 00 00 01 00 02 1E 03
				15 00 00 00 01 00 02 1F 3B
				15 00 00 00 01 00 02 20 03
				15 00 00 00 01 00 02 21 52
				15 00 00 00 01 00 02 22 03
				15 00 00 00 01 00 02 23 6D
				15 00 00 00 01 00 02 24 03
				15 00 00 00 01 00 02 25 89
				15 00 00 00 01 00 02 26 03
				15 00 00 00 01 00 02 27 A3
				15 00 00 00 01 00 02 28 03
				15 00 00 00 01 00 02 29 C9
				15 00 00 00 01 00 02 2A 03
				15 00 00 00 01 00 02 2B DD
				15 00 00 00 01 00 02 2D 03
				15 00 00 00 01 00 02 2F F5
				15 00 00 00 01 00 02 30 03
				15 00 00 00 01 00 02 31 FF
				15 00 00 00 01 00 02 32 00
				15 00 00 00 01 00 02 33 66
				15 00 00 00 01 00 02 34 00
				15 00 00 00 01 00 02 35 75
				15 00 00 00 01 00 02 36 00
				15 01 00 00 01 00 02 37 90
				15 00 00 00 01 00 02 38 00
				15 00 00 00 01 00 02 39 A6
				15 00 00 00 01 00 02 3A 00
				15 00 00 00 01 00 02 3B BA
				15 00 00 00 01 00 02 3D 00
				15 00 00 00 01 00 02 3F CB
				15 00 00 00 01 00 02 40 00
				15 00 00 00 01 00 02 41 DB
				15 00 00 00 01 00 02 42 00
				15 00 00 00 01 00 02 43 EA
				15 00 00 00 01 00 02 44 00
				15 00 00 00 01 00 02 45 F7
				15 00 00 00 01 00 02 46 01
				15 00 00 00 01 00 02 47 24
				15 00 00 00 01 00 02 48 01
				15 00 00 00 01 00 02 49 46
				15 00 00 00 01 00 02 4A 01
				15 00 00 00 01 00 02 4B 7C
				15 00 00 00 01 00 02 4C 01
				15 00 00 00 01 00 02 4D A5
				15 00 00 00 01 00 02 4E 01
				15 00 00 00 01 00 02 4F E3
				15 00 00 00 01 00 02 50 02
				15 00 00 00 01 00 02 51 15
				15 00 00 00 01 00 02 52 02
				15 00 00 00 01 00 02 53 17
				15 00 00 00 01 00 02 54 02
				15 00 00 00 01 00 02 55 47
				15 00 00 00 01 00 02 56 02
				15 00 00 00 01 00 02 58 81
				15 00 00 00 01 00 02 59 02
				15 00 00 00 01 00 02 5A A8
				15 00 00 00 01 00 02 5B 02
				15 00 00 00 01 00 02 5C DD
				15 00 00 00 01 00 02 5D 03
				15 00 00 00 01 00 02 5E 03
				15 00 00 00 01 00 02 5F 03
				15 00 00 00 01 00 02 60 3B
				15 00 00 00 01 00 02 61 03
				15 01 00 00 01 00 02 62 52
				15 00 00 00 01 00 02 63 03
				15 00 00 00 01 00 02 64 6D
				15 00 00 00 01 00 02 65 03
				15 00 00 00 01 00 02 66 89
				15 00 00 00 01 00 02 67 03
				15 00 00 00 01 00 02 68 A3
				15 00 00 00 01 00 02 69 03
				15 00 00 00 01 00 02 6A C9
				15 00 00 00 01 00 02 6B 03
				15 00 00 00 01 00 02 6C DD
				15 00 00 00 01 00 02 6D 03
				15 00 00 00 01 00 02 6E F5
				15 00 00 00 01 00 02 6F 03
				15 00 00 00 01 00 02 70 FF
				15 00 00 00 01 00 02 71 01
				15 00 00 00 01 00 02 72 99
				15 00 00 00 01 00 02 73 01
				15 00 00 00 01 00 02 74 9B
				15 00 00 00 01 00 02 75 01
				15 00 00 00 01 00 02 76 9E
				15 00 00 00 01 00 02 77 01
				15 00 00 00 01 00 02 78 A2
				15 00 00 00 01 00 02 79 01
				15 00 00 00 01 00 02 7A A5
				15 00 00 00 01 00 02 7B 01
				15 00 00 00 01 00 02 7C A9
				15 00 00 00 01 00 02 7D 01
				15 00 00 00 01 00 02 7E ac
				15 00 00 00 01 00 02 7F 01
				15 00 00 00 01 00 02 80 af
				15 00 00 00 01 00 02 81 01
				15 00 00 00 01 00 02 82 b2
				15 00 00 00 01 00 02 83 01
				15 00 00 00 01 00 02 84 bf
				15 00 00 00 01 00 02 85 01
				15 00 00 00 01 00 02 86 cb
				15 00 00 00 01 00 02 87 01
				15 00 00 00 01 00 02 88 e1
				15 01 00 00 01 00 02 89 01
				15 00 00 00 01 00 02 8A F4
				15 00 00 00 01 00 02 8B 02
				15 00 00 00 01 00 02 8C 1a
				15 00 00 00 01 00 02 8D 02
				15 00 00 00 01 00 02 8E 3f
				15 00 00 00 01 00 02 8F 02
				15 00 00 00 01 00 02 90 41
				15 00 00 00 01 00 02 91 02
				15 00 00 00 01 00 02 92 6b
				15 00 00 00 01 00 02 93 02
				15 00 00 00 01 00 02 94 a3
				15 00 00 00 01 00 02 95 02
				15 00 00 00 01 00 02 96 ca
				15 00 00 00 01 00 02 97 03
				15 00 00 00 01 00 02 98 02
				15 00 00 00 01 00 02 99 03
				15 00 00 00 01 00 02 9A 2e
				15 00 00 00 01 00 02 9B 03
				15 00 00 00 01 00 02 9C 7e
				15 00 00 00 01 00 02 9D 03
				15 00 00 00 01 00 02 9E b0
				15 00 00 00 01 00 02 9F 03
				15 00 00 00 01 00 02 A0 DB
				15 00 00 00 01 00 02 A2 03
				15 00 00 00 01 00 02 A3 E3
				15 00 00 00 01 00 02 A4 03
				15 00 00 00 01 00 02 A5 E7
				15 00 00 00 01 00 02 A6 03
				15 00 00 00 01 00 02 A7 ED
				15 00 00 00 01 00 02 A9 03
				15 00 00 00 10 00 02 AA F0
				15 00 00 00 01 00 02 AB 03
				15 00 00 00 01 00 02 AC F5
				15 00 00 00 01 00 02 AD 03
				15 00 00 00 01 00 02 AE FF
				15 00 00 00 01 00 02 AF 01
				15 00 00 00 01 00 02 B0 99
				15 00 00 00 01 00 02 B1 01
				15 00 00 00 01 00 02 B2 9B
				15 00 00 00 01 00 02 B3 01
				15 01 00 00 01 00 02 B4 9E
				15 00 00 00 01 00 02 B5 01
				15 00 00 00 01 00 02 B6 A2
				15 00 00 00 01 00 02 B7 01
				15 00 00 00 01 00 02 B8 A5
				15 00 00 00 01 00 02 B9 01
				15 00 00 00 01 00 02 BA A9
				15 00 00 00 01 00 02 BB 01
				15 00 00 00 01 00 02 BC ac
				15 00 00 00 01 00 02 BD 01
				15 00 00 00 01 00 02 BE af
				15 00 00 00 01 00 02 BF 01
				15 00 00 00 01 00 02 C0 b2
				15 00 00 00 01 00 02 C1 01
				15 00 00 00 01 00 02 C2 bf
				15 00 00 00 01 00 02 C3 01
				15 00 00 00 01 00 02 C4 cb
				15 00 00 00 01 00 02 C5 01
				15 00 00 00 01 00 02 C6 e1
				15 00 00 00 01 00 02 C7 01
				15 00 00 00 01 00 02 C8 f5
				15 00 00 00 01 00 02 C9 02
				15 00 00 00 01 00 02 CA 1a
				15 00 00 00 01 00 02 CB 02
				15 00 00 00 01 00 02 CC 40
				15 00 00 00 01 00 02 CD 02
				15 00 00 00 01 00 02 CE 41
				15 00 00 00 01 00 02 CF 02
				15 00 00 00 01 00 02 D0 6b
				15 00 00 00 01 00 02 D1 02
				15 00 00 00 01 00 02 D2 a3
				15 00 00 00 01 00 02 D3 02
				15 00 00 00 01 00 02 D4 ca
				15 00 00 00 01 00 02 D5 03
				15 00 00 00 01 00 02 D6 02
				15 00 00 00 01 00 02 D7 03
				15 00 00 00 01 00 02 D8 2e
				15 00 00 00 01 00 02 D9 03
				15 00 00 00 01 00 02 DA 7e
				15 00 00 00 01 00 02 DB 03
				15 01 00 00 01 00 02 DC b0
				15 00 00 00 01 00 02 DD 03
				15 00 00 00 01 00 02 DE DB
				15 00 00 00 01 00 02 DF 03
				15 00 00 00 01 00 02 E0 E3
				15 00 00 00 01 00 02 E1 03
				15 00 00 00 01 00 02 E2 E7
				15 00 00 00 01 00 02 E3 03
				15 00 00 00 01 00 02 E4 ED
				15 00 00 00 01 00 02 E5 03
				15 00 00 00 01 00 02 E6 F0
				15 00 00 00 01 00 02 E7 03
				15 00 00 00 01 00 02 E8 F5
				15 00 00 00 01 00 02 E9 03
				15 00 00 00 01 00 02 EA FF
				15 01 00 00 01 00 02 FF 00
			];
		qcom,mdss-dsi-dispparam-papermode6-command-state = "dsi_hs_mode";
		qcom,mdss-dsi-dispparam-papermode7-command = [
				15 01 00 00 01 00 02 FF 01
				15 00 00 00 01 00 02 FB 01
				15 00 00 00 01 00 02 75 00
				15 00 00 00 01 00 02 76 00
				15 00 00 00 01 00 02 77 00
				15 00 00 00 01 00 02 78 1F
				15 00 00 00 01 00 02 79 00
				15 00 00 00 01 00 02 7A 46
				15 00 00 00 01 00 02 7B 00
				15 00 00 00 01 00 02 7C 69
				15 00 00 00 01 00 02 7D 00
				15 00 00 00 01 00 02 7E 84
				15 00 00 00 01 00 02 7F 00
				15 00 00 00 01 00 02 80 9B
				15 00 00 00 01 00 02 81 00
				15 00 00 00 01 00 02 82 B0
				15 00 00 00 01 00 02 83 00
				15 00 00 00 01 00 02 84 C3
				15 00 00 00 01 00 02 85 00
				15 00 00 00 01 00 02 86 D3
				15 00 00 00 01 00 02 87 01
				15 00 00 00 01 00 02 88 09
				15 00 00 00 01 00 02 89 01
				15 00 00 00 01 00 02 8A 31
				15 00 00 00 01 00 02 8B 01
				15 00 00 00 01 00 02 8C 6D
				15 00 00 00 01 00 02 8D 01
				15 00 00 00 01 00 02 8E 99
				15 00 00 00 01 00 02 8F 01
				15 00 00 00 01 00 02 90 DB
				15 00 00 00 01 00 02 91 02
				15 00 00 00 01 00 02 92 0F
				15 00 00 00 01 00 02 93 02
				15 00 00 00 01 00 02 94 11
				15 00 00 00 01 00 02 95 02
				15 00 00 00 01 00 02 96 42
				15 00 00 00 01 00 02 97 02
				15 00 00 00 01 00 02 98 7D
				15 00 00 00 01 00 02 99 02
				15 01 00 00 01 00 02 9A A4
				15 00 00 00 01 00 02 9B 02
				15 00 00 00 01 00 02 9C D9
				15 00 00 00 01 00 02 9D 02
				15 00 00 00 01 00 02 9E FF
				15 00 00 00 01 00 02 9F 03
				15 00 00 00 01 00 02 A0 36
				15 00 00 00 01 00 02 A2 03
				15 00 00 00 01 00 02 A3 55
				15 00 00 00 01 00 02 A4 03
				15 00 00 00 01 00 02 A5 6D
				15 00 00 00 01 00 02 A6 03
				15 00 00 00 01 00 02 A7 89
				15 00 00 00 01 00 02 A9 03
				15 00 00 00 01 00 02 AA A3
				15 00 00 00 01 00 02 AB 03
				15 00 00 00 01 00 02 AC C9
				15 00 00 00 01 00 02 AD 03
				15 00 00 00 01 00 02 AE DD
				15 00 00 00 01 00 02 AF 03
				15 00 00 00 01 00 02 B0 F5
				15 00 00 00 01 00 02 B1 03
				15 00 00 00 01 00 02 B2 FF
				15 00 00 00 01 00 02 B3 00
				15 00 00 00 01 00 02 B4 00
				15 00 00 00 01 00 02 B5 00
				15 00 00 00 01 00 02 B6 1F
				15 00 00 00 01 00 02 B7 00
				15 00 00 00 01 00 02 B8 46
				15 00 00 00 01 00 02 B9 00
				15 00 00 00 01 00 02 BA 69
				15 00 00 00 01 00 02 BB 00
				15 00 00 00 01 00 02 BC 84
				15 00 00 00 01 00 02 BD 00
				15 00 00 00 01 00 02 BE 9B
				15 00 00 00 01 00 02 BF 00
				15 00 00 00 01 00 02 C0 B0
				15 00 00 00 01 00 02 C1 00
				15 00 00 00 01 00 02 C2 C3
				15 00 00 00 01 00 02 C3 00
				15 01 00 00 01 00 02 C4 D3
				15 00 00 00 01 00 02 C5 01
				15 00 00 00 01 00 02 C6 09
				15 00 00 00 01 00 02 C7 01
				15 00 00 00 01 00 02 C8 31
				15 00 00 00 01 00 02 C9 01
				15 00 00 00 01 00 02 CA 6D
				15 00 00 00 01 00 02 CB 01
				15 00 00 00 01 00 02 CC 9A
				15 00 00 00 01 00 02 CD 01
				15 00 00 00 01 00 02 CE DC
				15 00 00 00 01 00 02 CF 02
				15 00 00 00 01 00 02 D0 10
				15 00 00 00 01 00 02 D1 02
				15 00 00 00 01 00 02 D2 12
				15 00 00 00 01 00 02 D3 02
				15 00 00 00 01 00 02 D4 43
				15 00 00 00 01 00 02 D5 02
				15 00 00 00 01 00 02 D6 7D
				15 00 00 00 01 00 02 D7 02
				15 00 00 00 01 00 02 D8 A4
				15 00 00 00 01 00 02 D9 02
				15 00 00 00 01 00 02 DA D9
				15 00 00 00 01 00 02 DB 02
				15 00 00 00 01 00 02 DC FF
				15 00 00 00 01 00 02 DD 03
				15 00 00 00 01 00 02 DE 36
				15 00 00 00 01 00 02 DF 03
				15 00 00 00 01 00 02 E0 55
				15 00 00 00 01 00 02 E1 03
				15 00 00 00 01 00 02 E2 6D
				15 00 00 00 01 00 02 E3 03
				15 00 00 00 01 00 02 E4 89
				15 00 00 00 01 00 02 E5 03
				15 00 00 00 01 00 02 E6 A3
				15 00 00 00 01 00 02 E7 03
				15 00 00 00 01 00 02 E8 C9
				15 00 00 00 01 00 02 E9 03
				15 00 00 00 01 00 02 EA DD
				15 00 00 00 01 00 02 EB 03
				15 01 00 00 01 00 02 EC F5
				15 00 00 00 01 00 02 ED 03
				15 00 00 00 01 00 02 EE FF
				15 00 00 00 01 00 02 EF 00
				15 00 00 00 01 00 02 F0 66
				15 00 00 00 01 00 02 F1 00
				15 00 00 00 01 00 02 F2 75
				15 00 00 00 01 00 02 F3 00
				15 00 00 00 01 00 02 F4 90
				15 00 00 00 01 00 02 F5 00
				15 00 00 00 01 00 02 F6 A6
				15 00 00 00 01 00 02 F7 00
				15 00 00 00 01 00 02 F8 BA
				15 00 00 00 01 00 02 F9 00
				15 00 00 00 01 00 02 FA CB
				15 01 00 00 01 00 02 FF 02
				15 00 00 00 01 00 02 FB 01
				15 00 00 00 01 00 02 00 00
				15 00 00 00 01 00 02 01 DB
				15 00 00 00 01 00 02 02 00
				15 00 00 00 01 00 02 03 EA
				15 00 00 00 01 00 02 04 00
				15 00 00 00 01 00 02 05 F7
				15 00 00 00 01 00 02 06 01
				15 00 00 00 01 00 02 07 24
				15 00 00 00 01 00 02 08 01
				15 00 00 00 01 00 02 09 46
				15 00 00 00 01 00 02 0A 01
				15 00 00 00 01 00 02 0B 7C
				15 00 00 00 01 00 02 0C 01
				15 01 00 00 01 00 02 0D A5
				15 00 00 00 01 00 02 0E 01
				15 00 00 00 01 00 02 0F E3
				15 00 00 00 01 00 02 10 02
				15 00 00 00 01 00 02 11 15
				15 00 00 00 01 00 02 12 02
				15 00 00 00 01 00 02 13 17
				15 00 00 00 01 00 02 14 02
				15 00 00 00 01 00 02 15 47
				15 00 00 00 01 00 02 16 02
				15 00 00 00 01 00 02 17 81
				15 00 00 00 01 00 02 18 02
				15 00 00 00 01 00 02 19 A8
				15 00 00 00 01 00 02 1A 02
				15 00 00 00 01 00 02 1B DD
				15 00 00 00 01 00 02 1C 03
				15 00 00 00 01 00 02 1D 03
				15 00 00 00 01 00 02 1E 03
				15 00 00 00 01 00 02 1F 3B
				15 00 00 00 01 00 02 20 03
				15 00 00 00 01 00 02 21 52
				15 00 00 00 01 00 02 22 03
				15 00 00 00 01 00 02 23 6D
				15 00 00 00 01 00 02 24 03
				15 00 00 00 01 00 02 25 89
				15 00 00 00 01 00 02 26 03
				15 00 00 00 01 00 02 27 A3
				15 00 00 00 01 00 02 28 03
				15 00 00 00 01 00 02 29 C9
				15 00 00 00 01 00 02 2A 03
				15 00 00 00 01 00 02 2B DD
				15 00 00 00 01 00 02 2D 03
				15 00 00 00 01 00 02 2F F5
				15 00 00 00 01 00 02 30 03
				15 00 00 00 01 00 02 31 FF
				15 00 00 00 01 00 02 32 00
				15 00 00 00 01 00 02 33 66
				15 00 00 00 01 00 02 34 00
				15 00 00 00 01 00 02 35 75
				15 00 00 00 01 00 02 36 00
				15 01 00 00 01 00 02 37 90
				15 00 00 00 01 00 02 38 00
				15 00 00 00 01 00 02 39 A6
				15 00 00 00 01 00 02 3A 00
				15 00 00 00 01 00 02 3B BA
				15 00 00 00 01 00 02 3D 00
				15 00 00 00 01 00 02 3F CB
				15 00 00 00 01 00 02 40 00
				15 00 00 00 01 00 02 41 DB
				15 00 00 00 01 00 02 42 00
				15 00 00 00 01 00 02 43 EA
				15 00 00 00 01 00 02 44 00
				15 00 00 00 01 00 02 45 F7
				15 00 00 00 01 00 02 46 01
				15 00 00 00 01 00 02 47 24
				15 00 00 00 01 00 02 48 01
				15 00 00 00 01 00 02 49 46
				15 00 00 00 01 00 02 4A 01
				15 00 00 00 01 00 02 4B 7C
				15 00 00 00 01 00 02 4C 01
				15 00 00 00 01 00 02 4D A5
				15 00 00 00 01 00 02 4E 01
				15 00 00 00 01 00 02 4F E3
				15 00 00 00 01 00 02 50 02
				15 00 00 00 01 00 02 51 15
				15 00 00 00 01 00 02 52 02
				15 00 00 00 01 00 02 53 17
				15 00 00 00 01 00 02 54 02
				15 00 00 00 01 00 02 55 47
				15 00 00 00 01 00 02 56 02
				15 00 00 00 01 00 02 58 81
				15 00 00 00 01 00 02 59 02
				15 00 00 00 01 00 02 5A A8
				15 00 00 00 01 00 02 5B 02
				15 00 00 00 01 00 02 5C DD
				15 00 00 00 01 00 02 5D 03
				15 00 00 00 01 00 02 5E 03
				15 00 00 00 01 00 02 5F 03
				15 00 00 00 01 00 02 60 3B
				15 00 00 00 01 00 02 61 03
				15 01 00 00 01 00 02 62 52
				15 00 00 00 01 00 02 63 03
				15 00 00 00 01 00 02 64 6D
				15 00 00 00 01 00 02 65 03
				15 00 00 00 01 00 02 66 89
				15 00 00 00 01 00 02 67 03
				15 00 00 00 01 00 02 68 A3
				15 00 00 00 01 00 02 69 03
				15 00 00 00 01 00 02 6A C9
				15 00 00 00 01 00 02 6B 03
				15 00 00 00 01 00 02 6C DD
				15 00 00 00 01 00 02 6D 03
				15 00 00 00 01 00 02 6E F5
				15 00 00 00 01 00 02 6F 03
				15 00 00 00 01 00 02 70 FF
				15 00 00 00 01 00 02 71 01
				15 00 00 00 01 00 02 72 b6
				15 00 00 00 01 00 02 73 01
				15 00 00 00 01 00 02 74 b8
				15 00 00 00 01 00 02 75 01
				15 00 00 00 01 00 02 76 bb
				15 00 00 00 01 00 02 77 01
				15 00 00 00 01 00 02 78 bd
				15 00 00 00 01 00 02 79 01
				15 00 00 00 01 00 02 7A c0
				15 00 00 00 01 00 02 7B 01
				15 00 00 00 01 00 02 7C c2
				15 00 00 00 01 00 02 7D 01
				15 00 00 00 01 00 02 7E c5
				15 00 00 00 01 00 02 7F 01
				15 00 00 00 01 00 02 80 c8
				15 00 00 00 01 00 02 81 01
				15 00 00 00 01 00 02 82 ca
				15 00 00 00 01 00 02 83 01
				15 00 00 00 01 00 02 84 d5
				15 00 00 00 01 00 02 85 01
				15 00 00 00 01 00 02 86 df
				15 00 00 00 01 00 02 87 01
				15 00 00 00 01 00 02 88 f2
				15 01 00 00 01 00 02 89 02
				15 00 00 00 01 00 02 8A 04
				15 00 00 00 01 00 02 8B 02
				15 00 00 00 01 00 02 8C 26
				15 00 00 00 01 00 02 8D 02
				15 00 00 00 01 00 02 8E 4a
				15 00 00 00 01 00 02 8F 02
				15 00 00 00 01 00 02 90 4b
				15 00 00 00 01 00 02 91 02
				15 00 00 00 01 00 02 92 74
				15 00 00 00 01 00 02 93 02
				15 00 00 00 01 00 02 94 ac
				15 00 00 00 01 00 02 95 02
				15 00 00 00 01 00 02 96 d3
				15 00 00 00 01 00 02 97 03
				15 00 00 00 01 00 02 98 0b
				15 00 00 00 01 00 02 99 03
				15 00 00 00 01 00 02 9A 31
				15 00 00 00 01 00 02 9B 03
				15 00 00 00 01 00 02 9C 7e
				15 00 00 00 01 00 02 9D 03
				15 00 00 00 01 00 02 9E b0
				15 00 00 00 01 00 02 9F 03
				15 00 00 00 01 00 02 A0 DB
				15 00 00 00 01 00 02 A2 03
				15 00 00 00 01 00 02 A3 E3
				15 00 00 00 01 00 02 A4 03
				15 00 00 00 01 00 02 A5 E7
				15 00 00 00 01 00 02 A6 03
				15 00 00 00 01 00 02 A7 ED
				15 00 00 00 01 00 02 A9 03
				15 00 00 00 10 00 02 AA F0
				15 00 00 00 01 00 02 AB 03
				15 00 00 00 01 00 02 AC F5
				15 00 00 00 01 00 02 AD 03
				15 00 00 00 01 00 02 AE FF
				15 00 00 00 01 00 02 AF 01
				15 00 00 00 01 00 02 B0 b6
				15 00 00 00 01 00 02 B1 01
				15 00 00 00 01 00 02 B2 b8
				15 00 00 00 01 00 02 B3 01
				15 01 00 00 01 00 02 B4 bb
				15 00 00 00 01 00 02 B5 01
				15 00 00 00 01 00 02 B6 bd
				15 00 00 00 01 00 02 B7 01
				15 00 00 00 01 00 02 B8 c0
				15 00 00 00 01 00 02 B9 01
				15 00 00 00 01 00 02 BA c2
				15 00 00 00 01 00 02 BB 01
				15 00 00 00 01 00 02 BC c5
				15 00 00 00 01 00 02 BD 01
				15 00 00 00 01 00 02 BE c8
				15 00 00 00 01 00 02 BF 01
				15 00 00 00 01 00 02 C0 ca
				15 00 00 00 01 00 02 C1 01
				15 00 00 00 01 00 02 C2 d5
				15 00 00 00 01 00 02 C3 01
				15 00 00 00 01 00 02 C4 df
				15 00 00 00 01 00 02 C5 01
				15 00 00 00 01 00 02 C6 f2
				15 00 00 00 01 00 02 C7 02
				15 00 00 00 01 00 02 C8 04
				15 00 00 00 01 00 02 C9 02
				15 00 00 00 01 00 02 CA 26
				15 00 00 00 01 00 02 CB 02
				15 00 00 00 01 00 02 CC 4a
				15 00 00 00 01 00 02 CD 02
				15 00 00 00 01 00 02 CE 4c
				15 00 00 00 01 00 02 CF 02
				15 00 00 00 01 00 02 D0 74
				15 00 00 00 01 00 02 D1 02
				15 00 00 00 01 00 02 D2 ac
				15 00 00 00 01 00 02 D3 02
				15 00 00 00 01 00 02 D4 d3
				15 00 00 00 01 00 02 D5 03
				15 00 00 00 01 00 02 D6 0b
				15 00 00 00 01 00 02 D7 03
				15 00 00 00 01 00 02 D8 31
				15 00 00 00 01 00 02 D9 03
				15 00 00 00 01 00 02 DA 7e
				15 00 00 00 01 00 02 DB 03
				15 01 00 00 01 00 02 DC b0
				15 00 00 00 01 00 02 DD 03
				15 00 00 00 01 00 02 DE DB
				15 00 00 00 01 00 02 DF 03
				15 00 00 00 01 00 02 E0 E3
				15 00 00 00 01 00 02 E1 03
				15 00 00 00 01 00 02 E2 E7
				15 00 00 00 01 00 02 E3 03
				15 00 00 00 01 00 02 E4 ED
				15 00 00 00 01 00 02 E5 03
				15 00 00 00 01 00 02 E6 F0
				15 00 00 00 01 00 02 E7 03
				15 00 00 00 01 00 02 E8 F5
				15 00 00 00 01 00 02 E9 03
				15 00 00 00 01 00 02 EA FF
				15 01 00 00 01 00 02 FF 00
			];
		qcom,mdss-dsi-dispparam-papermode7-command-state = "dsi_hs_mode";
		};
	};

