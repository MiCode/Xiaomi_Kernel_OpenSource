/* Copyright (c) 2013, The Linux Foundation. All rights reserved.
 * Copyright (C) 2016 XiaoMi, Inc.
 *
 * This program is free software; you can redistribute it and/or modify
 * it under the terms of the GNU General Public License version 2 and
 * only version 2 as published by the Free Software Foundation.
 *
 * This program is distributed in the hope that it will be useful,
 * but WITHOUT ANY WARRANTY; without even the implied warranty of
 * MERCHANTABILITY or FITNESS FOR A PARTICULAR PURPOSE.  See the
 * GNU General Public License for more details.
 */

/*---------------------------------------------------------------------------
 * This file is autogenerated file using gcdb parser. Please do not edit it.
 * Update input XML file to add a new entry or update variable in this file
 * VERSION = "1.0"
 *---------------------------------------------------------------------------*/
&mdss_mdp {
	dsi_otm1285a_tianma_720p_video: qcom,mdss_dsi_otm1285a_tianma_720p_video {
		qcom,mdss-dsi-panel-name = "otm1285a_720p_video_TIANMA";
		qcom,mdss-dsi-panel-controller = <&mdss_dsi0>;
		qcom,mdss-dsi-panel-type = "dsi_video_mode";
		qcom,mdss-dsi-panel-destination = "display_1";
		qcom,mdss-dsi-panel-framerate = <60>;
		qcom,mdss-dsi-virtual-channel-id = <0>;
		qcom,mdss-dsi-stream = <0>;
		qcom,mdss-dsi-panel-width = <720>;
		qcom,mdss-dsi-panel-height = <1280>;
		qcom,mdss-pan-physical-width-dimension = <62>;
		qcom,mdss-pan-physical-height-dimension = <110>;
		qcom,mdss-dsi-h-front-porch = <180>;
		qcom,mdss-dsi-h-back-porch = <180>;
		qcom,mdss-dsi-h-pulse-width = <2>;
		qcom,mdss-dsi-h-sync-skew = <0>;
		qcom,mdss-dsi-v-back-porch = <16>;
		qcom,mdss-dsi-v-front-porch = <104>;
		qcom,mdss-dsi-v-pulse-width = <2>;
		qcom,mdss-dsi-h-left-border = <0>;
		qcom,mdss-dsi-h-right-border = <0>;
		qcom,mdss-dsi-v-top-border = <0>;
		qcom,mdss-dsi-v-bottom-border = <0>;
		qcom,mdss-dsi-bpp = <24>;
		qcom,mdss-dsi-color-order = "rgb_swap_rgb";
		qcom,mdss-dsi-underflow-color = <0xff>;
		qcom,mdss-dsi-border-color = <0>;
		qcom,mdss-dsi-on-command = [29 01 00 00 00 00 02 00 00
				29 01 00 00 00 00 04 FF 12 85 01
				29 01 00 00 00 00 02 00 80
				29 01 00 00 00 00 03 FF 12 85
				29 01 00 00 00 00 02 00 a2
				29 01 00 00 00 00 02 c1 21
				29 01 00 00 00 00 02 00 90
				29 01 00 00 00 00 02 b0 00
				29 01 00 00 00 00 02 00 00
				29 01 00 00 00 00 02 59 03
				29 01 00 00 00 00 02 35 01
				29 01 00 00 00 00 02 00 00
				05 01 00 00 78 00 02 11 00
				29 01 00 00 00 00 02 00 00
				05 01 00 00 20 00 02 29 00
				29 01 00 00 00 00 02 00 00
				29 01 00 00 00 00 03 99 00 00];
		qcom,mdss-dsi-off-command = [29 01 00 00 00 00 02 00 00
				29 01 00 00 00 00 03 99 95 27
				05 01 00 00 00 00 02 28 00
				05 01 00 00 78 00 02 10 00];
		qcom,mdss-dsi-on-command-state = "dsi_lp_mode";
		qcom,mdss-dsi-off-command-state = "dsi_hs_mode";
		qcom,mdss-dsi-panel-warm-command = [29 00 00 00 00 00 02 00 00
				29 01 00 00 00 00 19 E1 00 10 17 23 2C 33 3F 51 5B 6E 7B 85 73 6C 66 56 42 31 25 1E 14 0F 06 03
				29 00 00 00 00 00 02 00 00
				29 01 00 00 00 00 19 E2 00 10 17 23 2C 33 3F 51 5B 6E 7B 85 73 6C 66 56 42 31 25 1E 14 0F 06 03
				29 00 00 00 00 00 02 00 00
				29 01 00 00 00 00 19 E3 31 34 37 3D 42 47 4F 5B 63 73 7E 87 71 6B 65 56 42 31 24 1C 14 09 04 03
				29 00 00 00 00 00 02 00 00
				29 01 00 00 00 00 19 E4 31 34 37 3D 42 47 4F 5B 63 73 7E 87 71 6B 65 56 42 31 24 1C 14 09 04 03
				29 00 00 00 00 00 02 00 00
				29 01 00 00 00 00 19 E5 49 4A 4B 4F 52 54 59 63 69 76 7F 88 70 6A 65 55 43 31 25 1D 1A 17 09 03
				29 00 00 00 00 00 02 00 00
				29 01 00 00 00 00 19 E6 49 4A 4B 4F 52 54 59 63 69 76 7F 88 70 6A 65 55 43 31 25 1D 1A 17 09 03
				29 00 00 00 00 00 02 00 00
				29 01 00 00 00 00 02 FB 01];
		qcom,mdss-dsi-panel-cool-command = [29 00 00 00 00 00 02 00 00
				29 01 00 00 00 00 19 E1 4B 4D 4F 53 58 5A 60 6B 71 7E 87 8E 6A 64 5D 4C 38 26 1A 16 0D 05 04 03
				29 00 00 00 00 00 02 00 00
				29 01 00 00 00 00 19 E2 4B 4D 4F 53 58 5A 60 6B 71 7E 87 8E 6A 64 5D 4C 38 26 1A 16 0D 05 04 03
				29 00 00 00 00 00 02 00 00
				29 01 00 00 00 00 19 E3 33 36 39 3F 45 4A 52 5F 68 77 82 8B 6D 67 5F 50 3A 29 1C 15 0F 08 05 03
				29 00 00 00 00 00 02 00 00
				29 01 00 00 00 00 19 E4 33 36 39 3F 45 4A 52 5F 68 77 82 8B 6D 67 5F 50 3A 29 1C 15 0F 08 05 03
				29 00 00 00 00 00 02 00 00
				29 01 00 00 00 00 19 E5 00 08 0F 19 23 2A 37 4B 57 6C 7B 85 71 6A 62 51 3E 2C 18 0F 09 05 04 03
				29 00 00 00 00 00 02 00 00
				29 01 00 00 00 00 19 E6 00 08 0F 19 23 2A 37 4B 57 6C 7B 85 71 6A 62 51 3E 2C 18 0F 09 05 04 03
				29 00 00 00 00 00 02 00 00
				29 01 00 00 00 00 02 FB 01];
		  qcom,mdss-dsi-panel-nature-command = [29 00 00 00 00 00 02 00 00
				29 01 00 00 00 00 19 E1 00 0D 16 23 2D 34 41 54 5F 72 7F 89 6F 67 60 4F 3A 29 1B 17 0E 05 04 03
				29 00 00 00 00 00 02 00 00
				29 01 00 00 00 00 19 E2 00 0D 16 23 2D 34 41 54 5F 72 7F 89 6F 67 60 4F 3A 29 1B 17 0E 05 04 03
				29 00 00 00 00 00 02 00 00
				29 01 00 00 00 00 19 E3 05 10 18 23 2D 34 40 53 5E 71 7E 88 6F 68 61 51 3B 2A 1D 16 0F 08 05 03
				29 00 00 00 00 00 02 00 00
				29 01 00 00 00 00 19 E4 05 10 18 23 2D 34 40 53 5E 71 7E 88 6F 68 61 51 3B 2A 1D 16 0F 08 05 03
				29 00 00 00 00 00 02 00 00
				29 01 00 00 00 00 19 E5 06 0E 14 1D 26 2C 39 4D 58 6C 7B 86 71 6A 62 51 3E 2C 18 0F 09 05 04 03
				29 00 00 00 00 00 02 00 00
				29 01 00 00 00 00 19 E6 06 0E 14 1D 26 2C 39 4D 58 6C 7B 86 71 6A 62 51 3E 2C 18 0F 09 05 04 03
				29 00 00 00 00 00 02 00 00
				29 01 00 00 00 00 02 FB 01];
	  	qcom,mdss-dsi-panel-gamma-command-state = "dsi_lp_mode";
	  	qcom,mdss-dsi-panel-ce-std-command = [29 01 00 00 00 00 02 00 80
				29 01 00 00 00 00 02 D6 88
				29 01 00 00 00 00 02 00 A3
				29 01 00 00 00 00 02 B6 03
				29 01 00 00 00 00 02 00 A0
				29 01 00 00 00 00 0D D6 00 00 00 00 00 00 00 00 00 00 00 00
				29 01 00 00 00 00 02 00 B0
				29 01 00 00 00 00 0D D6 00 00 00 00 00 00 00 00 00 00 00 00
				29 01 00 00 00 00 02 00 C0
				29 01 00 00 00 00 0D D6 00 00 00 00 00 00 00 00 00 00 00 00
				29 01 00 00 00 00 02 00 D0
				29 01 00 00 00 00 0D D6 00 00 00 00 00 00 00 00 00 00 00 00
				29 01 00 00 00 00 02 00 00
				29 01 00 00 00 00 02 FB 01];
	 	qcom,mdss-dsi-panel-ce-vivid-command = [29 01 00 00 00 00 02 00 80
				29 01 00 00 00 00 02 D6 88
				29 01 00 00 00 00 02 00 A3
				29 01 00 00 00 00 02 B6 03
				29 01 00 00 00 00 02 00 A0
				29 01 00 00 00 00 0D D6 00 00 00 00 00 00 00 00 00 00 00 00
				29 01 00 00 00 00 02 00 B0
				29 01 00 00 00 00 0D D6 00 00 54 c5 e1 c5 a9 c5 e1 c5 a9 8d
				29 01 00 00 00 00 02 00 C0
				29 01 00 00 00 00 0D D6 26 00 71 83 96 83 71 83 96 83 71 5e
				29 01 00 00 00 00 02 00 D0
				29 01 00 00 00 00 0D D6 26 2f 38 42 4b 42 38 42 4b 42 38 2f
				29 01 00 00 00 00 02 00 00
				29 01 00 00 00 00 02 FB 01];
		qcom,mdss-dsi-panel-ce-command-state = "dsi_lp_mode";
		qcom,mdss-dsi-h-sync-pulse = <10>;
		qcom,mdss-dsi-traffic-mode = "non_burst_sync_event";
		qcom,mdss-dsi-bllp-eof-power-mode;
		qcom,mdss-dsi-bllp-power-mode;
		qcom,mdss-dsi-lane-0-state;
		qcom,mdss-dsi-lane-1-state;
		qcom,mdss-dsi-lane-2-state;
		qcom,mdss-dsi-lane-3-state;
		qcom,mdss-dsi-hfp-power-mode;
		qcom,mdss-dsi-hbp-power-mode;
		qcom,mdss-dsi-hsa-power-mode;
		qcom,esd-check-enabled;
		qcom,mdss-dsi-panel-status-command-num = <1>;
		qcom,mdss-dsi-panel-status-command1 = [06 01 00 01 00 00 02 0A 08];
		qcom,mdss-dsi-panel-status-command-state = "dsi_hs_mode";
		qcom,mdss-dsi-panel-status-check-mode = "reg_read";
		qcom,mdss-dsi-panel-status-value1 = <1 0x9c>;
		qcom,mdss-dsi-panel-timings = [98 22 16 00 4A 4E 1A 26 1A 03 04 00];
		qcom,mdss-dsi-t-clk-post = <0x04>;
		qcom,mdss-dsi-t-clk-pre = <0x1E>;
		qcom,mdss-dsi-bl-min-level = <4>;
		qcom,mdss-dsi-bl-max-level = <255>;
		qcom,mdss-dsi-bl-pmic-pwm-frequency = <100>;
		qcom,mdss-dsi-bl-pmic-bank-select = <0>;
		qcom,mdss-dsi-dma-trigger = "trigger_sw";
		qcom,mdss-dsi-mdp-trigger = "none";
		qcom,mdss-dsi-bl-pmic-control-type = "bl_ctrl_pwm";
		qcom,mdss-dsi-reset-sequence = <1 5>, <0 5>, <1 10>;
		qcom,mdss-dsi-lp11-init;
		qcom,mdss-dsi-init-delay-us = <50000>;
	};
};
