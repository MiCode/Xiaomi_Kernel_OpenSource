/* Copyright (c) 2012-2015, The Linux Foundation. All rights reserved.
 * Copyright (C) 2018 XiaoMi, Inc.
 *
 * This program is free software; you can redistribute it and/or modify
 * it under the terms of the GNU General Public License version 2 and
 * only version 2 as published by the Free Software Foundation.
 *
 * This program is distributed in the hope that it will be useful,
 * but WITHOUT ANY WARRANTY; without even the implied warranty of
 * MERCHANTABILITY or FITNESS FOR A PARTICULAR PURPOSE.  See the
 * GNU General Public License for more details.
 */

&mdss_mdp {
	dsi_nt35596_tianma_fhd_vid: qcom,mdss_dsi_nt35596_tianma_fhd_video {
		qcom,mdss-dsi-panel-name = "nt35596 tianma fhd video mode dsi panel";
		qcom,mdss-dsi-panel-type = "dsi_video_mode";
		qcom,mdss-dsi-panel-framerate = <60>;
		qcom,mdss-dsi-virtual-channel-id = <0>;
		qcom,mdss-dsi-stream = <0>;
		qcom,mdss-dsi-panel-width = <1080>;
		qcom,mdss-dsi-panel-height = <1920>;
		qcom,mdss-dsi-h-front-porch = <96>;
		qcom,mdss-dsi-h-back-porch = <64>;
		qcom,mdss-dsi-h-pulse-width = <16>;
		qcom,mdss-dsi-h-sync-skew = <0>;
		qcom,mdss-dsi-v-back-porch = <4>;
		qcom,mdss-dsi-v-front-porch = <14>;
		qcom,mdss-dsi-v-pulse-width = <2>;
		qcom,mdss-dsi-h-left-border = <0>;
		qcom,mdss-dsi-h-right-border = <0>;
		qcom,mdss-dsi-v-top-border = <0>;
		qcom,mdss-dsi-v-bottom-border = <0>;
		qcom,mdss-dsi-bpp = <24>;
		qcom,mdss-dsi-underflow-color = <0xff>;
		qcom,mdss-dsi-border-color = <0>;
		qcom,mdss-dsi-on-command = [29 01 00 00 01 00 02 ff 04
				29 01 00 00 00 00 02 fb 01
				29 01 00 00 00 00 02 08 05
				29 01 00 00 01 00 02 ff 00
				29 01 00 00 00 00 02 fb 01
				29 01 00 00 00 00 02 35 00
				29 01 00 00 00 00 02 36 00
				29 01 00 00 00 00 02 51 ff
				29 01 00 00 00 00 02 53 2c
				29 01 00 00 00 00 02 55 00
				29 01 00 00 00 00 02 d3 06
				29 01 00 00 00 00 02 d4 0e
				29 01 00 00 00 00 02 ff 01
				29 01 00 00 00 00 02 fb 01
				29 01 00 00 00 00 02 72 21
				29 01 00 00 00 00 02 6D 33
				29 01 00 00 00 00 02 FF 05
				29 01 00 00 00 00 02 Fb 01
				29 01 00 00 00 00 02 E7 80
				29 01 00 00 00 00 02 FF 00
				29 01 00 00 78 00 02 11 00
				29 01 00 00 14 00 02 29 00];
		qcom,mdss-dsi-off-command = [29 01 00 00 00 00 02 FF 00
				05 01 00 00 14 00 02 28 00
				05 01 00 00 3C 00 02 10 00];
		qcom,mdss-dsi-CABC_on-command = [29 01 00 00 00 00 02 ff 00
				29 01 00 00 00 00 02 55 B1];
		qcom,mdss-dsi-CABC_off-command = [29 01 00 00 00 00 02 ff 00
				29 01 00 00 00 00 02 55 00];
		qcom,mdss-dsi-CE_off-command = [29 01 00 00 00 00 02 ff 00
				29 01 00 00 00 00 02 55 00];
		qcom,mdss-dsi-CE_on-command = [

				23 00 00 00 00 00 02 FF 03
				23 00 00 00 00 00 02 FB 01

				23 00 00 00 00 00 02 00 00
				23 00 00 00 00 00 02 01 0D
				23 00 00 00 00 00 02 02 15
				23 00 00 00 00 00 02 03 1C
				23 00 00 00 00 00 02 04 21
				23 00 00 00 00 00 02 05 26
				23 00 00 00 00 00 02 06 2B
				23 00 00 00 00 00 02 07 2C
				23 00 00 00 00 00 02 08 2D
				23 00 00 00 00 00 02 09 2D
				23 00 00 00 00 00 02 0A 2D
				23 00 00 00 00 00 02 0B 2D
				23 00 00 00 00 00 02 0C 2C
				23 00 00 00 00 00 02 0D 2A
				23 00 00 00 00 00 02 0E 27
				23 00 00 00 00 00 02 0F 23
				23 00 00 00 00 00 02 10 1D
				23 00 00 00 00 00 02 11 17
				23 00 00 00 00 00 02 12 0B
				23 00 00 00 00 00 02 13 00
				23 00 00 00 00 00 02 1A 00
				23 00 00 00 00 00 02 1B 00
				23 00 00 00 00 00 02 1C 00
				23 00 00 00 00 00 02 1D 00
				23 00 00 00 00 00 02 1E 00
				23 00 00 00 00 00 02 1F 00
				23 00 00 00 00 00 02 20 00
				23 00 00 00 00 00 02 21 00
				23 00 00 00 00 00 02 22 00
				23 00 00 00 00 00 02 23 00
				23 00 00 00 00 00 02 24 00
				23 00 00 00 00 00 02 25 00
				23 00 00 00 00 00 02 26 00
				23 00 00 00 00 00 02 27 00
				23 00 00 00 00 00 02 28 00
				23 01 00 00 00 00 02 29 00

				23 00 00 00 00 00 02 2A 00
				23 00 00 00 00 00 02 2B 00
				23 00 00 00 00 00 02 2F 00
				23 00 00 00 00 00 02 30 00
				23 00 00 00 00 00 02 31 00
				23 00 00 00 00 00 02 32 85
				23 00 00 00 00 00 02 33 07
				23 00 00 00 00 00 02 34 0A
				23 00 00 00 00 00 02 35 0D
				23 00 00 00 00 00 02 36 12
				23 00 00 00 00 00 02 37 16
				23 00 00 00 00 00 02 38 1B
				23 00 00 00 00 00 02 39 1D
				23 00 00 00 00 00 02 3A 1C
				23 00 00 00 00 00 02 3B 1B
				23 00 00 00 00 00 02 3F 18
				23 00 00 00 00 00 02 40 14
				23 00 00 00 00 00 02 41 13
				23 00 00 00 00 00 02 42 12
				23 00 00 00 00 00 02 43 13
				23 00 00 00 00 00 02 44 13
				23 00 00 00 00 00 02 45 11
				23 00 00 00 00 00 02 46 0D
				23 00 00 00 00 00 02 47 09
				23 00 00 00 00 00 02 48 07
				23 00 00 00 00 00 02 49 07
				23 00 00 00 00 00 02 4A 07
				23 00 00 00 00 00 02 4B 06
				23 00 00 00 00 00 02 4C 06
				23 00 00 00 00 00 02 4D 00
				23 00 00 00 00 00 02 4E 00
				23 00 00 00 00 00 02 4F 00
				23 00 00 00 00 00 02 50 00
				23 00 00 00 00 00 02 51 00
				23 00 00 00 00 00 02 52 00
				23 00 00 00 00 00 02 53 05
				23 00 00 00 00 00 02 54 04
				23 00 00 00 00 00 02 55 04
				23 00 00 00 00 00 02 5B 00
				23 01 00 00 00 00 02 63 00

				23 00 00 00 00 00 02 FF 00
				23 00 00 00 00 00 02 FB 01

				23 00 00 00 00 00 02 55 B0];

		qcom,mdss-dsi-cold_gamma-command = [23 00 00 00 00 00 02 FF 01
				23 00 00 00 00 00 02 FB 01
				23 00 00 00 00 00 02 75 00
				23 00 00 00 00 00 02 76 F6
				23 00 00 00 00 00 02 77 00
				23 00 00 00 00 00 02 78 FE
				23 00 00 00 00 00 02 79 01
				23 00 00 00 00 00 02 7A 0E
				23 00 00 00 00 00 02 7B 01
				23 00 00 00 00 00 02 7C 1C
				23 00 00 00 00 00 02 7D 01
				23 00 00 00 00 00 02 7E 2A
				23 00 00 00 00 00 02 7F 01
				23 00 00 00 00 00 02 80 36
				23 00 00 00 00 00 02 81 01
				23 00 00 00 00 00 02 82 41
				23 00 00 00 00 00 02 83 01
				23 00 00 00 00 00 02 84 4B
				23 00 00 00 00 00 02 85 01
				23 00 00 00 00 00 02 86 55
				23 00 00 00 00 00 02 87 01
				23 00 00 00 00 00 02 88 77
				23 00 00 00 00 00 02 89 01
				23 00 00 00 00 00 02 8A 93
				23 00 00 00 00 00 02 8B 01
				23 00 00 00 00 00 02 8C BE
				23 00 00 00 00 00 02 8D 01
				23 00 00 00 00 00 02 8E E0
				23 00 00 00 00 00 02 8F 02
				23 00 00 00 00 00 02 90 14
				23 00 00 00 00 00 02 91 02
				23 01 00 00 00 00 02 92 41
				23 00 00 00 00 00 02 93 02
				23 00 00 00 00 00 02 94 43
				23 00 00 00 00 00 02 95 02
				23 00 00 00 00 00 02 96 71
				23 00 00 00 00 00 02 97 02
				23 00 00 00 00 00 02 98 AC
				23 00 00 00 00 00 02 99 02
				23 00 00 00 00 00 02 9A D5
				23 00 00 00 00 00 02 9B 03
				23 00 00 00 00 00 02 9C 0C
				23 00 00 00 00 00 02 9D 03
				23 00 00 00 00 00 02 9E 30
				23 00 00 00 00 00 02 9F 03
				23 00 00 00 00 00 02 A0 59
				23 00 00 00 00 00 02 A2 03
				23 00 00 00 00 00 02 A3 6A
				23 00 00 00 00 00 02 A4 03
				23 00 00 00 00 00 02 A5 75
				23 00 00 00 00 00 02 A6 03
				23 00 00 00 00 00 02 A7 84
				23 00 00 00 00 00 02 A9 03
				23 00 00 00 00 00 02 AA 90
				23 00 00 00 00 00 02 AB 03
				23 00 00 00 00 00 02 AC A3
				23 00 00 00 00 00 02 AD 03
				23 00 00 00 00 00 02 AE A7
				23 00 00 00 00 00 02 AF 03
				23 00 00 00 00 00 02 B0 A9
				23 00 00 00 00 00 02 B1 03
				23 01 00 00 00 00 02 B2 AD

				23 00 00 00 00 00 02 B3 00
				23 00 00 00 00 00 02 B4 F6
				23 00 00 00 00 00 02 B5 00
				23 00 00 00 00 00 02 B6 FE
				23 00 00 00 00 00 02 B7 01
				23 00 00 00 00 00 02 B8 0E
				23 00 00 00 00 00 02 B9 01
				23 00 00 00 00 00 02 BA 1C
				23 00 00 00 00 00 02 BB 01
				23 00 00 00 00 00 02 BC 2A
				23 00 00 00 00 00 02 BD 01
				23 00 00 00 00 00 02 BE 36
				23 00 00 00 00 00 02 BF 01
				23 00 00 00 00 00 02 C0 41
				23 00 00 00 00 00 02 C1 01
				23 00 00 00 00 00 02 C2 4B
				23 00 00 00 00 00 02 C3 01
				23 00 00 00 00 00 02 C4 55
				23 00 00 00 00 00 02 C5 01
				23 00 00 00 00 00 02 C6 77
				23 00 00 00 00 00 02 C7 01
				23 00 00 00 00 00 02 C8 93
				23 00 00 00 00 00 02 C9 01
				23 00 00 00 00 00 02 CA BE
				23 00 00 00 00 00 02 CB 01
				23 00 00 00 00 00 02 CC E0
				23 00 00 00 00 00 02 CD 02
				23 00 00 00 00 00 02 CE 14
				23 00 00 00 00 00 02 CF 02
				23 01 00 00 00 00 02 D0 41
				23 00 00 00 00 00 02 D1 02
				23 00 00 00 00 00 02 D2 43
				23 00 00 00 00 00 02 D3 02
				23 00 00 00 00 00 02 D4 71
				23 00 00 00 00 00 02 D5 02
				23 00 00 00 00 00 02 D6 AC
				23 00 00 00 00 00 02 D7 02
				23 00 00 00 00 00 02 D8 D5
				23 00 00 00 00 00 02 D9 03
				23 00 00 00 00 00 02 DA 0C
				23 00 00 00 00 00 02 DB 03
				23 00 00 00 00 00 02 DC 30
				23 00 00 00 00 00 02 DD 03
				23 00 00 00 00 00 02 DE 59
				23 00 00 00 00 00 02 DF 03
				23 00 00 00 00 00 02 E0 6A
				23 00 00 00 00 00 02 E1 03
				23 00 00 00 00 00 02 E2 75
				23 00 00 00 00 00 02 E3 03
				23 00 00 00 00 00 02 E4 84
				23 00 00 00 00 00 02 E5 03
				23 00 00 00 00 00 02 E6 90
				23 00 00 00 00 00 02 E7 03
				23 00 00 00 00 00 02 E8 A3
				23 00 00 00 00 00 02 E9 03
				23 00 00 00 00 00 02 EA A7
				23 00 00 00 00 00 02 EB 03
				23 00 00 00 00 00 02 EC A9
				23 00 00 00 00 00 02 ED 03
				23 01 00 00 00 00 02 EE AD

				23 00 00 00 00 00 02 EF 00
				23 00 00 00 00 00 02 F0 B5
				23 00 00 00 00 00 02 F1 00
				23 00 00 00 00 00 02 F2 C0
				23 00 00 00 00 00 02 F3 00
				23 00 00 00 00 00 02 F4 D5
				23 00 00 00 00 00 02 F5 00
				23 00 00 00 00 00 02 F6 EA
				23 00 00 00 00 00 02 F7 00
				23 00 00 00 00 00 02 F8 FE
				23 00 00 00 00 00 02 F9 01
				23 00 00 00 00 00 02 FA 11
				23 00 00 00 00 00 02 FF 02
				23 00 00 00 00 00 02 FB 01
				23 00 00 00 00 00 02 00 01
				23 00 00 00 00 00 02 01 20
				23 00 00 00 00 00 02 02 01
				23 00 00 00 00 00 02 03 2D
				23 00 00 00 00 00 02 04 01
				23 00 00 00 00 00 02 05 3A
				23 00 00 00 00 00 02 06 01
				23 00 00 00 00 00 02 07 63
				23 00 00 00 00 00 02 08 01
				23 00 00 00 00 00 02 09 83
				23 00 00 00 00 00 02 0A 01
				23 00 00 00 00 00 02 0B B4
				23 00 00 00 00 00 02 0C 01
				23 00 00 00 00 00 02 0D D9
				23 00 00 00 00 00 02 0E 02
				23 00 00 00 00 00 02 0F 11
				23 00 00 00 00 00 02 10 02
				23 01 00 00 00 00 02 11 40
				23 00 00 00 00 00 02 12 02
				23 00 00 00 00 00 02 13 41
				23 00 00 00 00 00 02 14 02
				23 00 00 00 00 00 02 15 71
				23 00 00 00 00 00 02 16 02
				23 00 00 00 00 00 02 17 AE
				23 00 00 00 00 00 02 18 02
				23 00 00 00 00 00 02 19 D8
				23 00 00 00 00 00 02 1A 03
				23 00 00 00 00 00 02 1B 0F
				23 00 00 00 00 00 02 1C 03
				23 00 00 00 00 00 02 1D 33
				23 00 00 00 00 00 02 1E 03
				23 00 00 00 00 00 02 1F 5F
				23 00 00 00 00 00 02 20 03
				23 00 00 00 00 00 02 21 6B
				23 00 00 00 00 00 02 22 03
				23 00 00 00 00 00 02 23 79
				23 00 00 00 00 00 02 24 03
				23 00 00 00 00 00 02 25 89
				23 00 00 00 00 00 02 26 03
				23 00 00 00 00 00 02 27 99
				23 00 00 00 00 00 02 28 03
				23 00 00 00 00 00 02 29 AF
				23 00 00 00 00 00 02 2A 03
				23 00 00 00 00 00 02 2B C9
				23 00 00 00 00 00 02 2D 03
				23 00 00 00 00 00 02 2F D3
				23 00 00 00 00 00 02 30 03
				23 01 00 00 00 00 02 31 D4

				23 00 00 00 00 00 02 32 00
				23 00 00 00 00 00 02 33 B5
				23 00 00 00 00 00 02 34 00
				23 00 00 00 00 00 02 35 C0
				23 00 00 00 00 00 02 36 00
				23 00 00 00 00 00 02 37 D5
				23 00 00 00 00 00 02 38 00
				23 00 00 00 00 00 02 39 EA
				23 00 00 00 00 00 02 3A 00
				23 00 00 00 00 00 02 3B FE
				23 00 00 00 00 00 02 3D 01
				23 00 00 00 00 00 02 3F 11
				23 00 00 00 00 00 02 40 01
				23 00 00 00 00 00 02 41 20
				23 00 00 00 00 00 02 42 01
				23 00 00 00 00 00 02 43 2D
				23 00 00 00 00 00 02 44 01
				23 00 00 00 00 00 02 45 3A
				23 00 00 00 00 00 02 46 01
				23 00 00 00 00 00 02 47 63
				23 00 00 00 00 00 02 48 01
				23 00 00 00 00 00 02 49 83
				23 00 00 00 00 00 02 4A 01
				23 00 00 00 00 00 02 4B B4
				23 00 00 00 00 00 02 4C 01
				23 00 00 00 00 00 02 4D D9
				23 00 00 00 00 00 02 4E 02
				23 00 00 00 00 00 02 4F 11
				23 00 00 00 00 00 02 50 02
				23 01 00 00 00 00 02 51 40
				23 00 00 00 00 00 02 52 02
				23 00 00 00 00 00 02 53 41
				23 00 00 00 00 00 02 54 02
				23 00 00 00 00 00 02 55 71
				23 00 00 00 00 00 02 56 02
				23 00 00 00 00 00 02 58 AE
				23 00 00 00 00 00 02 59 02
				23 00 00 00 00 00 02 5A D8
				23 00 00 00 00 00 02 5B 03
				23 00 00 00 00 00 02 5C 0F
				23 00 00 00 00 00 02 5D 03
				23 00 00 00 00 00 02 5E 33
				23 00 00 00 00 00 02 5F 03
				23 00 00 00 00 00 02 60 5F
				23 00 00 00 00 00 02 61 03
				23 00 00 00 00 00 02 62 6B
				23 00 00 00 00 00 02 63 03
				23 00 00 00 00 00 02 64 79
				23 00 00 00 00 00 02 65 03
				23 00 00 00 00 00 02 66 89
				23 00 00 00 00 00 02 67 03
				23 00 00 00 00 00 02 68 99
				23 00 00 00 00 00 02 69 03
				23 00 00 00 00 00 02 6A AF
				23 00 00 00 00 00 02 6B 03
				23 00 00 00 00 00 02 6C C9
				23 00 00 00 00 00 02 6D 03
				23 00 00 00 00 00 02 6E D3
				23 00 00 00 00 00 02 6F 03
				23 01 00 00 00 00 02 70 D4

				23 00 00 00 00 00 02 71 00
				23 00 00 00 00 00 02 72 3A
				23 00 00 00 00 00 02 73 00
				23 00 00 00 00 00 02 74 5D
				23 00 00 00 00 00 02 75 00
				23 00 00 00 00 00 02 76 8E
				23 00 00 00 00 00 02 77 00
				23 00 00 00 00 00 02 78 B2
				23 00 00 00 00 00 02 79 00
				23 00 00 00 00 00 02 7A CE
				23 00 00 00 00 00 02 7B 00
				23 00 00 00 00 00 02 7C E6
				23 00 00 00 00 00 02 7D 00
				23 00 00 00 00 00 02 7E FA
				23 00 00 00 00 00 02 7F 01
				23 00 00 00 00 00 02 80 0C
				23 00 00 00 00 00 02 81 01
				23 00 00 00 00 00 02 82 1C
				23 00 00 00 00 00 02 83 01
				23 00 00 00 00 00 02 84 4E
				23 00 00 00 00 00 02 85 01
				23 00 00 00 00 00 02 86 74
				23 00 00 00 00 00 02 87 01
				23 00 00 00 00 00 02 88 AA
				23 00 00 00 00 00 02 89 01
				23 00 00 00 00 00 02 8A D2
				23 00 00 00 00 00 02 8B 02
				23 00 00 00 00 00 02 8C 0C
				23 00 00 00 00 00 02 8D 02
				23 01 00 00 00 00 02 8E 3C
				23 00 00 00 00 00 02 8F 02
				23 00 00 00 00 00 02 90 3D
				23 00 00 00 00 00 02 91 02
				23 00 00 00 00 00 02 92 6C
				23 00 00 00 00 00 02 93 02
				23 00 00 00 00 00 02 94 A8
				23 00 00 00 00 00 02 95 02
				23 00 00 00 00 00 02 96 D1
				23 00 00 00 00 00 02 97 03
				23 00 00 00 00 00 02 98 07
				23 00 00 00 00 00 02 99 03
				23 00 00 00 00 00 02 9A 2B
				23 00 00 00 00 00 02 9B 03
				23 00 00 00 00 00 02 9C 57
				23 00 00 00 00 00 02 9D 03
				23 00 00 00 00 00 02 9E 65
				23 00 00 00 00 00 02 9F 03
				23 00 00 00 00 00 02 A0 77
				23 00 00 00 00 00 02 A2 03
				23 00 00 00 00 00 02 A3 82
				23 00 00 00 00 00 02 A4 03
				23 00 00 00 00 00 02 A5 8A
				23 00 00 00 00 00 02 A6 03
				23 00 00 00 00 00 02 A7 90
				23 00 00 00 00 00 02 A9 03
				23 00 00 00 00 00 02 AA 93
				23 00 00 00 00 00 02 AB 03
				23 00 00 00 00 00 02 AC AC
				23 00 00 00 00 00 02 AD 03
				23 01 00 00 00 00 02 AE D4

				23 00 00 00 00 00 02 AF 00
				23 00 00 00 00 00 02 B0 3A
				23 00 00 00 00 00 02 B1 00
				23 00 00 00 00 00 02 B2 5D
				23 00 00 00 00 00 02 B3 00
				23 00 00 00 00 00 02 B4 8E
				23 00 00 00 00 00 02 B5 00
				23 00 00 00 00 00 02 B6 B2
				23 00 00 00 00 00 02 B7 00
				23 00 00 00 00 00 02 B8 CE
				23 00 00 00 00 00 02 B9 00
				23 00 00 00 00 00 02 BA E6
				23 00 00 00 00 00 02 BB 00
				23 00 00 00 00 00 02 BC FA
				23 00 00 00 00 00 02 BD 01
				23 00 00 00 00 00 02 BE 0C
				23 00 00 00 00 00 02 BF 01
				23 00 00 00 00 00 02 C0 1C
				23 00 00 00 00 00 02 C1 01
				23 00 00 00 00 00 02 C2 4E
				23 00 00 00 00 00 02 C3 01
				23 00 00 00 00 00 02 C4 74
				23 00 00 00 00 00 02 C5 01
				23 00 00 00 00 00 02 C6 AA
				23 00 00 00 00 00 02 C7 01
				23 00 00 00 00 00 02 C8 D2
				23 00 00 00 00 00 02 C9 02
				23 00 00 00 00 00 02 CA 0C
				23 00 00 00 00 00 02 CB 02
				23 01 00 00 00 00 02 CC 3C
				23 00 00 00 00 00 02 CD 02
				23 00 00 00 00 00 02 CE 3D
				23 00 00 00 00 00 02 CF 02
				23 00 00 00 00 00 02 D0 6C
				23 00 00 00 00 00 02 D1 02
				23 00 00 00 00 00 02 D2 A8
				23 00 00 00 00 00 02 D3 02
				23 00 00 00 00 00 02 D4 D1
				23 00 00 00 00 00 02 D5 03
				23 00 00 00 00 00 02 D6 07
				23 00 00 00 00 00 02 D7 03
				23 00 00 00 00 00 02 D8 2B
				23 00 00 00 00 00 02 D9 03
				23 00 00 00 00 00 02 DA 57
				23 00 00 00 00 00 02 DB 03
				23 00 00 00 00 00 02 DC 65
				23 00 00 00 00 00 02 DD 03
				23 00 00 00 00 00 02 DE 77
				23 00 00 00 00 00 02 DF 03
				23 00 00 00 00 00 02 E0 82
				23 00 00 00 00 00 02 E1 03
				23 00 00 00 00 00 02 E2 8A
				23 00 00 00 00 00 02 E3 03
				23 00 00 00 00 00 02 E4 90
				23 00 00 00 00 00 02 E5 03
				23 00 00 00 00 00 02 E6 93
				23 00 00 00 00 00 02 E7 03
				23 00 00 00 00 00 02 E8 AC
				23 00 00 00 00 00 02 E9 03
				23 01 00 00 00 00 02 EA D4];

		qcom,mdss-dsi-warm_gamma-command = [23 00 00 00 00 00 02 FF 01
				23 00 00 00 00 00 02 FB 01
				23 00 00 00 00 00 02 75 00
				23 00 00 00 00 00 02 76 41
				23 00 00 00 00 00 02 77 00
				23 00 00 00 00 00 02 78 5B
				23 00 00 00 00 00 02 79 00
				23 00 00 00 00 00 02 7A 83
				23 00 00 00 00 00 02 7B 00
				23 00 00 00 00 00 02 7C A3
				23 00 00 00 00 00 02 7D 00
				23 00 00 00 00 00 02 7E BD
				23 00 00 00 00 00 02 7F 00
				23 00 00 00 00 00 02 80 D3
				23 00 00 00 00 00 02 81 00
				23 00 00 00 00 00 02 82 E7
				23 00 00 00 00 00 02 83 00
				23 00 00 00 00 00 02 84 F9
				23 00 00 00 00 00 02 85 01
				23 00 00 00 00 00 02 86 09
				23 00 00 00 00 00 02 87 01
				23 00 00 00 00 00 02 88 3B
				23 00 00 00 00 00 02 89 01
				23 00 00 00 00 00 02 8A 61
				23 00 00 00 00 00 02 8B 01
				23 00 00 00 00 00 02 8C 99
				23 00 00 00 00 00 02 8D 01
				23 00 00 00 00 00 02 8E C2
				23 00 00 00 00 00 02 8F 01
				23 00 00 00 00 00 02 90 FE
				23 00 00 00 00 00 02 91 02
				23 01 00 00 00 00 02 92 2D
				23 00 00 00 00 00 02 93 02
				23 00 00 00 00 00 02 94 2F
				23 00 00 00 00 00 02 95 02
				23 00 00 00 00 00 02 96 5C
				23 00 00 00 00 00 02 97 02
				23 00 00 00 00 00 02 98 94
				23 00 00 00 00 00 02 99 02
				23 00 00 00 00 00 02 9A BB
				23 00 00 00 00 00 02 9B 02
				23 00 00 00 00 00 02 9C EF
				23 00 00 00 00 00 02 9D 03
				23 00 00 00 00 00 02 9E 12
				23 00 00 00 00 00 02 9F 03
				23 00 00 00 00 00 02 A0 40
				23 00 00 00 00 00 02 A2 03
				23 00 00 00 00 00 02 A3 4E
				23 00 00 00 00 00 02 A4 03
				23 00 00 00 00 00 02 A5 5D
				23 00 00 00 00 00 02 A6 03
				23 00 00 00 00 00 02 A7 70
				23 00 00 00 00 00 02 A9 03
				23 00 00 00 00 00 02 AA 7F
				23 00 00 00 00 00 02 AB 03
				23 00 00 00 00 00 02 AC 99
				23 00 00 00 00 00 02 AD 03
				23 00 00 00 00 00 02 AE C0
				23 00 00 00 00 00 02 AF 03
				23 00 00 00 00 00 02 B0 D2
				23 00 00 00 00 00 02 B1 03
				23 01 00 00 00 00 02 B2 D4

				23 00 00 00 00 00 02 B3 00
				23 00 00 00 00 00 02 B4 41
				23 00 00 00 00 00 02 B5 00
				23 00 00 00 00 00 02 B6 5B
				23 00 00 00 00 00 02 B7 00
				23 00 00 00 00 00 02 B8 83
				23 00 00 00 00 00 02 B9 00
				23 00 00 00 00 00 02 BA A3
				23 00 00 00 00 00 02 BB 00
				23 00 00 00 00 00 02 BC BD
				23 00 00 00 00 00 02 BD 00
				23 00 00 00 00 00 02 BE D3
				23 00 00 00 00 00 02 BF 00
				23 00 00 00 00 00 02 C0 E7
				23 00 00 00 00 00 02 C1 00
				23 00 00 00 00 00 02 C2 F9
				23 00 00 00 00 00 02 C3 01
				23 00 00 00 00 00 02 C4 09
				23 00 00 00 00 00 02 C5 01
				23 00 00 00 00 00 02 C6 3B
				23 00 00 00 00 00 02 C7 01
				23 00 00 00 00 00 02 C8 61
				23 00 00 00 00 00 02 C9 01
				23 00 00 00 00 00 02 CA 99
				23 00 00 00 00 00 02 CB 01
				23 00 00 00 00 00 02 CC C2
				23 00 00 00 00 00 02 CD 01
				23 00 00 00 00 00 02 CE FE
				23 00 00 00 00 00 02 CF 02
				23 01 00 00 00 00 02 D0 2D
				23 00 00 00 00 00 02 D1 02
				23 00 00 00 00 00 02 D2 2F
				23 00 00 00 00 00 02 D3 02
				23 00 00 00 00 00 02 D4 5C
				23 00 00 00 00 00 02 D5 02
				23 00 00 00 00 00 02 D6 94
				23 00 00 00 00 00 02 D7 02
				23 00 00 00 00 00 02 D8 BB
				23 00 00 00 00 00 02 D9 02
				23 00 00 00 00 00 02 DA EF
				23 00 00 00 00 00 02 DB 03
				23 00 00 00 00 00 02 DC 12
				23 00 00 00 00 00 02 DD 03
				23 00 00 00 00 00 02 DE 40
				23 00 00 00 00 00 02 DF 03
				23 00 00 00 00 00 02 E0 4E
				23 00 00 00 00 00 02 E1 03
				23 00 00 00 00 00 02 E2 5D
				23 00 00 00 00 00 02 E3 03
				23 00 00 00 00 00 02 E4 70
				23 00 00 00 00 00 02 E5 03
				23 00 00 00 00 00 02 E6 7F
				23 00 00 00 00 00 02 E7 03
				23 00 00 00 00 00 02 E8 99
				23 00 00 00 00 00 02 E9 03
				23 00 00 00 00 00 02 EA C0
				23 00 00 00 00 00 02 EB 03
				23 00 00 00 00 00 02 EC D2
				23 00 00 00 00 00 02 ED 03
				23 01 00 00 00 00 02 EE D4

				23 00 00 00 00 00 02 EF 00
				23 00 00 00 00 00 02 F0 EA
				23 00 00 00 00 00 02 F1 00
				23 00 00 00 00 00 02 F2 F3
				23 00 00 00 00 00 02 F3 01
				23 00 00 00 00 00 02 F4 03
				23 00 00 00 00 00 02 F5 01
				23 00 00 00 00 00 02 F6 12
				23 00 00 00 00 00 02 F7 01
				23 00 00 00 00 00 02 F8 1F
				23 00 00 00 00 00 02 F9 01
				23 00 00 00 00 00 02 FA 2B
				23 00 00 00 00 00 02 FF 02
				23 00 00 00 00 00 02 FB 01
				23 00 00 00 00 00 02 00 01
				23 00 00 00 00 00 02 01 36
				23 00 00 00 00 00 02 02 01
				23 00 00 00 00 00 02 03 41
				23 00 00 00 00 00 02 04 01
				23 00 00 00 00 00 02 05 4B
				23 00 00 00 00 00 02 06 01
				23 00 00 00 00 00 02 07 6D
				23 00 00 00 00 00 02 08 01
				23 00 00 00 00 00 02 09 89
				23 00 00 00 00 00 02 0A 01
				23 00 00 00 00 00 02 0B B4
				23 00 00 00 00 00 02 0C 01
				23 00 00 00 00 00 02 0D D7
				23 00 00 00 00 00 02 0E 02
				23 00 00 00 00 00 02 0F 0B
				23 00 00 00 00 00 02 10 02
				23 01 00 00 00 00 02 11 38
				23 00 00 00 00 00 02 12 02
				23 00 00 00 00 00 02 13 39
				23 00 00 00 00 00 02 14 02
				23 00 00 00 00 00 02 15 66
				23 00 00 00 00 00 02 16 02
				23 00 00 00 00 00 02 17 9F
				23 00 00 00 00 00 02 18 02
				23 00 00 00 00 00 02 19 C5
				23 00 00 00 00 00 02 1A 02
				23 00 00 00 00 00 02 1B FA
				23 00 00 00 00 00 02 1C 03
				23 00 00 00 00 00 02 1D 1D
				23 00 00 00 00 00 02 1E 03
				23 00 00 00 00 00 02 1F 49
				23 00 00 00 00 00 02 20 03
				23 00 00 00 00 00 02 21 55
				23 00 00 00 00 00 02 22 03
				23 00 00 00 00 00 02 23 64
				23 00 00 00 00 00 02 24 03
				23 00 00 00 00 00 02 25 73
				23 00 00 00 00 00 02 26 03
				23 00 00 00 00 00 02 27 85
				23 00 00 00 00 00 02 28 03
				23 00 00 00 00 00 02 29 9C
				23 00 00 00 00 00 02 2A 03
				23 00 00 00 00 00 02 2B B4
				23 00 00 00 00 00 02 2D 03
				23 00 00 00 00 00 02 2F D0
				23 00 00 00 00 00 02 30 03
				23 01 00 00 00 00 02 31 D2

				23 00 00 00 00 00 02 32 00
				23 00 00 00 00 00 02 33 EA
				23 00 00 00 00 00 02 34 00
				23 00 00 00 00 00 02 35 F3
				23 00 00 00 00 00 02 36 01
				23 00 00 00 00 00 02 37 03
				23 00 00 00 00 00 02 38 01
				23 00 00 00 00 00 02 39 12
				23 00 00 00 00 00 02 3A 01
				23 00 00 00 00 00 02 3B 1F
				23 00 00 00 00 00 02 3D 01
				23 00 00 00 00 00 02 3F 2B
				23 00 00 00 00 00 02 40 01
				23 00 00 00 00 00 02 41 36
				23 00 00 00 00 00 02 42 01
				23 00 00 00 00 00 02 43 41
				23 00 00 00 00 00 02 44 01
				23 00 00 00 00 00 02 45 4B
				23 00 00 00 00 00 02 46 01
				23 00 00 00 00 00 02 47 6D
				23 00 00 00 00 00 02 48 01
				23 00 00 00 00 00 02 49 89
				23 00 00 00 00 00 02 4A 01
				23 00 00 00 00 00 02 4B B4
				23 00 00 00 00 00 02 4C 01
				23 00 00 00 00 00 02 4D D7
				23 00 00 00 00 00 02 4E 02
				23 00 00 00 00 00 02 4F 0B
				23 00 00 00 00 00 02 50 02
				23 01 00 00 00 00 02 51 38
				23 00 00 00 00 00 02 52 02
				23 00 00 00 00 00 02 53 39
				23 00 00 00 00 00 02 54 02
				23 00 00 00 00 00 02 55 66
				23 00 00 00 00 00 02 56 02
				23 00 00 00 00 00 02 58 9F
				23 00 00 00 00 00 02 59 02
				23 00 00 00 00 00 02 5A C5
				23 00 00 00 00 00 02 5B 02
				23 00 00 00 00 00 02 5C FA
				23 00 00 00 00 00 02 5D 03
				23 00 00 00 00 00 02 5E 1D
				23 00 00 00 00 00 02 5F 03
				23 00 00 00 00 00 02 60 49
				23 00 00 00 00 00 02 61 03
				23 00 00 00 00 00 02 62 55
				23 00 00 00 00 00 02 63 03
				23 00 00 00 00 00 02 64 64
				23 00 00 00 00 00 02 65 03
				23 00 00 00 00 00 02 66 73
				23 00 00 00 00 00 02 67 03
				23 00 00 00 00 00 02 68 85
				23 00 00 00 00 00 02 69 03
				23 00 00 00 00 00 02 6A 9C
				23 00 00 00 00 00 02 6B 03
				23 00 00 00 00 00 02 6C B4
				23 00 00 00 00 00 02 6D 03
				23 00 00 00 00 00 02 6E D0
				23 00 00 00 00 00 02 6F 03
				23 01 00 00 00 00 02 70 D2

				23 00 00 00 00 00 02 71 01
				23 00 00 00 00 00 02 72 3A
				23 00 00 00 00 00 02 73 01
				23 00 00 00 00 00 02 74 3F
				23 00 00 00 00 00 02 75 01
				23 00 00 00 00 00 02 76 49
				23 00 00 00 00 00 02 77 01
				23 00 00 00 00 00 02 78 52
				23 00 00 00 00 00 02 79 01
				23 00 00 00 00 00 02 7A 5B
				23 00 00 00 00 00 02 7B 01
				23 00 00 00 00 00 02 7C 63
				23 00 00 00 00 00 02 7D 01
				23 00 00 00 00 00 02 7E 6A
				23 00 00 00 00 00 02 7F 01
				23 00 00 00 00 00 02 80 72
				23 00 00 00 00 00 02 81 01
				23 00 00 00 00 00 02 82 79
				23 00 00 00 00 00 02 83 01
				23 00 00 00 00 00 02 84 92
				23 00 00 00 00 00 02 85 01
				23 00 00 00 00 00 02 86 A8
				23 00 00 00 00 00 02 87 01
				23 00 00 00 00 00 02 88 CB
				23 00 00 00 00 00 02 89 01
				23 00 00 00 00 00 02 8A E8
				23 00 00 00 00 00 02 8B 02
				23 00 00 00 00 00 02 8C 16
				23 00 00 00 00 00 02 8D 02
				23 01 00 00 00 00 02 8E 3F
				23 00 00 00 00 00 02 8F 02
				23 00 00 00 00 00 02 90 40
				23 00 00 00 00 00 02 91 02
				23 00 00 00 00 00 02 92 6B
				23 00 00 00 00 00 02 93 02
				23 00 00 00 00 00 02 94 A1
				23 00 00 00 00 00 02 95 02
				23 00 00 00 00 00 02 96 C7
				23 00 00 00 00 00 02 97 02
				23 00 00 00 00 00 02 98 FA
				23 00 00 00 00 00 02 99 03
				23 00 00 00 00 00 02 9A 1C
				23 00 00 00 00 00 02 9B 03
				23 00 00 00 00 00 02 9C 47
				23 00 00 00 00 00 02 9D 03
				23 00 00 00 00 00 02 9E 53
				23 00 00 00 00 00 02 9F 03
				23 00 00 00 00 00 02 A0 5F
				23 00 00 00 00 00 02 A2 03
				23 00 00 00 00 00 02 A3 6B
				23 00 00 00 00 00 02 A4 03
				23 00 00 00 00 00 02 A5 82
				23 00 00 00 00 00 02 A6 03
				23 00 00 00 00 00 02 A7 86
				23 00 00 00 00 00 02 A9 03
				23 00 00 00 00 00 02 AA AC
				23 00 00 00 00 00 02 AB 03
				23 00 00 00 00 00 02 AC B2
				23 00 00 00 00 00 02 AD 03
				23 01 00 00 00 00 02 AE D4

				23 00 00 00 00 00 02 AF 01
				23 00 00 00 00 00 02 B0 3A
				23 00 00 00 00 00 02 B1 01
				23 00 00 00 00 00 02 B2 3F
				23 00 00 00 00 00 02 B3 01
				23 00 00 00 00 00 02 B4 49
				23 00 00 00 00 00 02 B5 01
				23 00 00 00 00 00 02 B6 52
				23 00 00 00 00 00 02 B7 01
				23 00 00 00 00 00 02 B8 5B
				23 00 00 00 00 00 02 B9 01
				23 00 00 00 00 00 02 BA 63
				23 00 00 00 00 00 02 BB 01
				23 00 00 00 00 00 02 BC 6A
				23 00 00 00 00 00 02 BD 01
				23 00 00 00 00 00 02 BE 72
				23 00 00 00 00 00 02 BF 01
				23 00 00 00 00 00 02 C0 79
				23 00 00 00 00 00 02 C1 01
				23 00 00 00 00 00 02 C2 92
				23 00 00 00 00 00 02 C3 01
				23 00 00 00 00 00 02 C4 A8
				23 00 00 00 00 00 02 C5 01
				23 00 00 00 00 00 02 C6 CB
				23 00 00 00 00 00 02 C7 01
				23 00 00 00 00 00 02 C8 E8
				23 00 00 00 00 00 02 C9 02
				23 00 00 00 00 00 02 CA 16
				23 00 00 00 00 00 02 CB 02
				23 01 00 00 00 00 02 CC 3F
				23 00 00 00 00 00 02 CD 02
				23 00 00 00 00 00 02 CE 40
				23 00 00 00 00 00 02 CF 02
				23 00 00 00 00 00 02 D0 6B
				23 00 00 00 00 00 02 D1 02
				23 00 00 00 00 00 02 D2 A1
				23 00 00 00 00 00 02 D3 02
				23 00 00 00 00 00 02 D4 C7
				23 00 00 00 00 00 02 D5 02
				23 00 00 00 00 00 02 D6 FA
				23 00 00 00 00 00 02 D7 03
				23 00 00 00 00 00 02 D8 1C
				23 00 00 00 00 00 02 D9 03
				23 00 00 00 00 00 02 DA 47
				23 00 00 00 00 00 02 DB 03
				23 00 00 00 00 00 02 DC 53
				23 00 00 00 00 00 02 DD 03
				23 00 00 00 00 00 02 DE 5F
				23 00 00 00 00 00 02 DF 03
				23 00 00 00 00 00 02 E0 6B
				23 00 00 00 00 00 02 E1 03
				23 00 00 00 00 00 02 E2 82
				23 00 00 00 00 00 02 E3 03
				23 00 00 00 00 00 02 E4 86
				23 00 00 00 00 00 02 E5 03
				23 00 00 00 00 00 02 E6 AC
				23 00 00 00 00 00 02 E7 03
				23 00 00 00 00 00 02 E8 B2
				23 00 00 00 00 00 02 E9 03
				23 01 00 00 00 00 02 EA D4];

		qcom,mdss-dsi-default_gamma-command = [23 00 00 00 00 00 02 FF 01
				23 00 00 00 00 00 02 FB 01
				23 00 00 00 00 00 02 75 00
				23 00 00 00 00 00 02 76 00
				23 00 00 00 00 00 02 77 00
				23 00 00 00 00 00 02 78 2D
				23 00 00 00 00 00 02 79 00
				23 00 00 00 00 00 02 7A 6A
				23 00 00 00 00 00 02 7B 00
				23 00 00 00 00 00 02 7C 93
				23 00 00 00 00 00 02 7D 00
				23 00 00 00 00 00 02 7E B3
				23 00 00 00 00 00 02 7F 00
				23 00 00 00 00 00 02 80 CF
				23 00 00 00 00 00 02 81 00
				23 00 00 00 00 00 02 82 E5
				23 00 00 00 00 00 02 83 00
				23 00 00 00 00 00 02 84 F9
				23 00 00 00 00 00 02 85 01
				23 00 00 00 00 00 02 86 0B
				23 00 00 00 00 00 02 87 01
				23 00 00 00 00 00 02 88 41
				23 00 00 00 00 00 02 89 01
				23 00 00 00 00 00 02 8A 69
				23 00 00 00 00 00 02 8B 01
				23 00 00 00 00 00 02 8C A4
				23 00 00 00 00 00 02 8D 01
				23 00 00 00 00 00 02 8E CD
				23 00 00 00 00 00 02 8F 02
				23 00 00 00 00 00 02 90 0A
				23 00 00 00 00 00 02 91 02
				23 01 00 00 00 00 02 92 3A
				23 00 00 00 00 00 02 93 02
				23 00 00 00 00 00 02 94 3C
				23 00 00 00 00 00 02 95 02
				23 00 00 00 00 00 02 96 6B
				23 00 00 00 00 00 02 97 02
				23 00 00 00 00 00 02 98 A8
				23 00 00 00 00 00 02 99 02
				23 00 00 00 00 00 02 9A D1
				23 00 00 00 00 00 02 9B 03
				23 00 00 00 00 00 02 9C 08
				23 00 00 00 00 00 02 9D 03
				23 00 00 00 00 00 02 9E 2E
				23 00 00 00 00 00 02 9F 03
				23 00 00 00 00 00 02 A0 58
				23 00 00 00 00 00 02 A2 03
				23 00 00 00 00 00 02 A3 65
				23 00 00 00 00 00 02 A4 03
				23 00 00 00 00 00 02 A5 6F
				23 00 00 00 00 00 02 A6 03
				23 00 00 00 00 00 02 A7 7B
				23 00 00 00 00 00 02 A9 03
				23 00 00 00 00 00 02 AA 85
				23 00 00 00 00 00 02 AB 03
				23 00 00 00 00 00 02 AC 8B
				23 00 00 00 00 00 02 AD 03
				23 00 00 00 00 00 02 AE 8F
				23 00 00 00 00 00 02 AF 03
				23 00 00 00 00 00 02 B0 A1
				23 00 00 00 00 00 02 B1 03
				23 01 00 00 00 00 02 B2 B2

				23 00 00 00 00 00 02 B3 00
				23 00 00 00 00 00 02 B4 00
				23 00 00 00 00 00 02 B5 00
				23 00 00 00 00 00 02 B6 2D
				23 00 00 00 00 00 02 B7 00
				23 00 00 00 00 00 02 B8 6A
				23 00 00 00 00 00 02 B9 00
				23 00 00 00 00 00 02 BA 93
				23 00 00 00 00 00 02 BB 00
				23 00 00 00 00 00 02 BC B3
				23 00 00 00 00 00 02 BD 00
				23 00 00 00 00 00 02 BE CF
				23 00 00 00 00 00 02 BF 00
				23 00 00 00 00 00 02 C0 E5
				23 00 00 00 00 00 02 C1 00
				23 00 00 00 00 00 02 C2 F9
				23 00 00 00 00 00 02 C3 01
				23 00 00 00 00 00 02 C4 0B
				23 00 00 00 00 00 02 C5 01
				23 00 00 00 00 00 02 C6 41
				23 00 00 00 00 00 02 C7 01
				23 00 00 00 00 00 02 C8 69
				23 00 00 00 00 00 02 C9 01
				23 00 00 00 00 00 02 CA A4
				23 00 00 00 00 00 02 CB 01
				23 00 00 00 00 00 02 CC CD
				23 00 00 00 00 00 02 CD 02
				23 00 00 00 00 00 02 CE 0A
				23 00 00 00 00 00 02 CF 02
				23 01 00 00 00 00 02 D0 3A
				23 00 00 00 00 00 02 D1 02
				23 00 00 00 00 00 02 D2 3C
				23 00 00 00 00 00 02 D3 02
				23 00 00 00 00 00 02 D4 6B
				23 00 00 00 00 00 02 D5 02
				23 00 00 00 00 00 02 D6 A8
				23 00 00 00 00 00 02 D7 02
				23 00 00 00 00 00 02 D8 D1
				23 00 00 00 00 00 02 D9 03
				23 00 00 00 00 00 02 DA 08
				23 00 00 00 00 00 02 DB 03
				23 00 00 00 00 00 02 DC 2E
				23 00 00 00 00 00 02 DD 03
				23 00 00 00 00 00 02 DE 58
				23 00 00 00 00 00 02 DF 03
				23 00 00 00 00 00 02 E0 65
				23 00 00 00 00 00 02 E1 03
				23 00 00 00 00 00 02 E2 6F
				23 00 00 00 00 00 02 E3 03
				23 00 00 00 00 00 02 E4 7B
				23 00 00 00 00 00 02 E5 03
				23 00 00 00 00 00 02 E6 85
				23 00 00 00 00 00 02 E7 03
				23 00 00 00 00 00 02 E8 8B
				23 00 00 00 00 00 02 E9 03
				23 00 00 00 00 00 02 EA 8F
				23 00 00 00 00 00 02 EB 03
				23 00 00 00 00 00 02 EC A1
				23 00 00 00 00 00 02 ED 03
				23 01 00 00 00 00 02 EE B2

				23 00 00 00 00 00 02 EF 00
				23 00 00 00 00 00 02 F0 00
				23 00 00 00 00 00 02 F1 00
				23 00 00 00 00 00 02 F2 2B
				23 00 00 00 00 00 02 F3 00
				23 00 00 00 00 00 02 F4 69
				23 00 00 00 00 00 02 F5 00
				23 00 00 00 00 00 02 F6 94
				23 00 00 00 00 00 02 F7 00
				23 00 00 00 00 00 02 F8 B5
				23 00 00 00 00 00 02 F9 00
				23 00 00 00 00 00 02 FA D0
				23 00 00 00 00 00 02 FF 02
				23 00 00 00 00 00 02 FB 01
				23 00 00 00 00 00 02 00 00
				23 00 00 00 00 00 02 01 E7
				23 00 00 00 00 00 02 02 00
				23 00 00 00 00 00 02 03 FB
				23 00 00 00 00 00 02 04 01
				23 00 00 00 00 00 02 05 0C
				23 00 00 00 00 00 02 06 01
				23 00 00 00 00 00 02 07 43
				23 00 00 00 00 00 02 08 01
				23 00 00 00 00 00 02 09 6C
				23 00 00 00 00 00 02 0A 01
				23 00 00 00 00 00 02 0B A5
				23 00 00 00 00 00 02 0C 01
				23 00 00 00 00 00 02 0D D1
				23 00 00 00 00 00 02 0E 02
				23 00 00 00 00 00 02 0F 0F
				23 00 00 00 00 00 02 10 02
				23 01 00 00 00 00 02 11 3D
				23 00 00 00 00 00 02 12 02
				23 00 00 00 00 00 02 13 3E
				23 00 00 00 00 00 02 14 02
				23 00 00 00 00 00 02 15 6E
				23 00 00 00 00 00 02 16 02
				23 00 00 00 00 00 02 17 AC
				23 00 00 00 00 00 02 18 02
				23 00 00 00 00 00 02 19 D5
				23 00 00 00 00 00 02 1A 03
				23 00 00 00 00 00 02 1B 0D
				23 00 00 00 00 00 02 1C 03
				23 00 00 00 00 00 02 1D 30
				23 00 00 00 00 00 02 1E 03
				23 00 00 00 00 00 02 1F 5B
				23 00 00 00 00 00 02 20 03
				23 00 00 00 00 00 02 21 68
				23 00 00 00 00 00 02 22 03
				23 00 00 00 00 00 02 23 74
				23 00 00 00 00 00 02 24 03
				23 00 00 00 00 00 02 25 81
				23 00 00 00 00 00 02 26 03
				23 00 00 00 00 00 02 27 90
				23 00 00 00 00 00 02 28 03
				23 00 00 00 00 00 02 29 9F
				23 00 00 00 00 00 02 2A 03
				23 00 00 00 00 00 02 2B AC
				23 00 00 00 00 00 02 2D 03
				23 00 00 00 00 00 02 2F AF
				23 00 00 00 00 00 02 30 03
				23 01 00 00 00 00 02 31 B2

				23 00 00 00 00 00 02 32 00
				23 00 00 00 00 00 02 33 00
				23 00 00 00 00 00 02 34 00
				23 00 00 00 00 00 02 35 2B
				23 00 00 00 00 00 02 36 00
				23 00 00 00 00 00 02 37 69
				23 00 00 00 00 00 02 38 00
				23 00 00 00 00 00 02 39 94
				23 00 00 00 00 00 02 3A 00
				23 00 00 00 00 00 02 3B B5
				23 00 00 00 00 00 02 3D 00
				23 00 00 00 00 00 02 3F D0
				23 00 00 00 00 00 02 40 00
				23 00 00 00 00 00 02 41 E7
				23 00 00 00 00 00 02 42 00
				23 00 00 00 00 00 02 43 FB
				23 00 00 00 00 00 02 44 01
				23 00 00 00 00 00 02 45 0C
				23 00 00 00 00 00 02 46 01
				23 00 00 00 00 00 02 47 43
				23 00 00 00 00 00 02 48 01
				23 00 00 00 00 00 02 49 6C
				23 00 00 00 00 00 02 4A 01
				23 00 00 00 00 00 02 4B A5
				23 00 00 00 00 00 02 4C 01
				23 00 00 00 00 00 02 4D D1
				23 00 00 00 00 00 02 4E 02
				23 00 00 00 00 00 02 4F 0F
				23 00 00 00 00 00 02 50 02
				23 01 00 00 00 00 02 51 3D
				23 00 00 00 00 00 02 52 02
				23 00 00 00 00 00 02 53 3E
				23 00 00 00 00 00 02 54 02
				23 00 00 00 00 00 02 55 6E
				23 00 00 00 00 00 02 56 02
				23 00 00 00 00 00 02 58 AC
				23 00 00 00 00 00 02 59 02
				23 00 00 00 00 00 02 5A D5
				23 00 00 00 00 00 02 5B 03
				23 00 00 00 00 00 02 5C 0D
				23 00 00 00 00 00 02 5D 03
				23 00 00 00 00 00 02 5E 30
				23 00 00 00 00 00 02 5F 03
				23 00 00 00 00 00 02 60 5B
				23 00 00 00 00 00 02 61 03
				23 00 00 00 00 00 02 62 68
				23 00 00 00 00 00 02 63 03
				23 00 00 00 00 00 02 64 74
				23 00 00 00 00 00 02 65 03
				23 00 00 00 00 00 02 66 81
				23 00 00 00 00 00 02 67 03
				23 00 00 00 00 00 02 68 90
				23 00 00 00 00 00 02 69 03
				23 00 00 00 00 00 02 6A 9F
				23 00 00 00 00 00 02 6B 03
				23 00 00 00 00 00 02 6C AC
				23 00 00 00 00 00 02 6D 03
				23 00 00 00 00 00 02 6E AF
				23 00 00 00 00 00 02 6F 03
				23 01 00 00 00 00 02 70 B2

				23 00 00 00 00 00 02 71 00
				23 00 00 00 00 00 02 72 00
				23 00 00 00 00 00 02 73 00
				23 00 00 00 00 00 02 74 34
				23 00 00 00 00 00 02 75 00
				23 00 00 00 00 00 02 76 75
				23 00 00 00 00 00 02 77 00
				23 00 00 00 00 00 02 78 A1
				23 00 00 00 00 00 02 79 00
				23 00 00 00 00 00 02 7A C1
				23 00 00 00 00 00 02 7B 00
				23 00 00 00 00 00 02 7C DB
				23 00 00 00 00 00 02 7D 00
				23 00 00 00 00 00 02 7E F2
				23 00 00 00 00 00 02 7F 01
				23 00 00 00 00 00 02 80 04
				23 00 00 00 00 00 02 81 01
				23 00 00 00 00 00 02 82 15
				23 00 00 00 00 00 02 83 01
				23 00 00 00 00 00 02 84 4C
				23 00 00 00 00 00 02 85 01
				23 00 00 00 00 00 02 86 72
				23 00 00 00 00 00 02 87 01
				23 00 00 00 00 00 02 88 AF
				23 00 00 00 00 00 02 89 01
				23 00 00 00 00 00 02 8A D7
				23 00 00 00 00 00 02 8B 02
				23 00 00 00 00 00 02 8C 11
				23 00 00 00 00 00 02 8D 02
				23 01 00 00 00 00 02 8E 3F
				23 00 00 00 00 00 02 8F 02
				23 00 00 00 00 00 02 90 40
				23 00 00 00 00 00 02 91 02
				23 00 00 00 00 00 02 92 6E
				23 00 00 00 00 00 02 93 02
				23 00 00 00 00 00 02 94 AB
				23 00 00 00 00 00 02 95 02
				23 00 00 00 00 00 02 96 D1
				23 00 00 00 00 00 02 97 03
				23 00 00 00 00 00 02 98 07
				23 00 00 00 00 00 02 99 03
				23 00 00 00 00 00 02 9A 2B
				23 00 00 00 00 00 02 9B 03
				23 00 00 00 00 00 02 9C 58
				23 00 00 00 00 00 02 9D 03
				23 00 00 00 00 00 02 9E 64
				23 00 00 00 00 00 02 9F 03
				23 00 00 00 00 00 02 A0 78
				23 00 00 00 00 00 02 A2 03
				23 00 00 00 00 00 02 A3 A3
				23 00 00 00 00 00 02 A4 03
				23 00 00 00 00 00 02 A5 AA
				23 00 00 00 00 00 02 A6 03
				23 00 00 00 00 00 02 A7 AE
				23 00 00 00 00 00 02 A9 03
				23 00 00 00 00 00 02 AA BF
				23 00 00 00 00 00 02 AB 03
				23 00 00 00 00 00 02 AC B1
				23 00 00 00 00 00 02 AD 03
				23 01 00 00 00 00 02 AE B2

				23 00 00 00 00 00 02 AF 00
				23 00 00 00 00 00 02 B0 00
				23 00 00 00 00 00 02 B1 00
				23 00 00 00 00 00 02 B2 34
				23 00 00 00 00 00 02 B3 00
				23 00 00 00 00 00 02 B4 75
				23 00 00 00 00 00 02 B5 00
				23 00 00 00 00 00 02 B6 A1
				23 00 00 00 00 00 02 B7 00
				23 00 00 00 00 00 02 B8 C1
				23 00 00 00 00 00 02 B9 00
				23 00 00 00 00 00 02 BA DB
				23 00 00 00 00 00 02 BB 00
				23 00 00 00 00 00 02 BC F2
				23 00 00 00 00 00 02 BD 01
				23 00 00 00 00 00 02 BE 04
				23 00 00 00 00 00 02 BF 01
				23 00 00 00 00 00 02 C0 15
				23 00 00 00 00 00 02 C1 01
				23 00 00 00 00 00 02 C2 4C
				23 00 00 00 00 00 02 C3 01
				23 00 00 00 00 00 02 C4 72
				23 00 00 00 00 00 02 C5 01
				23 00 00 00 00 00 02 C6 AF
				23 00 00 00 00 00 02 C7 01
				23 00 00 00 00 00 02 C8 D7
				23 00 00 00 00 00 02 C9 02
				23 00 00 00 00 00 02 CA 11
				23 00 00 00 00 00 02 CB 02
				23 01 00 00 00 00 02 CC 3F
				23 00 00 00 00 00 02 CD 02
				23 00 00 00 00 00 02 CE 40
				23 00 00 00 00 00 02 CF 02
				23 00 00 00 00 00 02 D0 6E
				23 00 00 00 00 00 02 D1 02
				23 00 00 00 00 00 02 D2 AB
				23 00 00 00 00 00 02 D3 02
				23 00 00 00 00 00 02 D4 D1
				23 00 00 00 00 00 02 D5 03
				23 00 00 00 00 00 02 D6 07
				23 00 00 00 00 00 02 D7 03
				23 00 00 00 00 00 02 D8 2B
				23 00 00 00 00 00 02 D9 03
				23 00 00 00 00 00 02 DA 58
				23 00 00 00 00 00 02 DB 03
				23 00 00 00 00 00 02 DC 64
				23 00 00 00 00 00 02 DD 03
				23 00 00 00 00 00 02 DE 78
				23 00 00 00 00 00 02 DF 03
				23 00 00 00 00 00 02 E0 A3
				23 00 00 00 00 00 02 E1 03
				23 00 00 00 00 00 02 E2 AA
				23 00 00 00 00 00 02 E3 03
				23 00 00 00 00 00 02 E4 AE
				23 00 00 00 00 00 02 E5 03
				23 00 00 00 00 00 02 E6 AF
				23 00 00 00 00 00 02 E7 03
				23 00 00 00 00 00 02 E8 B1
				23 00 00 00 00 00 02 E9 03
				23 01 00 00 00 00 02 EA B2];

		qcom,mdss-dsi-PM1-command = [23 00 00 00 00 00 02 FF 01
				23 00 00 00 00 00 02 FB 01
				23 00 00 00 00 00 02 75 00
				23 00 00 00 00 00 02 76 00
				23 00 00 00 00 00 02 77 00
				23 00 00 00 00 00 02 78 22
				23 00 00 00 00 00 02 79 00
				23 00 00 00 00 00 02 7A 5E
				23 00 00 00 00 00 02 7B 00
				23 00 00 00 00 00 02 7C 8A
				23 00 00 00 00 00 02 7D 00
				23 00 00 00 00 00 02 7E AC
				23 00 00 00 00 00 02 7F 00
				23 00 00 00 00 00 02 80 C7
				23 00 00 00 00 00 02 81 00
				23 00 00 00 00 00 02 82 DE
				23 00 00 00 00 00 02 83 00
				23 00 00 00 00 00 02 84 F2
				23 00 00 00 00 00 02 85 01
				23 00 00 00 00 00 02 86 04
				23 00 00 00 00 00 02 87 01
				23 00 00 00 00 00 02 88 3B
				23 00 00 00 00 00 02 89 01
				23 00 00 00 00 00 02 8A 64
				23 00 00 00 00 00 02 8B 01
				23 00 00 00 00 00 02 8C 9F
				23 00 00 00 00 00 02 8D 01
				23 00 00 00 00 00 02 8E CA
				23 00 00 00 00 00 02 8F 02
				23 00 00 00 00 00 02 90 06
				23 00 00 00 00 00 02 91 02
				23 00 00 00 00 00 02 92 37
				23 00 00 00 00 00 02 93 02
				23 00 00 00 00 00 02 94 38
				23 00 00 00 00 00 02 95 02
				23 00 00 00 00 00 02 96 68
				23 00 00 00 00 00 02 97 02
				23 00 00 00 00 00 02 98 A4
				23 00 00 00 00 00 02 99 02
				23 00 00 00 00 00 02 9A CE
				23 00 00 00 00 00 02 9B 02
				23 00 00 00 00 00 02 9C FF
				23 00 00 00 00 00 02 9D 03
				23 00 00 00 00 00 02 9E 2A
				23 00 00 00 00 00 02 9F 03
				23 00 00 00 00 00 02 A0 56
				23 00 00 00 00 00 02 A2 03
				23 00 00 00 00 00 02 A3 63
				23 00 00 00 00 00 02 A4 03
				23 00 00 00 00 00 02 A5 71
				23 00 00 00 00 00 02 A6 03
				23 00 00 00 00 00 02 A7 81
				23 00 00 00 00 00 02 A9 03
				23 00 00 00 00 00 02 AA 92
				23 00 00 00 00 00 02 AB 03
				23 00 00 00 00 00 02 AC A8
				23 00 00 00 00 00 02 AD 03
				23 00 00 00 00 00 02 AE C1
				23 00 00 00 00 00 02 AF 03
				23 00 00 00 00 00 02 B0 D6
				23 00 00 00 00 00 02 B1 03
				23 01 00 00 00 00 02 B2 D9

				23 00 00 00 00 00 02 B3 00
				23 00 00 00 00 00 02 B4 00
				23 00 00 00 00 00 02 B5 00
				23 00 00 00 00 00 02 B6 22
				23 00 00 00 00 00 02 B7 00
				23 00 00 00 00 00 02 B8 5E
				23 00 00 00 00 00 02 B9 00
				23 00 00 00 00 00 02 BA 8A
				23 00 00 00 00 00 02 BB 00
				23 00 00 00 00 00 02 BC AC
				23 00 00 00 00 00 02 BD 00
				23 00 00 00 00 00 02 BE C7
				23 00 00 00 00 00 02 BF 00
				23 00 00 00 00 00 02 C0 DE
				23 00 00 00 00 00 02 C1 00
				23 00 00 00 00 00 02 C2 F2
				23 00 00 00 00 00 02 C3 01
				23 00 00 00 00 00 02 C4 04
				23 00 00 00 00 00 02 C5 01
				23 00 00 00 00 00 02 C6 3B
				23 00 00 00 00 00 02 C7 01
				23 00 00 00 00 00 02 C8 64
				23 00 00 00 00 00 02 C9 01
				23 00 00 00 00 00 02 CA 9F
				23 00 00 00 00 00 02 CB 01
				23 00 00 00 00 00 02 CC CA
				23 00 00 00 00 00 02 CD 02
				23 00 00 00 00 00 02 CE 06
				23 00 00 00 00 00 02 CF 02
				23 00 00 00 00 00 02 D0 37
				23 00 00 00 00 00 02 D1 02
				23 00 00 00 00 00 02 D2 38
				23 00 00 00 00 00 02 D3 02
				23 00 00 00 00 00 02 D4 68
				23 00 00 00 00 00 02 D5 02
				23 00 00 00 00 00 02 D6 A4
				23 00 00 00 00 00 02 D7 02
				23 00 00 00 00 00 02 D8 CE
				23 00 00 00 00 00 02 D9 02
				23 00 00 00 00 00 02 DA FF
				23 00 00 00 00 00 02 DB 03
				23 00 00 00 00 00 02 DC 2A
				23 00 00 00 00 00 02 DD 03
				23 00 00 00 00 00 02 DE 56
				23 00 00 00 00 00 02 DF 03
				23 00 00 00 00 00 02 E0 63
				23 00 00 00 00 00 02 E1 03
				23 00 00 00 00 00 02 E2 71
				23 00 00 00 00 00 02 E3 03
				23 00 00 00 00 00 02 E4 81
				23 00 00 00 00 00 02 E5 03
				23 00 00 00 00 00 02 E6 92
				23 00 00 00 00 00 02 E7 03
				23 00 00 00 00 00 02 E8 A8
				23 00 00 00 00 00 02 E9 03
				23 00 00 00 00 00 02 EA C1
				23 00 00 00 00 00 02 EB 03
				23 00 00 00 00 00 02 EC D6
				23 00 00 00 00 00 02 ED 03
				23 01 00 00 00 00 02 EE D9

				23 00 00 00 00 00 02 EF 00
				23 00 00 00 00 00 02 F0 00
				23 00 00 00 00 00 02 F1 00
				23 00 00 00 00 00 02 F2 31
				23 00 00 00 00 00 02 F3 00
				23 00 00 00 00 00 02 F4 69
				23 00 00 00 00 00 02 F5 00
				23 00 00 00 00 00 02 F6 92
				23 00 00 00 00 00 02 F7 00
				23 00 00 00 00 00 02 F8 B2
				23 00 00 00 00 00 02 F9 00
				23 00 00 00 00 00 02 FA CC
				23 00 00 00 00 00 02 FF 02
				23 00 00 00 00 00 02 FB 01
				23 00 00 00 00 00 02 00 00
				23 00 00 00 00 00 02 01 E3
				23 00 00 00 00 00 02 02 00
				23 00 00 00 00 00 02 03 F7
				23 00 00 00 00 00 02 04 01
				23 00 00 00 00 00 02 05 08
				23 00 00 00 00 00 02 06 01
				23 00 00 00 00 00 02 07 3F
				23 00 00 00 00 00 02 08 01
				23 00 00 00 00 00 02 09 68
				23 00 00 00 00 00 02 0A 01
				23 00 00 00 00 00 02 0B A3
				23 00 00 00 00 00 02 0C 01
				23 00 00 00 00 00 02 0D CD
				23 00 00 00 00 00 02 0E 02
				23 00 00 00 00 00 02 0F 0A
				23 00 00 00 00 00 02 10 02
				23 00 00 00 00 00 02 11 3A
				23 00 00 00 00 00 02 12 02
				23 00 00 00 00 00 02 13 3C
				23 00 00 00 00 00 02 14 02
				23 00 00 00 00 00 02 15 6C
				23 00 00 00 00 00 02 16 02
				23 00 00 00 00 00 02 17 A9
				23 00 00 00 00 00 02 18 02
				23 00 00 00 00 00 02 19 D4
				23 00 00 00 00 00 02 1A 03
				23 00 00 00 00 00 02 1B 04
				23 00 00 00 00 00 02 1C 03
				23 00 00 00 00 00 02 1D 2F
				23 00 00 00 00 00 02 1E 03
				23 00 00 00 00 00 02 1F 5B
				23 00 00 00 00 00 02 20 03
				23 00 00 00 00 00 02 21 68
				23 00 00 00 00 00 02 22 03
				23 00 00 00 00 00 02 23 76
				23 00 00 00 00 00 02 24 03
				23 00 00 00 00 00 02 25 85
				23 00 00 00 00 00 02 26 03
				23 00 00 00 00 00 02 27 97
				23 00 00 00 00 00 02 28 03
				23 00 00 00 00 00 02 29 AC
				23 00 00 00 00 00 02 2A 03
				23 00 00 00 00 00 02 2B C4
				23 00 00 00 00 00 02 2D 03
				23 00 00 00 00 00 02 2F D7
				23 00 00 00 00 00 02 30 03
				23 01 00 00 00 00 02 31 D9

				23 00 00 00 00 00 02 32 00
				23 00 00 00 00 00 02 33 00
				23 00 00 00 00 00 02 34 00
				23 00 00 00 00 00 02 35 31
				23 00 00 00 00 00 02 36 00
				23 00 00 00 00 00 02 37 69
				23 00 00 00 00 00 02 38 00
				23 00 00 00 00 00 02 39 92
				23 00 00 00 00 00 02 3A 00
				23 00 00 00 00 00 02 3B B2
				23 00 00 00 00 00 02 3D 00
				23 00 00 00 00 00 02 3F CC
				23 00 00 00 00 00 02 40 00
				23 00 00 00 00 00 02 41 E3
				23 00 00 00 00 00 02 42 00
				23 00 00 00 00 00 02 43 F7
				23 00 00 00 00 00 02 44 01
				23 00 00 00 00 00 02 45 08
				23 00 00 00 00 00 02 46 01
				23 00 00 00 00 00 02 47 3F
				23 00 00 00 00 00 02 48 01
				23 00 00 00 00 00 02 49 68
				23 00 00 00 00 00 02 4A 01
				23 00 00 00 00 00 02 4B A3
				23 00 00 00 00 00 02 4C 01
				23 00 00 00 00 00 02 4D CD
				23 00 00 00 00 00 02 4E 02
				23 00 00 00 00 00 02 4F 0A
				23 00 00 00 00 00 02 50 02
				23 00 00 00 00 00 02 51 3A
				23 00 00 00 00 00 02 52 02
				23 00 00 00 00 00 02 53 3C
				23 00 00 00 00 00 02 54 02
				23 00 00 00 00 00 02 55 6C
				23 00 00 00 00 00 02 56 02
				23 00 00 00 00 00 02 58 A9
				23 00 00 00 00 00 02 59 02
				23 00 00 00 00 00 02 5A D4
				23 00 00 00 00 00 02 5B 03
				23 00 00 00 00 00 02 5C 04
				23 00 00 00 00 00 02 5D 03
				23 00 00 00 00 00 02 5E 2F
				23 00 00 00 00 00 02 5F 03
				23 00 00 00 00 00 02 60 5B
				23 00 00 00 00 00 02 61 03
				23 00 00 00 00 00 02 62 68
				23 00 00 00 00 00 02 63 03
				23 00 00 00 00 00 02 64 76
				23 00 00 00 00 00 02 65 03
				23 00 00 00 00 00 02 66 85
				23 00 00 00 00 00 02 67 03
				23 00 00 00 00 00 02 68 97
				23 00 00 00 00 00 02 69 03
				23 00 00 00 00 00 02 6A AC
				23 00 00 00 00 00 02 6B 03
				23 00 00 00 00 00 02 6C C4
				23 00 00 00 00 00 02 6D 03
				23 00 00 00 00 00 02 6E D7
				23 00 00 00 00 00 02 6F 03
				23 01 00 00 00 00 02 70 D9

				23 00 00 00 00 00 02 71 00
				23 00 00 00 00 00 02 72 FF
				23 00 00 00 00 00 02 73 01
				23 00 00 00 00 00 02 74 08
				23 00 00 00 00 00 02 75 01
				23 00 00 00 00 00 02 76 17
				23 00 00 00 00 00 02 77 01
				23 00 00 00 00 00 02 78 25
				23 00 00 00 00 00 02 79 01
				23 00 00 00 00 00 02 7A 32
				23 00 00 00 00 00 02 7B 01
				23 00 00 00 00 00 02 7C 3E
				23 00 00 00 00 00 02 7D 01
				23 00 00 00 00 00 02 7E 49
				23 00 00 00 00 00 02 7F 01
				23 00 00 00 00 00 02 80 53
				23 00 00 00 00 00 02 81 01
				23 00 00 00 00 00 02 82 5D
				23 00 00 00 00 00 02 83 01
				23 00 00 00 00 00 02 84 7E
				23 00 00 00 00 00 02 85 01
				23 00 00 00 00 00 02 86 99
				23 00 00 00 00 00 02 87 01
				23 00 00 00 00 00 02 88 C4
				23 00 00 00 00 00 02 89 01
				23 00 00 00 00 00 02 8A E5
				23 00 00 00 00 00 02 8B 02
				23 00 00 00 00 00 02 8C 17
				23 00 00 00 00 00 02 8D 02
				23 00 00 00 00 00 02 8E 44
				23 00 00 00 00 00 02 8F 02
				23 00 00 00 00 00 02 90 45
				23 00 00 00 00 00 02 91 02
				23 00 00 00 00 00 02 92 73
				23 00 00 00 00 00 02 93 02
				23 00 00 00 00 00 02 94 AD
				23 00 00 00 00 00 02 95 02
				23 00 00 00 00 00 02 96 D7
				23 00 00 00 00 00 02 97 03
				23 00 00 00 00 00 02 98 07
				23 00 00 00 00 00 02 99 03
				23 00 00 00 00 00 02 9A 32
				23 00 00 00 00 00 02 9B 03
				23 00 00 00 00 00 02 9C 5E
				23 00 00 00 00 00 02 9D 03
				23 00 00 00 00 00 02 9E 6C
				23 00 00 00 00 00 02 9F 03
				23 00 00 00 00 00 02 A0 7A
				23 00 00 00 00 00 02 A2 03
				23 00 00 00 00 00 02 A3 8A
				23 00 00 00 00 00 02 A4 03
				23 00 00 00 00 00 02 A5 9D
				23 00 00 00 00 00 02 A6 03
				23 00 00 00 00 00 02 A7 B2
				23 00 00 00 00 00 02 A9 03
				23 00 00 00 00 00 02 AA C8
				23 00 00 00 00 00 02 AB 03
				23 00 00 00 00 00 02 AC D7
				23 00 00 00 00 00 02 AD 03
				23 01 00 00 00 00 02 AE D9

				23 00 00 00 00 00 02 AF 00
				23 00 00 00 00 00 02 B0 FF
				23 00 00 00 00 00 02 B1 01
				23 00 00 00 00 00 02 B2 08
				23 00 00 00 00 00 02 B3 01
				23 00 00 00 00 00 02 B4 17
				23 00 00 00 00 00 02 B5 01
				23 00 00 00 00 00 02 B6 25
				23 00 00 00 00 00 02 B7 01
				23 00 00 00 00 00 02 B8 32
				23 00 00 00 00 00 02 B9 01
				23 00 00 00 00 00 02 BA 3E
				23 00 00 00 00 00 02 BB 01
				23 00 00 00 00 00 02 BC 49
				23 00 00 00 00 00 02 BD 01
				23 00 00 00 00 00 02 BE 53
				23 00 00 00 00 00 02 BF 01
				23 00 00 00 00 00 02 C0 5D
				23 00 00 00 00 00 02 C1 01
				23 00 00 00 00 00 02 C2 7E
				23 00 00 00 00 00 02 C3 01
				23 00 00 00 00 00 02 C4 99
				23 00 00 00 00 00 02 C5 01
				23 00 00 00 00 00 02 C6 C4
				23 00 00 00 00 00 02 C7 01
				23 00 00 00 00 00 02 C8 E5
				23 00 00 00 00 00 02 C9 02
				23 00 00 00 00 00 02 CA 17
				23 00 00 00 00 00 02 CB 02
				23 00 00 00 00 00 02 CC 44
				23 00 00 00 00 00 02 CD 02
				23 00 00 00 00 00 02 CE 45
				23 00 00 00 00 00 02 CF 02
				23 00 00 00 00 00 02 D0 73
				23 00 00 00 00 00 02 D1 02
				23 00 00 00 00 00 02 D2 AD
				23 00 00 00 00 00 02 D3 02
				23 00 00 00 00 00 02 D4 D7
				23 00 00 00 00 00 02 D5 03
				23 00 00 00 00 00 02 D6 07
				23 00 00 00 00 00 02 D7 03
				23 00 00 00 00 00 02 D8 32
				23 00 00 00 00 00 02 D9 03
				23 00 00 00 00 00 02 DA 5E
				23 00 00 00 00 00 02 DB 03
				23 00 00 00 00 00 02 DC 6C
				23 00 00 00 00 00 02 DD 03
				23 00 00 00 00 00 02 DE 7A
				23 00 00 00 00 00 02 DF 03
				23 00 00 00 00 00 02 E0 8A
				23 00 00 00 00 00 02 E1 03
				23 00 00 00 00 00 02 E2 9D
				23 00 00 00 00 00 02 E3 03
				23 00 00 00 00 00 02 E4 B2
				23 00 00 00 00 00 02 E5 03
				23 00 00 00 00 00 02 E6 C8
				23 00 00 00 00 00 02 E7 03
				23 00 00 00 00 00 02 E8 D7
				23 00 00 00 00 00 02 E9 03
				23 01 00 00 00 00 02 EA D9];

		qcom,mdss-dsi-PM2-command = [23 00 00 00 00 00 02 FF 01
				23 00 00 00 00 00 02 FB 01
				23 00 00 00 00 00 02 75 00
				23 00 00 00 00 00 02 76 00
				23 00 00 00 00 00 02 77 00
				23 00 00 00 00 00 02 78 22
				23 00 00 00 00 00 02 79 00
				23 00 00 00 00 00 02 7A 5E
				23 00 00 00 00 00 02 7B 00
				23 00 00 00 00 00 02 7C 8A
				23 00 00 00 00 00 02 7D 00
				23 00 00 00 00 00 02 7E AC
				23 00 00 00 00 00 02 7F 00
				23 00 00 00 00 00 02 80 C7
				23 00 00 00 00 00 02 81 00
				23 00 00 00 00 00 02 82 DE
				23 00 00 00 00 00 02 83 00
				23 00 00 00 00 00 02 84 F2
				23 00 00 00 00 00 02 85 01
				23 00 00 00 00 00 02 86 04
				23 00 00 00 00 00 02 87 01
				23 00 00 00 00 00 02 88 3B
				23 00 00 00 00 00 02 89 01
				23 00 00 00 00 00 02 8A 64
				23 00 00 00 00 00 02 8B 01
				23 00 00 00 00 00 02 8C 9F
				23 00 00 00 00 00 02 8D 01
				23 00 00 00 00 00 02 8E CA
				23 00 00 00 00 00 02 8F 02
				23 00 00 00 00 00 02 90 06
				23 00 00 00 00 00 02 91 02
				23 00 00 00 00 00 02 92 37
				23 00 00 00 00 00 02 93 02
				23 00 00 00 00 00 02 94 38
				23 00 00 00 00 00 02 95 02
				23 00 00 00 00 00 02 96 68
				23 00 00 00 00 00 02 97 02
				23 00 00 00 00 00 02 98 A4
				23 00 00 00 00 00 02 99 02
				23 00 00 00 00 00 02 9A CE
				23 00 00 00 00 00 02 9B 02
				23 00 00 00 00 00 02 9C FF
				23 00 00 00 00 00 02 9D 03
				23 00 00 00 00 00 02 9E 2A
				23 00 00 00 00 00 02 9F 03
				23 00 00 00 00 00 02 A0 56
				23 00 00 00 00 00 02 A2 03
				23 00 00 00 00 00 02 A3 63
				23 00 00 00 00 00 02 A4 03
				23 00 00 00 00 00 02 A5 71
				23 00 00 00 00 00 02 A6 03
				23 00 00 00 00 00 02 A7 81
				23 00 00 00 00 00 02 A9 03
				23 00 00 00 00 00 02 AA 92
				23 00 00 00 00 00 02 AB 03
				23 00 00 00 00 00 02 AC A8
				23 00 00 00 00 00 02 AD 03
				23 00 00 00 00 00 02 AE C1
				23 00 00 00 00 00 02 AF 03
				23 00 00 00 00 00 02 B0 D6
				23 00 00 00 00 00 02 B1 03
				23 01 00 00 00 00 02 B2 D9

				23 00 00 00 00 00 02 B3 00
				23 00 00 00 00 00 02 B4 00
				23 00 00 00 00 00 02 B5 00
				23 00 00 00 00 00 02 B6 22
				23 00 00 00 00 00 02 B7 00
				23 00 00 00 00 00 02 B8 5E
				23 00 00 00 00 00 02 B9 00
				23 00 00 00 00 00 02 BA 8A
				23 00 00 00 00 00 02 BB 00
				23 00 00 00 00 00 02 BC AC
				23 00 00 00 00 00 02 BD 00
				23 00 00 00 00 00 02 BE C7
				23 00 00 00 00 00 02 BF 00
				23 00 00 00 00 00 02 C0 DE
				23 00 00 00 00 00 02 C1 00
				23 00 00 00 00 00 02 C2 F2
				23 00 00 00 00 00 02 C3 01
				23 00 00 00 00 00 02 C4 04
				23 00 00 00 00 00 02 C5 01
				23 00 00 00 00 00 02 C6 3B
				23 00 00 00 00 00 02 C7 01
				23 00 00 00 00 00 02 C8 64
				23 00 00 00 00 00 02 C9 01
				23 00 00 00 00 00 02 CA 9F
				23 00 00 00 00 00 02 CB 01
				23 00 00 00 00 00 02 CC CA
				23 00 00 00 00 00 02 CD 02
				23 00 00 00 00 00 02 CE 06
				23 00 00 00 00 00 02 CF 02
				23 00 00 00 00 00 02 D0 37
				23 00 00 00 00 00 02 D1 02
				23 00 00 00 00 00 02 D2 38
				23 00 00 00 00 00 02 D3 02
				23 00 00 00 00 00 02 D4 68
				23 00 00 00 00 00 02 D5 02
				23 00 00 00 00 00 02 D6 A4
				23 00 00 00 00 00 02 D7 02
				23 00 00 00 00 00 02 D8 CE
				23 00 00 00 00 00 02 D9 02
				23 00 00 00 00 00 02 DA FF
				23 00 00 00 00 00 02 DB 03
				23 00 00 00 00 00 02 DC 2A
				23 00 00 00 00 00 02 DD 03
				23 00 00 00 00 00 02 DE 56
				23 00 00 00 00 00 02 DF 03
				23 00 00 00 00 00 02 E0 63
				23 00 00 00 00 00 02 E1 03
				23 00 00 00 00 00 02 E2 71
				23 00 00 00 00 00 02 E3 03
				23 00 00 00 00 00 02 E4 81
				23 00 00 00 00 00 02 E5 03
				23 00 00 00 00 00 02 E6 92
				23 00 00 00 00 00 02 E7 03
				23 00 00 00 00 00 02 E8 A8
				23 00 00 00 00 00 02 E9 03
				23 00 00 00 00 00 02 EA C1
				23 00 00 00 00 00 02 EB 03
				23 00 00 00 00 00 02 EC D6
				23 00 00 00 00 00 02 ED 03
				23 01 00 00 00 00 02 EE D9

				23 00 00 00 00 00 02 EF 00
				23 00 00 00 00 00 02 F0 00
				23 00 00 00 00 00 02 F1 00
				23 00 00 00 00 00 02 F2 31
				23 00 00 00 00 00 02 F3 00
				23 00 00 00 00 00 02 F4 69
				23 00 00 00 00 00 02 F5 00
				23 00 00 00 00 00 02 F6 92
				23 00 00 00 00 00 02 F7 00
				23 00 00 00 00 00 02 F8 B2
				23 00 00 00 00 00 02 F9 00
				23 00 00 00 00 00 02 FA CC
				23 00 00 00 00 00 02 FF 02
				23 00 00 00 00 00 02 FB 01
				23 00 00 00 00 00 02 00 00
				23 00 00 00 00 00 02 01 E3
				23 00 00 00 00 00 02 02 00
				23 00 00 00 00 00 02 03 F7
				23 00 00 00 00 00 02 04 01
				23 00 00 00 00 00 02 05 08
				23 00 00 00 00 00 02 06 01
				23 00 00 00 00 00 02 07 3F
				23 00 00 00 00 00 02 08 01
				23 00 00 00 00 00 02 09 68
				23 00 00 00 00 00 02 0A 01
				23 00 00 00 00 00 02 0B A3
				23 00 00 00 00 00 02 0C 01
				23 00 00 00 00 00 02 0D CD
				23 00 00 00 00 00 02 0E 02
				23 00 00 00 00 00 02 0F 0A
				23 00 00 00 00 00 02 10 02
				23 00 00 00 00 00 02 11 3A
				23 00 00 00 00 00 02 12 02
				23 00 00 00 00 00 02 13 3C
				23 00 00 00 00 00 02 14 02
				23 00 00 00 00 00 02 15 6C
				23 00 00 00 00 00 02 16 02
				23 00 00 00 00 00 02 17 A9
				23 00 00 00 00 00 02 18 02
				23 00 00 00 00 00 02 19 D4
				23 00 00 00 00 00 02 1A 03
				23 00 00 00 00 00 02 1B 04
				23 00 00 00 00 00 02 1C 03
				23 00 00 00 00 00 02 1D 2F
				23 00 00 00 00 00 02 1E 03
				23 00 00 00 00 00 02 1F 5B
				23 00 00 00 00 00 02 20 03
				23 00 00 00 00 00 02 21 68
				23 00 00 00 00 00 02 22 03
				23 00 00 00 00 00 02 23 76
				23 00 00 00 00 00 02 24 03
				23 00 00 00 00 00 02 25 85
				23 00 00 00 00 00 02 26 03
				23 00 00 00 00 00 02 27 97
				23 00 00 00 00 00 02 28 03
				23 00 00 00 00 00 02 29 AC
				23 00 00 00 00 00 02 2A 03
				23 00 00 00 00 00 02 2B C4
				23 00 00 00 00 00 02 2D 03
				23 00 00 00 00 00 02 2F D7
				23 00 00 00 00 00 02 30 03
				23 01 00 00 00 00 02 31 D9

				23 00 00 00 00 00 02 32 00
				23 00 00 00 00 00 02 33 00
				23 00 00 00 00 00 02 34 00
				23 00 00 00 00 00 02 35 31
				23 00 00 00 00 00 02 36 00
				23 00 00 00 00 00 02 37 69
				23 00 00 00 00 00 02 38 00
				23 00 00 00 00 00 02 39 92
				23 00 00 00 00 00 02 3A 00
				23 00 00 00 00 00 02 3B B2
				23 00 00 00 00 00 02 3D 00
				23 00 00 00 00 00 02 3F CC
				23 00 00 00 00 00 02 40 00
				23 00 00 00 00 00 02 41 E3
				23 00 00 00 00 00 02 42 00
				23 00 00 00 00 00 02 43 F7
				23 00 00 00 00 00 02 44 01
				23 00 00 00 00 00 02 45 08
				23 00 00 00 00 00 02 46 01
				23 00 00 00 00 00 02 47 3F
				23 00 00 00 00 00 02 48 01
				23 00 00 00 00 00 02 49 68
				23 00 00 00 00 00 02 4A 01
				23 00 00 00 00 00 02 4B A3
				23 00 00 00 00 00 02 4C 01
				23 00 00 00 00 00 02 4D CD
				23 00 00 00 00 00 02 4E 02
				23 00 00 00 00 00 02 4F 0A
				23 00 00 00 00 00 02 50 02
				23 00 00 00 00 00 02 51 3A
				23 00 00 00 00 00 02 52 02
				23 00 00 00 00 00 02 53 3C
				23 00 00 00 00 00 02 54 02
				23 00 00 00 00 00 02 55 6C
				23 00 00 00 00 00 02 56 02
				23 00 00 00 00 00 02 58 A9
				23 00 00 00 00 00 02 59 02
				23 00 00 00 00 00 02 5A D4
				23 00 00 00 00 00 02 5B 03
				23 00 00 00 00 00 02 5C 04
				23 00 00 00 00 00 02 5D 03
				23 00 00 00 00 00 02 5E 2F
				23 00 00 00 00 00 02 5F 03
				23 00 00 00 00 00 02 60 5B
				23 00 00 00 00 00 02 61 03
				23 00 00 00 00 00 02 62 68
				23 00 00 00 00 00 02 63 03
				23 00 00 00 00 00 02 64 76
				23 00 00 00 00 00 02 65 03
				23 00 00 00 00 00 02 66 85
				23 00 00 00 00 00 02 67 03
				23 00 00 00 00 00 02 68 97
				23 00 00 00 00 00 02 69 03
				23 00 00 00 00 00 02 6A AC
				23 00 00 00 00 00 02 6B 03
				23 00 00 00 00 00 02 6C C4
				23 00 00 00 00 00 02 6D 03
				23 00 00 00 00 00 02 6E D7
				23 00 00 00 00 00 02 6F 03
				23 01 00 00 00 00 02 70 D9

				23 00 00 00 00 00 02 71 01
				23 00 00 00 00 00 02 72 59
				23 00 00 00 00 00 02 73 01
				23 00 00 00 00 00 02 74 5D
				23 00 00 00 00 00 02 75 01
				23 00 00 00 00 00 02 76 66
				23 00 00 00 00 00 02 77 01
				23 00 00 00 00 00 02 78 6E
				23 00 00 00 00 00 02 79 01
				23 00 00 00 00 00 02 7A 76
				23 00 00 00 00 00 02 7B 01
				23 00 00 00 00 00 02 7C 7D
				23 00 00 00 00 00 02 7D 01
				23 00 00 00 00 00 02 7E 84
				23 00 00 00 00 00 02 7F 01
				23 00 00 00 00 00 02 80 8A
				23 00 00 00 00 00 02 81 01
				23 00 00 00 00 00 02 82 91
				23 00 00 00 00 00 02 83 01
				23 00 00 00 00 00 02 84 A8
				23 00 00 00 00 00 02 85 01
				23 00 00 00 00 00 02 86 BB
				23 00 00 00 00 00 02 87 01
				23 00 00 00 00 00 02 88 DD
				23 00 00 00 00 00 02 89 01
				23 00 00 00 00 00 02 8A F6
				23 00 00 00 00 00 02 8B 02
				23 00 00 00 00 00 02 8C 24
				23 00 00 00 00 00 02 8D 02
				23 00 00 00 00 00 02 8E 4D
				23 00 00 00 00 00 02 8F 02
				23 00 00 00 00 00 02 90 4F
				23 00 00 00 00 00 02 91 02
				23 00 00 00 00 00 02 92 7B
				23 00 00 00 00 00 02 93 02
				23 00 00 00 00 00 02 94 B6
				23 00 00 00 00 00 02 95 02
				23 00 00 00 00 00 02 96 DF
				23 00 00 00 00 00 02 97 03
				23 00 00 00 00 00 02 98 0D
				23 00 00 00 00 00 02 99 03
				23 00 00 00 00 00 02 9A 39
				23 00 00 00 00 00 02 9B 03
				23 00 00 00 00 00 02 9C 64
				23 00 00 00 00 00 02 9D 03
				23 00 00 00 00 00 02 9E 71
				23 00 00 00 00 00 02 9F 03
				23 00 00 00 00 00 02 A0 7F
				23 00 00 00 00 00 02 A2 03
				23 00 00 00 00 00 02 A3 8E
				23 00 00 00 00 00 02 A4 03
				23 00 00 00 00 00 02 A5 A1
				23 00 00 00 00 00 02 A6 03
				23 00 00 00 00 00 02 A7 B5
				23 00 00 00 00 00 02 A9 03
				23 00 00 00 00 00 02 AA CA
				23 00 00 00 00 00 02 AB 03
				23 00 00 00 00 00 02 AC D7
				23 00 00 00 00 00 02 AD 03
				23 01 00 00 00 00 02 AE D9

				23 00 00 00 00 00 02 AF 01
				23 00 00 00 00 00 02 B0 59
				23 00 00 00 00 00 02 B1 01
				23 00 00 00 00 00 02 B2 5D
				23 00 00 00 00 00 02 B3 01
				23 00 00 00 00 00 02 B4 66
				23 00 00 00 00 00 02 B5 01
				23 00 00 00 00 00 02 B6 6E
				23 00 00 00 00 00 02 B7 01
				23 00 00 00 00 00 02 B8 76
				23 00 00 00 00 00 02 B9 01
				23 00 00 00 00 00 02 BA 7D
				23 00 00 00 00 00 02 BB 01
				23 00 00 00 00 00 02 BC 84
				23 00 00 00 00 00 02 BD 01
				23 00 00 00 00 00 02 BE 8A
				23 00 00 00 00 00 02 BF 01
				23 00 00 00 00 00 02 C0 91
				23 00 00 00 00 00 02 C1 01
				23 00 00 00 00 00 02 C2 A8
				23 00 00 00 00 00 02 C3 01
				23 00 00 00 00 00 02 C4 BB
				23 00 00 00 00 00 02 C5 01
				23 00 00 00 00 00 02 C6 DD
				23 00 00 00 00 00 02 C7 01
				23 00 00 00 00 00 02 C8 F6
				23 00 00 00 00 00 02 C9 02
				23 00 00 00 00 00 02 CA 24
				23 00 00 00 00 00 02 CB 02
				23 00 00 00 00 00 02 CC 4D
				23 00 00 00 00 00 02 CD 02
				23 00 00 00 00 00 02 CE 4F
				23 00 00 00 00 00 02 CF 02
				23 00 00 00 00 00 02 D0 7B
				23 00 00 00 00 00 02 D1 02
				23 00 00 00 00 00 02 D2 B6
				23 00 00 00 00 00 02 D3 02
				23 00 00 00 00 00 02 D4 DF
				23 00 00 00 00 00 02 D5 03
				23 00 00 00 00 00 02 D6 0D
				23 00 00 00 00 00 02 D7 03
				23 00 00 00 00 00 02 D8 39
				23 00 00 00 00 00 02 D9 03
				23 00 00 00 00 00 02 DA 64
				23 00 00 00 00 00 02 DB 03
				23 00 00 00 00 00 02 DC 71
				23 00 00 00 00 00 02 DD 03
				23 00 00 00 00 00 02 DE 7F
				23 00 00 00 00 00 02 DF 03
				23 00 00 00 00 00 02 E0 8E
				23 00 00 00 00 00 02 E1 03
				23 00 00 00 00 00 02 E2 A1
				23 00 00 00 00 00 02 E3 03
				23 00 00 00 00 00 02 E4 B5
				23 00 00 00 00 00 02 E5 03
				23 00 00 00 00 00 02 E6 CA
				23 00 00 00 00 00 02 E7 03
				23 00 00 00 00 00 02 E8 D7
				23 00 00 00 00 00 02 E9 03
				23 01 00 00 00 00 02 EA D9];

		qcom,mdss-dsi-PM3-command = [23 00 00 00 00 00 02 FF 01
				23 00 00 00 00 00 02 FB 01
				23 00 00 00 00 00 02 75 00
				23 00 00 00 00 00 02 76 00
				23 00 00 00 00 00 02 77 00
				23 00 00 00 00 00 02 78 21
				23 00 00 00 00 00 02 79 00
				23 00 00 00 00 00 02 7A 58
				23 00 00 00 00 00 02 7B 00
				23 00 00 00 00 00 02 7C 82
				23 00 00 00 00 00 02 7D 00
				23 00 00 00 00 00 02 7E A3
				23 00 00 00 00 00 02 7F 00
				23 00 00 00 00 00 02 80 BF
				23 00 00 00 00 00 02 81 00
				23 00 00 00 00 00 02 82 D6
				23 00 00 00 00 00 02 83 00
				23 00 00 00 00 00 02 84 EA
				23 00 00 00 00 00 02 85 00
				23 00 00 00 00 00 02 86 FC
				23 00 00 00 00 00 02 87 01
				23 00 00 00 00 00 02 88 34
				23 00 00 00 00 00 02 89 01
				23 00 00 00 00 00 02 8A 5E
				23 00 00 00 00 00 02 8B 01
				23 00 00 00 00 00 02 8C 9B
				23 00 00 00 00 00 02 8D 01
				23 00 00 00 00 00 02 8E C7
				23 00 00 00 00 00 02 8F 02
				23 00 00 00 00 00 02 90 05
				23 00 00 00 00 00 02 91 02
				23 00 00 00 00 00 02 92 36
				23 00 00 00 00 00 02 93 02
				23 00 00 00 00 00 02 94 37
				23 00 00 00 00 00 02 95 02
				23 00 00 00 00 00 02 96 67
				23 00 00 00 00 00 02 97 02
				23 00 00 00 00 00 02 98 A3
				23 00 00 00 00 00 02 99 02
				23 00 00 00 00 00 02 9A CE
				23 00 00 00 00 00 02 9B 02
				23 00 00 00 00 00 02 9C FF
				23 00 00 00 00 00 02 9D 03
				23 00 00 00 00 00 02 9E 29
				23 00 00 00 00 00 02 9F 03
				23 00 00 00 00 00 02 A0 56
				23 00 00 00 00 00 02 A2 03
				23 00 00 00 00 00 02 A3 63
				23 00 00 00 00 00 02 A4 03
				23 00 00 00 00 00 02 A5 71
				23 00 00 00 00 00 02 A6 03
				23 00 00 00 00 00 02 A7 81
				23 00 00 00 00 00 02 A9 03
				23 00 00 00 00 00 02 AA 94
				23 00 00 00 00 00 02 AB 03
				23 00 00 00 00 00 02 AC AA
				23 00 00 00 00 00 02 AD 03
				23 00 00 00 00 00 02 AE C4
				23 00 00 00 00 00 02 AF 03
				23 00 00 00 00 00 02 B0 D7
				23 00 00 00 00 00 02 B1 03
				23 01 00 00 00 00 02 B2 D9

				23 00 00 00 00 00 02 B3 00
				23 00 00 00 00 00 02 B4 00
				23 00 00 00 00 00 02 B5 00
				23 00 00 00 00 00 02 B6 21
				23 00 00 00 00 00 02 B7 00
				23 00 00 00 00 00 02 B8 58
				23 00 00 00 00 00 02 B9 00
				23 00 00 00 00 00 02 BA 82
				23 00 00 00 00 00 02 BB 00
				23 00 00 00 00 00 02 BC A3
				23 00 00 00 00 00 02 BD 00
				23 00 00 00 00 00 02 BE BF
				23 00 00 00 00 00 02 BF 00
				23 00 00 00 00 00 02 C0 D6
				23 00 00 00 00 00 02 C1 00
				23 00 00 00 00 00 02 C2 EA
				23 00 00 00 00 00 02 C3 00
				23 00 00 00 00 00 02 C4 FC
				23 00 00 00 00 00 02 C5 01
				23 00 00 00 00 00 02 C6 34
				23 00 00 00 00 00 02 C7 01
				23 00 00 00 00 00 02 C8 5E
				23 00 00 00 00 00 02 C9 01
				23 00 00 00 00 00 02 CA 9B
				23 00 00 00 00 00 02 CB 01
				23 00 00 00 00 00 02 CC C7
				23 00 00 00 00 00 02 CD 02
				23 00 00 00 00 00 02 CE 05
				23 00 00 00 00 00 02 CF 02
				23 00 00 00 00 00 02 D0 36
				23 00 00 00 00 00 02 D1 02
				23 00 00 00 00 00 02 D2 37
				23 00 00 00 00 00 02 D3 02
				23 00 00 00 00 00 02 D4 67
				23 00 00 00 00 00 02 D5 02
				23 00 00 00 00 00 02 D6 A3
				23 00 00 00 00 00 02 D7 02
				23 00 00 00 00 00 02 D8 CE
				23 00 00 00 00 00 02 D9 02
				23 00 00 00 00 00 02 DA FF
				23 00 00 00 00 00 02 DB 03
				23 00 00 00 00 00 02 DC 29
				23 00 00 00 00 00 02 DD 03
				23 00 00 00 00 00 02 DE 56
				23 00 00 00 00 00 02 DF 03
				23 00 00 00 00 00 02 E0 63
				23 00 00 00 00 00 02 E1 03
				23 00 00 00 00 00 02 E2 71
				23 00 00 00 00 00 02 E3 03
				23 00 00 00 00 00 02 E4 81
				23 00 00 00 00 00 02 E5 03
				23 00 00 00 00 00 02 E6 94
				23 00 00 00 00 00 02 E7 03
				23 00 00 00 00 00 02 E8 AA
				23 00 00 00 00 00 02 E9 03
				23 00 00 00 00 00 02 EA C4
				23 00 00 00 00 00 02 EB 03
				23 00 00 00 00 00 02 EC D7
				23 00 00 00 00 00 02 ED 03
				23 01 00 00 00 00 02 EE D9

				23 00 00 00 00 00 02 EF 00
				23 00 00 00 00 00 02 F0 00
				23 00 00 00 00 00 02 F1 00
				23 00 00 00 00 00 02 F2 2E
				23 00 00 00 00 00 02 F3 00
				23 00 00 00 00 00 02 F4 62
				23 00 00 00 00 00 02 F5 00
				23 00 00 00 00 00 02 F6 89
				23 00 00 00 00 00 02 F7 00
				23 00 00 00 00 00 02 F8 A9
				23 00 00 00 00 00 02 F9 00
				23 00 00 00 00 00 02 FA C4
				23 00 00 00 00 00 02 FF 02
				23 00 00 00 00 00 02 FB 01
				23 00 00 00 00 00 02 00 00
				23 00 00 00 00 00 02 01 DB
				23 00 00 00 00 00 02 02 00
				23 00 00 00 00 00 02 03 EE
				23 00 00 00 00 00 02 04 01
				23 00 00 00 00 00 02 05 00
				23 00 00 00 00 00 02 06 01
				23 00 00 00 00 00 02 07 38
				23 00 00 00 00 00 02 08 01
				23 00 00 00 00 00 02 09 62
				23 00 00 00 00 00 02 0A 01
				23 00 00 00 00 00 02 0B 9E
				23 00 00 00 00 00 02 0C 01
				23 00 00 00 00 00 02 0D CA
				23 00 00 00 00 00 02 0E 02
				23 00 00 00 00 00 02 0F 09
				23 00 00 00 00 00 02 10 02
				23 00 00 00 00 00 02 11 39
				23 00 00 00 00 00 02 12 02
				23 00 00 00 00 00 02 13 3B
				23 00 00 00 00 00 02 14 02
				23 00 00 00 00 00 02 15 6B
				23 00 00 00 00 00 02 16 02
				23 00 00 00 00 00 02 17 A8
				23 00 00 00 00 00 02 18 02
				23 00 00 00 00 00 02 19 D3
				23 00 00 00 00 00 02 1A 03
				23 00 00 00 00 00 02 1B 04
				23 00 00 00 00 00 02 1C 03
				23 00 00 00 00 00 02 1D 2F
				23 00 00 00 00 00 02 1E 03
				23 00 00 00 00 00 02 1F 5B
				23 00 00 00 00 00 02 20 03
				23 00 00 00 00 00 02 21 68
				23 00 00 00 00 00 02 22 03
				23 00 00 00 00 00 02 23 76
				23 00 00 00 00 00 02 24 03
				23 00 00 00 00 00 02 25 86
				23 00 00 00 00 00 02 26 03
				23 00 00 00 00 00 02 27 98
				23 00 00 00 00 00 02 28 03
				23 00 00 00 00 00 02 29 AD
				23 00 00 00 00 00 02 2A 03
				23 00 00 00 00 00 02 2B C5
				23 00 00 00 00 00 02 2D 03
				23 00 00 00 00 00 02 2F D7
				23 00 00 00 00 00 02 30 03
				23 01 00 00 00 00 02 31 D9

				23 00 00 00 00 00 02 32 00
				23 00 00 00 00 00 02 33 00
				23 00 00 00 00 00 02 34 00
				23 00 00 00 00 00 02 35 2E
				23 00 00 00 00 00 02 36 00
				23 00 00 00 00 00 02 37 62
				23 00 00 00 00 00 02 38 00
				23 00 00 00 00 00 02 39 89
				23 00 00 00 00 00 02 3A 00
				23 00 00 00 00 00 02 3B A9
				23 00 00 00 00 00 02 3D 00
				23 00 00 00 00 00 02 3F C4
				23 00 00 00 00 00 02 40 00
				23 00 00 00 00 00 02 41 DB
				23 00 00 00 00 00 02 42 00
				23 00 00 00 00 00 02 43 EE
				23 00 00 00 00 00 02 44 01
				23 00 00 00 00 00 02 45 00
				23 00 00 00 00 00 02 46 01
				23 00 00 00 00 00 02 47 38
				23 00 00 00 00 00 02 48 01
				23 00 00 00 00 00 02 49 62
				23 00 00 00 00 00 02 4A 01
				23 00 00 00 00 00 02 4B 9E
				23 00 00 00 00 00 02 4C 01
				23 00 00 00 00 00 02 4D CA
				23 00 00 00 00 00 02 4E 02
				23 00 00 00 00 00 02 4F 09
				23 00 00 00 00 00 02 50 02
				23 00 00 00 00 00 02 51 39
				23 00 00 00 00 00 02 52 02
				23 00 00 00 00 00 02 53 3B
				23 00 00 00 00 00 02 54 02
				23 00 00 00 00 00 02 55 6B
				23 00 00 00 00 00 02 56 02
				23 00 00 00 00 00 02 58 A8
				23 00 00 00 00 00 02 59 02
				23 00 00 00 00 00 02 5A D3
				23 00 00 00 00 00 02 5B 03
				23 00 00 00 00 00 02 5C 04
				23 00 00 00 00 00 02 5D 03
				23 00 00 00 00 00 02 5E 2F
				23 00 00 00 00 00 02 5F 03
				23 00 00 00 00 00 02 60 5B
				23 00 00 00 00 00 02 61 03
				23 00 00 00 00 00 02 62 68
				23 00 00 00 00 00 02 63 03
				23 00 00 00 00 00 02 64 76
				23 00 00 00 00 00 02 65 03
				23 00 00 00 00 00 02 66 86
				23 00 00 00 00 00 02 67 03
				23 00 00 00 00 00 02 68 98
				23 00 00 00 00 00 02 69 03
				23 00 00 00 00 00 02 6A AD
				23 00 00 00 00 00 02 6B 03
				23 00 00 00 00 00 02 6C C5
				23 00 00 00 00 00 02 6D 03
				23 00 00 00 00 00 02 6E D7
				23 00 00 00 00 00 02 6F 03
				23 01 00 00 00 00 02 70 D9

				23 00 00 00 00 00 02 71 01
				23 00 00 00 00 00 02 72 8B
				23 00 00 00 00 00 02 73 01
				23 00 00 00 00 00 02 74 8E
				23 00 00 00 00 00 02 75 01
				23 00 00 00 00 00 02 76 94
				23 00 00 00 00 00 02 77 01
				23 00 00 00 00 00 02 78 99
				23 00 00 00 00 00 02 79 01
				23 00 00 00 00 00 02 7A 9F
				23 00 00 00 00 00 02 7B 01
				23 00 00 00 00 00 02 7C A4
				23 00 00 00 00 00 02 7D 01
				23 00 00 00 00 00 02 7E A9
				23 00 00 00 00 00 02 7F 01
				23 00 00 00 00 00 02 80 AE
				23 00 00 00 00 00 02 81 01
				23 00 00 00 00 00 02 82 B3
				23 00 00 00 00 00 02 83 01
				23 00 00 00 00 00 02 84 C4
				23 00 00 00 00 00 02 85 01
				23 00 00 00 00 00 02 86 D4
				23 00 00 00 00 00 02 87 01
				23 00 00 00 00 00 02 88 F0
				23 00 00 00 00 00 02 89 02
				23 00 00 00 00 00 02 8A 06
				23 00 00 00 00 00 02 8B 02
				23 00 00 00 00 00 02 8C 2F
				23 00 00 00 00 00 02 8D 02
				23 00 00 00 00 00 02 8E 56
				23 00 00 00 00 00 02 8F 02
				23 00 00 00 00 00 02 90 58
				23 00 00 00 00 00 02 91 02
				23 00 00 00 00 00 02 92 83
				23 00 00 00 00 00 02 93 02
				23 00 00 00 00 00 02 94 BE
				23 00 00 00 00 00 02 95 02
				23 00 00 00 00 00 02 96 E6
				23 00 00 00 00 00 02 97 03
				23 00 00 00 00 00 02 98 12
				23 00 00 00 00 00 02 99 03
				23 00 00 00 00 00 02 9A 3D
				23 00 00 00 00 00 02 9B 03
				23 00 00 00 00 00 02 9C 68
				23 00 00 00 00 00 02 9D 03
				23 00 00 00 00 00 02 9E 76
				23 00 00 00 00 00 02 9F 03
				23 00 00 00 00 00 02 A0 85
				23 00 00 00 00 00 02 A2 03
				23 00 00 00 00 00 02 A3 97
				23 00 00 00 00 00 02 A4 03
				23 00 00 00 00 00 02 A5 AA
				23 00 00 00 00 00 02 A6 03
				23 00 00 00 00 00 02 A7 BE
				23 00 00 00 00 00 02 A9 03
				23 00 00 00 00 00 02 AA CE
				23 00 00 00 00 00 02 AB 03
				23 00 00 00 00 00 02 AC D7
				23 00 00 00 00 00 02 AD 03
				23 01 00 00 00 00 02 AE D9

				23 00 00 00 00 00 02 AF 01
				23 00 00 00 00 00 02 B0 8B
				23 00 00 00 00 00 02 B1 01
				23 00 00 00 00 00 02 B2 8E
				23 00 00 00 00 00 02 B3 01
				23 00 00 00 00 00 02 B4 94
				23 00 00 00 00 00 02 B5 01
				23 00 00 00 00 00 02 B6 99
				23 00 00 00 00 00 02 B7 01
				23 00 00 00 00 00 02 B8 9F
				23 00 00 00 00 00 02 B9 01
				23 00 00 00 00 00 02 BA A4
				23 00 00 00 00 00 02 BB 01
				23 00 00 00 00 00 02 BC A9
				23 00 00 00 00 00 02 BD 01
				23 00 00 00 00 00 02 BE AE
				23 00 00 00 00 00 02 BF 01
				23 00 00 00 00 00 02 C0 B3
				23 00 00 00 00 00 02 C1 01
				23 00 00 00 00 00 02 C2 C4
				23 00 00 00 00 00 02 C3 01
				23 00 00 00 00 00 02 C4 D4
				23 00 00 00 00 00 02 C5 01
				23 00 00 00 00 00 02 C6 F0
				23 00 00 00 00 00 02 C7 02
				23 00 00 00 00 00 02 C8 06
				23 00 00 00 00 00 02 C9 02
				23 00 00 00 00 00 02 CA 2F
				23 00 00 00 00 00 02 CB 02
				23 00 00 00 00 00 02 CC 56
				23 00 00 00 00 00 02 CD 02
				23 00 00 00 00 00 02 CE 58
				23 00 00 00 00 00 02 CF 02
				23 00 00 00 00 00 02 D0 83
				23 00 00 00 00 00 02 D1 02
				23 00 00 00 00 00 02 D2 BE
				23 00 00 00 00 00 02 D3 02
				23 00 00 00 00 00 02 D4 E6
				23 00 00 00 00 00 02 D5 03
				23 00 00 00 00 00 02 D6 12
				23 00 00 00 00 00 02 D7 03
				23 00 00 00 00 00 02 D8 3D
				23 00 00 00 00 00 02 D9 03
				23 00 00 00 00 00 02 DA 68
				23 00 00 00 00 00 02 DB 03
				23 00 00 00 00 00 02 DC 76
				23 00 00 00 00 00 02 DD 03
				23 00 00 00 00 00 02 DE 85
				23 00 00 00 00 00 02 DF 03
				23 00 00 00 00 00 02 E0 97
				23 00 00 00 00 00 02 E1 03
				23 00 00 00 00 00 02 E2 AA
				23 00 00 00 00 00 02 E3 03
				23 00 00 00 00 00 02 E4 BE
				23 00 00 00 00 00 02 E5 03
				23 00 00 00 00 00 02 E6 CE
				23 00 00 00 00 00 02 E7 03
				23 00 00 00 00 00 02 E8 D7
				23 00 00 00 00 00 02 E9 03
				23 01 00 00 00 00 02 EA D9];

		qcom,mdss-dsi-PM4-command = [23 00 00 00 00 00 02 FF 01
				23 00 00 00 00 00 02 FB 01
				23 00 00 00 00 00 02 75 00
				23 00 00 00 00 00 02 76 00
				23 00 00 00 00 00 02 77 00
				23 00 00 00 00 00 02 78 21
				23 00 00 00 00 00 02 79 00
				23 00 00 00 00 00 02 7A 58
				23 00 00 00 00 00 02 7B 00
				23 00 00 00 00 00 02 7C 82
				23 00 00 00 00 00 02 7D 00
				23 00 00 00 00 00 02 7E A3
				23 00 00 00 00 00 02 7F 00
				23 00 00 00 00 00 02 80 BF
				23 00 00 00 00 00 02 81 00
				23 00 00 00 00 00 02 82 D6
				23 00 00 00 00 00 02 83 00
				23 00 00 00 00 00 02 84 EA
				23 00 00 00 00 00 02 85 00
				23 00 00 00 00 00 02 86 FC
				23 00 00 00 00 00 02 87 01
				23 00 00 00 00 00 02 88 34
				23 00 00 00 00 00 02 89 01
				23 00 00 00 00 00 02 8A 5E
				23 00 00 00 00 00 02 8B 01
				23 00 00 00 00 00 02 8C 9B
				23 00 00 00 00 00 02 8D 01
				23 00 00 00 00 00 02 8E C7
				23 00 00 00 00 00 02 8F 02
				23 00 00 00 00 00 02 90 05
				23 00 00 00 00 00 02 91 02
				23 00 00 00 00 00 02 92 36
				23 00 00 00 00 00 02 93 02
				23 00 00 00 00 00 02 94 37
				23 00 00 00 00 00 02 95 02
				23 00 00 00 00 00 02 96 67
				23 00 00 00 00 00 02 97 02
				23 00 00 00 00 00 02 98 A3
				23 00 00 00 00 00 02 99 02
				23 00 00 00 00 00 02 9A CE
				23 00 00 00 00 00 02 9B 02
				23 00 00 00 00 00 02 9C FF
				23 00 00 00 00 00 02 9D 03
				23 00 00 00 00 00 02 9E 29
				23 00 00 00 00 00 02 9F 03
				23 00 00 00 00 00 02 A0 56
				23 00 00 00 00 00 02 A2 03
				23 00 00 00 00 00 02 A3 63
				23 00 00 00 00 00 02 A4 03
				23 00 00 00 00 00 02 A5 71
				23 00 00 00 00 00 02 A6 03
				23 00 00 00 00 00 02 A7 81
				23 00 00 00 00 00 02 A9 03
				23 00 00 00 00 00 02 AA 94
				23 00 00 00 00 00 02 AB 03
				23 00 00 00 00 00 02 AC AA
				23 00 00 00 00 00 02 AD 03
				23 00 00 00 00 00 02 AE C4
				23 00 00 00 00 00 02 AF 03
				23 00 00 00 00 00 02 B0 D7
				23 00 00 00 00 00 02 B1 03
				23 01 00 00 00 00 02 B2 D9

				23 00 00 00 00 00 02 B3 00
				23 00 00 00 00 00 02 B4 00
				23 00 00 00 00 00 02 B5 00
				23 00 00 00 00 00 02 B6 21
				23 00 00 00 00 00 02 B7 00
				23 00 00 00 00 00 02 B8 58
				23 00 00 00 00 00 02 B9 00
				23 00 00 00 00 00 02 BA 82
				23 00 00 00 00 00 02 BB 00
				23 00 00 00 00 00 02 BC A3
				23 00 00 00 00 00 02 BD 00
				23 00 00 00 00 00 02 BE BF
				23 00 00 00 00 00 02 BF 00
				23 00 00 00 00 00 02 C0 D6
				23 00 00 00 00 00 02 C1 00
				23 00 00 00 00 00 02 C2 EA
				23 00 00 00 00 00 02 C3 00
				23 00 00 00 00 00 02 C4 FC
				23 00 00 00 00 00 02 C5 01
				23 00 00 00 00 00 02 C6 34
				23 00 00 00 00 00 02 C7 01
				23 00 00 00 00 00 02 C8 5E
				23 00 00 00 00 00 02 C9 01
				23 00 00 00 00 00 02 CA 9B
				23 00 00 00 00 00 02 CB 01
				23 00 00 00 00 00 02 CC C7
				23 00 00 00 00 00 02 CD 02
				23 00 00 00 00 00 02 CE 05
				23 00 00 00 00 00 02 CF 02
				23 00 00 00 00 00 02 D0 36
				23 00 00 00 00 00 02 D1 02
				23 00 00 00 00 00 02 D2 37
				23 00 00 00 00 00 02 D3 02
				23 00 00 00 00 00 02 D4 67
				23 00 00 00 00 00 02 D5 02
				23 00 00 00 00 00 02 D6 A3
				23 00 00 00 00 00 02 D7 02
				23 00 00 00 00 00 02 D8 CE
				23 00 00 00 00 00 02 D9 02
				23 00 00 00 00 00 02 DA FF
				23 00 00 00 00 00 02 DB 03
				23 00 00 00 00 00 02 DC 29
				23 00 00 00 00 00 02 DD 03
				23 00 00 00 00 00 02 DE 56
				23 00 00 00 00 00 02 DF 03
				23 00 00 00 00 00 02 E0 63
				23 00 00 00 00 00 02 E1 03
				23 00 00 00 00 00 02 E2 71
				23 00 00 00 00 00 02 E3 03
				23 00 00 00 00 00 02 E4 81
				23 00 00 00 00 00 02 E5 03
				23 00 00 00 00 00 02 E6 94
				23 00 00 00 00 00 02 E7 03
				23 00 00 00 00 00 02 E8 AA
				23 00 00 00 00 00 02 E9 03
				23 00 00 00 00 00 02 EA C4
				23 00 00 00 00 00 02 EB 03
				23 00 00 00 00 00 02 EC D7
				23 00 00 00 00 00 02 ED 03
				23 01 00 00 00 00 02 EE D9

				23 00 00 00 00 00 02 EF 00
				23 00 00 00 00 00 02 F0 00
				23 00 00 00 00 00 02 F1 00
				23 00 00 00 00 00 02 F2 2E
				23 00 00 00 00 00 02 F3 00
				23 00 00 00 00 00 02 F4 62
				23 00 00 00 00 00 02 F5 00
				23 00 00 00 00 00 02 F6 89
				23 00 00 00 00 00 02 F7 00
				23 00 00 00 00 00 02 F8 A9
				23 00 00 00 00 00 02 F9 00
				23 00 00 00 00 00 02 FA C4
				23 00 00 00 00 00 02 FF 02
				23 00 00 00 00 00 02 FB 01
				23 00 00 00 00 00 02 00 00
				23 00 00 00 00 00 02 01 DB
				23 00 00 00 00 00 02 02 00
				23 00 00 00 00 00 02 03 EE
				23 00 00 00 00 00 02 04 01
				23 00 00 00 00 00 02 05 00
				23 00 00 00 00 00 02 06 01
				23 00 00 00 00 00 02 07 38
				23 00 00 00 00 00 02 08 01
				23 00 00 00 00 00 02 09 62
				23 00 00 00 00 00 02 0A 01
				23 00 00 00 00 00 02 0B 9E
				23 00 00 00 00 00 02 0C 01
				23 00 00 00 00 00 02 0D CA
				23 00 00 00 00 00 02 0E 02
				23 00 00 00 00 00 02 0F 09
				23 00 00 00 00 00 02 10 02
				23 00 00 00 00 00 02 11 39
				23 00 00 00 00 00 02 12 02
				23 00 00 00 00 00 02 13 3B
				23 00 00 00 00 00 02 14 02
				23 00 00 00 00 00 02 15 6B
				23 00 00 00 00 00 02 16 02
				23 00 00 00 00 00 02 17 A8
				23 00 00 00 00 00 02 18 02
				23 00 00 00 00 00 02 19 D3
				23 00 00 00 00 00 02 1A 03
				23 00 00 00 00 00 02 1B 04
				23 00 00 00 00 00 02 1C 03
				23 00 00 00 00 00 02 1D 2F
				23 00 00 00 00 00 02 1E 03
				23 00 00 00 00 00 02 1F 5B
				23 00 00 00 00 00 02 20 03
				23 00 00 00 00 00 02 21 68
				23 00 00 00 00 00 02 22 03
				23 00 00 00 00 00 02 23 76
				23 00 00 00 00 00 02 24 03
				23 00 00 00 00 00 02 25 86
				23 00 00 00 00 00 02 26 03
				23 00 00 00 00 00 02 27 98
				23 00 00 00 00 00 02 28 03
				23 00 00 00 00 00 02 29 AD
				23 00 00 00 00 00 02 2A 03
				23 00 00 00 00 00 02 2B C5
				23 00 00 00 00 00 02 2D 03
				23 00 00 00 00 00 02 2F D7
				23 00 00 00 00 00 02 30 03
				23 01 00 00 00 00 02 31 D9

				23 00 00 00 00 00 02 32 00
				23 00 00 00 00 00 02 33 00
				23 00 00 00 00 00 02 34 00
				23 00 00 00 00 00 02 35 2E
				23 00 00 00 00 00 02 36 00
				23 00 00 00 00 00 02 37 62
				23 00 00 00 00 00 02 38 00
				23 00 00 00 00 00 02 39 89
				23 00 00 00 00 00 02 3A 00
				23 00 00 00 00 00 02 3B A9
				23 00 00 00 00 00 02 3D 00
				23 00 00 00 00 00 02 3F C4
				23 00 00 00 00 00 02 40 00
				23 00 00 00 00 00 02 41 DB
				23 00 00 00 00 00 02 42 00
				23 00 00 00 00 00 02 43 EE
				23 00 00 00 00 00 02 44 01
				23 00 00 00 00 00 02 45 00
				23 00 00 00 00 00 02 46 01
				23 00 00 00 00 00 02 47 38
				23 00 00 00 00 00 02 48 01
				23 00 00 00 00 00 02 49 62
				23 00 00 00 00 00 02 4A 01
				23 00 00 00 00 00 02 4B 9E
				23 00 00 00 00 00 02 4C 01
				23 00 00 00 00 00 02 4D CA
				23 00 00 00 00 00 02 4E 02
				23 00 00 00 00 00 02 4F 09
				23 00 00 00 00 00 02 50 02
				23 00 00 00 00 00 02 51 39
				23 00 00 00 00 00 02 52 02
				23 00 00 00 00 00 02 53 3B
				23 00 00 00 00 00 02 54 02
				23 00 00 00 00 00 02 55 6B
				23 00 00 00 00 00 02 56 02
				23 00 00 00 00 00 02 58 A8
				23 00 00 00 00 00 02 59 02
				23 00 00 00 00 00 02 5A D3
				23 00 00 00 00 00 02 5B 03
				23 00 00 00 00 00 02 5C 04
				23 00 00 00 00 00 02 5D 03
				23 00 00 00 00 00 02 5E 2F
				23 00 00 00 00 00 02 5F 03
				23 00 00 00 00 00 02 60 5B
				23 00 00 00 00 00 02 61 03
				23 00 00 00 00 00 02 62 68
				23 00 00 00 00 00 02 63 03
				23 00 00 00 00 00 02 64 76
				23 00 00 00 00 00 02 65 03
				23 00 00 00 00 00 02 66 86
				23 00 00 00 00 00 02 67 03
				23 00 00 00 00 00 02 68 98
				23 00 00 00 00 00 02 69 03
				23 00 00 00 00 00 02 6A AD
				23 00 00 00 00 00 02 6B 03
				23 00 00 00 00 00 02 6C C5
				23 00 00 00 00 00 02 6D 03
				23 00 00 00 00 00 02 6E D7
				23 00 00 00 00 00 02 6F 03
				23 01 00 00 00 00 02 70 D9

				23 00 00 00 00 00 02 71 01
				23 00 00 00 00 00 02 72 B2
				23 00 00 00 00 00 02 73 01
				23 00 00 00 00 00 02 74 B4
				23 00 00 00 00 00 02 75 01
				23 00 00 00 00 00 02 76 B9
				23 00 00 00 00 00 02 77 01
				23 00 00 00 00 00 02 78 BD
				23 00 00 00 00 00 02 79 01
				23 00 00 00 00 00 02 7A C1
				23 00 00 00 00 00 02 7B 01
				23 00 00 00 00 00 02 7C C5
				23 00 00 00 00 00 02 7D 01
				23 00 00 00 00 00 02 7E C9
				23 00 00 00 00 00 02 7F 01
				23 00 00 00 00 00 02 80 CC
				23 00 00 00 00 00 02 81 01
				23 00 00 00 00 00 02 82 D0
				23 00 00 00 00 00 02 83 01
				23 00 00 00 00 00 02 84 DE
				23 00 00 00 00 00 02 85 01
				23 00 00 00 00 00 02 86 EB
				23 00 00 00 00 00 02 87 02
				23 00 00 00 00 00 02 88 01
				23 00 00 00 00 00 02 89 02
				23 00 00 00 00 00 02 8A 15
				23 00 00 00 00 00 02 8B 02
				23 00 00 00 00 00 02 8C 3A
				23 00 00 00 00 00 02 8D 02
				23 00 00 00 00 00 02 8E 60
				23 00 00 00 00 00 02 8F 02
				23 00 00 00 00 00 02 90 61
				23 00 00 00 00 00 02 91 02
				23 00 00 00 00 00 02 92 8B
				23 00 00 00 00 00 02 93 02
				23 00 00 00 00 00 02 94 C6
				23 00 00 00 00 00 02 95 02
				23 00 00 00 00 00 02 96 ED
				23 00 00 00 00 00 02 97 03
				23 00 00 00 00 00 02 98 23
				23 00 00 00 00 00 02 99 03
				23 00 00 00 00 00 02 9A 44
				23 00 00 00 00 00 02 9B 03
				23 00 00 00 00 00 02 9C 6E
				23 00 00 00 00 00 02 9D 03
				23 00 00 00 00 00 02 9E 7B
				23 00 00 00 00 00 02 9F 03
				23 00 00 00 00 00 02 A0 8A
				23 00 00 00 00 00 02 A2 03
				23 00 00 00 00 00 02 A3 9B
				23 00 00 00 00 00 02 A4 03
				23 00 00 00 00 00 02 A5 AE
				23 00 00 00 00 00 02 A6 03
				23 00 00 00 00 00 02 A7 C0
				23 00 00 00 00 00 02 A9 03
				23 00 00 00 00 00 02 AA CF
				23 00 00 00 00 00 02 AB 03
				23 00 00 00 00 00 02 AC D7
				23 00 00 00 00 00 02 AD 03
				23 01 00 00 00 00 02 AE D9

				23 00 00 00 00 00 02 AF 01
				23 00 00 00 00 00 02 B0 B2
				23 00 00 00 00 00 02 B1 01
				23 00 00 00 00 00 02 B2 B4
				23 00 00 00 00 00 02 B3 01
				23 00 00 00 00 00 02 B4 B9
				23 00 00 00 00 00 02 B5 01
				23 00 00 00 00 00 02 B6 BD
				23 00 00 00 00 00 02 B7 01
				23 00 00 00 00 00 02 B8 C1
				23 00 00 00 00 00 02 B9 01
				23 00 00 00 00 00 02 BA C5
				23 00 00 00 00 00 02 BB 01
				23 00 00 00 00 00 02 BC C9
				23 00 00 00 00 00 02 BD 01
				23 00 00 00 00 00 02 BE CC
				23 00 00 00 00 00 02 BF 01
				23 00 00 00 00 00 02 C0 D0
				23 00 00 00 00 00 02 C1 01
				23 00 00 00 00 00 02 C2 DE
				23 00 00 00 00 00 02 C3 01
				23 00 00 00 00 00 02 C4 EB
				23 00 00 00 00 00 02 C5 02
				23 00 00 00 00 00 02 C6 01
				23 00 00 00 00 00 02 C7 02
				23 00 00 00 00 00 02 C8 15
				23 00 00 00 00 00 02 C9 02
				23 00 00 00 00 00 02 CA 3A
				23 00 00 00 00 00 02 CB 02
				23 00 00 00 00 00 02 CC 60
				23 00 00 00 00 00 02 CD 02
				23 00 00 00 00 00 02 CE 61
				23 00 00 00 00 00 02 CF 02
				23 00 00 00 00 00 02 D0 8B
				23 00 00 00 00 00 02 D1 02
				23 00 00 00 00 00 02 D2 C6
				23 00 00 00 00 00 02 D3 02
				23 00 00 00 00 00 02 D4 ED
				23 00 00 00 00 00 02 D5 03
				23 00 00 00 00 00 02 D6 23
				23 00 00 00 00 00 02 D7 03
				23 00 00 00 00 00 02 D8 44
				23 00 00 00 00 00 02 D9 03
				23 00 00 00 00 00 02 DA 6E
				23 00 00 00 00 00 02 DB 03
				23 00 00 00 00 00 02 DC 7B
				23 00 00 00 00 00 02 DD 03
				23 00 00 00 00 00 02 DE 8A
				23 00 00 00 00 00 02 DF 03
				23 00 00 00 00 00 02 E0 9B
				23 00 00 00 00 00 02 E1 03
				23 00 00 00 00 00 02 E2 AE
				23 00 00 00 00 00 02 E3 03
				23 00 00 00 00 00 02 E4 C0
				23 00 00 00 00 00 02 E5 03
				23 00 00 00 00 00 02 E6 CF
				23 00 00 00 00 00 02 E7 03
				23 00 00 00 00 00 02 E8 D7
				23 00 00 00 00 00 02 E9 03
				23 01 00 00 00 00 02 EA D9];

		qcom,mdss-dsi-PM5-command = [23 00 00 00 00 00 02 FF 01
				23 00 00 00 00 00 02 FB 01
				23 00 00 00 00 00 02 75 00
				23 00 00 00 00 00 02 76 00
				23 00 00 00 00 00 02 77 00
				23 00 00 00 00 00 02 78 21
				23 00 00 00 00 00 02 79 00
				23 00 00 00 00 00 02 7A 58
				23 00 00 00 00 00 02 7B 00
				23 00 00 00 00 00 02 7C 82
				23 00 00 00 00 00 02 7D 00
				23 00 00 00 00 00 02 7E A3
				23 00 00 00 00 00 02 7F 00
				23 00 00 00 00 00 02 80 BF
				23 00 00 00 00 00 02 81 00
				23 00 00 00 00 00 02 82 D6
				23 00 00 00 00 00 02 83 00
				23 00 00 00 00 00 02 84 EA
				23 00 00 00 00 00 02 85 00
				23 00 00 00 00 00 02 86 FC
				23 00 00 00 00 00 02 87 01
				23 00 00 00 00 00 02 88 34
				23 00 00 00 00 00 02 89 01
				23 00 00 00 00 00 02 8A 5E
				23 00 00 00 00 00 02 8B 01
				23 00 00 00 00 00 02 8C 9B
				23 00 00 00 00 00 02 8D 01
				23 00 00 00 00 00 02 8E C7
				23 00 00 00 00 00 02 8F 02
				23 00 00 00 00 00 02 90 05
				23 00 00 00 00 00 02 91 02
				23 00 00 00 00 00 02 92 36
				23 00 00 00 00 00 02 93 02
				23 00 00 00 00 00 02 94 37
				23 00 00 00 00 00 02 95 02
				23 00 00 00 00 00 02 96 67
				23 00 00 00 00 00 02 97 02
				23 00 00 00 00 00 02 98 A3
				23 00 00 00 00 00 02 99 02
				23 00 00 00 00 00 02 9A CE
				23 00 00 00 00 00 02 9B 02
				23 00 00 00 00 00 02 9C FF
				23 00 00 00 00 00 02 9D 03
				23 00 00 00 00 00 02 9E 29
				23 00 00 00 00 00 02 9F 03
				23 00 00 00 00 00 02 A0 56
				23 00 00 00 00 00 02 A2 03
				23 00 00 00 00 00 02 A3 63
				23 00 00 00 00 00 02 A4 03
				23 00 00 00 00 00 02 A5 71
				23 00 00 00 00 00 02 A6 03
				23 00 00 00 00 00 02 A7 81
				23 00 00 00 00 00 02 A9 03
				23 00 00 00 00 00 02 AA 94
				23 00 00 00 00 00 02 AB 03
				23 00 00 00 00 00 02 AC AA
				23 00 00 00 00 00 02 AD 03
				23 00 00 00 00 00 02 AE C4
				23 00 00 00 00 00 02 AF 03
				23 00 00 00 00 00 02 B0 D7
				23 00 00 00 00 00 02 B1 03
				23 01 00 00 00 00 02 B2 D9

				23 00 00 00 00 00 02 B3 00
				23 00 00 00 00 00 02 B4 00
				23 00 00 00 00 00 02 B5 00
				23 00 00 00 00 00 02 B6 21
				23 00 00 00 00 00 02 B7 00
				23 00 00 00 00 00 02 B8 58
				23 00 00 00 00 00 02 B9 00
				23 00 00 00 00 00 02 BA 82
				23 00 00 00 00 00 02 BB 00
				23 00 00 00 00 00 02 BC A3
				23 00 00 00 00 00 02 BD 00
				23 00 00 00 00 00 02 BE BF
				23 00 00 00 00 00 02 BF 00
				23 00 00 00 00 00 02 C0 D6
				23 00 00 00 00 00 02 C1 00
				23 00 00 00 00 00 02 C2 EA
				23 00 00 00 00 00 02 C3 00
				23 00 00 00 00 00 02 C4 FC
				23 00 00 00 00 00 02 C5 01
				23 00 00 00 00 00 02 C6 34
				23 00 00 00 00 00 02 C7 01
				23 00 00 00 00 00 02 C8 5E
				23 00 00 00 00 00 02 C9 01
				23 00 00 00 00 00 02 CA 9B
				23 00 00 00 00 00 02 CB 01
				23 00 00 00 00 00 02 CC C7
				23 00 00 00 00 00 02 CD 02
				23 00 00 00 00 00 02 CE 05
				23 00 00 00 00 00 02 CF 02
				23 00 00 00 00 00 02 D0 36
				23 00 00 00 00 00 02 D1 02
				23 00 00 00 00 00 02 D2 37
				23 00 00 00 00 00 02 D3 02
				23 00 00 00 00 00 02 D4 67
				23 00 00 00 00 00 02 D5 02
				23 00 00 00 00 00 02 D6 A3
				23 00 00 00 00 00 02 D7 02
				23 00 00 00 00 00 02 D8 CE
				23 00 00 00 00 00 02 D9 02
				23 00 00 00 00 00 02 DA FF
				23 00 00 00 00 00 02 DB 03
				23 00 00 00 00 00 02 DC 29
				23 00 00 00 00 00 02 DD 03
				23 00 00 00 00 00 02 DE 56
				23 00 00 00 00 00 02 DF 03
				23 00 00 00 00 00 02 E0 63
				23 00 00 00 00 00 02 E1 03
				23 00 00 00 00 00 02 E2 71
				23 00 00 00 00 00 02 E3 03
				23 00 00 00 00 00 02 E4 81
				23 00 00 00 00 00 02 E5 03
				23 00 00 00 00 00 02 E6 94
				23 00 00 00 00 00 02 E7 03
				23 00 00 00 00 00 02 E8 AA
				23 00 00 00 00 00 02 E9 03
				23 00 00 00 00 00 02 EA C4
				23 00 00 00 00 00 02 EB 03
				23 00 00 00 00 00 02 EC D7
				23 00 00 00 00 00 02 ED 03
				23 01 00 00 00 00 02 EE D9

				23 00 00 00 00 00 02 EF 00
				23 00 00 00 00 00 02 F0 00
				23 00 00 00 00 00 02 F1 00
				23 00 00 00 00 00 02 F2 2E
				23 00 00 00 00 00 02 F3 00
				23 00 00 00 00 00 02 F4 62
				23 00 00 00 00 00 02 F5 00
				23 00 00 00 00 00 02 F6 89
				23 00 00 00 00 00 02 F7 00
				23 00 00 00 00 00 02 F8 A9
				23 00 00 00 00 00 02 F9 00
				23 00 00 00 00 00 02 FA C4
				23 00 00 00 00 00 02 FF 02
				23 00 00 00 00 00 02 FB 01
				23 00 00 00 00 00 02 00 00
				23 00 00 00 00 00 02 01 DB
				23 00 00 00 00 00 02 02 00
				23 00 00 00 00 00 02 03 EE
				23 00 00 00 00 00 02 04 01
				23 00 00 00 00 00 02 05 00
				23 00 00 00 00 00 02 06 01
				23 00 00 00 00 00 02 07 38
				23 00 00 00 00 00 02 08 01
				23 00 00 00 00 00 02 09 62
				23 00 00 00 00 00 02 0A 01
				23 00 00 00 00 00 02 0B 9E
				23 00 00 00 00 00 02 0C 01
				23 00 00 00 00 00 02 0D CA
				23 00 00 00 00 00 02 0E 02
				23 00 00 00 00 00 02 0F 09
				23 00 00 00 00 00 02 10 02
				23 00 00 00 00 00 02 11 39
				23 00 00 00 00 00 02 12 02
				23 00 00 00 00 00 02 13 3B
				23 00 00 00 00 00 02 14 02
				23 00 00 00 00 00 02 15 6B
				23 00 00 00 00 00 02 16 02
				23 00 00 00 00 00 02 17 A8
				23 00 00 00 00 00 02 18 02
				23 00 00 00 00 00 02 19 D3
				23 00 00 00 00 00 02 1A 03
				23 00 00 00 00 00 02 1B 04
				23 00 00 00 00 00 02 1C 03
				23 00 00 00 00 00 02 1D 2F
				23 00 00 00 00 00 02 1E 03
				23 00 00 00 00 00 02 1F 5B
				23 00 00 00 00 00 02 20 03
				23 00 00 00 00 00 02 21 68
				23 00 00 00 00 00 02 22 03
				23 00 00 00 00 00 02 23 76
				23 00 00 00 00 00 02 24 03
				23 00 00 00 00 00 02 25 86
				23 00 00 00 00 00 02 26 03
				23 00 00 00 00 00 02 27 98
				23 00 00 00 00 00 02 28 03
				23 00 00 00 00 00 02 29 AD
				23 00 00 00 00 00 02 2A 03
				23 00 00 00 00 00 02 2B C5
				23 00 00 00 00 00 02 2D 03
				23 00 00 00 00 00 02 2F D7
				23 00 00 00 00 00 02 30 03
				23 01 00 00 00 00 02 31 D9

				23 00 00 00 00 00 02 32 00
				23 00 00 00 00 00 02 33 00
				23 00 00 00 00 00 02 34 00
				23 00 00 00 00 00 02 35 2E
				23 00 00 00 00 00 02 36 00
				23 00 00 00 00 00 02 37 62
				23 00 00 00 00 00 02 38 00
				23 00 00 00 00 00 02 39 89
				23 00 00 00 00 00 02 3A 00
				23 00 00 00 00 00 02 3B A9
				23 00 00 00 00 00 02 3D 00
				23 00 00 00 00 00 02 3F C4
				23 00 00 00 00 00 02 40 00
				23 00 00 00 00 00 02 41 DB
				23 00 00 00 00 00 02 42 00
				23 00 00 00 00 00 02 43 EE
				23 00 00 00 00 00 02 44 01
				23 00 00 00 00 00 02 45 00
				23 00 00 00 00 00 02 46 01
				23 00 00 00 00 00 02 47 38
				23 00 00 00 00 00 02 48 01
				23 00 00 00 00 00 02 49 62
				23 00 00 00 00 00 02 4A 01
				23 00 00 00 00 00 02 4B 9E
				23 00 00 00 00 00 02 4C 01
				23 00 00 00 00 00 02 4D CA
				23 00 00 00 00 00 02 4E 02
				23 00 00 00 00 00 02 4F 09
				23 00 00 00 00 00 02 50 02
				23 00 00 00 00 00 02 51 39
				23 00 00 00 00 00 02 52 02
				23 00 00 00 00 00 02 53 3B
				23 00 00 00 00 00 02 54 02
				23 00 00 00 00 00 02 55 6B
				23 00 00 00 00 00 02 56 02
				23 00 00 00 00 00 02 58 A8
				23 00 00 00 00 00 02 59 02
				23 00 00 00 00 00 02 5A D3
				23 00 00 00 00 00 02 5B 03
				23 00 00 00 00 00 02 5C 04
				23 00 00 00 00 00 02 5D 03
				23 00 00 00 00 00 02 5E 2F
				23 00 00 00 00 00 02 5F 03
				23 00 00 00 00 00 02 60 5B
				23 00 00 00 00 00 02 61 03
				23 00 00 00 00 00 02 62 68
				23 00 00 00 00 00 02 63 03
				23 00 00 00 00 00 02 64 76
				23 00 00 00 00 00 02 65 03
				23 00 00 00 00 00 02 66 86
				23 00 00 00 00 00 02 67 03
				23 00 00 00 00 00 02 68 98
				23 00 00 00 00 00 02 69 03
				23 00 00 00 00 00 02 6A AD
				23 00 00 00 00 00 02 6B 03
				23 00 00 00 00 00 02 6C C5
				23 00 00 00 00 00 02 6D 03
				23 00 00 00 00 00 02 6E D7
				23 00 00 00 00 00 02 6F 03
				23 01 00 00 00 00 02 70 D9

				23 00 00 00 00 00 02 71 01
				23 00 00 00 00 00 02 72 D0
				23 00 00 00 00 00 02 73 01
				23 00 00 00 00 00 02 74 D2
				23 00 00 00 00 00 02 75 01
				23 00 00 00 00 00 02 76 D5
				23 00 00 00 00 00 02 77 01
				23 00 00 00 00 00 02 78 D8
				23 00 00 00 00 00 02 79 01
				23 00 00 00 00 00 02 7A DC
				23 00 00 00 00 00 02 7B 01
				23 00 00 00 00 00 02 7C DF
				23 00 00 00 00 00 02 7D 01
				23 00 00 00 00 00 02 7E E2
				23 00 00 00 00 00 02 7F 01
				23 00 00 00 00 00 02 80 E5
				23 00 00 00 00 00 02 81 01
				23 00 00 00 00 00 02 82 E8
				23 00 00 00 00 00 02 83 01
				23 00 00 00 00 00 02 84 F3
				23 00 00 00 00 00 02 85 01
				23 00 00 00 00 00 02 86 FD
				23 00 00 00 00 00 02 87 02
				23 00 00 00 00 00 02 88 10
				23 00 00 00 00 00 02 89 02
				23 00 00 00 00 00 02 8A 22
				23 00 00 00 00 00 02 8B 02
				23 00 00 00 00 00 02 8C 45
				23 00 00 00 00 00 02 8D 02
				23 00 00 00 00 00 02 8E 69
				23 00 00 00 00 00 02 8F 02
				23 00 00 00 00 00 02 90 6A
				23 00 00 00 00 00 02 91 02
				23 00 00 00 00 00 02 92 94
				23 00 00 00 00 00 02 93 02
				23 00 00 00 00 00 02 94 CF
				23 00 00 00 00 00 02 95 02
				23 00 00 00 00 00 02 96 F4
				23 00 00 00 00 00 02 97 03
				23 00 00 00 00 00 02 98 2A
				23 00 00 00 00 00 02 99 03
				23 00 00 00 00 00 02 9A 4A
				23 00 00 00 00 00 02 9B 03
				23 00 00 00 00 00 02 9C 74
				23 00 00 00 00 00 02 9D 03
				23 00 00 00 00 00 02 9E 81
				23 00 00 00 00 00 02 9F 03
				23 00 00 00 00 00 02 A0 90
				23 00 00 00 00 00 02 A2 03
				23 00 00 00 00 00 02 A3 A0
				23 00 00 00 00 00 02 A4 03
				23 00 00 00 00 00 02 A5 B2
				23 00 00 00 00 00 02 A6 03
				23 00 00 00 00 00 02 A7 C3
				23 00 00 00 00 00 02 A9 03
				23 00 00 00 00 00 02 AA D0
				23 00 00 00 00 00 02 AB 03
				23 00 00 00 00 00 02 AC D7
				23 00 00 00 00 00 02 AD 03
				23 01 00 00 00 00 02 AE D9

				23 00 00 00 00 00 02 AF 01
				23 00 00 00 00 00 02 B0 D0
				23 00 00 00 00 00 02 B1 01
				23 00 00 00 00 00 02 B2 D2
				23 00 00 00 00 00 02 B3 01
				23 00 00 00 00 00 02 B4 D5
				23 00 00 00 00 00 02 B5 01
				23 00 00 00 00 00 02 B6 D8
				23 00 00 00 00 00 02 B7 01
				23 00 00 00 00 00 02 B8 DC
				23 00 00 00 00 00 02 B9 01
				23 00 00 00 00 00 02 BA DF
				23 00 00 00 00 00 02 BB 01
				23 00 00 00 00 00 02 BC E2
				23 00 00 00 00 00 02 BD 01
				23 00 00 00 00 00 02 BE E5
				23 00 00 00 00 00 02 BF 01
				23 00 00 00 00 00 02 C0 E8
				23 00 00 00 00 00 02 C1 01
				23 00 00 00 00 00 02 C2 F3
				23 00 00 00 00 00 02 C3 01
				23 00 00 00 00 00 02 C4 FD
				23 00 00 00 00 00 02 C5 02
				23 00 00 00 00 00 02 C6 10
				23 00 00 00 00 00 02 C7 02
				23 00 00 00 00 00 02 C8 22
				23 00 00 00 00 00 02 C9 02
				23 00 00 00 00 00 02 CA 45
				23 00 00 00 00 00 02 CB 02
				23 00 00 00 00 00 02 CC 69
				23 00 00 00 00 00 02 CD 02
				23 00 00 00 00 00 02 CE 6A
				23 00 00 00 00 00 02 CF 02
				23 00 00 00 00 00 02 D0 94
				23 00 00 00 00 00 02 D1 02
				23 00 00 00 00 00 02 D2 CF
				23 00 00 00 00 00 02 D3 02
				23 00 00 00 00 00 02 D4 F4
				23 00 00 00 00 00 02 D5 03
				23 00 00 00 00 00 02 D6 2A
				23 00 00 00 00 00 02 D7 03
				23 00 00 00 00 00 02 D8 4A
				23 00 00 00 00 00 02 D9 03
				23 00 00 00 00 00 02 DA 74
				23 00 00 00 00 00 02 DB 03
				23 00 00 00 00 00 02 DC 81
				23 00 00 00 00 00 02 DD 03
				23 00 00 00 00 00 02 DE 90
				23 00 00 00 00 00 02 DF 03
				23 00 00 00 00 00 02 E0 A0
				23 00 00 00 00 00 02 E1 03
				23 00 00 00 00 00 02 E2 B2
				23 00 00 00 00 00 02 E3 03
				23 00 00 00 00 00 02 E4 C3
				23 00 00 00 00 00 02 E5 03
				23 00 00 00 00 00 02 E6 D0
				23 00 00 00 00 00 02 E7 03
				23 00 00 00 00 00 02 E8 D7
				23 00 00 00 00 00 02 E9 03
				23 01 00 00 00 00 02 EA D9];

		qcom,mdss-dsi-PM6-command = [23 00 00 00 00 00 02 FF 01
				23 00 00 00 00 00 02 FB 01
				23 00 00 00 00 00 02 75 00
				23 00 00 00 00 00 02 76 00
				23 00 00 00 00 00 02 77 00
				23 00 00 00 00 00 02 78 21
				23 00 00 00 00 00 02 79 00
				23 00 00 00 00 00 02 7A 58
				23 00 00 00 00 00 02 7B 00
				23 00 00 00 00 00 02 7C 82
				23 00 00 00 00 00 02 7D 00
				23 00 00 00 00 00 02 7E A3
				23 00 00 00 00 00 02 7F 00
				23 00 00 00 00 00 02 80 BF
				23 00 00 00 00 00 02 81 00
				23 00 00 00 00 00 02 82 D6
				23 00 00 00 00 00 02 83 00
				23 00 00 00 00 00 02 84 EA
				23 00 00 00 00 00 02 85 00
				23 00 00 00 00 00 02 86 FC
				23 00 00 00 00 00 02 87 01
				23 00 00 00 00 00 02 88 34
				23 00 00 00 00 00 02 89 01
				23 00 00 00 00 00 02 8A 5E
				23 00 00 00 00 00 02 8B 01
				23 00 00 00 00 00 02 8C 9B
				23 00 00 00 00 00 02 8D 01
				23 00 00 00 00 00 02 8E C7
				23 00 00 00 00 00 02 8F 02
				23 00 00 00 00 00 02 90 05
				23 00 00 00 00 00 02 91 02
				23 00 00 00 00 00 02 92 36
				23 00 00 00 00 00 02 93 02
				23 00 00 00 00 00 02 94 37
				23 00 00 00 00 00 02 95 02
				23 00 00 00 00 00 02 96 67
				23 00 00 00 00 00 02 97 02
				23 00 00 00 00 00 02 98 A3
				23 00 00 00 00 00 02 99 02
				23 00 00 00 00 00 02 9A CE
				23 00 00 00 00 00 02 9B 02
				23 00 00 00 00 00 02 9C FF
				23 00 00 00 00 00 02 9D 03
				23 00 00 00 00 00 02 9E 29
				23 00 00 00 00 00 02 9F 03
				23 00 00 00 00 00 02 A0 56
				23 00 00 00 00 00 02 A2 03
				23 00 00 00 00 00 02 A3 63
				23 00 00 00 00 00 02 A4 03
				23 00 00 00 00 00 02 A5 71
				23 00 00 00 00 00 02 A6 03
				23 00 00 00 00 00 02 A7 81
				23 00 00 00 00 00 02 A9 03
				23 00 00 00 00 00 02 AA 94
				23 00 00 00 00 00 02 AB 03
				23 00 00 00 00 00 02 AC AA
				23 00 00 00 00 00 02 AD 03
				23 00 00 00 00 00 02 AE C4
				23 00 00 00 00 00 02 AF 03
				23 00 00 00 00 00 02 B0 D7
				23 00 00 00 00 00 02 B1 03
				23 01 00 00 00 00 02 B2 D9

				23 00 00 00 00 00 02 B3 00
				23 00 00 00 00 00 02 B4 00
				23 00 00 00 00 00 02 B5 00
				23 00 00 00 00 00 02 B6 21
				23 00 00 00 00 00 02 B7 00
				23 00 00 00 00 00 02 B8 58
				23 00 00 00 00 00 02 B9 00
				23 00 00 00 00 00 02 BA 82
				23 00 00 00 00 00 02 BB 00
				23 00 00 00 00 00 02 BC A3
				23 00 00 00 00 00 02 BD 00
				23 00 00 00 00 00 02 BE BF
				23 00 00 00 00 00 02 BF 00
				23 00 00 00 00 00 02 C0 D6
				23 00 00 00 00 00 02 C1 00
				23 00 00 00 00 00 02 C2 EA
				23 00 00 00 00 00 02 C3 00
				23 00 00 00 00 00 02 C4 FC
				23 00 00 00 00 00 02 C5 01
				23 00 00 00 00 00 02 C6 34
				23 00 00 00 00 00 02 C7 01
				23 00 00 00 00 00 02 C8 5E
				23 00 00 00 00 00 02 C9 01
				23 00 00 00 00 00 02 CA 9B
				23 00 00 00 00 00 02 CB 01
				23 00 00 00 00 00 02 CC C7
				23 00 00 00 00 00 02 CD 02
				23 00 00 00 00 00 02 CE 05
				23 00 00 00 00 00 02 CF 02
				23 00 00 00 00 00 02 D0 36
				23 00 00 00 00 00 02 D1 02
				23 00 00 00 00 00 02 D2 37
				23 00 00 00 00 00 02 D3 02
				23 00 00 00 00 00 02 D4 67
				23 00 00 00 00 00 02 D5 02
				23 00 00 00 00 00 02 D6 A3
				23 00 00 00 00 00 02 D7 02
				23 00 00 00 00 00 02 D8 CE
				23 00 00 00 00 00 02 D9 02
				23 00 00 00 00 00 02 DA FF
				23 00 00 00 00 00 02 DB 03
				23 00 00 00 00 00 02 DC 29
				23 00 00 00 00 00 02 DD 03
				23 00 00 00 00 00 02 DE 56
				23 00 00 00 00 00 02 DF 03
				23 00 00 00 00 00 02 E0 63
				23 00 00 00 00 00 02 E1 03
				23 00 00 00 00 00 02 E2 71
				23 00 00 00 00 00 02 E3 03
				23 00 00 00 00 00 02 E4 81
				23 00 00 00 00 00 02 E5 03
				23 00 00 00 00 00 02 E6 94
				23 00 00 00 00 00 02 E7 03
				23 00 00 00 00 00 02 E8 AA
				23 00 00 00 00 00 02 E9 03
				23 00 00 00 00 00 02 EA C4
				23 00 00 00 00 00 02 EB 03
				23 00 00 00 00 00 02 EC D7
				23 00 00 00 00 00 02 ED 03
				23 01 00 00 00 00 02 EE D9

				23 00 00 00 00 00 02 EF 00
				23 00 00 00 00 00 02 F0 00
				23 00 00 00 00 00 02 F1 00
				23 00 00 00 00 00 02 F2 2E
				23 00 00 00 00 00 02 F3 00
				23 00 00 00 00 00 02 F4 62
				23 00 00 00 00 00 02 F5 00
				23 00 00 00 00 00 02 F6 89
				23 00 00 00 00 00 02 F7 00
				23 00 00 00 00 00 02 F8 A9
				23 00 00 00 00 00 02 F9 00
				23 00 00 00 00 00 02 FA C4
				23 00 00 00 00 00 02 FF 02
				23 00 00 00 00 00 02 FB 01
				23 00 00 00 00 00 02 00 00
				23 00 00 00 00 00 02 01 DB
				23 00 00 00 00 00 02 02 00
				23 00 00 00 00 00 02 03 EE
				23 00 00 00 00 00 02 04 01
				23 00 00 00 00 00 02 05 00
				23 00 00 00 00 00 02 06 01
				23 00 00 00 00 00 02 07 38
				23 00 00 00 00 00 02 08 01
				23 00 00 00 00 00 02 09 62
				23 00 00 00 00 00 02 0A 01
				23 00 00 00 00 00 02 0B 9E
				23 00 00 00 00 00 02 0C 01
				23 00 00 00 00 00 02 0D CA
				23 00 00 00 00 00 02 0E 02
				23 00 00 00 00 00 02 0F 09
				23 00 00 00 00 00 02 10 02
				23 00 00 00 00 00 02 11 39
				23 00 00 00 00 00 02 12 02
				23 00 00 00 00 00 02 13 3B
				23 00 00 00 00 00 02 14 02
				23 00 00 00 00 00 02 15 6B
				23 00 00 00 00 00 02 16 02
				23 00 00 00 00 00 02 17 A8
				23 00 00 00 00 00 02 18 02
				23 00 00 00 00 00 02 19 D3
				23 00 00 00 00 00 02 1A 03
				23 00 00 00 00 00 02 1B 04
				23 00 00 00 00 00 02 1C 03
				23 00 00 00 00 00 02 1D 2F
				23 00 00 00 00 00 02 1E 03
				23 00 00 00 00 00 02 1F 5B
				23 00 00 00 00 00 02 20 03
				23 00 00 00 00 00 02 21 68
				23 00 00 00 00 00 02 22 03
				23 00 00 00 00 00 02 23 76
				23 00 00 00 00 00 02 24 03
				23 00 00 00 00 00 02 25 86
				23 00 00 00 00 00 02 26 03
				23 00 00 00 00 00 02 27 98
				23 00 00 00 00 00 02 28 03
				23 00 00 00 00 00 02 29 AD
				23 00 00 00 00 00 02 2A 03
				23 00 00 00 00 00 02 2B C5
				23 00 00 00 00 00 02 2D 03
				23 00 00 00 00 00 02 2F D7
				23 00 00 00 00 00 02 30 03
				23 01 00 00 00 00 02 31 D9

				23 00 00 00 00 00 02 32 00
				23 00 00 00 00 00 02 33 00
				23 00 00 00 00 00 02 34 00
				23 00 00 00 00 00 02 35 2E
				23 00 00 00 00 00 02 36 00
				23 00 00 00 00 00 02 37 62
				23 00 00 00 00 00 02 38 00
				23 00 00 00 00 00 02 39 89
				23 00 00 00 00 00 02 3A 00
				23 00 00 00 00 00 02 3B A9
				23 00 00 00 00 00 02 3D 00
				23 00 00 00 00 00 02 3F C4
				23 00 00 00 00 00 02 40 00
				23 00 00 00 00 00 02 41 DB
				23 00 00 00 00 00 02 42 00
				23 00 00 00 00 00 02 43 EE
				23 00 00 00 00 00 02 44 01
				23 00 00 00 00 00 02 45 00
				23 00 00 00 00 00 02 46 01
				23 00 00 00 00 00 02 47 38
				23 00 00 00 00 00 02 48 01
				23 00 00 00 00 00 02 49 62
				23 00 00 00 00 00 02 4A 01
				23 00 00 00 00 00 02 4B 9E
				23 00 00 00 00 00 02 4C 01
				23 00 00 00 00 00 02 4D CA
				23 00 00 00 00 00 02 4E 02
				23 00 00 00 00 00 02 4F 09
				23 00 00 00 00 00 02 50 02
				23 00 00 00 00 00 02 51 39
				23 00 00 00 00 00 02 52 02
				23 00 00 00 00 00 02 53 3B
				23 00 00 00 00 00 02 54 02
				23 00 00 00 00 00 02 55 6B
				23 00 00 00 00 00 02 56 02
				23 00 00 00 00 00 02 58 A8
				23 00 00 00 00 00 02 59 02
				23 00 00 00 00 00 02 5A D3
				23 00 00 00 00 00 02 5B 03
				23 00 00 00 00 00 02 5C 04
				23 00 00 00 00 00 02 5D 03
				23 00 00 00 00 00 02 5E 2F
				23 00 00 00 00 00 02 5F 03
				23 00 00 00 00 00 02 60 5B
				23 00 00 00 00 00 02 61 03
				23 00 00 00 00 00 02 62 68
				23 00 00 00 00 00 02 63 03
				23 00 00 00 00 00 02 64 76
				23 00 00 00 00 00 02 65 03
				23 00 00 00 00 00 02 66 86
				23 00 00 00 00 00 02 67 03
				23 00 00 00 00 00 02 68 98
				23 00 00 00 00 00 02 69 03
				23 00 00 00 00 00 02 6A AD
				23 00 00 00 00 00 02 6B 03
				23 00 00 00 00 00 02 6C C5
				23 00 00 00 00 00 02 6D 03
				23 00 00 00 00 00 02 6E D7
				23 00 00 00 00 00 02 6F 03
				23 01 00 00 00 00 02 70 D9

				23 00 00 00 00 00 02 71 01
				23 00 00 00 00 00 02 72 E9
				23 00 00 00 00 00 02 73 01
				23 00 00 00 00 00 02 74 EA
				23 00 00 00 00 00 02 75 01
				23 00 00 00 00 00 02 76 ED
				23 00 00 00 00 00 02 77 01
				23 00 00 00 00 00 02 78 F0
				23 00 00 00 00 00 02 79 01
				23 00 00 00 00 00 02 7A F2
				23 00 00 00 00 00 02 7B 01
				23 00 00 00 00 00 02 7C F4
				23 00 00 00 00 00 02 7D 01
				23 00 00 00 00 00 02 7E F6
				23 00 00 00 00 00 02 7F 01
				23 00 00 00 00 00 02 80 F9
				23 00 00 00 00 00 02 81 01
				23 00 00 00 00 00 02 82 FB
				23 00 00 00 00 00 02 83 02
				23 00 00 00 00 00 02 84 05
				23 00 00 00 00 00 02 85 02
				23 00 00 00 00 00 02 86 0E
				23 00 00 00 00 00 02 87 02
				23 00 00 00 00 00 02 88 1F
				23 00 00 00 00 00 02 89 02
				23 00 00 00 00 00 02 8A 2F
				23 00 00 00 00 00 02 8B 02
				23 00 00 00 00 00 02 8C 50
				23 00 00 00 00 00 02 8D 02
				23 00 00 00 00 00 02 8E 72
				23 00 00 00 00 00 02 8F 02
				23 00 00 00 00 00 02 90 74
				23 00 00 00 00 00 02 91 02
				23 00 00 00 00 00 02 92 9D
				23 00 00 00 00 00 02 93 02
				23 00 00 00 00 00 02 94 D8
				23 00 00 00 00 00 02 95 02
				23 00 00 00 00 00 02 96 FA
				23 00 00 00 00 00 02 97 03
				23 00 00 00 00 00 02 98 31
				23 00 00 00 00 00 02 99 03
				23 00 00 00 00 00 02 9A 51
				23 00 00 00 00 00 02 9B 03
				23 00 00 00 00 00 02 9C 7A
				23 00 00 00 00 00 02 9D 03
				23 00 00 00 00 00 02 9E 87
				23 00 00 00 00 00 02 9F 03
				23 00 00 00 00 00 02 A0 95
				23 00 00 00 00 00 02 A2 03
				23 00 00 00 00 00 02 A3 A5
				23 00 00 00 00 00 02 A4 03
				23 00 00 00 00 00 02 A5 B6
				23 00 00 00 00 00 02 A6 03
				23 00 00 00 00 00 02 A7 C5
				23 00 00 00 00 00 02 A9 03
				23 00 00 00 00 00 02 AA D1
				23 00 00 00 00 00 02 AB 03
				23 00 00 00 00 00 02 AC D7
				23 00 00 00 00 00 02 AD 03
				23 01 00 00 00 00 02 AE D9

				23 00 00 00 00 00 02 AF 01
				23 00 00 00 00 00 02 B0 E9
				23 00 00 00 00 00 02 B1 01
				23 00 00 00 00 00 02 B2 EA
				23 00 00 00 00 00 02 B3 01
				23 00 00 00 00 00 02 B4 ED
				23 00 00 00 00 00 02 B5 01
				23 00 00 00 00 00 02 B6 F0
				23 00 00 00 00 00 02 B7 01
				23 00 00 00 00 00 02 B8 F2
				23 00 00 00 00 00 02 B9 01
				23 00 00 00 00 00 02 BA F4
				23 00 00 00 00 00 02 BB 01
				23 00 00 00 00 00 02 BC F6
				23 00 00 00 00 00 02 BD 01
				23 00 00 00 00 00 02 BE F9
				23 00 00 00 00 00 02 BF 01
				23 00 00 00 00 00 02 C0 FB
				23 00 00 00 00 00 02 C1 02
				23 00 00 00 00 00 02 C2 05
				23 00 00 00 00 00 02 C3 02
				23 00 00 00 00 00 02 C4 0E
				23 00 00 00 00 00 02 C5 02
				23 00 00 00 00 00 02 C6 1F
				23 00 00 00 00 00 02 C7 02
				23 00 00 00 00 00 02 C8 2F
				23 00 00 00 00 00 02 C9 02
				23 00 00 00 00 00 02 CA 50
				23 00 00 00 00 00 02 CB 02
				23 00 00 00 00 00 02 CC 72
				23 00 00 00 00 00 02 CD 02
				23 00 00 00 00 00 02 CE 74
				23 00 00 00 00 00 02 CF 02
				23 00 00 00 00 00 02 D0 9D
				23 00 00 00 00 00 02 D1 02
				23 00 00 00 00 00 02 D2 D8
				23 00 00 00 00 00 02 D3 02
				23 00 00 00 00 00 02 D4 FA
				23 00 00 00 00 00 02 D5 03
				23 00 00 00 00 00 02 D6 31
				23 00 00 00 00 00 02 D7 03
				23 00 00 00 00 00 02 D8 51
				23 00 00 00 00 00 02 D9 03
				23 00 00 00 00 00 02 DA 7A
				23 00 00 00 00 00 02 DB 03
				23 00 00 00 00 00 02 DC 87
				23 00 00 00 00 00 02 DD 03
				23 00 00 00 00 00 02 DE 95
				23 00 00 00 00 00 02 DF 03
				23 00 00 00 00 00 02 E0 A5
				23 00 00 00 00 00 02 E1 03
				23 00 00 00 00 00 02 E2 B6
				23 00 00 00 00 00 02 E3 03
				23 00 00 00 00 00 02 E4 C5
				23 00 00 00 00 00 02 E5 03
				23 00 00 00 00 00 02 E6 D1
				23 00 00 00 00 00 02 E7 03
				23 00 00 00 00 00 02 E8 D7
				23 00 00 00 00 00 02 E9 03
				23 01 00 00 00 00 02 EA D9];

		qcom,mdss-dsi-PM7-command = [23 00 00 00 00 00 02 FF 01
				23 00 00 00 00 00 02 FB 01
				23 00 00 00 00 00 02 75 00
				23 00 00 00 00 00 02 76 00
				23 00 00 00 00 00 02 77 00
				23 00 00 00 00 00 02 78 21
				23 00 00 00 00 00 02 79 00
				23 00 00 00 00 00 02 7A 58
				23 00 00 00 00 00 02 7B 00
				23 00 00 00 00 00 02 7C 82
				23 00 00 00 00 00 02 7D 00
				23 00 00 00 00 00 02 7E A3
				23 00 00 00 00 00 02 7F 00
				23 00 00 00 00 00 02 80 BF
				23 00 00 00 00 00 02 81 00
				23 00 00 00 00 00 02 82 D6
				23 00 00 00 00 00 02 83 00
				23 00 00 00 00 00 02 84 EA
				23 00 00 00 00 00 02 85 00
				23 00 00 00 00 00 02 86 FC
				23 00 00 00 00 00 02 87 01
				23 00 00 00 00 00 02 88 34
				23 00 00 00 00 00 02 89 01
				23 00 00 00 00 00 02 8A 5E
				23 00 00 00 00 00 02 8B 01
				23 00 00 00 00 00 02 8C 9B
				23 00 00 00 00 00 02 8D 01
				23 00 00 00 00 00 02 8E C7
				23 00 00 00 00 00 02 8F 02
				23 00 00 00 00 00 02 90 05
				23 00 00 00 00 00 02 91 02
				23 00 00 00 00 00 02 92 36
				23 00 00 00 00 00 02 93 02
				23 00 00 00 00 00 02 94 37
				23 00 00 00 00 00 02 95 02
				23 00 00 00 00 00 02 96 67
				23 00 00 00 00 00 02 97 02
				23 00 00 00 00 00 02 98 A3
				23 00 00 00 00 00 02 99 02
				23 00 00 00 00 00 02 9A CE
				23 00 00 00 00 00 02 9B 02
				23 00 00 00 00 00 02 9C FF
				23 00 00 00 00 00 02 9D 03
				23 00 00 00 00 00 02 9E 29
				23 00 00 00 00 00 02 9F 03
				23 00 00 00 00 00 02 A0 56
				23 00 00 00 00 00 02 A2 03
				23 00 00 00 00 00 02 A3 63
				23 00 00 00 00 00 02 A4 03
				23 00 00 00 00 00 02 A5 71
				23 00 00 00 00 00 02 A6 03
				23 00 00 00 00 00 02 A7 81
				23 00 00 00 00 00 02 A9 03
				23 00 00 00 00 00 02 AA 94
				23 00 00 00 00 00 02 AB 03
				23 00 00 00 00 00 02 AC AA
				23 00 00 00 00 00 02 AD 03
				23 00 00 00 00 00 02 AE C4
				23 00 00 00 00 00 02 AF 03
				23 00 00 00 00 00 02 B0 D7
				23 00 00 00 00 00 02 B1 03
				23 01 00 00 00 00 02 B2 D9

				23 00 00 00 00 00 02 B3 00
				23 00 00 00 00 00 02 B4 00
				23 00 00 00 00 00 02 B5 00
				23 00 00 00 00 00 02 B6 21
				23 00 00 00 00 00 02 B7 00
				23 00 00 00 00 00 02 B8 58
				23 00 00 00 00 00 02 B9 00
				23 00 00 00 00 00 02 BA 82
				23 00 00 00 00 00 02 BB 00
				23 00 00 00 00 00 02 BC A3
				23 00 00 00 00 00 02 BD 00
				23 00 00 00 00 00 02 BE BF
				23 00 00 00 00 00 02 BF 00
				23 00 00 00 00 00 02 C0 D6
				23 00 00 00 00 00 02 C1 00
				23 00 00 00 00 00 02 C2 EA
				23 00 00 00 00 00 02 C3 00
				23 00 00 00 00 00 02 C4 FC
				23 00 00 00 00 00 02 C5 01
				23 00 00 00 00 00 02 C6 34
				23 00 00 00 00 00 02 C7 01
				23 00 00 00 00 00 02 C8 5E
				23 00 00 00 00 00 02 C9 01
				23 00 00 00 00 00 02 CA 9B
				23 00 00 00 00 00 02 CB 01
				23 00 00 00 00 00 02 CC C7
				23 00 00 00 00 00 02 CD 02
				23 00 00 00 00 00 02 CE 05
				23 00 00 00 00 00 02 CF 02
				23 00 00 00 00 00 02 D0 36
				23 00 00 00 00 00 02 D1 02
				23 00 00 00 00 00 02 D2 37
				23 00 00 00 00 00 02 D3 02
				23 00 00 00 00 00 02 D4 67
				23 00 00 00 00 00 02 D5 02
				23 00 00 00 00 00 02 D6 A3
				23 00 00 00 00 00 02 D7 02
				23 00 00 00 00 00 02 D8 CE
				23 00 00 00 00 00 02 D9 02
				23 00 00 00 00 00 02 DA FF
				23 00 00 00 00 00 02 DB 03
				23 00 00 00 00 00 02 DC 29
				23 00 00 00 00 00 02 DD 03
				23 00 00 00 00 00 02 DE 56
				23 00 00 00 00 00 02 DF 03
				23 00 00 00 00 00 02 E0 63
				23 00 00 00 00 00 02 E1 03
				23 00 00 00 00 00 02 E2 71
				23 00 00 00 00 00 02 E3 03
				23 00 00 00 00 00 02 E4 81
				23 00 00 00 00 00 02 E5 03
				23 00 00 00 00 00 02 E6 94
				23 00 00 00 00 00 02 E7 03
				23 00 00 00 00 00 02 E8 AA
				23 00 00 00 00 00 02 E9 03
				23 00 00 00 00 00 02 EA C4
				23 00 00 00 00 00 02 EB 03
				23 00 00 00 00 00 02 EC D7
				23 00 00 00 00 00 02 ED 03
				23 01 00 00 00 00 02 EE D9

				23 00 00 00 00 00 02 EF 00
				23 00 00 00 00 00 02 F0 00
				23 00 00 00 00 00 02 F1 00
				23 00 00 00 00 00 02 F2 2E
				23 00 00 00 00 00 02 F3 00
				23 00 00 00 00 00 02 F4 62
				23 00 00 00 00 00 02 F5 00
				23 00 00 00 00 00 02 F6 89
				23 00 00 00 00 00 02 F7 00
				23 00 00 00 00 00 02 F8 A9
				23 00 00 00 00 00 02 F9 00
				23 00 00 00 00 00 02 FA C4
				23 00 00 00 00 00 02 FF 02
				23 00 00 00 00 00 02 FB 01
				23 00 00 00 00 00 02 00 00
				23 00 00 00 00 00 02 01 DB
				23 00 00 00 00 00 02 02 00
				23 00 00 00 00 00 02 03 EE
				23 00 00 00 00 00 02 04 01
				23 00 00 00 00 00 02 05 00
				23 00 00 00 00 00 02 06 01
				23 00 00 00 00 00 02 07 38
				23 00 00 00 00 00 02 08 01
				23 00 00 00 00 00 02 09 62
				23 00 00 00 00 00 02 0A 01
				23 00 00 00 00 00 02 0B 9E
				23 00 00 00 00 00 02 0C 01
				23 00 00 00 00 00 02 0D CA
				23 00 00 00 00 00 02 0E 02
				23 00 00 00 00 00 02 0F 09
				23 00 00 00 00 00 02 10 02
				23 00 00 00 00 00 02 11 39
				23 00 00 00 00 00 02 12 02
				23 00 00 00 00 00 02 13 3B
				23 00 00 00 00 00 02 14 02
				23 00 00 00 00 00 02 15 6B
				23 00 00 00 00 00 02 16 02
				23 00 00 00 00 00 02 17 A8
				23 00 00 00 00 00 02 18 02
				23 00 00 00 00 00 02 19 D3
				23 00 00 00 00 00 02 1A 03
				23 00 00 00 00 00 02 1B 04
				23 00 00 00 00 00 02 1C 03
				23 00 00 00 00 00 02 1D 2F
				23 00 00 00 00 00 02 1E 03
				23 00 00 00 00 00 02 1F 5B
				23 00 00 00 00 00 02 20 03
				23 00 00 00 00 00 02 21 68
				23 00 00 00 00 00 02 22 03
				23 00 00 00 00 00 02 23 76
				23 00 00 00 00 00 02 24 03
				23 00 00 00 00 00 02 25 86
				23 00 00 00 00 00 02 26 03
				23 00 00 00 00 00 02 27 98
				23 00 00 00 00 00 02 28 03
				23 00 00 00 00 00 02 29 AD
				23 00 00 00 00 00 02 2A 03
				23 00 00 00 00 00 02 2B C5
				23 00 00 00 00 00 02 2D 03
				23 00 00 00 00 00 02 2F D7
				23 00 00 00 00 00 02 30 03
				23 01 00 00 00 00 02 31 D9

				23 00 00 00 00 00 02 32 00
				23 00 00 00 00 00 02 33 00
				23 00 00 00 00 00 02 34 00
				23 00 00 00 00 00 02 35 2E
				23 00 00 00 00 00 02 36 00
				23 00 00 00 00 00 02 37 62
				23 00 00 00 00 00 02 38 00
				23 00 00 00 00 00 02 39 89
				23 00 00 00 00 00 02 3A 00
				23 00 00 00 00 00 02 3B A9
				23 00 00 00 00 00 02 3D 00
				23 00 00 00 00 00 02 3F C4
				23 00 00 00 00 00 02 40 00
				23 00 00 00 00 00 02 41 DB
				23 00 00 00 00 00 02 42 00
				23 00 00 00 00 00 02 43 EE
				23 00 00 00 00 00 02 44 01
				23 00 00 00 00 00 02 45 00
				23 00 00 00 00 00 02 46 01
				23 00 00 00 00 00 02 47 38
				23 00 00 00 00 00 02 48 01
				23 00 00 00 00 00 02 49 62
				23 00 00 00 00 00 02 4A 01
				23 00 00 00 00 00 02 4B 9E
				23 00 00 00 00 00 02 4C 01
				23 00 00 00 00 00 02 4D CA
				23 00 00 00 00 00 02 4E 02
				23 00 00 00 00 00 02 4F 09
				23 00 00 00 00 00 02 50 02
				23 00 00 00 00 00 02 51 39
				23 00 00 00 00 00 02 52 02
				23 00 00 00 00 00 02 53 3B
				23 00 00 00 00 00 02 54 02
				23 00 00 00 00 00 02 55 6B
				23 00 00 00 00 00 02 56 02
				23 00 00 00 00 00 02 58 A8
				23 00 00 00 00 00 02 59 02
				23 00 00 00 00 00 02 5A D3
				23 00 00 00 00 00 02 5B 03
				23 00 00 00 00 00 02 5C 04
				23 00 00 00 00 00 02 5D 03
				23 00 00 00 00 00 02 5E 2F
				23 00 00 00 00 00 02 5F 03
				23 00 00 00 00 00 02 60 5B
				23 00 00 00 00 00 02 61 03
				23 00 00 00 00 00 02 62 68
				23 00 00 00 00 00 02 63 03
				23 00 00 00 00 00 02 64 76
				23 00 00 00 00 00 02 65 03
				23 00 00 00 00 00 02 66 86
				23 00 00 00 00 00 02 67 03
				23 00 00 00 00 00 02 68 98
				23 00 00 00 00 00 02 69 03
				23 00 00 00 00 00 02 6A AD
				23 00 00 00 00 00 02 6B 03
				23 00 00 00 00 00 02 6C C5
				23 00 00 00 00 00 02 6D 03
				23 00 00 00 00 00 02 6E D7
				23 00 00 00 00 00 02 6F 03
				23 01 00 00 00 00 02 70 D9

				23 00 00 00 00 00 02 71 02
				23 00 00 00 00 00 02 72 00
				23 00 00 00 00 00 02 73 02
				23 00 00 00 00 00 02 74 01
				23 00 00 00 00 00 02 75 02
				23 00 00 00 00 00 02 76 03
				23 00 00 00 00 00 02 77 02
				23 00 00 00 00 00 02 78 05
				23 00 00 00 00 00 02 79 02
				23 00 00 00 00 00 02 7A 08
				23 00 00 00 00 00 02 7B 02
				23 00 00 00 00 00 02 7C 0A
				23 00 00 00 00 00 02 7D 02
				23 00 00 00 00 00 02 7E 0C
				23 00 00 00 00 00 02 7F 02
				23 00 00 00 00 00 02 80 0E
				23 00 00 00 00 00 02 81 02
				23 00 00 00 00 00 02 82 10
				23 00 00 00 00 00 02 83 02
				23 00 00 00 00 00 02 84 18
				23 00 00 00 00 00 02 85 02
				23 00 00 00 00 00 02 86 20
				23 00 00 00 00 00 02 87 02
				23 00 00 00 00 00 02 88 30
				23 00 00 00 00 00 02 89 02
				23 00 00 00 00 00 02 8A 40
				23 00 00 00 00 00 02 8B 02
				23 00 00 00 00 00 02 8C 60
				23 00 00 00 00 00 02 8D 02
				23 00 00 00 00 00 02 8E 80
				23 00 00 00 00 00 02 8F 02
				23 00 00 00 00 00 02 90 81
				23 00 00 00 00 00 02 91 02
				23 00 00 00 00 00 02 92 A8
				23 00 00 00 00 00 02 93 02
				23 00 00 00 00 00 02 94 E2
				23 00 00 00 00 00 02 95 03
				23 00 00 00 00 00 02 96 02
				23 00 00 00 00 00 02 97 03
				23 00 00 00 00 00 02 98 39
				23 00 00 00 00 00 02 99 03
				23 00 00 00 00 00 02 9A 58
				23 00 00 00 00 00 02 9B 03
				23 00 00 00 00 00 02 9C 81
				23 00 00 00 00 00 02 9D 03
				23 00 00 00 00 00 02 9E 8D
				23 00 00 00 00 00 02 9F 03
				23 00 00 00 00 00 02 A0 9C
				23 00 00 00 00 00 02 A2 03
				23 00 00 00 00 00 02 A3 AB
				23 00 00 00 00 00 02 A4 03
				23 00 00 00 00 00 02 A5 BA
				23 00 00 00 00 00 02 A6 03
				23 00 00 00 00 00 02 A7 C8
				23 00 00 00 00 00 02 A9 03
				23 00 00 00 00 00 02 AA D3
				23 00 00 00 00 00 02 AB 03
				23 00 00 00 00 00 02 AC D7
				23 00 00 00 00 00 02 AD 03
				23 01 00 00 00 00 02 AE D9

				23 00 00 00 00 00 02 AF 02
				23 00 00 00 00 00 02 B0 00
				23 00 00 00 00 00 02 B1 02
				23 00 00 00 00 00 02 B2 01
				23 00 00 00 00 00 02 B3 02
				23 00 00 00 00 00 02 B4 03
				23 00 00 00 00 00 02 B5 02
				23 00 00 00 00 00 02 B6 05
				23 00 00 00 00 00 02 B7 02
				23 00 00 00 00 00 02 B8 08
				23 00 00 00 00 00 02 B9 02
				23 00 00 00 00 00 02 BA 0A
				23 00 00 00 00 00 02 BB 02
				23 00 00 00 00 00 02 BC 0C
				23 00 00 00 00 00 02 BD 02
				23 00 00 00 00 00 02 BE 0E
				23 00 00 00 00 00 02 BF 02
				23 00 00 00 00 00 02 C0 10
				23 00 00 00 00 00 02 C1 02
				23 00 00 00 00 00 02 C2 18
				23 00 00 00 00 00 02 C3 02
				23 00 00 00 00 00 02 C4 20
				23 00 00 00 00 00 02 C5 02
				23 00 00 00 00 00 02 C6 30
				23 00 00 00 00 00 02 C7 02
				23 00 00 00 00 00 02 C8 40
				23 00 00 00 00 00 02 C9 02
				23 00 00 00 00 00 02 CA 60
				23 00 00 00 00 00 02 CB 02
				23 00 00 00 00 00 02 CC 80
				23 00 00 00 00 00 02 CD 02
				23 00 00 00 00 00 02 CE 81
				23 00 00 00 00 00 02 CF 02
				23 00 00 00 00 00 02 D0 A8
				23 00 00 00 00 00 02 D1 02
				23 00 00 00 00 00 02 D2 E2
				23 00 00 00 00 00 02 D3 03
				23 00 00 00 00 00 02 D4 02
				23 00 00 00 00 00 02 D5 03
				23 00 00 00 00 00 02 D6 39
				23 00 00 00 00 00 02 D7 03
				23 00 00 00 00 00 02 D8 58
				23 00 00 00 00 00 02 D9 03
				23 00 00 00 00 00 02 DA 81
				23 00 00 00 00 00 02 DB 03
				23 00 00 00 00 00 02 DC 8D
				23 00 00 00 00 00 02 DD 03
				23 00 00 00 00 00 02 DE 9C
				23 00 00 00 00 00 02 DF 03
				23 00 00 00 00 00 02 E0 AB
				23 00 00 00 00 00 02 E1 03
				23 00 00 00 00 00 02 E2 BA
				23 00 00 00 00 00 02 E3 03
				23 00 00 00 00 00 02 E4 C8
				23 00 00 00 00 00 02 E5 03
				23 00 00 00 00 00 02 E6 D3
				23 00 00 00 00 00 02 E7 03
				23 00 00 00 00 00 02 E8 D7
				23 00 00 00 00 00 02 E9 03
				23 01 00 00 00 00 02 EA D9];

		qcom,mdss-dsi-PM8-command = [23 00 00 00 00 00 02 FF 01
				23 00 00 00 00 00 02 FB 01
				23 00 00 00 00 00 02 75 00
				23 00 00 00 00 00 02 76 00
				23 00 00 00 00 00 02 77 00
				23 00 00 00 00 00 02 78 21
				23 00 00 00 00 00 02 79 00
				23 00 00 00 00 00 02 7A 58
				23 00 00 00 00 00 02 7B 00
				23 00 00 00 00 00 02 7C 82
				23 00 00 00 00 00 02 7D 00
				23 00 00 00 00 00 02 7E A3
				23 00 00 00 00 00 02 7F 00
				23 00 00 00 00 00 02 80 BF
				23 00 00 00 00 00 02 81 00
				23 00 00 00 00 00 02 82 D6
				23 00 00 00 00 00 02 83 00
				23 00 00 00 00 00 02 84 EA
				23 00 00 00 00 00 02 85 00
				23 00 00 00 00 00 02 86 FC
				23 00 00 00 00 00 02 87 01
				23 00 00 00 00 00 02 88 34
				23 00 00 00 00 00 02 89 01
				23 00 00 00 00 00 02 8A 5E
				23 00 00 00 00 00 02 8B 01
				23 00 00 00 00 00 02 8C 9B
				23 00 00 00 00 00 02 8D 01
				23 00 00 00 00 00 02 8E C7
				23 00 00 00 00 00 02 8F 02
				23 00 00 00 00 00 02 90 05
				23 00 00 00 00 00 02 91 02
				23 00 00 00 00 00 02 92 36
				23 00 00 00 00 00 02 93 02
				23 00 00 00 00 00 02 94 37
				23 00 00 00 00 00 02 95 02
				23 00 00 00 00 00 02 96 67
				23 00 00 00 00 00 02 97 02
				23 00 00 00 00 00 02 98 A3
				23 00 00 00 00 00 02 99 02
				23 00 00 00 00 00 02 9A CE
				23 00 00 00 00 00 02 9B 02
				23 00 00 00 00 00 02 9C FF
				23 00 00 00 00 00 02 9D 03
				23 00 00 00 00 00 02 9E 29
				23 00 00 00 00 00 02 9F 03
				23 00 00 00 00 00 02 A0 56
				23 00 00 00 00 00 02 A2 03
				23 00 00 00 00 00 02 A3 63
				23 00 00 00 00 00 02 A4 03
				23 00 00 00 00 00 02 A5 71
				23 00 00 00 00 00 02 A6 03
				23 00 00 00 00 00 02 A7 81
				23 00 00 00 00 00 02 A9 03
				23 00 00 00 00 00 02 AA 94
				23 00 00 00 00 00 02 AB 03
				23 00 00 00 00 00 02 AC AA
				23 00 00 00 00 00 02 AD 03
				23 00 00 00 00 00 02 AE C4
				23 00 00 00 00 00 02 AF 03
				23 00 00 00 00 00 02 B0 D7
				23 00 00 00 00 00 02 B1 03
				23 01 00 00 00 00 02 B2 D9

				23 00 00 00 00 00 02 B3 00
				23 00 00 00 00 00 02 B4 00
				23 00 00 00 00 00 02 B5 00
				23 00 00 00 00 00 02 B6 21
				23 00 00 00 00 00 02 B7 00
				23 00 00 00 00 00 02 B8 58
				23 00 00 00 00 00 02 B9 00
				23 00 00 00 00 00 02 BA 82
				23 00 00 00 00 00 02 BB 00
				23 00 00 00 00 00 02 BC A3
				23 00 00 00 00 00 02 BD 00
				23 00 00 00 00 00 02 BE BF
				23 00 00 00 00 00 02 BF 00
				23 00 00 00 00 00 02 C0 D6
				23 00 00 00 00 00 02 C1 00
				23 00 00 00 00 00 02 C2 EA
				23 00 00 00 00 00 02 C3 00
				23 00 00 00 00 00 02 C4 FC
				23 00 00 00 00 00 02 C5 01
				23 00 00 00 00 00 02 C6 34
				23 00 00 00 00 00 02 C7 01
				23 00 00 00 00 00 02 C8 5E
				23 00 00 00 00 00 02 C9 01
				23 00 00 00 00 00 02 CA 9B
				23 00 00 00 00 00 02 CB 01
				23 00 00 00 00 00 02 CC C7
				23 00 00 00 00 00 02 CD 02
				23 00 00 00 00 00 02 CE 05
				23 00 00 00 00 00 02 CF 02
				23 00 00 00 00 00 02 D0 36
				23 00 00 00 00 00 02 D1 02
				23 00 00 00 00 00 02 D2 37
				23 00 00 00 00 00 02 D3 02
				23 00 00 00 00 00 02 D4 67
				23 00 00 00 00 00 02 D5 02
				23 00 00 00 00 00 02 D6 A3
				23 00 00 00 00 00 02 D7 02
				23 00 00 00 00 00 02 D8 CE
				23 00 00 00 00 00 02 D9 02
				23 00 00 00 00 00 02 DA FF
				23 00 00 00 00 00 02 DB 03
				23 00 00 00 00 00 02 DC 29
				23 00 00 00 00 00 02 DD 03
				23 00 00 00 00 00 02 DE 56
				23 00 00 00 00 00 02 DF 03
				23 00 00 00 00 00 02 E0 63
				23 00 00 00 00 00 02 E1 03
				23 00 00 00 00 00 02 E2 71
				23 00 00 00 00 00 02 E3 03
				23 00 00 00 00 00 02 E4 81
				23 00 00 00 00 00 02 E5 03
				23 00 00 00 00 00 02 E6 94
				23 00 00 00 00 00 02 E7 03
				23 00 00 00 00 00 02 E8 AA
				23 00 00 00 00 00 02 E9 03
				23 00 00 00 00 00 02 EA C4
				23 00 00 00 00 00 02 EB 03
				23 00 00 00 00 00 02 EC D7
				23 00 00 00 00 00 02 ED 03
				23 01 00 00 00 00 02 EE D9

				23 00 00 00 00 00 02 EF 00
				23 00 00 00 00 00 02 F0 00
				23 00 00 00 00 00 02 F1 00
				23 00 00 00 00 00 02 F2 2E
				23 00 00 00 00 00 02 F3 00
				23 00 00 00 00 00 02 F4 62
				23 00 00 00 00 00 02 F5 00
				23 00 00 00 00 00 02 F6 89
				23 00 00 00 00 00 02 F7 00
				23 00 00 00 00 00 02 F8 A9
				23 00 00 00 00 00 02 F9 00
				23 00 00 00 00 00 02 FA C4
				23 00 00 00 00 00 02 FF 02
				23 00 00 00 00 00 02 FB 01
				23 00 00 00 00 00 02 00 00
				23 00 00 00 00 00 02 01 DB
				23 00 00 00 00 00 02 02 00
				23 00 00 00 00 00 02 03 EE
				23 00 00 00 00 00 02 04 01
				23 00 00 00 00 00 02 05 00
				23 00 00 00 00 00 02 06 01
				23 00 00 00 00 00 02 07 38
				23 00 00 00 00 00 02 08 01
				23 00 00 00 00 00 02 09 62
				23 00 00 00 00 00 02 0A 01
				23 00 00 00 00 00 02 0B 9E
				23 00 00 00 00 00 02 0C 01
				23 00 00 00 00 00 02 0D CA
				23 00 00 00 00 00 02 0E 02
				23 00 00 00 00 00 02 0F 09
				23 00 00 00 00 00 02 10 02
				23 00 00 00 00 00 02 11 39
				23 00 00 00 00 00 02 12 02
				23 00 00 00 00 00 02 13 3B
				23 00 00 00 00 00 02 14 02
				23 00 00 00 00 00 02 15 6B
				23 00 00 00 00 00 02 16 02
				23 00 00 00 00 00 02 17 A8
				23 00 00 00 00 00 02 18 02
				23 00 00 00 00 00 02 19 D3
				23 00 00 00 00 00 02 1A 03
				23 00 00 00 00 00 02 1B 04
				23 00 00 00 00 00 02 1C 03
				23 00 00 00 00 00 02 1D 2F
				23 00 00 00 00 00 02 1E 03
				23 00 00 00 00 00 02 1F 5B
				23 00 00 00 00 00 02 20 03
				23 00 00 00 00 00 02 21 68
				23 00 00 00 00 00 02 22 03
				23 00 00 00 00 00 02 23 76
				23 00 00 00 00 00 02 24 03
				23 00 00 00 00 00 02 25 86
				23 00 00 00 00 00 02 26 03
				23 00 00 00 00 00 02 27 98
				23 00 00 00 00 00 02 28 03
				23 00 00 00 00 00 02 29 AD
				23 00 00 00 00 00 02 2A 03
				23 00 00 00 00 00 02 2B C5
				23 00 00 00 00 00 02 2D 03
				23 00 00 00 00 00 02 2F D7
				23 00 00 00 00 00 02 30 03
				23 01 00 00 00 00 02 31 D9

				23 00 00 00 00 00 02 32 00
				23 00 00 00 00 00 02 33 00
				23 00 00 00 00 00 02 34 00
				23 00 00 00 00 00 02 35 2E
				23 00 00 00 00 00 02 36 00
				23 00 00 00 00 00 02 37 62
				23 00 00 00 00 00 02 38 00
				23 00 00 00 00 00 02 39 89
				23 00 00 00 00 00 02 3A 00
				23 00 00 00 00 00 02 3B A9
				23 00 00 00 00 00 02 3D 00
				23 00 00 00 00 00 02 3F C4
				23 00 00 00 00 00 02 40 00
				23 00 00 00 00 00 02 41 DB
				23 00 00 00 00 00 02 42 00
				23 00 00 00 00 00 02 43 EE
				23 00 00 00 00 00 02 44 01
				23 00 00 00 00 00 02 45 00
				23 00 00 00 00 00 02 46 01
				23 00 00 00 00 00 02 47 38
				23 00 00 00 00 00 02 48 01
				23 00 00 00 00 00 02 49 62
				23 00 00 00 00 00 02 4A 01
				23 00 00 00 00 00 02 4B 9E
				23 00 00 00 00 00 02 4C 01
				23 00 00 00 00 00 02 4D CA
				23 00 00 00 00 00 02 4E 02
				23 00 00 00 00 00 02 4F 09
				23 00 00 00 00 00 02 50 02
				23 00 00 00 00 00 02 51 39
				23 00 00 00 00 00 02 52 02
				23 00 00 00 00 00 02 53 3B
				23 00 00 00 00 00 02 54 02
				23 00 00 00 00 00 02 55 6B
				23 00 00 00 00 00 02 56 02
				23 00 00 00 00 00 02 58 A8
				23 00 00 00 00 00 02 59 02
				23 00 00 00 00 00 02 5A D3
				23 00 00 00 00 00 02 5B 03
				23 00 00 00 00 00 02 5C 04
				23 00 00 00 00 00 02 5D 03
				23 00 00 00 00 00 02 5E 2F
				23 00 00 00 00 00 02 5F 03
				23 00 00 00 00 00 02 60 5B
				23 00 00 00 00 00 02 61 03
				23 00 00 00 00 00 02 62 68
				23 00 00 00 00 00 02 63 03
				23 00 00 00 00 00 02 64 76
				23 00 00 00 00 00 02 65 03
				23 00 00 00 00 00 02 66 86
				23 00 00 00 00 00 02 67 03
				23 00 00 00 00 00 02 68 98
				23 00 00 00 00 00 02 69 03
				23 00 00 00 00 00 02 6A AD
				23 00 00 00 00 00 02 6B 03
				23 00 00 00 00 00 02 6C C5
				23 00 00 00 00 00 02 6D 03
				23 00 00 00 00 00 02 6E D7
				23 00 00 00 00 00 02 6F 03
				23 01 00 00 00 00 02 70 D9

				23 00 00 00 00 00 02 71 02
				23 00 00 00 00 00 02 72 14
				23 00 00 00 00 00 02 73 02
				23 00 00 00 00 00 02 74 15
				23 00 00 00 00 00 02 75 02
				23 00 00 00 00 00 02 76 17
				23 00 00 00 00 00 02 77 02
				23 00 00 00 00 00 02 78 19
				23 00 00 00 00 00 02 79 02
				23 00 00 00 00 00 02 7A 1B
				23 00 00 00 00 00 02 7B 02
				23 00 00 00 00 00 02 7C 1D
				23 00 00 00 00 00 02 7D 02
				23 00 00 00 00 00 02 7E 1F
				23 00 00 00 00 00 02 7F 02
				23 00 00 00 00 00 02 80 21
				23 00 00 00 00 00 02 81 02
				23 00 00 00 00 00 02 82 23
				23 00 00 00 00 00 02 83 02
				23 00 00 00 00 00 02 84 2B
				23 00 00 00 00 00 02 85 02
				23 00 00 00 00 00 02 86 33
				23 00 00 00 00 00 02 87 02
				23 00 00 00 00 00 02 88 43
				23 00 00 00 00 00 02 89 02
				23 00 00 00 00 00 02 8A 53
				23 00 00 00 00 00 02 8B 02
				23 00 00 00 00 00 02 8C 73
				23 00 00 00 00 00 02 8D 02
				23 00 00 00 00 00 02 8E 93
				23 00 00 00 00 00 02 8F 02
				23 00 00 00 00 00 02 90 94
				23 00 00 00 00 00 02 91 02
				23 00 00 00 00 00 02 92 B4
				23 00 00 00 00 00 02 93 02
				23 00 00 00 00 00 02 94 EB
				23 00 00 00 00 00 02 95 03
				23 00 00 00 00 00 02 96 09
				23 00 00 00 00 00 02 97 03
				23 00 00 00 00 00 02 98 42
				23 00 00 00 00 00 02 99 03
				23 00 00 00 00 00 02 9A 60
				23 00 00 00 00 00 02 9B 03
				23 00 00 00 00 00 02 9C 88
				23 00 00 00 00 00 02 9D 03
				23 00 00 00 00 00 02 9E 94
				23 00 00 00 00 00 02 9F 03
				23 00 00 00 00 00 02 A0 A2
				23 00 00 00 00 00 02 A2 03
				23 00 00 00 00 00 02 A3 B0
				23 00 00 00 00 00 02 A4 03
				23 00 00 00 00 00 02 A5 BE
				23 00 00 00 00 00 02 A6 03
				23 00 00 00 00 00 02 A7 CA
				23 00 00 00 00 00 02 A9 03
				23 00 00 00 00 00 02 AA D3
				23 00 00 00 00 00 02 AB 03
				23 00 00 00 00 00 02 AC D7
				23 00 00 00 00 00 02 AD 03
				23 01 00 00 00 00 02 AE D9

				23 00 00 00 00 00 02 AF 02
				23 00 00 00 00 00 02 B0 14
				23 00 00 00 00 00 02 B1 02
				23 00 00 00 00 00 02 B2 15
				23 00 00 00 00 00 02 B3 02
				23 00 00 00 00 00 02 B4 17
				23 00 00 00 00 00 02 B5 02
				23 00 00 00 00 00 02 B6 19
				23 00 00 00 00 00 02 B7 02
				23 00 00 00 00 00 02 B8 1B
				23 00 00 00 00 00 02 B9 02
				23 00 00 00 00 00 02 BA 1D
				23 00 00 00 00 00 02 BB 02
				23 00 00 00 00 00 02 BC 1F
				23 00 00 00 00 00 02 BD 02
				23 00 00 00 00 00 02 BE 21
				23 00 00 00 00 00 02 BF 02
				23 00 00 00 00 00 02 C0 23
				23 00 00 00 00 00 02 C1 02
				23 00 00 00 00 00 02 C2 2B
				23 00 00 00 00 00 02 C3 02
				23 00 00 00 00 00 02 C4 33
				23 00 00 00 00 00 02 C5 02
				23 00 00 00 00 00 02 C6 43
				23 00 00 00 00 00 02 C7 02
				23 00 00 00 00 00 02 C8 53
				23 00 00 00 00 00 02 C9 02
				23 00 00 00 00 00 02 CA 73
				23 00 00 00 00 00 02 CB 02
				23 00 00 00 00 00 02 CC 93
				23 00 00 00 00 00 02 CD 02
				23 00 00 00 00 00 02 CE 94
				23 00 00 00 00 00 02 CF 02
				23 00 00 00 00 00 02 D0 B4
				23 00 00 00 00 00 02 D1 02
				23 00 00 00 00 00 02 D2 EB
				23 00 00 00 00 00 02 D3 03
				23 00 00 00 00 00 02 D4 09
				23 00 00 00 00 00 02 D5 03
				23 00 00 00 00 00 02 D6 42
				23 00 00 00 00 00 02 D7 03
				23 00 00 00 00 00 02 D8 60
				23 00 00 00 00 00 02 D9 03
				23 00 00 00 00 00 02 DA 88
				23 00 00 00 00 00 02 DB 03
				23 00 00 00 00 00 02 DC 94
				23 00 00 00 00 00 02 DD 03
				23 00 00 00 00 00 02 DE A2
				23 00 00 00 00 00 02 DF 03
				23 00 00 00 00 00 02 E0 B0
				23 00 00 00 00 00 02 E1 03
				23 00 00 00 00 00 02 E2 BE
				23 00 00 00 00 00 02 E3 03
				23 00 00 00 00 00 02 E4 CA
				23 00 00 00 00 00 02 E5 03
				23 00 00 00 00 00 02 E6 D3
				23 00 00 00 00 00 02 E7 03
				23 00 00 00 00 00 02 E8 D7
				23 00 00 00 00 00 02 E9 03
				23 01 00 00 00 00 02 EA D9];

		qcom,mdss-dsi-on-command-state = "dsi_lp_mode";
		qcom,mdss-dsi-off-command-state = "dsi_hs_mode";
		qcom,mdss-dsi-CABC_on-command-state = "dsi_hs_mode";
		qcom,mdss-dsi-CABC_off-command-state = "dsi_hs_mode";
		qcom,mdss-dsi-CE_on-command-state = "dsi_hs_mode";
		qcom,mdss-dsi-CE_off-command-state = "dsi_hs_mode";
		qcom,mdss-dsi-cold_gamma-command-state = "dsi_hs_mode";
		qcom,mdss-dsi-warm_gamma-command-state = "dsi_hs_mode";
		qcom,mdss-dsi-default_gamma-command-state = "dsi_hs_mode";
		qcom,mdss-dsi-PM1-command-state = "dsi_hs_mode";
		qcom,mdss-dsi-PM2-command-state = "dsi_hs_mode";
		qcom,mdss-dsi-PM3-command-state = "dsi_hs_mode";
		qcom,mdss-dsi-PM4-command-state = "dsi_hs_mode";
		qcom,mdss-dsi-PM5-command-state = "dsi_hs_mode";
		qcom,mdss-dsi-PM6-command-state = "dsi_hs_mode";
		qcom,mdss-dsi-PM7-command-state = "dsi_hs_mode";
		qcom,mdss-dsi-PM8-command-state = "dsi_hs_mode";
		qcom,mdss-dsi-h-sync-pulse = <1>;
		qcom,mdss-dsi-traffic-mode = "burst_mode";
		qcom,mdss-dsi-bllp-eof-power-mode;
		qcom,mdss-dsi-bllp-power-mode;
		qcom,mdss-dsi-lane-0-state;
		qcom,mdss-dsi-lane-1-state;
		qcom,mdss-dsi-lane-2-state;
		qcom,mdss-dsi-lane-3-state;
		qcom,mdss-dsi-t-clk-post = <0x0d>;
		qcom,mdss-dsi-t-clk-pre = <0x2f>;
		qcom,mdss-dsi-bl-min-level = <1>;
		qcom,mdss-dsi-bl-max-level = <4095>;
		qcom,mdss-dsi-dma-trigger = "trigger_sw";
		qcom,mdss-dsi-mdp-trigger = "none";
		qcom,mdss-dsi-bl-pmic-control-type = "bl_ctrl_wled";
		qcom,mdss-dsi-reset-sequence = <1 5>, <0 5>, <1 5>, <0 5>, <1 20>;
		qcom,mdss-dsi-tx-eot-append;
		qcom,esd-check-enabled;
		qcom,mdss-dsi-panel-status-command = [06 01 00 01 05 00 01 0A];
		qcom,mdss-dsi-panel-status-command-mode = "dsi_lp_mode";
		qcom,mdss-dsi-panel-status-check-mode = "TE_check_NT35596";
		qcom,mdss-dsi-panel-status-read-length = <1>;
		qcom,mdss-dsi-panel-status-value = <0x9C>;
		qcom,mdss-dsi-panel-max-error-count = <3>;
		qcom,mdss-pan-physical-width-dimension = <69>;
		qcom,mdss-pan-physical-height-dimension = <122>;
	};
};
