/* Copyright (c) 2014-2015, The Linux Foundation. All rights reserved.
 *
 * This program is free software; you can redistribute it and/or modify
 * it under the terms of the GNU General Public License version 2 and
 * only version 2 as published by the Free Software Foundation.
 *
 * This program is distributed in the hope that it will be useful,
 * but WITHOUT ANY WARRANTY; without even the implied warranty of
 * MERCHANTABILITY or FITNESS FOR A PARTICULAR PURPOSE.  See the
 * GNU General Public License for more details.
 */

/*---------------------------------------------------------------------------
 * This file is autogenerated file using gcdb parser. Please do not edit it.
 * Update input XML file to add a new entry or update variable in this file
 * VERSION = "1.0"
 *---------------------------------------------------------------------------*/
&mdss_mdp {
	dsi_ili9806e_fwvga_video: qcom,mdss_dsi_ili9806e_fwvga_video {
		qcom,mdss-dsi-panel-name = "ili9806e fwvga video mode dsi panel";
		qcom,mdss-dsi-panel-controller = <&mdss_dsi0>;
		qcom,mdss-dsi-panel-type = "dsi_video_mode";
		qcom,mdss-dsi-panel-destination = "display_1";
		qcom,mdss-dsi-panel-framerate = <60>;
		qcom,mdss-dsi-virtual-channel-id = <0>;
		qcom,mdss-dsi-stream = <0>;
		qcom,mdss-dsi-panel-width = <480>;
		qcom,mdss-dsi-panel-height = <854>;
		qcom,mdss-dsi-h-front-porch = <54>;
		qcom,mdss-dsi-h-back-porch = <100>;
		qcom,mdss-dsi-h-pulse-width = <36>;
		qcom,mdss-dsi-h-sync-skew = <0>;
		qcom,mdss-dsi-v-back-porch = <20>;
		qcom,mdss-dsi-v-front-porch = <8>;
		qcom,mdss-dsi-v-pulse-width = <5>;
		qcom,mdss-dsi-h-left-border = <0>;
		qcom,mdss-dsi-h-right-border = <0>;
		qcom,mdss-dsi-v-top-border = <0>;
		qcom,mdss-dsi-v-bottom-border = <0>;
		qcom,mdss-dsi-bpp = <24>;
		qcom,mdss-dsi-color-order = <0>;
		qcom,mdss-dsi-underflow-color = <0xff>;
		qcom,mdss-dsi-border-color = <0>;
		qcom,mdss-dsi-on-command = [39 01 00 00 00 00 06 FF FF 98 06 04 01
				39 01 00 00 00 00 02 08 10
				39 01 00 00 00 00 02 21 01
				39 01 00 00 00 00 02 30 01
				39 01 00 00 00 00 02 31 00
				39 01 00 00 00 00 02 40 1A
				39 01 00 00 00 00 02 41 33
				39 01 00 00 00 00 02 42 03
				39 01 00 00 00 00 02 43 09
				39 01 00 00 00 00 02 44 09
				39 01 00 00 00 00 02 50 78
				39 01 00 00 00 00 02 51 78
				39 01 00 00 00 00 02 52 00
				39 01 00 00 00 00 02 53 2B
				39 01 00 00 00 00 02 57 50
				39 01 00 00 00 00 02 60 07
				39 01 00 00 00 00 02 61 00
				39 01 00 00 00 00 02 62 08
				39 01 00 00 00 00 02 63 00
				39 01 00 00 00 00 02 A0 00
				39 01 00 00 00 00 02 A1 06
				39 01 00 00 00 00 02 A2 10
				39 01 00 00 00 00 02 A3 11
				39 01 00 00 00 00 02 A4 08
				39 01 00 00 00 00 02 A5 1A
				39 01 00 00 00 00 02 A6 09
				39 01 00 00 00 00 02 A7 08
				39 01 00 00 00 00 02 A8 05
				39 01 00 00 00 00 02 A9 0A
				39 01 00 00 00 00 02 AA 04
				39 01 00 00 00 00 02 AB 08
				39 01 00 00 00 00 02 AC 10
				39 01 00 00 00 00 02 AD 38
				39 01 00 00 00 00 02 AE 34
				39 01 00 00 00 00 02 AF 00
				39 01 00 00 00 00 02 C0 00
				39 01 00 00 00 00 02 C1 07
				39 01 00 00 00 00 02 C2 15
				39 01 00 00 00 00 02 C3 11
				39 01 00 00 00 00 02 C4 0A
				39 01 00 00 00 00 02 C5 18
				39 01 00 00 00 00 02 C6 08
				39 01 00 00 00 00 02 C7 07
				39 01 00 00 00 00 02 C8 03
				39 01 00 00 00 00 02 C9 08
				39 01 00 00 00 00 02 CA 07
				39 01 00 00 00 00 02 CB 05
				39 01 00 00 00 00 02 CC 0C
				39 01 00 00 00 00 02 CD 1E
				39 01 00 00 00 00 02 CE 1A
				39 01 00 00 00 00 02 CF 00
				39 01 00 00 00 00 06 FF FF 98 06 04 02
				39 01 00 00 00 00 02 40 01
				39 01 00 00 00 00 02 00 00
				39 01 00 00 00 00 02 01 00
				39 01 00 00 00 00 02 02 00
				39 01 00 00 00 00 02 03 00
				39 01 00 00 00 00 02 04 00
				39 01 00 00 00 00 02 05 00
				39 01 00 00 00 00 02 06 09
				39 01 00 00 00 00 02 07 19
				39 01 00 00 00 00 02 08 19
				39 01 00 00 00 00 02 09 19
				39 01 00 00 00 00 02 0A 19
				39 01 00 00 00 00 02 0B 19
				39 01 00 00 00 00 02 0C 1C
				39 01 00 00 00 00 02 0D 1C
				39 01 00 00 00 00 02 0E 1C
				39 01 00 00 00 00 02 0F 1C
				39 01 00 00 00 00 02 10 1D
				39 01 00 00 00 00 02 11 1D
				39 01 00 00 00 00 02 12 1D
				39 01 00 00 00 00 02 13 1D
				39 01 00 00 00 00 02 14 1D
				39 01 00 00 00 00 02 15 3E
				39 01 00 00 00 00 02 16 3E
				39 01 00 00 00 00 02 17 3E
				39 01 00 00 00 00 02 18 3E
				39 01 00 00 00 00 02 19 4E
				39 01 00 00 00 00 02 1A 4E
				39 01 00 00 00 00 02 1B 4E
				39 01 00 00 00 00 02 1C 4E
				39 01 00 00 00 00 02 1D 4E
				39 01 00 00 00 00 02 1E 4E
				39 01 00 00 00 00 02 1F 4E
				39 01 00 00 00 00 02 20 4E
				39 01 00 00 00 00 02 21 4E
				39 01 00 00 00 00 02 22 4E
				39 01 00 00 00 00 02 23 4E
				39 01 00 00 00 00 02 24 4E
				39 01 00 00 00 00 02 25 4E
				39 01 00 00 00 00 02 26 5E
				39 01 00 00 00 00 02 27 5E
				39 01 00 00 00 00 02 28 5E
				39 01 00 00 00 00 02 29 5E
				39 01 00 00 00 00 02 2A 5E
				39 01 00 00 00 00 02 2B 5E
				39 01 00 00 00 00 02 2C 5E
				39 01 00 00 00 00 02 2D 5E
				39 01 00 00 00 00 02 2E 5E
				39 01 00 00 00 00 02 2F 5E
				39 01 00 00 00 00 02 30 5E
				39 01 00 00 00 00 02 31 5E
				39 01 00 00 00 00 02 32 5E
				39 01 00 00 00 00 02 33 5E
				39 01 00 00 00 00 02 34 5E
				39 01 00 00 00 00 02 35 5E
				39 01 00 00 00 00 02 36 5E
				39 01 00 00 00 00 02 37 5E
				39 01 00 00 00 00 02 38 5C
				39 01 00 00 00 00 02 39 4C
				39 01 00 00 00 00 02 3A 4C
				39 01 00 00 00 00 02 3B 3B
				39 01 00 00 00 00 02 3C 3B
				39 01 00 00 00 00 02 3D 2A
				39 01 00 00 00 00 02 3E 10
				39 01 00 00 00 00 02 3F 00
				39 01 00 00 00 00 06 FF FF 98 06 04 03
				39 01 00 00 00 00 02 00 00
				39 01 00 00 00 00 02 01 00
				39 01 00 00 00 00 02 02 00
				39 01 00 00 00 00 02 03 00
				39 01 00 00 00 00 02 04 00
				39 01 00 00 00 00 02 05 00
				39 01 00 00 00 00 02 06 00
				39 01 00 00 00 00 02 07 00
				39 01 00 00 00 00 02 08 00
				39 01 00 00 00 00 02 09 00
				39 01 00 00 00 00 02 0A 00
				39 01 00 00 00 00 02 0B 00
				39 01 00 00 00 00 02 0C 00
				39 01 00 00 00 00 02 0D 00
				39 01 00 00 00 00 02 0E 00
				39 01 00 00 00 00 02 0F 00
				39 01 00 00 00 00 02 10 00
				39 01 00 00 00 00 02 11 00
				39 01 00 00 00 00 02 12 00
				39 01 00 00 00 00 02 13 00
				39 01 00 00 00 00 02 14 00
				39 01 00 00 00 00 02 15 00
				39 01 00 00 00 00 02 16 00
				39 01 00 00 00 00 02 17 00
				39 01 00 00 00 00 02 18 00
				39 01 00 00 00 00 02 19 00
				39 01 00 00 00 00 02 1A 00
				39 01 00 00 00 00 02 1B 00
				39 01 00 00 00 00 02 1C 00
				39 01 00 00 00 00 02 1D 00
				39 01 00 00 00 00 02 1E 00
				39 01 00 00 00 00 02 1F 00
				39 01 00 00 00 00 02 20 00
				39 01 00 00 00 00 02 21 00
				39 01 00 00 00 00 02 22 00
				39 01 00 00 00 00 02 23 00
				39 01 00 00 00 00 02 24 00
				39 01 00 00 00 00 02 25 00
				39 01 00 00 00 00 02 26 00
				39 01 00 00 00 00 02 27 00
				39 01 00 00 00 00 02 28 00
				39 01 00 00 00 00 02 29 00
				39 01 00 00 00 00 02 2A 00
				39 01 00 00 00 00 02 2B 00
				39 01 00 00 00 00 02 2C 00
				39 01 00 00 00 00 02 2D 00
				39 01 00 00 00 00 02 2E 00
				39 01 00 00 00 00 02 2F 00
				39 01 00 00 00 00 02 30 00
				39 01 00 00 00 00 02 31 00
				39 01 00 00 00 00 02 32 00
				39 01 00 00 00 00 02 33 00
				39 01 00 00 00 00 02 34 00
				39 01 00 00 00 00 02 35 00
				39 01 00 00 00 00 02 36 00
				39 01 00 00 00 00 02 37 00
				39 01 00 00 00 00 02 38 00
				39 01 00 00 00 00 02 39 00
				39 01 00 00 00 00 02 3A 00
				39 01 00 00 00 00 02 3B 00
				39 01 00 00 00 00 02 3C 00
				39 01 00 00 00 00 02 3D 00
				39 01 00 00 00 00 02 3E 00
				39 01 00 00 00 00 02 3F 00
				39 01 00 00 00 00 02 40 00
				39 01 00 00 00 00 02 41 00
				39 01 00 00 00 00 02 42 00
				39 01 00 00 00 00 02 43 00
				39 01 00 00 00 00 02 44 00
				39 01 00 00 00 00 02 45 00
				39 01 00 00 00 00 02 46 00
				39 01 00 00 00 00 02 47 00
				39 01 00 00 00 00 02 48 00
				39 01 00 00 00 00 02 49 00
				39 01 00 00 00 00 02 4A 00
				39 01 00 00 00 00 02 4B 00
				39 01 00 00 00 00 02 4C 00
				39 01 00 00 00 00 02 4D 00
				39 01 00 00 00 00 02 4E 00
				39 01 00 00 00 00 02 4F 00
				39 01 00 00 00 00 02 50 00
				39 01 00 00 00 00 02 51 00
				39 01 00 00 00 00 02 52 00
				39 01 00 00 00 00 02 53 00
				39 01 00 00 00 00 02 54 00
				39 01 00 00 00 00 02 55 00
				39 01 00 00 00 00 02 56 00
				39 01 00 00 00 00 02 57 00
				39 01 00 00 00 00 02 58 00
				39 01 00 00 00 00 02 59 00
				39 01 00 00 00 00 02 5A 00
				39 01 00 00 00 00 02 5B 00
				39 01 00 00 00 00 02 5C 00
				39 01 00 00 00 00 02 5D 00
				39 01 00 00 00 00 02 5E 00
				39 01 00 00 00 00 02 5F 00
				39 01 00 00 00 00 02 60 00
				39 01 00 00 00 00 02 61 00
				39 01 00 00 00 00 02 62 00
				39 01 00 00 00 00 02 63 00
				39 01 00 00 00 00 02 64 00
				39 01 00 00 00 00 02 65 00
				39 01 00 00 00 00 02 66 00
				39 01 00 00 00 00 02 67 00
				39 01 00 00 00 00 02 68 00
				39 01 00 00 00 00 02 69 00
				39 01 00 00 00 00 02 6A 00
				39 01 00 00 00 00 02 6B 00
				39 01 00 00 00 00 02 6C 00
				39 01 00 00 00 00 02 6D 00
				39 01 00 00 00 00 02 6E 00
				39 01 00 00 00 00 02 6F 00
				39 01 00 00 00 00 02 70 00
				39 01 00 00 00 00 02 71 00
				39 01 00 00 00 00 02 72 00
				39 01 00 00 00 00 02 73 00
				39 01 00 00 00 00 02 74 00
				39 01 00 00 00 00 02 75 00
				39 01 00 00 00 00 02 76 00
				39 01 00 00 00 00 02 77 00
				39 01 00 00 00 00 02 78 00
				39 01 00 00 00 00 02 79 00
				39 01 00 00 00 00 02 7A 00
				39 01 00 00 00 00 02 7B 00
				39 01 00 00 00 00 02 7C 00
				39 01 00 00 00 00 02 7D 00
				39 01 00 00 00 00 02 7E 00
				39 01 00 00 00 00 02 7F 00
				39 01 00 00 00 00 06 FF FF 98 06 04 04
				39 01 00 00 00 00 02 00 00
				39 01 00 00 00 00 02 01 00
				39 01 00 00 00 00 02 02 00
				39 01 00 00 00 00 02 03 00
				39 01 00 00 00 00 02 04 00
				39 01 00 00 00 00 02 05 00
				39 01 00 00 00 00 02 06 00
				39 01 00 00 00 00 02 07 00
				39 01 00 00 00 00 02 08 00
				39 01 00 00 00 00 02 09 00
				39 01 00 00 00 00 02 0A 00
				39 01 00 00 00 00 02 0B 00
				39 01 00 00 00 00 02 0C 00
				39 01 00 00 00 00 02 0D 00
				39 01 00 00 00 00 02 0E 00
				39 01 00 00 00 00 02 0F 00
				39 01 00 00 00 00 02 10 00
				39 01 00 00 00 00 02 11 00
				39 01 00 00 00 00 02 12 00
				39 01 00 00 00 00 02 13 00
				39 01 00 00 00 00 02 14 00
				39 01 00 00 00 00 02 15 00
				39 01 00 00 00 00 02 16 00
				39 01 00 00 00 00 02 17 00
				39 01 00 00 00 00 02 18 00
				39 01 00 00 00 00 02 19 00
				39 01 00 00 00 00 02 1A 00
				39 01 00 00 00 00 02 1B 00
				39 01 00 00 00 00 02 1C 00
				39 01 00 00 00 00 02 1D 00
				39 01 00 00 00 00 02 1E 00
				39 01 00 00 00 00 02 1F 00
				39 01 00 00 00 00 02 20 00
				39 01 00 00 00 00 02 21 00
				39 01 00 00 00 00 02 22 00
				39 01 00 00 00 00 02 23 00
				39 01 00 00 00 00 02 24 00
				39 01 00 00 00 00 02 25 00
				39 01 00 00 00 00 02 26 00
				39 01 00 00 00 00 02 27 00
				39 01 00 00 00 00 02 28 00
				39 01 00 00 00 00 02 29 00
				39 01 00 00 00 00 02 2A 00
				39 01 00 00 00 00 02 2B 00
				39 01 00 00 00 00 02 2C 00
				39 01 00 00 00 00 02 2D 00
				39 01 00 00 00 00 02 2E 00
				39 01 00 00 00 00 02 2F 00
				39 01 00 00 00 00 02 30 00
				39 01 00 00 00 00 02 31 00
				39 01 00 00 00 00 02 32 00
				39 01 00 00 00 00 02 33 00
				39 01 00 00 00 00 02 34 00
				39 01 00 00 00 00 02 35 00
				39 01 00 00 00 00 02 36 00
				39 01 00 00 00 00 02 37 00
				39 01 00 00 00 00 02 38 00
				39 01 00 00 00 00 02 39 00
				39 01 00 00 00 00 02 3A 00
				39 01 00 00 00 00 02 3B 00
				39 01 00 00 00 00 02 3C 00
				39 01 00 00 00 00 02 3D 00
				39 01 00 00 00 00 02 3E 00
				39 01 00 00 00 00 02 3F 00
				39 01 00 00 00 00 02 40 00
				39 01 00 00 00 00 02 41 00
				39 01 00 00 00 00 02 42 00
				39 01 00 00 00 00 02 43 00
				39 01 00 00 00 00 02 44 00
				39 01 00 00 00 00 02 45 00
				39 01 00 00 00 00 02 46 00
				39 01 00 00 00 00 02 47 00
				39 01 00 00 00 00 02 48 00
				39 01 00 00 00 00 02 49 00
				39 01 00 00 00 00 02 4A 00
				39 01 00 00 00 00 02 4B 00
				39 01 00 00 00 00 02 4C 00
				39 01 00 00 00 00 02 4D 00
				39 01 00 00 00 00 02 4E 00
				39 01 00 00 00 00 02 4F 00
				39 01 00 00 00 00 02 50 00
				39 01 00 00 00 00 02 51 00
				39 01 00 00 00 00 02 52 00
				39 01 00 00 00 00 02 53 00
				39 01 00 00 00 00 02 54 00
				39 01 00 00 00 00 02 55 00
				39 01 00 00 00 00 02 56 00
				39 01 00 00 00 00 02 57 00
				39 01 00 00 00 00 02 58 00
				39 01 00 00 00 00 02 59 00
				39 01 00 00 00 00 02 5A 00
				39 01 00 00 00 00 02 5B 00
				39 01 00 00 00 00 02 5C 00
				39 01 00 00 00 00 02 5D 00
				39 01 00 00 00 00 02 5E 00
				39 01 00 00 00 00 02 5F 00
				39 01 00 00 00 00 02 60 00
				39 01 00 00 00 00 02 61 00
				39 01 00 00 00 00 02 62 00
				39 01 00 00 00 00 02 63 10
				39 01 00 00 00 00 02 64 10
				39 01 00 00 00 00 02 65 20
				39 01 00 00 00 00 02 66 10
				39 01 00 00 00 00 02 67 10
				39 01 00 00 00 00 02 68 00
				39 01 00 00 00 00 02 69 00
				39 01 00 00 00 00 02 6A 00
				39 01 00 00 00 00 02 6B 00
				39 01 00 00 00 00 02 6C 00
				39 01 00 00 00 00 02 6D 00
				39 01 00 00 00 00 02 6E 00
				39 01 00 00 00 00 02 6F 00
				39 01 00 00 00 00 02 70 00
				39 01 00 00 00 00 02 71 00
				39 01 00 00 00 00 02 72 00
				39 01 00 00 00 00 02 73 00
				39 01 00 00 00 00 02 74 00
				39 01 00 00 00 00 02 75 00
				39 01 00 00 00 00 02 76 00
				39 01 00 00 00 00 02 77 00
				39 01 00 00 00 00 02 78 00
				39 01 00 00 00 00 02 79 00
				39 01 00 00 00 00 02 7A 00
				39 01 00 00 00 00 02 7B 00
				39 01 00 00 00 00 02 7C 00
				39 01 00 00 00 00 02 7D 00
				39 01 00 00 00 00 02 7E 00
				39 01 00 00 00 00 02 7F 00
				39 01 00 00 00 00 06 FF FF 98 06 04 04
				39 01 00 00 00 00 02 00 00
				39 01 00 00 00 00 02 01 00
				39 01 00 00 00 00 02 02 00
				39 01 00 00 00 00 02 03 00
				39 01 00 00 00 00 02 04 00
				39 01 00 00 00 00 02 05 00
				39 01 00 00 00 00 02 06 00
				39 01 00 00 00 00 02 07 00
				39 01 00 00 00 00 02 08 00
				39 01 00 00 00 00 02 09 00
				39 01 00 00 00 00 02 0A 00
				39 01 00 00 00 00 02 0B 00
				39 01 00 00 00 00 02 0C 00
				39 01 00 00 00 00 02 0D 00
				39 01 00 00 00 00 02 0E 00
				39 01 00 00 00 00 02 0F 00
				39 01 00 00 00 00 02 10 00
				39 01 00 00 00 00 02 11 00
				39 01 00 00 00 00 02 12 00
				39 01 00 00 00 00 02 13 00
				39 01 00 00 00 00 02 14 00
				39 01 00 00 00 00 02 15 00
				39 01 00 00 00 00 02 16 00
				39 01 00 00 00 00 02 17 00
				39 01 00 00 00 00 02 18 00
				39 01 00 00 00 00 02 19 00
				39 01 00 00 00 00 02 1A 00
				39 01 00 00 00 00 02 1B 00
				39 01 00 00 00 00 02 1C 00
				39 01 00 00 00 00 02 1D 00
				39 01 00 00 00 00 02 1E 00
				39 01 00 00 00 00 02 1F 00
				39 01 00 00 00 00 02 20 00
				39 01 00 00 00 00 02 21 00
				39 01 00 00 00 00 02 22 00
				39 01 00 00 00 00 02 23 00
				39 01 00 00 00 00 02 24 00
				39 01 00 00 00 00 02 25 00
				39 01 00 00 00 00 02 26 00
				39 01 00 00 00 00 02 27 00
				39 01 00 00 00 00 02 28 00
				39 01 00 00 00 00 02 29 00
				39 01 00 00 00 00 02 2A 00
				39 01 00 00 00 00 02 2B 00
				39 01 00 00 00 00 02 2C 00
				39 01 00 00 00 00 02 2D 00
				39 01 00 00 00 00 02 2E 00
				39 01 00 00 00 00 02 2F 00
				39 01 00 00 00 00 02 30 00
				39 01 00 00 00 00 02 31 00
				39 01 00 00 00 00 02 32 00
				39 01 00 00 00 00 02 33 00
				39 01 00 00 00 00 02 34 00
				39 01 00 00 00 00 02 35 00
				39 01 00 00 00 00 02 36 00
				39 01 00 00 00 00 02 37 00
				39 01 00 00 00 00 02 38 00
				39 01 00 00 00 00 02 39 00
				39 01 00 00 00 00 02 3A 00
				39 01 00 00 00 00 02 3B 00
				39 01 00 00 00 00 02 3C 00
				39 01 00 00 00 00 02 3D 00
				39 01 00 00 00 00 02 3E 00
				39 01 00 00 00 00 02 3F 00
				39 01 00 00 00 00 02 40 00
				39 01 00 00 00 00 02 41 00
				39 01 00 00 00 00 02 42 00
				39 01 00 00 00 00 02 43 00
				39 01 00 00 00 00 02 44 00
				39 01 00 00 00 00 02 45 00
				39 01 00 00 00 00 02 46 00
				39 01 00 00 00 00 02 47 00
				39 01 00 00 00 00 02 48 00
				39 01 00 00 00 00 02 49 00
				39 01 00 00 00 00 02 4A 00
				39 01 00 00 00 00 02 4B 00
				39 01 00 00 00 00 02 4C 00
				39 01 00 00 00 00 02 4D 00
				39 01 00 00 00 00 02 4E 00
				39 01 00 00 00 00 02 4F 00
				39 01 00 00 00 00 02 50 00
				39 01 00 00 00 00 02 51 00
				39 01 00 00 00 00 02 52 00
				39 01 00 00 00 00 02 53 00
				39 01 00 00 00 00 02 54 00
				39 01 00 00 00 00 02 55 00
				39 01 00 00 00 00 02 56 00
				39 01 00 00 00 00 02 57 00
				39 01 00 00 00 00 02 58 00
				39 01 00 00 00 00 02 59 00
				39 01 00 00 00 00 02 5A 00
				39 01 00 00 00 00 02 5B 00
				39 01 00 00 00 00 02 5C 00
				39 01 00 00 00 00 02 5D 00
				39 01 00 00 00 00 02 5E 00
				39 01 00 00 00 00 02 5F 00
				39 01 00 00 00 00 02 60 00
				39 01 00 00 00 00 02 61 00
				39 01 00 00 00 00 02 62 00
				39 01 00 00 00 00 02 63 00
				39 01 00 00 00 00 02 64 00
				39 01 00 00 00 00 02 65 00
				39 01 00 00 00 00 02 66 00
				39 01 00 00 00 00 02 67 00
				39 01 00 00 00 00 02 68 00
				39 01 00 00 00 00 02 69 00
				39 01 00 00 00 00 02 6A 00
				39 01 00 00 00 00 02 6B 00
				39 01 00 00 00 00 02 6C 00
				39 01 00 00 00 00 02 6D 00
				39 01 00 00 00 00 02 6E 00
				39 01 00 00 00 00 02 6F 00
				39 01 00 00 00 00 02 70 00
				39 01 00 00 00 00 02 71 00
				39 01 00 00 00 00 02 72 00
				39 01 00 00 00 00 02 73 00
				39 01 00 00 00 00 02 74 00
				39 01 00 00 00 00 02 75 00
				39 01 00 00 00 00 02 76 00
				39 01 00 00 00 00 02 77 00
				39 01 00 00 00 00 02 78 00
				39 01 00 00 00 00 02 79 00
				39 01 00 00 00 00 02 7A 00
				39 01 00 00 00 00 02 7B 00
				39 01 00 00 00 00 02 7C 00
				39 01 00 00 00 00 02 7D 00
				39 01 00 00 00 00 02 7E 00
				39 01 00 00 00 00 02 7F 00
				39 01 00 00 00 00 06 FF FF 98 06 04 06
				39 01 00 00 00 00 02 00 21
				39 01 00 00 00 00 02 01 0A
				39 01 00 00 00 00 02 02 00
				39 01 00 00 00 00 02 03 00
				39 01 00 00 00 00 02 04 01
				39 01 00 00 00 00 02 05 01
				39 01 00 00 00 00 02 06 80
				39 01 00 00 00 00 02 07 06
				39 01 00 00 00 00 02 08 01
				39 01 00 00 00 00 02 09 80
				39 01 00 00 00 00 02 0A 00
				39 01 00 00 00 00 02 0B 00
				39 01 00 00 00 00 02 0C 0A
				39 01 00 00 00 00 02 0D 0A
				39 01 00 00 00 00 02 0E 00
				39 01 00 00 00 00 02 0F 00
				39 01 00 00 00 00 02 10 F0
				39 01 00 00 00 00 02 11 F4
				39 01 00 00 00 00 02 12 04
				39 01 00 00 00 00 02 13 00
				39 01 00 00 00 00 02 14 00
				39 01 00 00 00 00 02 15 C0
				39 01 00 00 00 00 02 16 08
				39 01 00 00 00 00 02 17 00
				39 01 00 00 00 00 02 18 00
				39 01 00 00 00 00 02 19 00
				39 01 00 00 00 00 02 1A 00
				39 01 00 00 00 00 02 1B 00
				39 01 00 00 00 00 02 1C 00
				39 01 00 00 00 00 02 1D 00
				39 01 00 00 00 00 02 20 01
				39 01 00 00 00 00 02 21 23
				39 01 00 00 00 00 02 22 45
				39 01 00 00 00 00 02 23 67
				39 01 00 00 00 00 02 24 01
				39 01 00 00 00 00 02 25 23
				39 01 00 00 00 00 02 26 45
				39 01 00 00 00 00 02 27 67
				39 01 00 00 00 00 02 30 01
				39 01 00 00 00 00 02 31 11
				39 01 00 00 00 00 02 32 00
				39 01 00 00 00 00 02 33 EE
				39 01 00 00 00 00 02 34 FF
				39 01 00 00 00 00 02 35 BB
				39 01 00 00 00 00 02 36 CA
				39 01 00 00 00 00 02 37 DD
				39 01 00 00 00 00 02 38 AC
				39 01 00 00 00 00 02 39 76
				39 01 00 00 00 00 02 3A 67
				39 01 00 00 00 00 02 3B 22
				39 01 00 00 00 00 02 3C 22
				39 01 00 00 00 00 02 3D 22
				39 01 00 00 00 00 02 3E 22
				39 01 00 00 00 00 02 3F 22
				39 01 00 00 00 00 02 40 22
				39 01 00 00 00 00 02 52 10
				39 01 00 00 00 00 02 53 10
				39 01 00 00 00 00 06 FF FF 98 06 04 07
				39 01 00 00 00 00 02 17 22
				39 01 00 00 00 00 02 02 77
				39 01 00 00 00 00 02 E1 79
				39 01 00 00 00 00 02 06 01
				39 01 00 00 00 00 06 FF FF 98 06 04 00
			05 01 00 00 78 00 02 11 00
			05 01 00 00 0A 00 02 29 00];
		qcom,mdss-dsi-off-command = [05 01 00 00 32 00 02 28 00
					05 01 00 00 78 00 02 10 00];
		qcom,mdss-dsi-on-command-state = "dsi_lp_mode";
		qcom,mdss-dsi-off-command-state = "dsi_hs_mode";
		qcom,mdss-dsi-h-sync-pulse = <1>;
		qcom,mdss-dsi-traffic-mode = "burst_mode";
		qcom,mdss-dsi-lane-map = "lane_map_0123";
		qcom,mdss-dsi-bllp-eof-power-mode;
		qcom,mdss-dsi-bllp-power-mode;
		qcom,mdss-dsi-lane-0-state;
		qcom,mdss-dsi-lane-1-state;
		qcom,mdss-dsi-panel-timings = [7D 24 19 00 34 31 1D 26 2A 03 04 00];
		qcom,mdss-dsi-t-clk-post = <0x1F>;
		qcom,mdss-dsi-t-clk-pre = <0x2C>;
		qcom,mdss-dsi-bl-min-level = <1>;
		qcom,mdss-dsi-bl-max-level = <4095>;
		qcom,mdss-dsi-bl-pmic-control-type = "bl_ctrl_pwm";
		qcom,mdss-dsi-bl-pmic-pwm-frequency = <100>;
		qcom,mdss-dsi-bl-pmic-bank-select = <0>;
		qcom,mdss-dsi-pwm-gpio = <&pm8909_mpps 2 0>;
		qcom,mdss-dsi-dma-trigger = "trigger_sw";
		qcom,mdss-dsi-mdp-trigger = "none";
		qcom,mdss-dsi-reset-sequence = <1 20>, <0 20>, <1 20>;
		qcom,mdss-dsi-post-init-delay = <4>;
	};
};
