/* Copyright (c) 2014, The Linux Foundation. All rights reserved.
 *
 * This program is free software; you can redistribute it and/or modify
 * it under the terms of the GNU General Public License version 2 and
 * only version 2 as published by the Free Software Foundation.
 *
 * This program is distributed in the hope that it will be useful,
 * but WITHOUT ANY WARRANTY; without even the implied warranty of
 * MERCHANTABILITY or FITNESS FOR A PARTICULAR PURPOSE.  See the
 * GNU General Public License for more details.
 */

/*---------------------------------------------------------------------------
 * This file is autogenerated file using gcdb parser. Please do not edit it.
 * Update input XML file to add a new entry or update variable in this file
 * VERSION = "1.0"
 *---------------------------------------------------------------------------*/
&mdss_mdp {
	dsi_nt35590_qvga_cmd: qcom,mdss_dsi_nt35590_qvga_cmd {
		qcom,mdss-dsi-panel-name = "nt35590 qvga command mode dsi panel";
		qcom,mdss-dsi-panel-controller = <&mdss_dsi0>;
		qcom,ulps-enabled;
		qcom,mdss-dsi-panel-type = "dsi_cmd_mode";
		qcom,mdss-dsi-panel-destination = "display_1";
		qcom,mdss-dsi-panel-framerate = <60>;
		qcom,mdss-dsi-virtual-channel-id = <0>;
		qcom,mdss-dsi-stream = <0>;
		qcom,mdss-dsi-panel-width = <320>;
		qcom,mdss-dsi-panel-height = <240>;
		qcom,mdss-dsi-h-front-porch = <140>;
		qcom,mdss-dsi-h-back-porch = <164>;
		qcom,mdss-dsi-h-pulse-width = <8>;
		qcom,mdss-dsi-h-sync-skew = <0>;
		qcom,mdss-dsi-v-back-porch = <1>;
		qcom,mdss-dsi-v-front-porch = <6>;
		qcom,mdss-dsi-v-pulse-width = <1>;
		qcom,mdss-dsi-h-left-border = <0>;
		qcom,mdss-dsi-h-right-border = <0>;
		qcom,mdss-dsi-v-top-border = <0>;
		qcom,mdss-dsi-v-bottom-border = <0>;
		qcom,mdss-dsi-bpp = <24>;
		qcom,mdss-dsi-color-order = "rgb_swap_rgb";
		qcom,mdss-dsi-underflow-color = <0xff>;
		qcom,mdss-dsi-border-color = <0>;
		qcom,mdss-dsi-on-command = [29 01 00 00 00 00 02 ff ee
					29 01 00 00 00 00 02 26 08
					29 01 00 00 00 00 02 26 00
					29 01 00 00 10 00 02 ff 00
					29 01 00 00 00 00 02 ba 00
					29 01 00 00 00 00 02 c2 08
					29 01 00 00 00 00 02 ff 01
					29 01 00 00 00 00 02 fb 01
					29 01 00 00 00 00 02 00 4a
					29 01 00 00 00 00 02 01 33
					29 01 00 00 00 00 02 02 53
					29 01 00 00 00 00 02 03 55
					29 01 00 00 00 00 02 04 55
					29 01 00 00 00 00 02 05 33
					29 01 00 00 00 00 02 06 22
					29 01 00 00 00 00 02 08 56
					29 01 00 00 00 00 02 09 8f
					29 01 00 00 00 00 02 36 73
					29 01 00 00 00 00 02 0b 9f
					29 01 00 00 00 00 02 0c 9f
					29 01 00 00 00 00 02 0d 2f
					29 01 00 00 00 00 02 0e 24
					29 01 00 00 00 00 02 11 83
					29 01 00 00 00 00 02 12 03
					29 01 00 00 00 00 02 71 2c
					29 01 00 00 00 00 02 6f 03
					29 01 00 00 00 00 02 0f 0a
					29 01 00 00 00 00 02 ff 05
					29 01 00 00 00 00 02 fb 01
					29 01 00 00 00 00 02 01 00
					29 01 00 00 00 00 02 02 8b
					29 01 00 00 00 00 02 03 82
					29 01 00 00 00 00 02 04 82
					29 01 00 00 00 00 02 05 30
					29 01 00 00 00 00 02 06 33
					29 01 00 00 00 00 02 07 01
					29 01 00 00 00 00 02 08 00
					29 01 00 00 00 00 02 09 46
					29 01 00 00 00 00 02 0a 46
					29 01 00 00 00 00 02 0d 0b
					29 01 00 00 00 00 02 0e 1d
					29 01 00 00 00 00 02 0f 08
					29 01 00 00 00 00 02 10 53
					29 01 00 00 00 00 02 11 00
					29 01 00 00 00 00 02 12 00
					29 01 00 00 00 00 02 14 01
					29 01 00 00 00 00 02 15 00
					29 01 00 00 00 00 02 16 05
					29 01 00 00 00 00 02 17 00
					29 01 00 00 00 00 02 19 7f
					29 01 00 00 00 00 02 1a ff
					29 01 00 00 00 00 02 1b 0f
					29 01 00 00 00 00 02 1c 00
					29 01 00 00 00 00 02 1d 00
					29 01 00 00 00 00 02 1e 00
					29 01 00 00 00 00 02 1f 07
					29 01 00 00 00 00 02 20 00
					29 01 00 00 00 00 02 21 06
					29 01 00 00 00 00 02 22 55
					29 01 00 00 00 00 02 23 4d
					29 01 00 00 00 00 02 2d 02
					29 01 00 00 00 00 02 28 01
					29 01 00 00 00 00 02 2f 02
					29 01 00 00 00 00 02 83 01
					29 01 00 00 00 00 02 9e 58
					29 01 00 00 00 00 02 9f 6a
					29 01 00 00 00 00 02 a0 01
					29 01 00 00 00 00 02 a2 10
					29 01 00 00 00 00 02 bb 0a
					29 01 00 00 00 00 02 bc 0a
					29 01 00 00 00 00 02 32 08
					29 01 00 00 00 00 02 33 b8
					29 01 00 00 00 00 02 36 01
					29 01 00 00 00 00 02 37 00
					29 01 00 00 00 00 02 43 00
					29 01 00 00 00 00 02 4b 21
					29 01 00 00 00 00 02 4c 03
					29 01 00 00 00 00 02 50 21
					29 01 00 00 00 00 02 51 03
					29 01 00 00 00 00 02 58 21
					29 01 00 00 00 00 02 59 03
					29 01 00 00 00 00 02 5d 21
					29 01 00 00 00 00 02 5e 03
					29 01 00 00 00 00 02 6c 00
					29 01 00 00 00 00 02 6d 00
					29 01 00 00 00 00 02 fb 01
					29 01 00 00 00 00 02 ff 01
					29 01 00 00 00 00 02 fb 01
					29 01 00 00 00 00 02 75 00
					29 01 00 00 00 00 02 76 7d
					29 01 00 00 00 00 02 77 00
					29 01 00 00 00 00 02 78 8a
					29 01 00 00 00 00 02 79 00
					29 01 00 00 00 00 02 7a 9c
					29 01 00 00 00 00 02 7b 00
					29 01 00 00 00 00 02 7c b1
					29 01 00 00 00 00 02 7d 00
					29 01 00 00 00 00 02 7e bf
					29 01 00 00 00 00 02 7f 00
					29 01 00 00 00 00 02 80 cf
					29 01 00 00 00 00 02 81 00
					29 01 00 00 00 00 02 82 dd
					29 01 00 00 00 00 02 83 00
					29 01 00 00 00 00 02 84 e8
					29 01 00 00 00 00 02 85 00
					29 01 00 00 00 00 02 86 f2
					29 01 00 00 00 00 02 87 01
					29 01 00 00 00 00 02 88 1f
					29 01 00 00 00 00 02 89 01
					29 01 00 00 00 00 02 8a 41
					29 01 00 00 00 00 02 8b 01
					29 01 00 00 00 00 02 8c 78
					29 01 00 00 00 00 02 8d 01
					29 01 00 00 00 00 02 8e a5
					29 01 00 00 00 00 02 8f 01
					29 01 00 00 00 00 02 90 ee
					29 01 00 00 00 00 02 91 02
					29 01 00 00 00 00 02 92 29
					29 01 00 00 00 00 02 93 02
					29 01 00 00 00 00 02 94 2a
					29 01 00 00 00 00 02 95 02
					29 01 00 00 00 00 02 96 5d
					29 01 00 00 00 00 02 97 02
					29 01 00 00 00 00 02 98 93
					29 01 00 00 00 00 02 99 02
					29 01 00 00 00 00 02 9a b8
					29 01 00 00 00 00 02 9b 02
					29 01 00 00 00 00 02 9c e7
					29 01 00 00 00 00 02 9d 03
					29 01 00 00 00 00 02 9e 07
					29 01 00 00 00 00 02 9f 03
					29 01 00 00 00 00 02 a0 37
					29 01 00 00 00 00 02 a2 03
					29 01 00 00 00 00 02 a3 46
					29 01 00 00 00 00 02 a4 03
					29 01 00 00 00 00 02 a5 56
					29 01 00 00 00 00 02 a6 03
					29 01 00 00 00 00 02 a7 66
					29 01 00 00 00 00 02 a9 03
					29 01 00 00 00 00 02 aa 7a
					29 01 00 00 00 00 02 ab 03
					29 01 00 00 00 00 02 ac 93
					29 01 00 00 00 00 02 ad 03
					29 01 00 00 00 00 02 ae a3
					29 01 00 00 00 00 02 af 03
					29 01 00 00 00 00 02 b0 b4
					29 01 00 00 00 00 02 b1 03
					29 01 00 00 00 00 02 b2 cb
					29 01 00 00 00 00 02 b3 00
					29 01 00 00 00 00 02 b4 7d
					29 01 00 00 00 00 02 b5 00
					29 01 00 00 00 00 02 b6 8a
					29 01 00 00 00 00 02 b7 00
					29 01 00 00 00 00 02 b8 9c
					29 01 00 00 00 00 02 b9 00
					29 01 00 00 00 00 02 ba b1
					29 01 00 00 00 00 02 bb 00
					29 01 00 00 00 00 02 bc bf
					29 01 00 00 00 00 02 bd 00
					29 01 00 00 00 00 02 be cf
					29 01 00 00 00 00 02 bf 00
					29 01 00 00 00 00 02 c0 dd
					29 01 00 00 00 00 02 c1 00
					29 01 00 00 00 00 02 c2 e8
					29 01 00 00 00 00 02 c3 00
					29 01 00 00 00 00 02 c4 f2
					29 01 00 00 00 00 02 c5 01
					29 01 00 00 00 00 02 c6 1f
					29 01 00 00 00 00 02 c7 01
					29 01 00 00 00 00 02 c8 41
					29 01 00 00 00 00 02 c9 01
					29 01 00 00 00 00 02 ca 78
					29 01 00 00 00 00 02 cb 01
					29 01 00 00 00 00 02 cc a5
					29 01 00 00 00 00 02 cd 01
					29 01 00 00 00 00 02 ce ee
					29 01 00 00 00 00 02 cf 02
					29 01 00 00 00 00 02 d0 29
					29 01 00 00 00 00 02 d1 02
					29 01 00 00 00 00 02 d2 2a
					29 01 00 00 00 00 02 d3 02
					29 01 00 00 00 00 02 d4 5d
					29 01 00 00 00 00 02 d5 02
					29 01 00 00 00 00 02 d6 93
					29 01 00 00 00 00 02 d7 02
					29 01 00 00 00 00 02 d8 b8
					29 01 00 00 00 00 02 d9 02
					29 01 00 00 00 00 02 da e7
					29 01 00 00 00 00 02 db 03
					29 01 00 00 00 00 02 dc 07
					29 01 00 00 00 00 02 dd 03
					29 01 00 00 00 00 02 de 37
					29 01 00 00 00 00 02 df 03
					29 01 00 00 00 00 02 e0 46
					29 01 00 00 00 00 02 e1 03
					29 01 00 00 00 00 02 e2 56
					29 01 00 00 00 00 02 e3 03
					29 01 00 00 00 00 02 e4 66
					29 01 00 00 00 00 02 e5 03
					29 01 00 00 00 00 02 e6 7a
					29 01 00 00 00 00 02 e7 03
					29 01 00 00 00 00 02 e8 93
					29 01 00 00 00 00 02 e9 03
					29 01 00 00 00 00 02 ea a3
					29 01 00 00 00 00 02 eb 03
					29 01 00 00 00 00 02 ec b4
					29 01 00 00 00 00 02 ed 03
					29 01 00 00 00 00 02 ee cb
					29 01 00 00 00 00 02 ef 00
					29 01 00 00 00 00 02 f0 ed
					29 01 00 00 00 00 02 f1 00
					29 01 00 00 00 00 02 f2 f3
					29 01 00 00 00 00 02 f3 00
					29 01 00 00 00 00 02 f4 fe
					29 01 00 00 00 00 02 f5 01
					29 01 00 00 00 00 02 f6 09
					29 01 00 00 00 00 02 f7 01
					29 01 00 00 00 00 02 f8 13
					29 01 00 00 00 00 02 f9 01
					29 01 00 00 00 00 02 fa 1d
					29 01 00 00 00 00 02 ff 02
					29 01 00 00 00 00 02 fb 01
					29 01 00 00 00 00 02 00 01
					29 01 00 00 00 00 02 01 26
					29 01 00 00 00 00 02 02 01
					29 01 00 00 00 00 02 03 2f
					29 01 00 00 00 00 02 04 01
					29 01 00 00 00 00 02 05 37
					29 01 00 00 00 00 02 06 01
					29 01 00 00 00 00 02 07 56
					29 01 00 00 00 00 02 08 01
					29 01 00 00 00 00 02 09 70
					29 01 00 00 00 00 02 0a 01
					29 01 00 00 00 00 02 0b 9d
					29 01 00 00 00 00 02 0c 01
					29 01 00 00 00 00 02 0d c2
					29 01 00 00 00 00 02 0e 01
					29 01 00 00 00 00 02 0f ff
					29 01 00 00 00 00 02 10 02
					29 01 00 00 00 00 02 11 31
					29 01 00 00 00 00 02 12 02
					29 01 00 00 00 00 02 13 32
					29 01 00 00 00 00 02 14 02
					29 01 00 00 00 00 02 15 60
					29 01 00 00 00 00 02 16 02
					29 01 00 00 00 00 02 17 94
					29 01 00 00 00 00 02 18 02
					29 01 00 00 00 00 02 19 b5
					29 01 00 00 00 00 02 1a 02
					29 01 00 00 00 00 02 1b e3
					29 01 00 00 00 00 02 1c 03
					29 01 00 00 00 00 02 1d 03
					29 01 00 00 00 00 02 1e 03
					29 01 00 00 00 00 02 1f 2d
					29 01 00 00 00 00 02 20 03
					29 01 00 00 00 00 02 21 3a
					29 01 00 00 00 00 02 22 03
					29 01 00 00 00 00 02 23 48
					29 01 00 00 00 00 02 24 03
					29 01 00 00 00 00 02 25 57
					29 01 00 00 00 00 02 26 03
					29 01 00 00 00 00 02 27 68
					29 01 00 00 00 00 02 28 03
					29 01 00 00 00 00 02 29 7b
					29 01 00 00 00 00 02 2a 03
					29 01 00 00 00 00 02 2b 90
					29 01 00 00 00 00 02 2d 03
					29 01 00 00 00 00 02 2f a0
					29 01 00 00 00 00 02 30 03
					29 01 00 00 00 00 02 31 cb
					29 01 00 00 00 00 02 32 00
					29 01 00 00 00 00 02 33 ed
					29 01 00 00 00 00 02 34 00
					29 01 00 00 00 00 02 35 f3
					29 01 00 00 00 00 02 36 00
					29 01 00 00 00 00 02 37 fe
					29 01 00 00 00 00 02 38 01
					29 01 00 00 00 00 02 39 09
					29 01 00 00 00 00 02 3a 01
					29 01 00 00 00 00 02 3b 13
					29 01 00 00 00 00 02 3d 01
					29 01 00 00 00 00 02 3f 1d
					29 01 00 00 00 00 02 40 01
					29 01 00 00 00 00 02 41 26
					29 01 00 00 00 00 02 42 01
					29 01 00 00 00 00 02 43 2f
					29 01 00 00 00 00 02 44 01
					29 01 00 00 00 00 02 45 37
					29 01 00 00 00 00 02 46 01
					29 01 00 00 00 00 02 47 56
					29 01 00 00 00 00 02 48 01
					29 01 00 00 00 00 02 49 70
					29 01 00 00 00 00 02 4a 01
					29 01 00 00 00 00 02 4b 9d
					29 01 00 00 00 00 02 4c 01
					29 01 00 00 00 00 02 4d c2
					29 01 00 00 00 00 02 4e 01
					29 01 00 00 00 00 02 4f ff
					29 01 00 00 00 00 02 50 02
					29 01 00 00 00 00 02 51 31
					29 01 00 00 00 00 02 52 02
					29 01 00 00 00 00 02 53 32
					29 01 00 00 00 00 02 54 02
					29 01 00 00 00 00 02 55 60
					29 01 00 00 00 00 02 56 02
					29 01 00 00 00 00 02 58 94
					29 01 00 00 00 00 02 59 02
					29 01 00 00 00 00 02 5a b5
					29 01 00 00 00 00 02 5b 02
					29 01 00 00 00 00 02 5c e3
					29 01 00 00 00 00 02 5d 03
					29 01 00 00 00 00 02 5e 03
					29 01 00 00 00 00 02 5f 03
					29 01 00 00 00 00 02 60 2d
					29 01 00 00 00 00 02 61 03
					29 01 00 00 00 00 02 62 3a
					29 01 00 00 00 00 02 63 03
					29 01 00 00 00 00 02 64 48
					29 01 00 00 00 00 02 65 03
					29 01 00 00 00 00 02 66 57
					29 01 00 00 00 00 02 67 03
					29 01 00 00 00 00 02 68 68
					29 01 00 00 00 00 02 69 03
					29 01 00 00 00 00 02 6a 7b
					29 01 00 00 00 00 02 6b 03
					29 01 00 00 00 00 02 6c 90
					29 01 00 00 00 00 02 6d 03
					29 01 00 00 00 00 02 6e a0
					29 01 00 00 00 00 02 6f 03
					29 01 00 00 00 00 02 70 cb
					29 01 00 00 00 00 02 71 00
					29 01 00 00 00 00 02 72 19
					29 01 00 00 00 00 02 73 00
					29 01 00 00 00 00 02 74 36
					29 01 00 00 00 00 02 75 00
					29 01 00 00 00 00 02 76 55
					29 01 00 00 00 00 02 77 00
					29 01 00 00 00 00 02 78 70
					29 01 00 00 00 00 02 79 00
					29 01 00 00 00 00 02 7a 83
					29 01 00 00 00 00 02 7b 00
					29 01 00 00 00 00 02 7c 99
					29 01 00 00 00 00 02 7d 00
					29 01 00 00 00 00 02 7e a8
					29 01 00 00 00 00 02 7f 00
					29 01 00 00 00 00 02 80 b7
					29 01 00 00 00 00 02 81 00
					29 01 00 00 00 00 02 82 c5
					29 01 00 00 00 00 02 83 00
					29 01 00 00 00 00 02 84 f7
					29 01 00 00 00 00 02 85 01
					29 01 00 00 00 00 02 86 1e
					29 01 00 00 00 00 02 87 01
					29 01 00 00 00 00 02 88 60
					29 01 00 00 00 00 02 89 01
					29 01 00 00 00 00 02 8a 95
					29 01 00 00 00 00 02 8b 01
					29 01 00 00 00 00 02 8c e1
					29 01 00 00 00 00 02 8d 02
					29 01 00 00 00 00 02 8e 20
					29 01 00 00 00 00 02 8f 02
					29 01 00 00 00 00 02 90 23
					29 01 00 00 00 00 02 91 02
					29 01 00 00 00 00 02 92 59
					29 01 00 00 00 00 02 93 02
					29 01 00 00 00 00 02 94 94
					29 01 00 00 00 00 02 95 02
					29 01 00 00 00 00 02 96 b4
					29 01 00 00 00 00 02 97 02
					29 01 00 00 00 00 02 98 e1
					29 01 00 00 00 00 02 99 03
					29 01 00 00 00 00 02 9a 01
					29 01 00 00 00 00 02 9b 03
					29 01 00 00 00 00 02 9c 28
					29 01 00 00 00 00 02 9d 03
					29 01 00 00 00 00 02 9e 30
					29 01 00 00 00 00 02 9f 03
					29 01 00 00 00 00 02 a0 37
					29 01 00 00 00 00 02 a2 03
					29 01 00 00 00 00 02 a3 3b
					29 01 00 00 00 00 02 a4 03
					29 01 00 00 00 00 02 a5 40
					29 01 00 00 00 00 02 a6 03
					29 01 00 00 00 00 02 a7 50
					29 01 00 00 00 00 02 a9 03
					29 01 00 00 00 00 02 aa 6d
					29 01 00 00 00 00 02 ab 03
					29 01 00 00 00 00 02 ac 80
					29 01 00 00 00 00 02 ad 03
					29 01 00 00 00 00 02 ae cb
					29 01 00 00 00 00 02 af 00
					29 01 00 00 00 00 02 b0 19
					29 01 00 00 00 00 02 b1 00
					29 01 00 00 00 00 02 b2 36
					29 01 00 00 00 00 02 b3 00
					29 01 00 00 00 00 02 b4 55
					29 01 00 00 00 00 02 b5 00
					29 01 00 00 00 00 02 b6 70
					29 01 00 00 00 00 02 b7 00
					29 01 00 00 00 00 02 b8 83
					29 01 00 00 00 00 02 b9 00
					29 01 00 00 00 00 02 ba 99
					29 01 00 00 00 00 02 bb 00
					29 01 00 00 00 00 02 bc a8
					29 01 00 00 00 00 02 bd 00
					29 01 00 00 00 00 02 be b7
					29 01 00 00 00 00 02 bf 00
					29 01 00 00 00 00 02 c0 c5
					29 01 00 00 00 00 02 c1 00
					29 01 00 00 00 00 02 c2 f7
					29 01 00 00 00 00 02 c3 01
					29 01 00 00 00 00 02 c4 1e
					29 01 00 00 00 00 02 c5 01
					29 01 00 00 00 00 02 c6 60
					29 01 00 00 00 00 02 c7 01
					29 01 00 00 00 00 02 c8 95
					29 01 00 00 00 00 02 c9 01
					29 01 00 00 00 00 02 ca e1
					29 01 00 00 00 00 02 cb 02
					29 01 00 00 00 00 02 cc 20
					29 01 00 00 00 00 02 cd 02
					29 01 00 00 00 00 02 ce 23
					29 01 00 00 00 00 02 cf 02
					29 01 00 00 00 00 02 d0 59
					29 01 00 00 00 00 02 d1 02
					29 01 00 00 00 00 02 d2 94
					29 01 00 00 00 00 02 d3 02
					29 01 00 00 00 00 02 d4 b4
					29 01 00 00 00 00 02 d5 02
					29 01 00 00 00 00 02 d6 e1
					29 01 00 00 00 00 02 d7 03
					29 01 00 00 00 00 02 d8 01
					29 01 00 00 00 00 02 d9 03
					29 01 00 00 00 00 02 da 28
					29 01 00 00 00 00 02 db 03
					29 01 00 00 00 00 02 dc 30
					29 01 00 00 00 00 02 dd 03
					29 01 00 00 00 00 02 de 37
					29 01 00 00 00 00 02 df 03
					29 01 00 00 00 00 02 e0 3b
					29 01 00 00 00 00 02 e1 03
					29 01 00 00 00 00 02 e2 40
					29 01 00 00 00 00 02 e3 03
					29 01 00 00 00 00 02 e4 50
					29 01 00 00 00 00 02 e5 03
					29 01 00 00 00 00 02 e6 6d
					29 01 00 00 00 00 02 e7 03
					29 01 00 00 00 00 02 e8 80
					29 01 00 00 00 00 02 e9 03
					29 01 00 00 00 00 02 ea cb
					29 01 00 00 00 00 02 ff 01
					29 01 00 00 00 00 02 fb 01
					29 01 00 00 00 00 02 ff 02
					29 01 00 00 00 00 02 fb 01
					29 01 00 00 00 00 02 ff 04
					29 01 00 00 00 00 02 fb 01
					29 01 00 00 00 00 02 ff 00
					29 01 00 00 64 00 02 11 00
					29 01 00 00 00 00 02 ff ee
					29 01 00 00 00 00 02 12 50
					29 01 00 00 00 00 02 13 02
					29 01 00 00 00 00 02 6a 60
					29 01 00 00 00 00 02 ff 00
					29 01 00 00 78 00 02 29 00
					29 01 00 00 00 00 05 2a 00 00 01 3f
					29 01 00 00 00 00 05 2b 00 00 00 ef];
		qcom,mdss-dsi-off-command = [05 01 00 00 32 00 02 28 00
					05 01 00 00 78 00 02 10 00];
		qcom,mdss-dsi-on-command-state = "dsi_lp_mode";
		qcom,mdss-dsi-off-command-state = "dsi_hs_mode";
		qcom,mdss-dsi-h-sync-pulse = <1>;
		qcom,mdss-dsi-traffic-mode = "burst_mode";
		qcom,mdss-dsi-lane-map = "lane_map_0123";
		qcom,mdss-dsi-bllp-eof-power-mode;
		qcom,mdss-dsi-bllp-power-mode;
		qcom,mdss-dsi-lane-0-state;
		qcom,mdss-dsi-te-pin-select = <1>;
		qcom,mdss-dsi-te-v-sync-rd-ptr-irq-line = <0x2c>;
		qcom,mdss-dsi-te-dcs-command = <1>;
		qcom,mdss-dsi-te-check-enable;
		qcom,mdss-dsi-te-using-te-pin;
		qcom,mdss-dsi-panel-timings = [2d 0e 08 00 2c 30 0c 12 0b 03 04 00];
		qcom,mdss-dsi-t-clk-post = <0x05>;
		qcom,mdss-dsi-t-clk-pre = <0x0f>;
		qcom,mdss-dsi-bl-min-level = <1>;
		qcom,mdss-dsi-bl-max-level = <4095>;
		qcom,mdss-dsi-dma-trigger = "trigger_sw";
		qcom,mdss-dsi-mdp-trigger = "none";
		qcom,mdss-dsi-bl-pmic-control-type = "bl_ctrl_wled";
		qcom,mdss-dsi-reset-sequence = <1 20>, <0 1>, <1 20>;
		qcom,mdss-pan-physical-width-dimension = <26>;
		qcom,mdss-pan-physical-height-dimension = <27>;
	};
};
