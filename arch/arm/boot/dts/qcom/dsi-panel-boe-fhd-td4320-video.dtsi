/* Copyright (c) 2015, The Linux Foundation. All rights reserved.
 * Copyright (C) 2020 XiaoMi, Inc.
 *
 * This program is free software; you can redistribute it and/or modify
 * it under the terms of the GNU General Public License version 2 and
 * only version 2 as published by the Free Software Foundation.
 *
 * This program is distributed in the hope that it will be useful,
 * but WITHOUT ANY WARRANTY; without even the implied warranty of
 * MERCHANTABILITY or FITNESS FOR A PARTICULAR PURPOSE.  See the
 * GNU General Public License for more details.
 */

/*---------------------------------------------------------------------------
 * This file is autogenerated file using gcdb parser. Please do not edit it.
 * Update input XML file to add a new entry or update variable in this file
 * VERSION = "1.0"
 *---------------------------------------------------------------------------
 */
&mdss_mdp {
	dsi_boe_fhd_td4320_video: qcom,mdss_dsi_boe_fhd_td4320_video {
		qcom,mdss-dsi-panel-name = "boe fhd video dsi panel";
		qcom,mdss-dsi-panel-id = <0>;
		qcom,mdss-dsi-panel-model = "BOE FHD TD4320 VIDEO PANEL";
		qcom,mdss-dsi-panel-sleepwrmod = <0>;
		qcom,mdss-dsi-panel-type = "dsi_video_mode";
		qcom,mdss-dsi-panel-framerate = <60>;
		qcom,mdss-dsi-virtual-channel-id = <0>;
		qcom,mdss-dsi-stream = <0>;
		qcom,mdss-dsi-panel-width = <1080>;
		qcom,mdss-dsi-panel-height = <2280>;
		qcom,mdss-dsi-h-front-porch = <92>;
		qcom,mdss-dsi-h-back-porch = <112>;
		qcom,mdss-dsi-h-pulse-width = <20>;
		qcom,mdss-dsi-h-sync-skew = <0>;
		qcom,mdss-dsi-v-back-porch = <60>;
		qcom,mdss-dsi-v-front-porch = <12>;
		qcom,mdss-dsi-v-pulse-width = <4>;
		qcom,mdss-dsi-h-left-border = <0>;
		qcom,mdss-dsi-h-right-border = <0>;
		qcom,mdss-dsi-v-top-border = <0>;
		qcom,mdss-dsi-v-bottom-border = <0>;
		qcom,mdss-dsi-bpp = <24>;
		qcom,mdss-dsi-color-order = "0";
		qcom,mdss-dsi-underflow-color = <0x0>;
		qcom,mdss-dsi-border-color = <0>;
		qcom,mdss-dsi-on-command = [
				15 00 00 00 00 00 02 51 FF
				15 00 00 00 00 00 02 53 24
				15 00 00 00 00 00 02 55 00
				15 00 00 00 00 00 02 B0 04
				15 01 00 00 00 00 02 D6 00
				05 01 00 00 00 00 02 29 00
				05 01 00 00 4B 00 02 11 00
				15 01 00 00 00 00 02 B0 04
				29 00 00 00 00 00 08 B8 23 51 01 BE 00 04 04
				29 00 00 00 00 00 08 B9 67 51 01 E6 00 02 03
				29 01 00 00 00 00 08 BA CD 51 11 E6 00 00 00
				29 01 00 00 00 00 22 CE 5D 40 57 6F 87 9F B7 CF E7 FF FF FF FF FF FF FF FF FF 04 00 04 04 42 00 69 5A 40 40 00 00 04 FA 00
				29 01 00 00 00 00 22 CE 5D 40 4B 57 63 6F 7B 87 93 9F AB B7 C3 CF DB E7 F3 FF 04 00 04 04 42 00 69 5A 40 40 00 00 04 FA 00
				29 01 00 00 00 00 42 CA 1C FC FC FC 00 07 0B 07 00 07 00 00 00 00 00 00 00 07 FD FD 00 DB C8 80 84 C8 80 84 00 00 00 00 00 00 00 00 00 00 00 00 00 00 00 00 00 00 00 00 00 00 00 00 00 00 00 00 00 00 00 00 00 00 00 00 00
				15 01 00 00 00 00 02 B0 03];
		qcom,mdss-dsi-off-command = [
				05 01 00 00 00 00 02 28 00
				05 01 00 00 46 00 02 10 00];
		qcom,mdss-dsi-on-command-state = "dsi_lp_mode";
		qcom,mdss-dsi-off-command-state = "dsi_hs_mode";
		qcom,mdss-dsi-h-sync-pulse = <1>;
		qcom,mdss-dsi-traffic-mode = "burst_mode";
		qcom,mdss-dsi-bllp-eof-power-mode;
		qcom,mdss-dsi-bllp-power-mode;
		qcom,mdss-dsi-lp11-init;
		qcom,mdss-dsi-lane-0-state;
		qcom,mdss-dsi-lane-1-state;
		qcom,mdss-dsi-lane-2-state;
		qcom,mdss-dsi-lane-3-state;
		qcom,mdss-dsi-t-clk-post = <0x0A>;
		qcom,mdss-dsi-t-clk-pre = <0x35>;
		qcom,mdss-dsi-bl-min-level = <1>;
		qcom,mdss-dsi-bl-max-level = <4095>;
		qcom,mdss-brightness-max-level = <4095>;
		qcom,mdss-dsi-dma-trigger = "trigger_sw";
		qcom,mdss-dsi-mdp-trigger = "none";
		qcom,mdss-dsi-bl-pmic-control-type = "bl_ctrl_wled";
		qcom,mdss-dsi-reset-sequence = <1 1>, <0 1>, <1 10>;
		qcom,mdss-dsi-tp-reset-sequence = <1 4>;
		qcom,mdss-pan-physical-width-dimension = <68>;
		qcom,mdss-pan-physical-height-dimension = <144>;
		qcom,mdss-dsi-tx-eot-append;
		qcom,ulps-enabled;
		qcom,esd-err-irq-gpio = <&tlmm 59 0x2001>;
		qcom,esd-check-enabled;
		qcom,dispparam-enabled;
		qcom,mdss-panel-on-dimming-delay = <120>;
		qcom,mdss-dsi-dispparam-dimmingon-command = [
			15 01 00 00 01 00 02 53 2C];
		/* CABC control */
		qcom,mdss-dsi-dispparam-cabcon-command = [
			15 01 00 00 00 00 02 55 01
			29 01 00 00 00 00 02 b0 04
			29 01 00 00 00 00 08 B8 23 51 01 BE 00 04 04 
			29 01 00 00 00 00 22 CE 5D 40 57 6F 87 9F B7 CF E7 FF FF FF FF FF FF FF FF FF 04 00 04 04 42 00 69 5A 40 40 00 00 04 FA 00
			29 01 00 00 00 00 02 b0 03
		];
		qcom,mdss-dsi-dispparam-cabcon-command-state = "dsi_hs_mode";
		qcom,mdss-dsi-dispparam-cabcstillon-command = [
			15 01 00 00 00 00 02 55 03
			29 01 00 00 00 00 02 b0 04
			29 01 00 00 00 00 08 BA CD 51 11 E6 00 00 00
			29 01 00 00 00 00 22 CE 5D 40 4B 57 63 6F 7B 87 93 9F AB B7 C3 CF DB E7 F3 FF 04 00 04 04 42 00 69 5A 40 40 00 00 04 FA 00
			29 01 00 00 00 00 02 b0 03
		];
		qcom,mdss-dsi-dispparam-cabcstillon-command-state = "dsi_hs_mode";
		qcom,mdss-dsi-dispparam-cabcmovieon-command = [
			15 01 00 00 00 00 02 55 02
			29 01 00 00 00 00 02 b0 04
			29 01 00 00 00 00 08 B9 67 51 01 E6 00 04 04
			29 01 00 00 00 00 22 CE 5D 40 57 6F 87 9F B7 CF E7 FF FF FF FF FF FF FF FF FF 04 00 04 04 42 00 69 5A 40 40 00 00 04 FA 00
			29 01 00 00 00 00 02 b0 03
		];
		qcom,mdss-dsi-dispparam-cabcmovieon-command-state = "dsi_hs_mode";
		qcom,mdss-dsi-dispparam-cabcoff-command = [
			15 01 00 00 00 00 02 55 00
		];
		qcom,mdss-dsi-dispparam-cabcoff-command-state = "dsi_hs_mode";
		qcom,mdss-dsi-dispparam-skince-cabcuion-command = [
			15 01 00 00 00 00 02 55 81
			29 01 00 00 00 00 02 b0 04
			29 01 00 00 00 00 08 B8 23 51 01 BE 00 04 04 
			29 01 00 00 00 00 22 CE 5D 40 57 6F 87 9F B7 CF E7 FF FF FF FF FF FF FF FF FF 04 00 04 04 42 00 69 5A 40 40 00 00 04 FA 00
			29 01 00 00 00 00 02 b0 03
		];
		qcom,mdss-dsi-dispparam-skince-cabcuion-command-state = "dsi_hs_mode";
		qcom,mdss-dsi-dispparam-skince-cabcstillon-command = [
			15 01 00 00 00 00 02 55 83
			29 01 00 00 00 00 02 b0 04
			29 01 00 00 00 00 08 BA CD 51 11 E6 00 00 00
			29 01 00 00 00 00 22 CE 5D 40 4B 57 63 6F 7B 87 93 9F AB B7 C3 CF DB E7 F3 FF 04 00 04 04 42 00 69 5A 40 40 00 00 04 FA 00
			29 01 00 00 00 00 02 b0 03
		];
		qcom,mdss-dsi-dispparam-skince-cabcstillon-command-state = "dsi_hs_mode";
		qcom,mdss-dsi-dispparam-skince-cabcmovieon-command = [
			15 01 00 00 00 00 02 55 82
			29 01 00 00 00 00 02 b0 04
			29 01 00 00 00 00 08 B9 67 51 01 E6 00 04 04
			29 01 00 00 00 00 22 CE 5D 40 57 6F 87 9F B7 CF E7 FF FF FF FF FF FF FF FF FF 04 00 04 04 42 00 69 5A 40 40 00 00 04 FA 00
			29 01 00 00 00 00 02 b0 03
		];
		qcom,mdss-dsi-dispparam-skince-cabcmovieon-command-state = "dsi_hs_mode";
		qcom,mdss-dsi-dispparam-skince-cabcoff-command = [
			15 01 00 00 00 00 02 55 00
		];
		qcom,mdss-dsi-dispparam-skince-cabcoff-command-state = "dsi_hs_mode";
		qcom,mdss-dsi-dispparam-skin-ce-command = [
			15 01 00 00 00 00 02 CA 1D];
		qcom,mdss-dsi-dispparam-skin-ce-off-command = [
			15 01 00 00 00 00 02 CA 1C];
	};
};
