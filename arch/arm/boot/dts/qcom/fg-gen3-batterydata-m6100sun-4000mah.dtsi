
qcom,m6100sun_4000mah {
	qcom, = <24>;
	/* #3995578_LC_M6100_Sunwoda_4000mAH_PM660_averaged_MasterSlave_May6th2019*/
	qcom,max-voltage-uv = <4400000>;
	qcom,fastchg-current-ma = <2900>;
	qcom,fg-cc-cv-threshold-mv = <4390>;
	qcom,nom-batt-capacity-mah = <4000>;
	qcom,batt-id-kohm = <330>;
	qcom,battery-beta = <4250>;
	qcom,battery-full-design = <4000>;
	qcom,battery-type = "3995578_lc_m6100_sunwoda_4000mah_pm660_averaged_masterslave_may6th2019";
	qcom,checksum = <0x01FE>;
	qcom,gui-version = "PM660GUI - 0.0.0.45";
	qcom,fg-profile-data = [
		 AA 20 68 04
		 4C 0B 9B 05
		 F3 1C 43 FB
		 CB 04 BB 03
		 53 17 19 2A
		 06 44 91 5A
		 88 00 00 00
		 10 00 00 00
		 00 00 36 C5
		 A2 CD BE C2
		 19 00 08 00
		 9B E3 1C ED
		 8D 06 3B F3
		 91 FD 2E 0B
		 13 07 54 32
		 21 06 09 20
		 27 00 14 00
		 0D 20 28 05
		 D4 0A F6 05
		 BE 1C 11 03
		 E5 15 49 12
		 7C 18 D8 23
		 E6 4D 2F 5B
		 6B 00 00 00
		 0E 00 00 00
		 00 00 DC D5
		 10 CA 6B B4
		 16 00 00 00
		 FD EB 1C ED
		 2A F4 71 EB
		 15 E5 CF 02
		 19 FB 23 1A
		 B1 33 CC FF
		 07 10 00 00
		 C6 0F 66 46
		 16 00 40 00
		 80 01 0A FA
		 FF 00 00 00
		 00 00 00 00
		 00 00 00 00
		 00 00 00 00
		 00 00 00 00
		 00 00 00 00
		 00 00 00 00
		 00 00 00 00
		 00 00 00 00
		 00 00 00 00
		 00 00 00 00
		 00 00 00 00
		 00 00 00 00
		 00 00 00 00
		 00 00 00 00
		 00 00 00 00
		 00 00 00 00
		 00 00 00 00
		 00 00 00 00
	];
};
