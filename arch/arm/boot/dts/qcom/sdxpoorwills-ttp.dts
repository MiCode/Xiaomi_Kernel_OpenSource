/* Copyright (c) 2017-2018, The Linux Foundation. All rights reserved.
 *
 * This program is free software; you can redistribute it and/or modify
 * it under the terms of the GNU General Public License version 2 and
 * only version 2 as published by the Free Software Foundation.
 *
 * This program is distributed in the hope that it will be useful,
 * but WITHOUT ANY WARRANTY; without even the implied warranty of
 * MERCHANTABILITY or FITNESS FOR A PARTICULAR PURPOSE.  See the
 * GNU General Public License for more details.
 */

/dts-v1/;

#include "sdxpoorwills-ttp.dtsi"

/ {
	model = "Qualcomm Technologies, Inc. SDXPOORWILLS TTP";
	compatible = "qcom,sdxpoorwills-ttp",
		"qcom,sdxpoorwills", "qcom,ttp";
	qcom,board-id = <30 0x100>;
};

&blsp1_uart2b_hs {
	status = "okay";
};
