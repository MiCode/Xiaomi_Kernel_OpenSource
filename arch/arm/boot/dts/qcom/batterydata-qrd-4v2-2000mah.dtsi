/* Copyright (c) 2013, The Linux Foundation. All rights reserved.
 *
 * This program is free software; you can redistribute it and/or modify
 * it under the terms of the GNU General Public License version 2 and
 * only version 2 as published by the Free Software Foundation.
 *
 * This program is distributed in the hope that it will be useful,
 * but WITHOUT ANY WARRANTY; without even the implied warranty of
 * MERCHANTABILITY or FITNESS FOR A PARTICULAR PURPOSE.  See the
 * GNU General Public License for more details.
 */

qcom,qrd-4v2-2000mah-data {
	qcom,fcc-mah = <2000>;
	qcom,default-rbatt-mohm = <138>;
	qcom,rbatt-capacitive-mohm = <0>;
	qcom,flat-ocv-threshold-uv = <3800000>;
	qcom,max-voltage-uv = <4200000>;
	qcom,v-cutoff-uv = <3400000>;
	qcom,chg-term-ua = <100000>;
	qcom,batt-id-kohm = <130 115>;
	qcom,battery-type = "qrd_4v2_2000mah";

	qcom,rbatt-sf-lut {
		qcom,lut-col-legend = <(-20) 0 25 40 60>;
		qcom,lut-row-legend = <100 95 90 85 80>,
				<75 70 65 60 55>,
				<50 45 40 35 30>,
				<25 20 15 10 9>,
				<8 7 6 5 4>,
				<3 2 1 0>;
		qcom,lut-data = <1191 250 100 78 69>,
				<1192 250 100 78 69>,
				<1242 263 102 80 70>,
				<1192 277 105 81 71>,
				<1202 294 108 83 72>,
				<1205 308 113 86 73>,
				<1234 313 118 90 76>,
				<1255 294 131 96 80>,
				<1284 276 139 103 84>,
				<1321 271 115 89 74>,
				<1363 273 104 81 72>,
				<1400 283 103 79 71>,
				<1404 295 105 81 71>,
				<1428 313 108 84 73>,
				<1489 341 112 87 74>,
				<1615 374 115 84 73>,
				<1813 404 117 85 73>,
				<2121 387 127 89 76>,
				<2310 366 115 88 77>,
				<2543 386 116 89 77>,
				<2879 415 118 92 78>,
				<3633 457 122 93 78>,
				<5901 507 128 94 79>,
				<9939 561 131 93 79>,
				<16631 634 129 94 78>,
				<26968 794 134 97 81>,
				<42610 1203 145 102 85>,
				<64024 2628 174 115 94>,
				<115224 17430 577 620 4155>;
	};

	qcom,fcc-temp-lut {
		qcom,lut-col-legend = <(-20) 0 25 40 60>;
		qcom,lut-data = <2024 2033 2035 2031 2027>;
	};

	qcom,pc-temp-ocv-lut {
		qcom,lut-col-legend = <(-20) 0 25 40 60>;
		qcom,lut-row-legend = <100 95 90 85 80>,
				<75 70 65 60 55>,
				<50 45 40 35 30>,
				<25 20 15 10 9>,
				<8 7 6 5 4>,
				<3 2 1 0>;
		qcom,lut-data = <4179 4177 4173 4170 4164>,
				<4097 4107 4108 4106 4104>,
				<4040 4060 4059 4057 4054>,
				<3974 4007 4012 4012 4009>,
				<3929 3968 3972 3972 3969>,
				<3889 3933 3937 3935 3933>,
				<3852 3896 3905 3904 3900>,
				<3822 3859 3876 3875 3872>,
				<3797 3827 3846 3847 3844>,
				<3777 3803 3809 3809 3806>,
				<3758 3787 3788 3786 3784>,
				<3740 3779 3777 3774 3771>,
				<3717 3774 3771 3768 3763>,
				<3685 3767 3767 3764 3758>,
				<3649 3757 3761 3756 3749>,
				<3613 3734 3747 3738 3724>,
				<3578 3689 3711 3706 3694>,
				<3538 3615 3649 3648 3643>,
				<3483 3543 3564 3568 3567>,
				<3470 3533 3553 3556 3556>,
				<3453 3522 3542 3545 3545>,
				<3434 3509 3531 3534 3533>,
				<3414 3492 3519 3521 3519>,
				<3388 3467 3498 3499 3492>,
				<3358 3428 3457 3459 3447>,
				<3321 3374 3397 3400 3387>,
				<3268 3300 3318 3323 3307>,
				<3182 3188 3207 3213 3191>,
				<3000 3000 3000 3000 3000>;
	};
};
