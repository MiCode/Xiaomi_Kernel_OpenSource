/* Copyright (c) 2015, The Linux Foundation. All rights reserved.
 * Copyright (C) 2018 XiaoMi, Inc.
 *
 * This program is free software; you can redistribute it and/or modify
 * it under the terms of the GNU General Public License version 2 and
 * only version 2 as published by the Free Software Foundation.
 *
 * This program is distributed in the hope that it will be useful,
 * but WITHOUT ANY WARRANTY; without even the implied warranty of
 * MERCHANTABILITY or FITNESS FOR A PARTICULAR PURPOSE.  See the
 * GNU General Public License for more details.
 */

/*---------------------------------------------------------------------------
 * This file is autogenerated file using gcdb parser. Please do not edit it.
 * Update input XML file to add a new entry or update variable in this file
 * VERSION = "1.0"
 *---------------------------------------------------------------------------*/
&soc {
	dsi_sharp_fhd_nt35695_cmd: qcom,mdss_dsi_sharp_fhd_nt35695_cmd {
		qcom,mdss-dsi-panel-name = "sharp fhd cmd incell dsi panel";
		qcom,mdss-dsi-panel-id = <2>;
		qcom,mdss-dsi-panel-model = "SHARP FHD NT35695 CMD PANEL";
		qcom,mdss-dsi-panel-sleepwrmod = <0>;
		qcom,mdss-dsi-panel-type = "dsi_cmd_mode";
		qcom,mdss-dsi-panel-framerate = <60>;
		qcom,mdss-dsi-virtual-channel-id = <0>;
		qcom,mdss-dsi-stream = <0>;
		qcom,mdss-dsi-panel-width = <1080>;
		qcom,mdss-dsi-panel-height = <1920>;
		qcom,mdss-dsi-h-front-porch = <80>;
		qcom,mdss-dsi-h-back-porch = <40>;
		qcom,mdss-dsi-h-pulse-width = <10>;
		qcom,mdss-dsi-h-sync-skew = <0>;
		qcom,mdss-dsi-v-back-porch = <4>;
		qcom,mdss-dsi-v-front-porch = <4>;
		qcom,mdss-dsi-v-pulse-width = <2>;
		qcom,mdss-dsi-h-left-border = <0>;
		qcom,mdss-dsi-h-right-border = <0>;
		qcom,mdss-dsi-v-top-border = <0>;
		qcom,mdss-dsi-v-bottom-border = <0>;
		qcom,mdss-dsi-bpp = <24>;
		qcom,mdss-dsi-color-order = <0>;
		qcom,mdss-dsi-underflow-color = <0xff>;
		qcom,mdss-dsi-border-color = <0>;
		qcom,mdss-dsi-on-command = [
				15 01 00 00 00 00 02 FF 22
				15 00 00 00 00 00 02 FB 01
				15 00 00 00 00 00 02 FA 00
				15 01 00 00 00 00 02 FF 10
				15 00 00 00 00 00 02 FB 01
				15 00 00 00 00 00 02 BA 03
				15 00 00 00 00 00 02 B0 03
				15 00 00 00 00 00 02 35 00
				39 00 00 00 00 00 06 3B 03 06 0A 98 B4
				39 00 00 00 00 00 05 2A 00 00 04 37
				39 00 00 00 00 00 05 2B 00 00 07 7F
				15 00 00 00 00 00 02 BB 10
				15 00 00 00 00 00 02 51 FF
				15 00 00 00 00 00 02 53 24
				15 01 00 00 00 00 02 55 00
				05 01 00 00 78 00 02 11 00
				05 01 00 00 14 00 02 29 00];
		qcom,mdss-dsi-off-command = [
				15 01 00 00 00 00 02 FF 10
				05 01 00 00 02 00 02 28 00
				05 01 00 00 78 00 02 10 00];
		qcom,mdss-dsi-displayoff-command = [05 01 00 00 20 00 02 28 00];
		qcom,mdss-dsi-displayon-command = [05 01 00 00 20 00 02 29 00];
		qcom,mdss-dsi-on-command-state = "dsi_lp_mode";
		qcom,mdss-dsi-off-command-state = "dsi_hs_mode";
		qcom,mdss-dsi-displayoff-command-state = "dsi_hs_mode";
		qcom,mdss-dsi-displayon-command-state = "dsi_hs_mode";
		qcom,mdss-dsi-h-sync-pulse = <0>;
		qcom,mdss-dsi-traffic-mode = "burst_mode";
		qcom,mdss-dsi-bllp-eof-power-mode;
		qcom,mdss-dsi-bllp-power-mode;
		qcom,mdss-dsi-lp11-init;
		qcom,mdss-dsi-lane-0-state;
		qcom,mdss-dsi-lane-1-state;
		qcom,mdss-dsi-lane-2-state;
		qcom,mdss-dsi-lane-3-state;
		qcom,mdss-dsi-panel-timings = [e3 50 36 00 a9 a3 3a 50 3d 03 04 00];
		qcom,mdss-dsi-t-clk-post = <0x20>;
		qcom,mdss-dsi-t-clk-pre = <0x36>;
		qcom,mdss-dsi-bl-min-level = <1>;
		qcom,mdss-dsi-bl-max-level = <4095>;
		qcom,mdss-brightness-max-level = <4095>;
		qcom,mdss-dsi-dma-trigger = "trigger_sw";
		qcom,mdss-dsi-mdp-trigger = "none";
		qcom,mdss-dsi-bl-pmic-control-type = "bl_ctrl_wled";
		qcom,mdss-dsi-reset-sequence = <1 10>, <0 1>, <1 10>;
		qcom,mdss-pan-physical-width-dimension = <64>;
		qcom,mdss-pan-physical-height-dimension = <114>;
		qcom,mdss-dsi-te-pin-select = <1>;
		qcom,mdss-dsi-wr-mem-start = <0x2c>;
		qcom,mdss-dsi-wr-mem-continue = <0x3c>;
		qcom,mdss-dsi-te-dcs-command = <1>;
		qcom,mdss-dsi-te-check-enable;
		qcom,mdss-dsi-te-using-te-pin;
		qcom,mdss-night-brightness = <7 25 43 61>;
		qcom,mdss-panel-on-dimming-delay = <120>;
		qcom,panel-identify-read-command = [06 01 00 00 01 00 02 F4 00];
		qcom,panel-identify-code = <0xF5>;
		qcom,dispparam-enabled;
		qcom,mdss-dsi-dispparam-cabcon-command = [
				15 01 00 00 01 00 02 FF 23
				15 00 00 00 01 00 02 FB 01
				15 00 00 00 01 00 02 09 02
				15 00 00 00 01 00 02 0a 03
				15 00 00 00 01 00 02 0B 05
				15 00 00 00 01 00 02 0C 05
				15 00 00 00 01 00 02 0D 06
				15 00 00 00 01 00 02 0E 08
				15 00 00 00 01 00 02 0F 08
				15 00 00 00 01 00 02 10 09
				15 00 00 00 01 00 02 11 0A
				15 00 00 00 01 00 02 12 0A
				15 00 00 00 01 00 02 32 02
				15 00 00 00 01 00 02 33 08
				15 00 00 00 01 00 02 17 F3
				15 00 00 00 01 00 02 18 E2
				15 00 00 00 01 00 02 19 D2
				15 00 00 00 01 00 02 1A C1
				15 00 00 00 01 00 02 1B B1
				15 00 00 00 01 00 02 1C A3
				15 00 00 00 01 00 02 1D 87
				15 00 00 00 01 00 02 1E 87
				15 00 00 00 01 00 02 1F 87
				15 00 00 00 01 00 02 20 66
				15 01 00 00 01 00 02 FF 10
				15 00 00 00 01 00 02 51 FF
				15 01 00 00 01 00 02 55 02
				];
		qcom,mdss-dsi-dispparam-cabcguion-command = [
				15 00 00 00 01 00 02 FF 10
				15 01 00 00 01 00 02 55 01
				];
		qcom,mdss-dsi-dispparam-cabcstillon-command = [
				15 00 00 00 01 00 02 FF 10
				15 01 00 00 01 00 02 55 02
				];
		qcom,mdss-dsi-dispparam-cabcmovieon-command = [
				15 00 00 00 01 00 02 FF 10
				15 01 00 00 01 00 02 55 03
				];
		qcom,mdss-dsi-dispparam-cabcoff-command = [
				15 00 00 00 01 00 02 FF 10
				15 01 00 00 01 00 02 55 00
				];
		qcom,mdss-dsi-dispparam-dimmingon-command = [
				15 01 00 00 01 00 02 53 2C
				];
		qcom,mdss-dsi-dispparam-idleon-command = [
				15 00 00 00 01 00 02 FF 10
				05 01 00 00 01 00 02 39 00
				];
		qcom,mdss-dsi-dispparam-idleoff-command = [
				15 00 00 00 01 00 02 FF 10
				05 01 00 00 01 00 02 38 00
				];
		qcom,mdss-dsi-dispparam-warm-command = [
				15 01 00 00 01 00 02 FF 22
				15 00 00 00 01 00 02 FB 01
				15 00 00 00 01 00 02 FA 00
				15 01 00 00 01 00 02 FF 20
				15 00 00 00 01 00 02 FB 01
				15 00 00 00 01 00 02 75 00
				15 00 00 00 01 00 02 76 1D
				15 00 00 00 01 00 02 77 00
				15 00 00 00 01 00 02 78 3B
				15 00 00 00 01 00 02 79 00
				15 00 00 00 01 00 02 7A 68
				15 00 00 00 01 00 02 7B 00
				15 00 00 00 01 00 02 7C 8B
				15 00 00 00 01 00 02 7D 00
				15 00 00 00 01 00 02 7E A7
				15 00 00 00 01 00 02 7F 00
				15 00 00 00 01 00 02 80 BE
				15 00 00 00 01 00 02 81 00
				15 00 00 00 01 00 02 82 D2
				15 00 00 00 01 00 02 83 00
				15 00 00 00 01 00 02 84 E5
				15 00 00 00 01 00 02 85 00
				15 00 00 00 01 00 02 86 F5
				15 00 00 00 01 00 02 87 01
				15 00 00 00 01 00 02 88 29
				15 00 00 00 01 00 02 89 01
				15 00 00 00 01 00 02 8A 52
				15 00 00 00 01 00 02 8B 01
				15 00 00 00 01 00 02 8C 8E
				15 00 00 00 01 00 02 8D 01
				15 00 00 00 01 00 02 8E B9
				15 00 00 00 01 00 02 8F 01
				15 00 00 00 01 00 02 90 FC
				15 00 00 00 01 00 02 91 02
				15 00 00 00 01 00 02 92 31
				15 00 00 00 01 00 02 93 02
				15 00 00 00 01 00 02 94 33
				15 00 00 00 01 00 02 95 02
				15 00 00 00 01 00 02 96 65
				15 00 00 00 01 00 02 97 02
				15 00 00 00 01 00 02 98 AB
				15 00 00 00 01 00 02 99 02
				15 00 00 00 01 00 02 9A D7
				15 00 00 00 01 00 02 9B 03
				15 00 00 00 01 00 02 9C 0F
				15 00 00 00 01 00 02 9D 03
				15 00 00 00 01 00 02 9E 2E
				15 00 00 00 01 00 02 9F 03
				15 00 00 00 01 00 02 A0 59
				15 00 00 00 01 00 02 A2 03
				15 00 00 00 01 00 02 A3 64
				15 00 00 00 01 00 02 A4 03
				15 00 00 00 01 00 02 A5 72
				15 00 00 00 01 00 02 A6 03
				15 00 00 00 01 00 02 A7 81
				15 00 00 00 01 00 02 A9 03
				15 00 00 00 01 00 02 AA 92
				15 00 00 00 01 00 02 AB 03
				15 00 00 00 01 00 02 AC A4
				15 00 00 00 01 00 02 AD 03
				15 00 00 00 01 00 02 AE BC
				15 00 00 00 01 00 02 AF 03
				15 00 00 00 01 00 02 B0 D3
				15 00 00 00 01 00 02 B1 03
				15 00 00 00 01 00 02 B2 D8
				15 00 00 00 01 00 02 B3 00
				15 00 00 00 01 00 02 B4 57
				15 00 00 00 01 00 02 B5 00
				15 00 00 00 01 00 02 B6 75
				15 00 00 00 01 00 02 B7 00
				15 00 00 00 01 00 02 B8 A2
				15 00 00 00 01 00 02 B9 00
				15 00 00 00 01 00 02 BA C5
				15 00 00 00 01 00 02 BB 00
				15 00 00 00 01 00 02 BC E1
				15 00 00 00 01 00 02 BD 00
				15 00 00 00 01 00 02 BE F9
				15 00 00 00 01 00 02 BF 01
				15 00 00 00 01 00 02 C0 0C
				15 00 00 00 01 00 02 C1 01
				15 00 00 00 01 00 02 C2 1F
				15 00 00 00 01 00 02 C3 01
				15 00 00 00 01 00 02 C4 2F
				15 00 00 00 01 00 02 C5 01
				15 00 00 00 01 00 02 C6 64
				15 00 00 00 01 00 02 C7 01
				15 00 00 00 01 00 02 C8 8D
				15 00 00 00 01 00 02 C9 01
				15 00 00 00 01 00 02 CA C8
				15 00 00 00 01 00 02 CB 01
				15 00 00 00 01 00 02 CC F4
				15 00 00 00 01 00 02 CD 02
				15 00 00 00 01 00 02 CE 37
				15 00 00 00 01 00 02 CF 02
				15 00 00 00 01 00 02 D0 6C
				15 00 00 00 01 00 02 D1 02
				15 00 00 00 01 00 02 D2 6E
				15 00 00 00 01 00 02 D3 02
				15 00 00 00 01 00 02 D4 A0
				15 00 00 00 01 00 02 D5 02
				15 00 00 00 01 00 02 D6 D1
				15 00 00 00 01 00 02 D7 02
				15 00 00 00 01 00 02 D8 EE
				15 00 00 00 01 00 02 D9 03
				15 00 00 00 01 00 02 DA 15
				15 00 00 00 01 00 02 DB 03
				15 00 00 00 01 00 02 DC 33
				15 00 00 00 01 00 02 DD 03
				15 00 00 00 01 00 02 DE 5C
				15 00 00 00 01 00 02 DF 03
				15 00 00 00 01 00 02 E0 67
			15 00 00 00 01 00 02 E1 03
			15 00 00 00 01 00 02 E2 74
			15 00 00 00 01 00 02 E3 03
			15 00 00 00 01 00 02 E4 83
			15 00 00 00 01 00 02 E5 03
			15 00 00 00 01 00 02 E6 94
			15 00 00 00 01 00 02 E7 03
			15 00 00 00 01 00 02 E8 A5
			15 00 00 00 01 00 02 E9 03
			15 00 00 00 01 00 02 EA BD
			15 00 00 00 01 00 02 EB 03
			15 00 00 00 01 00 02 EC D3
			15 00 00 00 01 00 02 ED 03
			15 00 00 00 01 00 02 EE D8
			15 00 00 00 01 00 02 EF 01
			15 00 00 00 01 00 02 F0 1A
			15 00 00 00 01 00 02 F1 01
			15 00 00 00 01 00 02 F2 1F
			15 00 00 00 01 00 02 F3 01
			15 00 00 00 01 00 02 F4 2B
			15 00 00 00 01 00 02 F5 01
			15 00 00 00 01 00 02 F6 35
			15 00 00 00 01 00 02 F7 01
			15 00 00 00 01 00 02 F8 40
			15 00 00 00 01 00 02 F9 01
			15 00 00 00 01 00 02 FA 48
			15 01 00 00 01 00 02 FF 21
			15 00 00 00 01 00 02 FB 01
			15 00 00 00 01 00 02 00 01
			15 00 00 00 01 00 02 01 50
			15 00 00 00 01 00 02 02 01
			15 00 00 00 01 00 02 03 58
			15 00 00 00 01 00 02 04 01
			15 00 00 00 01 00 02 05 5F
			15 00 00 00 01 00 02 06 01
			15 00 00 00 01 00 02 07 7B
			15 00 00 00 01 00 02 08 01
			15 00 00 00 01 00 02 09 92
			15 00 00 00 01 00 02 0A 01
			15 00 00 00 01 00 02 0B B9
			15 00 00 00 01 00 02 0C 01
			15 00 00 00 01 00 02 0D D8
			15 00 00 00 01 00 02 0E 02
			15 00 00 00 01 00 02 0F 0D
			15 00 00 00 01 00 02 10 02
			15 00 00 00 01 00 02 11 3B
			15 00 00 00 01 00 02 12 02
			15 00 00 00 01 00 02 13 3C
			15 00 00 00 01 00 02 14 02
			15 00 00 00 01 00 02 15 6D
				15 00 00 00 01 00 02 16 02
				15 00 00 00 01 00 02 17 B0
				15 00 00 00 01 00 02 18 02
				15 00 00 00 01 00 02 19 DB
				15 00 00 00 01 00 02 1A 03
				15 00 00 00 01 00 02 1B 12
				15 00 00 00 01 00 02 1C 03
				15 00 00 00 01 00 02 1D 31
				15 00 00 00 01 00 02 1E 03
				15 00 00 00 01 00 02 1F 5B
				15 00 00 00 01 00 02 20 03
				15 00 00 00 01 00 02 21 66
				15 00 00 00 01 00 02 22 03
				15 00 00 00 01 00 02 23 74
				15 00 00 00 01 00 02 24 03
				15 00 00 00 01 00 02 25 82
				15 00 00 00 01 00 02 26 03
				15 00 00 00 01 00 02 27 92
				15 00 00 00 01 00 02 28 03
				15 00 00 00 01 00 02 29 A5
				15 00 00 00 01 00 02 2A 03
				15 00 00 00 01 00 02 2B BC
				15 00 00 00 01 00 02 2D 03
				15 00 00 00 01 00 02 2F D3
				15 00 00 00 01 00 02 30 03
				15 00 00 00 01 00 02 31 D8
				15 00 00 00 01 00 02 32 01
				15 00 00 00 01 00 02 33 35
				15 00 00 00 01 00 02 34 01
				15 00 00 00 01 00 02 35 3B
				15 00 00 00 01 00 02 36 01
				15 00 00 00 01 00 02 37 47
				15 00 00 00 01 00 02 38 01
				15 00 00 00 01 00 02 39 53
				15 00 00 00 01 00 02 3A 01
				15 00 00 00 01 00 02 3B 5E
				15 00 00 00 01 00 02 3D 01
				15 00 00 00 01 00 02 3F 67
				15 00 00 00 01 00 02 40 01
				15 00 00 00 01 00 02 41 6F
				15 00 00 00 01 00 02 42 01
				15 00 00 00 01 00 02 43 78
				15 00 00 00 01 00 02 44 01
				15 00 00 00 01 00 02 45 80
				15 00 00 00 01 00 02 46 01
				15 00 00 00 01 00 02 47 9F
				15 00 00 00 01 00 02 48 01
				15 00 00 00 01 00 02 49 B9
				15 00 00 00 01 00 02 4A 01
				15 00 00 00 01 00 02 4B E6
				15 00 00 00 01 00 02 4C 02
				15 00 00 00 01 00 02 4D 0B
				15 00 00 00 01 00 02 4E 02
				15 00 00 00 01 00 02 4F 48
				15 00 00 00 01 00 02 50 02
				15 00 00 00 01 00 02 51 76
				15 00 00 00 01 00 02 52 02
				15 00 00 00 01 00 02 53 78
				15 00 00 00 01 00 02 54 02
				15 00 00 00 01 00 02 55 A8
				15 00 00 00 01 00 02 56 02
				15 00 00 00 01 00 02 58 D7
				15 00 00 00 01 00 02 59 02
				15 00 00 00 01 00 02 5A F2
				15 00 00 00 01 00 02 5B 03
				15 00 00 00 01 00 02 5C 19
				15 00 00 00 01 00 02 5D 03
				15 00 00 00 01 00 02 5E 36
				15 00 00 00 01 00 02 5F 03
				15 00 00 00 01 00 02 60 5E
				15 00 00 00 01 00 02 61 03
				15 00 00 00 01 00 02 62 69
				15 00 00 00 01 00 02 63 03
				15 00 00 00 01 00 02 64 76
				15 00 00 00 01 00 02 65 03
				15 00 00 00 01 00 02 66 84
				15 00 00 00 01 00 02 67 03
				15 00 00 00 01 00 02 68 93
				15 00 00 00 01 00 02 69 03
				15 00 00 00 01 00 02 6A A6
				15 00 00 00 01 00 02 6B 03
				15 00 00 00 01 00 02 6C BD
				15 00 00 00 01 00 02 6D 03
				15 00 00 00 01 00 02 6E D3
				15 00 00 00 01 00 02 6F 03
				15 00 00 00 01 00 02 70 D8
				15 00 00 00 01 00 02 71 01
				15 00 00 00 01 00 02 72 68
				15 00 00 00 01 00 02 73 01
				15 00 00 00 01 00 02 74 6B
				15 00 00 00 01 00 02 75 01
				15 00 00 00 01 00 02 76 72
				15 00 00 00 01 00 02 77 01
				15 00 00 00 01 00 02 78 78
				15 00 00 00 01 00 02 79 01
				15 00 00 00 01 00 02 7A 7F
				15 00 00 00 01 00 02 7B 01
				15 00 00 00 01 00 02 7C 85
				15 00 00 00 01 00 02 7D 01
				15 00 00 00 01 00 02 7E 8B
				15 00 00 00 01 00 02 7F 01
				15 00 00 00 01 00 02 80 8F
				15 00 00 00 01 00 02 81 01
				15 00 00 00 01 00 02 82 94
				15 00 00 00 01 00 02 83 01
				15 00 00 00 01 00 02 84 A7
				15 00 00 00 01 00 02 85 01
				15 00 00 00 01 00 02 86 B8
				15 00 00 00 01 00 02 87 01
				15 00 00 00 01 00 02 88 D6
				15 00 00 00 01 00 02 89 01
				15 00 00 00 01 00 02 8A F1
				15 00 00 00 01 00 02 8B 02
				15 00 00 00 01 00 02 8C 1D
				15 00 00 00 01 00 02 8D 02
				15 00 00 00 01 00 02 8E 48
				15 00 00 00 01 00 02 8F 02
				15 00 00 00 01 00 02 90 4A
				15 00 00 00 01 00 02 91 02
				15 00 00 00 01 00 02 92 7B
				15 00 00 00 01 00 02 93 02
				15 00 00 00 01 00 02 94 BB
				15 00 00 00 01 00 02 95 02
				15 00 00 00 01 00 02 96 E6
				15 00 00 00 01 00 02 97 03
				15 00 00 00 01 00 02 98 1C
				15 00 00 00 01 00 02 99 03
				15 00 00 00 01 00 02 9A 3A
				15 00 00 00 01 00 02 9B 03
				15 00 00 00 01 00 02 9C 63
				15 00 00 00 01 00 02 9D 03
				15 00 00 00 01 00 02 9E 6D
				15 00 00 00 01 00 02 9F 03
				15 00 00 00 01 00 02 A0 7A
				15 00 00 00 01 00 02 A2 03
				15 00 00 00 01 00 02 A3 8A
				15 00 00 00 01 00 02 A4 03
				15 00 00 00 01 00 02 A5 99
				15 00 00 00 01 00 02 A6 03
				15 00 00 00 01 00 02 A7 AB
				15 00 00 00 01 00 02 A9 03
				15 00 00 00 01 00 02 AA C1
				15 00 00 00 01 00 02 AB 03
				15 00 00 00 01 00 02 AC D4
				15 00 00 00 01 00 02 AD 03
				15 00 00 00 01 00 02 AE D8
				15 00 00 00 01 00 02 AF 01
				15 00 00 00 01 00 02 B0 87
				15 00 00 00 01 00 02 B1 01
				15 00 00 00 01 00 02 B2 8B
				15 00 00 00 01 00 02 B3 01
				15 00 00 00 01 00 02 B4 92
				15 00 00 00 01 00 02 B5 01
				15 00 00 00 01 00 02 B6 99
				15 00 00 00 01 00 02 B7 01
				15 00 00 00 01 00 02 B8 A0
				15 00 00 00 01 00 02 B9 01
				15 00 00 00 01 00 02 BA A7
				15 00 00 00 01 00 02 BB 01
				15 00 00 00 01 00 02 BC AE
				15 00 00 00 01 00 02 BD 01
				15 00 00 00 01 00 02 BE B3
				15 00 00 00 01 00 02 BF 01
				15 00 00 00 01 00 02 C0 B8
				15 00 00 00 01 00 02 C1 01
				15 00 00 00 01 00 02 C2 CE
				15 00 00 00 01 00 02 C3 01
				15 00 00 00 01 00 02 C4 E1
				15 00 00 00 01 00 02 C5 02
				15 00 00 00 01 00 02 C6 05
				15 00 00 00 01 00 02 C7 02
				15 00 00 00 01 00 02 C8 25
				15 00 00 00 01 00 02 C9 02
				15 00 00 00 01 00 02 CA 58
				15 00 00 00 01 00 02 CB 02
				15 00 00 00 01 00 02 CC 83
				15 00 00 00 01 00 02 CD 02
				15 00 00 00 01 00 02 CE 85
				15 00 00 00 01 00 02 CF 02
				15 00 00 00 01 00 02 D0 B6
				15 00 00 00 01 00 02 D1 02
				15 00 00 00 01 00 02 D2 E2
				15 00 00 00 01 00 02 D3 02
				15 00 00 00 01 00 02 D4 FD
				15 00 00 00 01 00 02 D5 03
				15 00 00 00 01 00 02 D6 23
				15 00 00 00 01 00 02 D7 03
				15 00 00 00 01 00 02 D8 3F
				15 00 00 00 01 00 02 D9 03
				15 00 00 00 01 00 02 DA 66
				15 00 00 00 01 00 02 DB 03
				15 00 00 00 01 00 02 DC 70
				15 00 00 00 01 00 02 DD 03
				15 00 00 00 01 00 02 DE 7C
				15 00 00 00 01 00 02 DF 03
				15 00 00 00 01 00 02 E0 8C
				15 00 00 00 01 00 02 E1 03
				15 00 00 00 01 00 02 E2 9B
				15 00 00 00 01 00 02 E3 03
				15 00 00 00 01 00 02 E4 AC
				15 00 00 00 01 00 02 E5 03
				15 00 00 00 01 00 02 E6 C1
				15 00 00 00 01 00 02 E7 03
				15 00 00 00 01 00 02 E8 D4
				15 00 00 00 01 00 02 E9 03
				15 00 00 00 01 00 02 EA D8
				15 01 00 00 01 00 02 FF 10
				];
		qcom,mdss-dsi-dispparam-warm-command-state = "dsi_hs_mode";
		qcom,mdss-dsi-dispparam-normal1-command = [
				15 01 00 00 01 00 02 FF 22
				15 00 00 00 01 00 02 FB 01
				15 00 00 00 01 00 02 FA 00
				15 01 00 00 01 00 02 FF 20
				15 00 00 00 01 00 02 FB 01
				15 00 00 00 01 00 02 75 00
				15 00 00 00 01 00 02 76 1D
				15 00 00 00 01 00 02 77 00
				15 00 00 00 01 00 02 78 3A
				15 00 00 00 01 00 02 79 00
				15 00 00 00 01 00 02 7A 67
				15 00 00 00 01 00 02 7B 00
				15 00 00 00 01 00 02 7C 8A
				15 00 00 00 01 00 02 7D 00
				15 00 00 00 01 00 02 7E A6
				15 00 00 00 01 00 02 7F 00
				15 00 00 00 01 00 02 80 BD
				15 00 00 00 01 00 02 81 00
				15 00 00 00 01 00 02 82 D2
				15 00 00 00 01 00 02 83 00
				15 00 00 00 01 00 02 84 E4
				15 00 00 00 01 00 02 85 00
				15 00 00 00 01 00 02 86 F4
				15 00 00 00 01 00 02 87 01
				15 00 00 00 01 00 02 88 28
				15 00 00 00 01 00 02 89 01
				15 00 00 00 01 00 02 8A 52
				15 00 00 00 01 00 02 8B 01
				15 00 00 00 01 00 02 8C 8E
				15 00 00 00 01 00 02 8D 01
				15 00 00 00 01 00 02 8E BA
				15 00 00 00 01 00 02 8F 01
				15 00 00 00 01 00 02 90 FC
				15 00 00 00 01 00 02 91 02
				15 00 00 00 01 00 02 92 31
				15 00 00 00 01 00 02 93 02
				15 00 00 00 01 00 02 94 33
				15 00 00 00 01 00 02 95 02
				15 00 00 00 01 00 02 96 65
				15 00 00 00 01 00 02 97 02
				15 00 00 00 01 00 02 98 AA
				15 00 00 00 01 00 02 99 02
				15 00 00 00 01 00 02 9A D7
				15 00 00 00 01 00 02 9B 03
				15 00 00 00 01 00 02 9C 0E
				15 00 00 00 01 00 02 9D 03
				15 00 00 00 01 00 02 9E 2E
				15 00 00 00 01 00 02 9F 03
				15 00 00 00 01 00 02 A0 58
				15 00 00 00 01 00 02 A2 03
				15 00 00 00 01 00 02 A3 64
				15 00 00 00 01 00 02 A4 03
				15 00 00 00 01 00 02 A5 71
				15 00 00 00 01 00 02 A6 03
				15 00 00 00 01 00 02 A7 81
				15 00 00 00 01 00 02 A9 03
				15 00 00 00 01 00 02 AA 92
				15 00 00 00 01 00 02 AB 03
				15 00 00 00 01 00 02 AC A4
				15 00 00 00 01 00 02 AD 03
				15 00 00 00 01 00 02 AE BB
				15 00 00 00 01 00 02 AF 03
				15 00 00 00 01 00 02 B0 D2
				15 00 00 00 01 00 02 B1 03
				15 00 00 00 01 00 02 B2 D8
				15 00 00 00 01 00 02 B3 00
				15 00 00 00 01 00 02 B4 57
				15 00 00 00 01 00 02 B5 00
				15 00 00 00 01 00 02 B6 75
				15 00 00 00 01 00 02 B7 00
				15 00 00 00 01 00 02 B8 A1
				15 00 00 00 01 00 02 B9 00
				15 00 00 00 01 00 02 BA C5
				15 00 00 00 01 00 02 BB 00
				15 00 00 00 01 00 02 BC E0
				15 00 00 00 01 00 02 BD 00
				15 00 00 00 01 00 02 BE F8
				15 00 00 00 01 00 02 BF 01
				15 00 00 00 01 00 02 C0 0C
				15 00 00 00 01 00 02 C1 01
				15 00 00 00 01 00 02 C2 1F
				15 00 00 00 01 00 02 C3 01
				15 00 00 00 01 00 02 C4 2E
				15 00 00 00 01 00 02 C5 01
				15 00 00 00 01 00 02 C6 62
				15 00 00 00 01 00 02 C7 01
				15 00 00 00 01 00 02 C8 8D
				15 00 00 00 01 00 02 C9 01
				15 00 00 00 01 00 02 CA C9
				15 00 00 00 01 00 02 CB 01
				15 00 00 00 01 00 02 CC F5
				15 00 00 00 01 00 02 CD 02
				15 00 00 00 01 00 02 CE 37
				15 00 00 00 01 00 02 CF 02
				15 00 00 00 01 00 02 D0 6C
				15 00 00 00 01 00 02 D1 02
				15 00 00 00 01 00 02 D2 6E
				15 00 00 00 01 00 02 D3 02
				15 00 00 00 01 00 02 D4 A0
				15 00 00 00 01 00 02 D5 02
				15 00 00 00 01 00 02 D6 D1
				15 00 00 00 01 00 02 D7 02
				15 00 00 00 01 00 02 D8 EE
				15 00 00 00 01 00 02 D9 03
				15 00 00 00 01 00 02 DA 15
				15 00 00 00 01 00 02 DB 03
				15 00 00 00 01 00 02 DC 33
				15 00 00 00 01 00 02 DD 03
				15 00 00 00 01 00 02 DE 5B
				15 00 00 00 01 00 02 DF 03
				15 00 00 00 01 00 02 E0 67
				15 00 00 00 01 00 02 E1 03
				15 00 00 00 01 00 02 E2 74
				15 00 00 00 01 00 02 E3 03
				15 00 00 00 01 00 02 E4 82
				15 00 00 00 01 00 02 E5 03
				15 00 00 00 01 00 02 E6 93
				15 00 00 00 01 00 02 E7 03
				15 00 00 00 01 00 02 E8 A5
				15 00 00 00 01 00 02 E9 03
				15 00 00 00 01 00 02 EA BC
				15 00 00 00 01 00 02 EB 03
				15 00 00 00 01 00 02 EC D3
				15 00 00 00 01 00 02 ED 03
				15 00 00 00 01 00 02 EE D8
				15 00 00 00 01 00 02 EF 00
				15 00 00 00 01 00 02 F0 AE
				15 00 00 00 01 00 02 F1 00
				15 00 00 00 01 00 02 F2 B9
				15 00 00 00 01 00 02 F3 00
				15 00 00 00 01 00 02 F4 CE
				15 00 00 00 01 00 02 F5 00
				15 00 00 00 01 00 02 F6 E1
				15 00 00 00 01 00 02 F7 00
				15 00 00 00 01 00 02 F8 F2
				15 00 00 00 01 00 02 F9 01
				15 00 00 00 01 00 02 FA 01
				15 01 00 00 01 00 02 FF 21
				15 00 00 00 01 00 02 FB 01
				15 00 00 00 01 00 02 00 01
				15 00 00 00 01 00 02 01 0E
				15 00 00 00 01 00 02 02 01
				15 00 00 00 01 00 02 03 1B
				15 00 00 00 01 00 02 04 01
				15 00 00 00 01 00 02 05 27
				15 00 00 00 01 00 02 06 01
				15 00 00 00 01 00 02 07 4E
				15 00 00 00 01 00 02 08 01
				15 00 00 00 01 00 02 09 6E
				15 00 00 00 01 00 02 0A 01
				15 00 00 00 01 00 02 0B 9F
				15 00 00 00 01 00 02 0C 01
				15 00 00 00 01 00 02 0D C5
				15 00 00 00 01 00 02 0E 02
				15 00 00 00 01 00 02 0F 01
				15 00 00 00 01 00 02 10 02
				15 00 00 00 01 00 02 11 34
				15 00 00 00 01 00 02 12 02
				15 00 00 00 01 00 02 13 35
				15 00 00 00 01 00 02 14 02
				15 00 00 00 01 00 02 15 67
				15 00 00 00 01 00 02 16 02
				15 00 00 00 01 00 02 17 AC
				15 00 00 00 01 00 02 18 02
				15 00 00 00 01 00 02 19 D7
				15 00 00 00 01 00 02 1A 03
				15 00 00 00 01 00 02 1B 0F
				15 00 00 00 01 00 02 1C 03
				15 00 00 00 01 00 02 1D 2F
				15 00 00 00 01 00 02 1E 03
				15 00 00 00 01 00 02 1F 57
				15 00 00 00 01 00 02 20 03
				15 00 00 00 01 00 02 21 63
				15 00 00 00 01 00 02 22 03
				15 00 00 00 01 00 02 23 71
				15 00 00 00 01 00 02 24 03
				15 00 00 00 01 00 02 25 7F
				15 00 00 00 01 00 02 26 03
				15 00 00 00 01 00 02 27 8F
				15 00 00 00 01 00 02 28 03
				15 00 00 00 01 00 02 29 A3
				15 00 00 00 01 00 02 2A 03
				15 00 00 00 01 00 02 2B BA
				15 00 00 00 01 00 02 2D 03
				15 00 00 00 01 00 02 2F D2
				15 00 00 00 01 00 02 30 03
				15 00 00 00 01 00 02 31 D8
				15 00 00 00 01 00 02 32 00
				15 00 00 00 01 00 02 33 D2
				15 00 00 00 01 00 02 34 00
				15 00 00 00 01 00 02 35 DE
				15 00 00 00 01 00 02 36 00
				15 00 00 00 01 00 02 37 F3
				15 00 00 00 01 00 02 38 01
				15 00 00 00 01 00 02 39 07
				15 00 00 00 01 00 02 3A 01
				15 00 00 00 01 00 02 3B 19
				15 00 00 00 01 00 02 3D 01
				15 00 00 00 01 00 02 3F 28
				15 00 00 00 01 00 02 40 01
				15 00 00 00 01 00 02 41 36
				15 00 00 00 01 00 02 42 01
				15 00 00 00 01 00 02 43 43
				15 00 00 00 01 00 02 44 01
				15 00 00 00 01 00 02 45 50
				15 00 00 00 01 00 02 46 01
				15 00 00 00 01 00 02 47 78
				15 00 00 00 01 00 02 48 01
				15 00 00 00 01 00 02 49 9B
				15 00 00 00 01 00 02 4A 01
				15 00 00 00 01 00 02 4B D0
				15 00 00 00 01 00 02 4C 01
				15 00 00 00 01 00 02 4D FA
				15 00 00 00 01 00 02 4E 02
				15 00 00 00 01 00 02 4F 3C
				15 00 00 00 01 00 02 50 02
				15 00 00 00 01 00 02 51 6F
				15 00 00 00 01 00 02 52 02
				15 00 00 00 01 00 02 53 70
				15 00 00 00 01 00 02 54 02
				15 00 00 00 01 00 02 55 A2
				15 00 00 00 01 00 02 56 02
				15 00 00 00 01 00 02 58 D2
				15 00 00 00 01 00 02 59 02
				15 00 00 00 01 00 02 5A EE
				15 00 00 00 01 00 02 5B 03
				15 00 00 00 01 00 02 5C 16
				15 00 00 00 01 00 02 5D 03
				15 00 00 00 01 00 02 5E 34
				15 00 00 00 01 00 02 5F 03
				15 00 00 00 01 00 02 60 5A
				15 00 00 00 01 00 02 61 03
				15 00 00 00 01 00 02 62 66
				15 00 00 00 01 00 02 63 03
				15 00 00 00 01 00 02 64 73
				15 00 00 00 01 00 02 65 03
				15 00 00 00 01 00 02 66 81
				15 00 00 00 01 00 02 67 03
				15 00 00 00 01 00 02 68 91
				15 00 00 00 01 00 02 69 03
				15 00 00 00 01 00 02 6A A4
				15 00 00 00 01 00 02 6B 03
				15 00 00 00 01 00 02 6C BB
				15 00 00 00 01 00 02 6D 03
				15 00 00 00 01 00 02 6E D2
				15 00 00 00 01 00 02 6F 03
				15 00 00 00 01 00 02 70 D8
				15 00 00 00 01 00 02 71 00
				15 00 00 00 01 00 02 72 F4
				15 00 00 00 01 00 02 73 00
				15 00 00 00 01 00 02 74 FC
				15 00 00 00 01 00 02 75 01
				15 00 00 00 01 00 02 76 0A
				15 00 00 00 01 00 02 77 01
				15 00 00 00 01 00 02 78 17
				15 00 00 00 01 00 02 79 01
				15 00 00 00 01 00 02 7A 23
				15 00 00 00 01 00 02 7B 01
				15 00 00 00 01 00 02 7C 2F
				15 00 00 00 01 00 02 7D 01
				15 00 00 00 01 00 02 7E 3B
				15 00 00 00 01 00 02 7F 01
				15 00 00 00 01 00 02 80 4C
				15 00 00 00 01 00 02 81 01
				15 00 00 00 01 00 02 82 4C
				15 00 00 00 01 00 02 83 01
				15 00 00 00 01 00 02 84 6C
				15 00 00 00 01 00 02 85 01
				15 00 00 00 01 00 02 86 87
				15 00 00 00 01 00 02 87 01
				15 00 00 00 01 00 02 88 B2
				15 00 00 00 01 00 02 89 01
				15 00 00 00 01 00 02 8A D3
				15 00 00 00 01 00 02 8B 02
				15 00 00 00 01 00 02 8C 09
				15 00 00 00 01 00 02 8D 02
				15 00 00 00 01 00 02 8E 3B
				15 00 00 00 01 00 02 8F 02
				15 00 00 00 01 00 02 90 3C
				15 00 00 00 01 00 02 91 02
				15 00 00 00 01 00 02 92 6E
				15 00 00 00 01 00 02 93 02
				15 00 00 00 01 00 02 94 B2
				15 00 00 00 01 00 02 95 02
				15 00 00 00 01 00 02 96 DE
				15 00 00 00 01 00 02 97 03
				15 00 00 00 01 00 02 98 16
				15 00 00 00 01 00 02 99 03
				15 00 00 00 01 00 02 9A 36
				15 00 00 00 01 00 02 9B 03
				15 00 00 00 01 00 02 9C 5E
				15 00 00 00 01 00 02 9D 03
				15 00 00 00 01 00 02 9E 69
				15 00 00 00 01 00 02 9F 03
				15 00 00 00 01 00 02 A0 77
				15 00 00 00 01 00 02 A2 03
				15 00 00 00 01 00 02 A3 85
				15 00 00 00 01 00 02 A4 03
				15 00 00 00 01 00 02 A5 95
				15 00 00 00 01 00 02 A6 03
				15 00 00 00 01 00 02 A7 A8
				15 00 00 00 01 00 02 A9 03
				15 00 00 00 01 00 02 AA BF
				15 00 00 00 01 00 02 AB 03
				15 00 00 00 01 00 02 AC D3
				15 00 00 00 01 00 02 AD 03
				15 00 00 00 01 00 02 AE D8
				15 00 00 00 01 00 02 AF 01
				15 00 00 00 01 00 02 B0 0D
				15 00 00 00 01 00 02 B1 01
				15 00 00 00 01 00 02 B2 16
				15 00 00 00 01 00 02 B3 01
				15 00 00 00 01 00 02 B4 25
				15 00 00 00 01 00 02 B5 01
				15 00 00 00 01 00 02 B6 32
				15 00 00 00 01 00 02 B7 01
				15 00 00 00 01 00 02 B8 40
				15 00 00 00 01 00 02 B9 01
				15 00 00 00 01 00 02 BA 4C
				15 00 00 00 01 00 02 BB 01
				15 00 00 00 01 00 02 BC 59
				15 00 00 00 01 00 02 BD 01
				15 00 00 00 01 00 02 BE 6B
				15 00 00 00 01 00 02 BF 01
				15 00 00 00 01 00 02 C0 6C
				15 00 00 00 01 00 02 C1 01
				15 00 00 00 01 00 02 C2 8F
				15 00 00 00 01 00 02 C3 01
				15 00 00 00 01 00 02 C4 AD
				15 00 00 00 01 00 02 C5 01
				15 00 00 00 01 00 02 C6 DF
				15 00 00 00 01 00 02 C7 02
				15 00 00 00 01 00 02 C8 06
				15 00 00 00 01 00 02 C9 02
				15 00 00 00 01 00 02 CA 44
				15 00 00 00 01 00 02 CB 02
				15 00 00 00 01 00 02 CC 76
				15 00 00 00 01 00 02 CD 02
				15 00 00 00 01 00 02 CE 77
				15 00 00 00 01 00 02 CF 02
				15 00 00 00 01 00 02 D0 A9
				15 00 00 00 01 00 02 D1 02
				15 00 00 00 01 00 02 D2 D8
				15 00 00 00 01 00 02 D3 02
				15 00 00 00 01 00 02 D4 F4
				15 00 00 00 01 00 02 D5 03
				15 00 00 00 01 00 02 D6 1D
				15 00 00 00 01 00 02 D7 03
				15 00 00 00 01 00 02 D8 3B
				15 00 00 00 01 00 02 D9 03
				15 00 00 00 01 00 02 DA 61
				15 00 00 00 01 00 02 DB 03
				15 00 00 00 01 00 02 DC 6C
				15 00 00 00 01 00 02 DD 03
				15 00 00 00 01 00 02 DE 79
				15 00 00 00 01 00 02 DF 03
				15 00 00 00 01 00 02 E0 87
				15 00 00 00 01 00 02 E1 03
				15 00 00 00 01 00 02 E2 97
				15 00 00 00 01 00 02 E3 03
				15 00 00 00 01 00 02 E4 A9
				15 00 00 00 01 00 02 E5 03
				15 00 00 00 01 00 02 E6 BF
				15 00 00 00 01 00 02 E7 03
				15 00 00 00 01 00 02 E8 D3
				15 00 00 00 01 00 02 E9 03
				15 00 00 00 01 00 02 EA D8
				15 01 00 00 01 00 02 FF 10
				];
		qcom,mdss-dsi-dispparam-normal1-command-state = "dsi_hs_mode";

		qcom,mdss-dsi-dispparam-cold-command = [
				15 01 00 00 01 00 02 FF 22
				15 00 00 00 01 00 02 FB 01
				15 00 00 00 01 00 02 FA 00
				15 01 00 00 01 00 02 FF 20
				15 00 00 00 01 00 02 FB 01
				15 00 00 00 01 00 02 75 00
				15 00 00 00 01 00 02 76 1D
				15 00 00 00 01 00 02 77 00
				15 00 00 00 01 00 02 78 3B
				15 00 00 00 01 00 02 79 00
				15 00 00 00 01 00 02 7A 68
				15 00 00 00 01 00 02 7B 00
				15 00 00 00 01 00 02 7C 8B
				15 00 00 00 01 00 02 7D 00
				15 00 00 00 01 00 02 7E A7
				15 00 00 00 01 00 02 7F 00
				15 00 00 00 01 00 02 80 BF
				15 00 00 00 01 00 02 81 00
				15 00 00 00 01 00 02 82 D3
				15 00 00 00 01 00 02 83 00
				15 00 00 00 01 00 02 84 E5
				15 00 00 00 01 00 02 85 00
				15 00 00 00 01 00 02 86 F6
				15 00 00 00 01 00 02 87 01
				15 00 00 00 01 00 02 88 2A
				15 00 00 00 01 00 02 89 01
				15 00 00 00 01 00 02 8A 53
				15 00 00 00 01 00 02 8B 01
				15 00 00 00 01 00 02 8C 8E
				15 00 00 00 01 00 02 8D 01
				15 00 00 00 01 00 02 8E BA
				15 00 00 00 01 00 02 8F 01
				15 00 00 00 01 00 02 90 FD
				15 00 00 00 01 00 02 91 02
				15 00 00 00 01 00 02 92 32
				15 00 00 00 01 00 02 93 02
				15 00 00 00 01 00 02 94 34
				15 00 00 00 01 00 02 95 02
				15 00 00 00 01 00 02 96 66
				15 00 00 00 01 00 02 97 02
				15 00 00 00 01 00 02 98 AB
				15 00 00 00 01 00 02 99 02
				15 00 00 00 01 00 02 9A D8
				15 00 00 00 01 00 02 9B 03
				15 00 00 00 01 00 02 9C 10
				15 00 00 00 01 00 02 9D 03
				15 00 00 00 01 00 02 9E 2F
				15 00 00 00 01 00 02 9F 03
				15 00 00 00 01 00 02 A0 5A
				15 00 00 00 01 00 02 A2 03
				15 00 00 00 01 00 02 A3 65
				15 00 00 00 01 00 02 A4 03
				15 00 00 00 01 00 02 A5 73
				15 00 00 00 01 00 02 A6 03
				15 00 00 00 01 00 02 A7 82
				15 00 00 00 01 00 02 A9 03
				15 00 00 00 01 00 02 AA 93
				15 00 00 00 01 00 02 AB 03
				15 00 00 00 01 00 02 AC A5
				15 00 00 00 01 00 02 AD 03
				15 00 00 00 01 00 02 AE BD
				15 00 00 00 01 00 02 AF 03
				15 00 00 00 01 00 02 B0 D3
				15 00 00 00 01 00 02 B1 03
				15 00 00 00 01 00 02 B2 D8
				15 00 00 00 01 00 02 B3 00
				15 00 00 00 01 00 02 B4 57
				15 00 00 00 01 00 02 B5 00
				15 00 00 00 01 00 02 B6 75
				15 00 00 00 01 00 02 B7 00
				15 00 00 00 01 00 02 B8 A2
				15 00 00 00 01 00 02 B9 00
				15 00 00 00 01 00 02 BA C5
				15 00 00 00 01 00 02 BB 00
				15 00 00 00 01 00 02 BC E1
				15 00 00 00 01 00 02 BD 00
				15 00 00 00 01 00 02 BE F9
				15 00 00 00 01 00 02 BF 01
				15 00 00 00 01 00 02 C0 0D
				15 00 00 00 01 00 02 C1 01
				15 00 00 00 01 00 02 C2 1F
				15 00 00 00 01 00 02 C3 01
				15 00 00 00 01 00 02 C4 30
				15 00 00 00 01 00 02 C5 01
				15 00 00 00 01 00 02 C6 64
				15 00 00 00 01 00 02 C7 01
				15 00 00 00 01 00 02 C8 8D
				15 00 00 00 01 00 02 C9 01
				15 00 00 00 01 00 02 CA C9
				15 00 00 00 01 00 02 CB 01
				15 00 00 00 01 00 02 CC F5
				15 00 00 00 01 00 02 CD 02
				15 00 00 00 01 00 02 CE 38
				15 00 00 00 01 00 02 CF 02
				15 00 00 00 01 00 02 D0 6D
				15 00 00 00 01 00 02 D1 02
				15 00 00 00 01 00 02 D2 6F
				15 00 00 00 01 00 02 D3 02
				15 00 00 00 01 00 02 D4 A1
				15 00 00 00 01 00 02 D5 02
				15 00 00 00 01 00 02 D6 D2
				15 00 00 00 01 00 02 D7 02
				15 00 00 00 01 00 02 D8 EF
				15 00 00 00 01 00 02 D9 03
				15 00 00 00 01 00 02 DA 16
				15 00 00 00 01 00 02 DB 03
				15 00 00 00 01 00 02 DC 34
				15 00 00 00 01 00 02 DD 03
				15 00 00 00 01 00 02 DE 5D
				15 00 00 00 01 00 02 DF 03
				15 00 00 00 01 00 02 E0 68
				15 00 00 00 01 00 02 E1 03
				15 00 00 00 01 00 02 E2 75
				15 00 00 00 01 00 02 E3 03
				15 00 00 00 01 00 02 E4 84
				15 00 00 00 01 00 02 E5 03
				15 00 00 00 01 00 02 E6 95
				15 00 00 00 01 00 02 E7 03
				15 00 00 00 01 00 02 E8 A6
				15 00 00 00 01 00 02 E9 03
				15 00 00 00 01 00 02 EA BD
				15 00 00 00 01 00 02 EB 03
				15 00 00 00 01 00 02 EC D3
				15 00 00 00 01 00 02 ED 03
				15 00 00 00 01 00 02 EE D8
				15 00 00 00 01 00 02 EF 00
				15 00 00 00 01 00 02 F0 79
				15 00 00 00 01 00 02 F1 00
				15 00 00 00 01 00 02 F2 87
				15 00 00 00 01 00 02 F3 00
				15 00 00 00 01 00 02 F4 A4
				15 00 00 00 01 00 02 F5 00
				15 00 00 00 01 00 02 F6 B9
				15 00 00 00 01 00 02 F7 00
				15 00 00 00 01 00 02 F8 CF
				15 00 00 00 01 00 02 F9 00
				15 00 00 00 01 00 02 FA E1
				15 01 00 00 01 00 02 FF 21
				15 00 00 00 01 00 02 FB 01
				15 00 00 00 01 00 02 00 00
				15 00 00 00 01 00 02 01 F0
				15 00 00 00 01 00 02 02 00
				15 00 00 00 01 00 02 03 FF
				15 00 00 00 01 00 02 04 01
				15 00 00 00 01 00 02 05 0D
				15 00 00 00 01 00 02 06 01
				15 00 00 00 01 00 02 07 39
				15 00 00 00 01 00 02 08 01
				15 00 00 00 01 00 02 09 5F
				15 00 00 00 01 00 02 0A 01
				15 00 00 00 01 00 02 0B 95
				15 00 00 00 01 00 02 0C 01
				15 00 00 00 01 00 02 0D BB
				15 00 00 00 01 00 02 0E 01
				15 00 00 00 01 00 02 0F FE
				15 00 00 00 01 00 02 10 02
				15 00 00 00 01 00 02 11 2F
				15 00 00 00 01 00 02 12 02
				15 00 00 00 01 00 02 13 31
				15 00 00 00 01 00 02 14 02
				15 00 00 00 01 00 02 15 64
				15 00 00 00 01 00 02 16 02
				15 00 00 00 01 00 02 17 A6
				15 00 00 00 01 00 02 18 02
				15 00 00 00 01 00 02 19 D4
				15 00 00 00 01 00 02 1A 03
				15 00 00 00 01 00 02 1B 0B
				15 00 00 00 01 00 02 1C 03
				15 00 00 00 01 00 02 1D 2D
				15 00 00 00 01 00 02 1E 03
				15 00 00 00 01 00 02 1F 54
				15 00 00 00 01 00 02 20 03
				15 00 00 00 01 00 02 21 62
				15 00 00 00 01 00 02 22 03
				15 00 00 00 01 00 02 23 71
				15 00 00 00 01 00 02 24 03
				15 00 00 00 01 00 02 25 7F
				15 00 00 00 01 00 02 26 03
				15 00 00 00 01 00 02 27 8E
				15 00 00 00 01 00 02 28 03
				15 00 00 00 01 00 02 29 A1
				15 00 00 00 01 00 02 2A 03
				15 00 00 00 01 00 02 2B BA
				15 00 00 00 01 00 02 2D 03
				15 00 00 00 01 00 02 2F D1
				15 00 00 00 01 00 02 30 03
				15 00 00 00 01 00 02 31 D8
				15 00 00 00 01 00 02 32 00
				15 00 00 00 01 00 02 33 A5
				15 00 00 00 01 00 02 34 00
				15 00 00 00 01 00 02 35 B4
				15 00 00 00 01 00 02 36 00
				15 00 00 00 01 00 02 37 D0
				15 00 00 00 01 00 02 38 00
				15 00 00 00 01 00 02 39 E6
				15 00 00 00 01 00 02 3A 00
				15 00 00 00 01 00 02 3B FC
				15 00 00 00 01 00 02 3D 01
				15 00 00 00 01 00 02 3F 0E
				15 00 00 00 01 00 02 40 01
				15 00 00 00 01 00 02 41 1E
				15 00 00 00 01 00 02 42 01
				15 00 00 00 01 00 02 43 2D
				15 00 00 00 01 00 02 44 01
				15 00 00 00 01 00 02 45 3C
				15 00 00 00 01 00 02 46 01
				15 00 00 00 01 00 02 47 69
				15 00 00 00 01 00 02 48 01
				15 00 00 00 01 00 02 49 90
				15 00 00 00 01 00 02 4A 01
				15 00 00 00 01 00 02 4B C9
				15 00 00 00 01 00 02 4C 01
				15 00 00 00 01 00 02 4D F2
				15 00 00 00 01 00 02 4E 02
				15 00 00 00 01 00 02 4F 39
				15 00 00 00 01 00 02 50 02
				15 00 00 00 01 00 02 51 6A
				15 00 00 00 01 00 02 52 02
				15 00 00 00 01 00 02 53 6C
				15 00 00 00 01 00 02 54 02
				15 00 00 00 01 00 02 55 9F
				15 00 00 00 01 00 02 56 02
				15 00 00 00 01 00 02 58 CD
				15 00 00 00 01 00 02 59 02
				15 00 00 00 01 00 02 5A EB
				15 00 00 00 01 00 02 5B 03
				15 00 00 00 01 00 02 5C 12
				15 00 00 00 01 00 02 5D 03
				15 00 00 00 01 00 02 5E 32
				15 00 00 00 01 00 02 5F 03
				15 00 00 00 01 00 02 60 58
				15 00 00 00 01 00 02 61 03
				15 00 00 00 01 00 02 62 65
				15 00 00 00 01 00 02 63 03
				15 00 00 00 01 00 02 64 73
				15 00 00 00 01 00 02 65 03
				15 00 00 00 01 00 02 66 80
				15 00 00 00 01 00 02 67 03
				15 00 00 00 01 00 02 68 90
				15 00 00 00 01 00 02 69 03
				15 00 00 00 01 00 02 6A A2
				15 00 00 00 01 00 02 6B 03
				15 00 00 00 01 00 02 6C BB
				15 00 00 00 01 00 02 6D 03
				15 00 00 00 01 00 02 6E D2
				15 00 00 00 01 00 02 6F 03
				15 00 00 00 01 00 02 70 D8
				15 00 00 00 01 00 02 71 00
				15 00 00 00 01 00 02 72 1D
				15 00 00 00 01 00 02 73 00
				15 00 00 00 01 00 02 74 3B
				15 00 00 00 01 00 02 75 00
				15 00 00 00 01 00 02 76 68
				15 00 00 00 01 00 02 77 00
				15 00 00 00 01 00 02 78 8B
				15 00 00 00 01 00 02 79 00
				15 00 00 00 01 00 02 7A A7
				15 00 00 00 01 00 02 7B 00
				15 00 00 00 01 00 02 7C BE
				15 00 00 00 01 00 02 7D 00
				15 00 00 00 01 00 02 7E D2
				15 00 00 00 01 00 02 7F 00
				15 00 00 00 01 00 02 80 E5
				15 00 00 00 01 00 02 81 00
				15 00 00 00 01 00 02 82 F5
				15 00 00 00 01 00 02 83 01
				15 00 00 00 01 00 02 84 29
				15 00 00 00 01 00 02 85 01
				15 00 00 00 01 00 02 86 52
				15 00 00 00 01 00 02 87 01
				15 00 00 00 01 00 02 88 8E
				15 00 00 00 01 00 02 89 01
				15 00 00 00 01 00 02 8A B9
				15 00 00 00 01 00 02 8B 01
				15 00 00 00 01 00 02 8C FC
				15 00 00 00 01 00 02 8D 02
				15 00 00 00 01 00 02 8E 31
				15 00 00 00 01 00 02 8F 02
				15 00 00 00 01 00 02 90 33
				15 00 00 00 01 00 02 91 02
				15 00 00 00 01 00 02 92 65
				15 00 00 00 01 00 02 93 02
				15 00 00 00 01 00 02 94 AB
				15 00 00 00 01 00 02 95 02
				15 00 00 00 01 00 02 96 D7
				15 00 00 00 01 00 02 97 03
				15 00 00 00 01 00 02 98 0F
				15 00 00 00 01 00 02 99 03
				15 00 00 00 01 00 02 9A 2E
				15 00 00 00 01 00 02 9B 03
				15 00 00 00 01 00 02 9C 59
				15 00 00 00 01 00 02 9D 03
				15 00 00 00 01 00 02 9E 64
				15 00 00 00 01 00 02 9F 03
				15 00 00 00 01 00 02 A0 72
				15 00 00 00 01 00 02 A2 03
				15 00 00 00 01 00 02 A3 81
				15 00 00 00 01 00 02 A4 03
				15 00 00 00 01 00 02 A5 92
				15 00 00 00 01 00 02 A6 03
				15 00 00 00 01 00 02 A7 A4
				15 00 00 00 01 00 02 A9 03
				15 00 00 00 01 00 02 AA BC
				15 00 00 00 01 00 02 AB 03
				15 00 00 00 01 00 02 AC D3
				15 00 00 00 01 00 02 AD 03
				15 00 00 00 01 00 02 AE D8
				15 00 00 00 01 00 02 AF 00
				15 00 00 00 01 00 02 B0 57
				15 00 00 00 01 00 02 B1 00
				15 00 00 00 01 00 02 B2 75
				15 00 00 00 01 00 02 B3 00
				15 00 00 00 01 00 02 B4 A2
				15 00 00 00 01 00 02 B5 00
				15 00 00 00 01 00 02 B6 C5
				15 00 00 00 01 00 02 B7 00
				15 00 00 00 01 00 02 B8 E1
				15 00 00 00 01 00 02 B9 00
				15 00 00 00 01 00 02 BA F9
				15 00 00 00 01 00 02 BB 01
				15 00 00 00 01 00 02 BC 0C
				15 00 00 00 01 00 02 BD 01
				15 00 00 00 01 00 02 BE 1F
				15 00 00 00 01 00 02 BF 01
				15 00 00 00 01 00 02 C0 2F
				15 00 00 00 01 00 02 C1 01
				15 00 00 00 01 00 02 C2 64
				15 00 00 00 01 00 02 C3 01
				15 00 00 00 01 00 02 C4 8D
				15 00 00 00 01 00 02 C5 01
				15 00 00 00 01 00 02 C6 C8
				15 00 00 00 01 00 02 C7 01
				15 00 00 00 01 00 02 C8 F4
				15 00 00 00 01 00 02 C9 02
				15 00 00 00 01 00 02 CA 37
				15 00 00 00 01 00 02 CB 02
				15 00 00 00 01 00 02 CC 6C
				15 00 00 00 01 00 02 CD 02
				15 00 00 00 01 00 02 CE 6E
				15 00 00 00 01 00 02 CF 02
				15 00 00 00 01 00 02 D0 A0
				15 00 00 00 01 00 02 D1 02
				15 00 00 00 01 00 02 D2 D1
				15 00 00 00 01 00 02 D3 02
				15 00 00 00 01 00 02 D4 EE
				15 00 00 00 01 00 02 D5 03
				15 00 00 00 01 00 02 D6 15
				15 00 00 00 01 00 02 D7 03
				15 00 00 00 01 00 02 D8 33
				15 00 00 00 01 00 02 D9 03
				15 00 00 00 01 00 02 DA 5C
				15 00 00 00 01 00 02 DB 03
				15 00 00 00 01 00 02 DC 67
				15 00 00 00 01 00 02 DD 03
				15 00 00 00 01 00 02 DE 74
				15 00 00 00 01 00 02 DF 03
				15 00 00 00 01 00 02 E0 83
				15 00 00 00 01 00 02 E1 03
				15 00 00 00 01 00 02 E2 94
				15 00 00 00 01 00 02 E3 03
				15 00 00 00 01 00 02 E4 A5
				15 00 00 00 01 00 02 E5 03
				15 00 00 00 01 00 02 E6 BD
				15 00 00 00 01 00 02 E7 03
				15 00 00 00 01 00 02 E8 D3
				15 00 00 00 01 00 02 E9 03
				15 00 00 00 01 00 02 EA D8
				15 01 00 00 01 00 02 FF 10
				];
		qcom,mdss-dsi-dispparam-cold-command-state = "dsi_hs_mode";
		qcom,mdss-dsi-dispparam-papermode-command = [
				15 01 00 00 01 00 02 FF 22
				15 00 00 00 01 00 02 FB 01
				15 00 00 00 01 00 02 FA 00
				15 01 00 00 01 00 02 FF 20
				15 00 00 00 01 00 02 FB 01
				15 00 00 00 01 00 02 75 00
				15 00 00 00 01 00 02 76 1D
				15 00 00 00 01 00 02 77 00
				15 00 00 00 01 00 02 78 38
				15 00 00 00 01 00 02 79 00
				15 00 00 00 01 00 02 7A 67
				15 00 00 00 01 00 02 7B 00
				15 00 00 00 01 00 02 7C 89
				15 00 00 00 01 00 02 7D 00
				15 00 00 00 01 00 02 7E A7
				15 00 00 00 01 00 02 7F 00
				15 00 00 00 01 00 02 80 BE
				15 00 00 00 01 00 02 81 00
				15 00 00 00 01 00 02 82 D3
				15 00 00 00 01 00 02 83 00
				15 00 00 00 01 00 02 84 E4
				15 00 00 00 01 00 02 85 00
				15 00 00 00 01 00 02 86 F4
				15 00 00 00 01 00 02 87 01
				15 00 00 00 01 00 02 88 2A
				15 00 00 00 01 00 02 89 01
				15 00 00 00 01 00 02 8A 51
				15 00 00 00 01 00 02 8B 01
				15 00 00 00 01 00 02 8C 8C
				15 00 00 00 01 00 02 8D 01
				15 00 00 00 01 00 02 8E B9
				15 00 00 00 01 00 02 8F 01
				15 00 00 00 01 00 02 90 FC
				15 00 00 00 01 00 02 91 02
				15 00 00 00 01 00 02 92 31
				15 00 00 00 01 00 02 93 02
				15 00 00 00 01 00 02 94 33
				15 00 00 00 01 00 02 95 02
				15 00 00 00 01 00 02 96 66
				15 00 00 00 01 00 02 97 02
				15 00 00 00 01 00 02 98 AB
				15 00 00 00 01 00 02 99 02
				15 00 00 00 01 00 02 9A D7
				15 00 00 00 01 00 02 9B 03
				15 00 00 00 01 00 02 9C 0F
				15 00 00 00 01 00 02 9D 03
				15 00 00 00 01 00 02 9E 2F
				15 00 00 00 01 00 02 9F 03
				15 00 00 00 01 00 02 A0 58
				15 00 00 00 01 00 02 A2 03
				15 00 00 00 01 00 02 A3 63
				15 00 00 00 01 00 02 A4 03
				15 00 00 00 01 00 02 A5 70
				15 00 00 00 01 00 02 A6 03
				15 00 00 00 01 00 02 A7 80
				15 00 00 00 01 00 02 A9 03
				15 00 00 00 01 00 02 AA 90
				15 00 00 00 01 00 02 AB 03
				15 00 00 00 01 00 02 AC A3
				15 00 00 00 01 00 02 AD 03
				15 00 00 00 01 00 02 AE BB
				15 00 00 00 01 00 02 AF 03
				15 00 00 00 01 00 02 B0 D2
				15 00 00 00 01 00 02 B1 03
				15 00 00 00 01 00 02 B2 D8
				15 00 00 00 01 00 02 B3 00
				15 00 00 00 01 00 02 B4 57
				15 00 00 00 01 00 02 B5 00
				15 00 00 00 01 00 02 B6 72
				15 00 00 00 01 00 02 B7 00
				15 00 00 00 01 00 02 B8 A1
				15 00 00 00 01 00 02 B9 00
				15 00 00 00 01 00 02 BA C4
				15 00 00 00 01 00 02 BB 00
				15 00 00 00 01 00 02 BC E1
				15 00 00 00 01 00 02 BD 00
				15 00 00 00 01 00 02 BE F9
				15 00 00 00 01 00 02 BF 01
				15 00 00 00 01 00 02 C0 0D
				15 00 00 00 01 00 02 C1 01
				15 00 00 00 01 00 02 C2 1F
				15 00 00 00 01 00 02 C3 01
				15 00 00 00 01 00 02 C4 2E
				15 00 00 00 01 00 02 C5 01
				15 00 00 00 01 00 02 C6 64
				15 00 00 00 01 00 02 C7 01
				15 00 00 00 01 00 02 C8 8C
				15 00 00 00 01 00 02 C9 01
				15 00 00 00 01 00 02 CA C7
				15 00 00 00 01 00 02 CB 01
				15 00 00 00 01 00 02 CC F4
				15 00 00 00 01 00 02 CD 02
				15 00 00 00 01 00 02 CE 37
				15 00 00 00 01 00 02 CF 02
				15 00 00 00 01 00 02 D0 6C
				15 00 00 00 01 00 02 D1 02
				15 00 00 00 01 00 02 D2 6E
				15 00 00 00 01 00 02 D3 02
				15 00 00 00 01 00 02 D4 A1
				15 00 00 00 01 00 02 D5 02
				15 00 00 00 01 00 02 D6 D2
				15 00 00 00 01 00 02 D7 02
				15 00 00 00 01 00 02 D8 EE
				15 00 00 00 01 00 02 D9 03
				15 00 00 00 01 00 02 DA 16
				15 00 00 00 01 00 02 DB 03
				15 00 00 00 01 00 02 DC 34
				15 00 00 00 01 00 02 DD 03
				15 00 00 00 01 00 02 DE 5B
				15 00 00 00 01 00 02 DF 03
				15 00 00 00 01 00 02 E0 66
				15 00 00 00 01 00 02 E1 03
				15 00 00 00 01 00 02 E2 73
				15 00 00 00 01 00 02 E3 03
				15 00 00 00 01 00 02 E4 81
				15 00 00 00 01 00 02 E5 03
				15 00 00 00 01 00 02 E6 91
				15 00 00 00 01 00 02 E7 03
				15 00 00 00 01 00 02 E8 A4
				15 00 00 00 01 00 02 E9 03
				15 00 00 00 01 00 02 EA BC
				15 00 00 00 01 00 02 EB 03
				15 00 00 00 01 00 02 EC D3
				15 00 00 00 01 00 02 ED 03
				15 00 00 00 01 00 02 EE D8
				15 00 00 00 01 00 02 EF 00
				15 00 00 00 01 00 02 F0 8A
				15 00 00 00 01 00 02 F1 00
				15 00 00 00 01 00 02 F2 98
				15 00 00 00 01 00 02 F3 00
				15 00 00 00 01 00 02 F4 B1
				15 00 00 00 01 00 02 F5 00
				15 00 00 00 01 00 02 F6 C7
				15 00 00 00 01 00 02 F7 00
				15 00 00 00 01 00 02 F8 DC
				15 00 00 00 01 00 02 F9 00
				15 00 00 00 01 00 02 FA EC
				15 01 00 00 01 00 02 FF 21
				15 00 00 00 01 00 02 FB 01
				15 00 00 00 01 00 02 00 00
				15 00 00 00 01 00 02 01 FB
				15 00 00 00 01 00 02 02 01
				15 00 00 00 01 00 02 03 09
				15 00 00 00 01 00 02 04 01
				15 00 00 00 01 00 02 05 17
				15 00 00 00 01 00 02 06 01
				15 00 00 00 01 00 02 07 43
				15 00 00 00 01 00 02 08 01
				15 00 00 00 01 00 02 09 65
				15 00 00 00 01 00 02 0A 01
				15 00 00 00 01 00 02 0B 99
				15 00 00 00 01 00 02 0C 01
				15 00 00 00 01 00 02 0D C1
				15 00 00 00 01 00 02 0E 01
				15 00 00 00 01 00 02 0F FF
				15 00 00 00 01 00 02 10 02
				15 00 00 00 01 00 02 11 34
				15 00 00 00 01 00 02 12 02
				15 00 00 00 01 00 02 13 35
				15 00 00 00 01 00 02 14 02
				15 00 00 00 01 00 02 15 68
				15 00 00 00 01 00 02 16 02
				15 00 00 00 01 00 02 17 AC
				15 00 00 00 01 00 02 18 02
				15 00 00 00 01 00 02 19 D9
				15 00 00 00 01 00 02 1A 03
				15 00 00 00 01 00 02 1B 10
				15 00 00 00 01 00 02 1C 03
				15 00 00 00 01 00 02 1D 30
				15 00 00 00 01 00 02 1E 03
				15 00 00 00 01 00 02 1F 59
				15 00 00 00 01 00 02 20 03
				15 00 00 00 01 00 02 21 64
				15 00 00 00 01 00 02 22 03
				15 00 00 00 01 00 02 23 71
				15 00 00 00 01 00 02 24 03
				15 00 00 00 01 00 02 25 80
				15 00 00 00 01 00 02 26 03
				15 00 00 00 01 00 02 27 90
				15 00 00 00 01 00 02 28 03
				15 00 00 00 01 00 02 29 A3
				15 00 00 00 01 00 02 2A 03
				15 00 00 00 01 00 02 2B BA
				15 00 00 00 01 00 02 2D 03
				15 00 00 00 01 00 02 2F D0
				15 00 00 00 01 00 02 30 03
				15 00 00 00 01 00 02 31 D8
				15 00 00 00 01 00 02 32 00
				15 00 00 00 01 00 02 33 B3
				15 00 00 00 01 00 02 34 00
				15 00 00 00 01 00 02 35 C2
				15 00 00 00 01 00 02 36 00
				15 00 00 00 01 00 02 37 DB
				15 00 00 00 01 00 02 38 00
				15 00 00 00 01 00 02 39 F1
				15 00 00 00 01 00 02 3A 01
				15 00 00 00 01 00 02 3B 07
				15 00 00 00 01 00 02 3D 01
				15 00 00 00 01 00 02 3F 17
				15 00 00 00 01 00 02 40 01
				15 00 00 00 01 00 02 41 27
				15 00 00 00 01 00 02 42 01
				15 00 00 00 01 00 02 43 36
				15 00 00 00 01 00 02 44 01
				15 00 00 00 01 00 02 45 44
				15 00 00 00 01 00 02 46 01
				15 00 00 00 01 00 02 47 71
				15 00 00 00 01 00 02 48 01
				15 00 00 00 01 00 02 49 95
				15 00 00 00 01 00 02 4A 01
				15 00 00 00 01 00 02 4B CC
				15 00 00 00 01 00 02 4C 01
				15 00 00 00 01 00 02 4D F8
				15 00 00 00 01 00 02 4E 02
				15 00 00 00 01 00 02 4F 3A
				15 00 00 00 01 00 02 50 02
				15 00 00 00 01 00 02 51 6F
				15 00 00 00 01 00 02 52 02
				15 00 00 00 01 00 02 53 70
				15 00 00 00 01 00 02 54 02
				15 00 00 00 01 00 02 55 A3
				15 00 00 00 01 00 02 56 02
				15 00 00 00 01 00 02 58 D3
				15 00 00 00 01 00 02 59 02
				15 00 00 00 01 00 02 5A EF
				15 00 00 00 01 00 02 5B 03
				15 00 00 00 01 00 02 5C 17
				15 00 00 00 01 00 02 5D 03
				15 00 00 00 01 00 02 5E 35
				15 00 00 00 01 00 02 5F 03
				15 00 00 00 01 00 02 60 5C
				15 00 00 00 01 00 02 61 03
				15 00 00 00 01 00 02 62 67
				15 00 00 00 01 00 02 63 03
				15 00 00 00 01 00 02 64 74
				15 00 00 00 01 00 02 65 03
				15 00 00 00 01 00 02 66 82
				15 00 00 00 01 00 02 67 03
				15 00 00 00 01 00 02 68 91
				15 00 00 00 01 00 02 69 03
				15 00 00 00 01 00 02 6A A4
				15 00 00 00 01 00 02 6B 03
				15 00 00 00 01 00 02 6C BB
				15 00 00 00 01 00 02 6D 03
				15 00 00 00 01 00 02 6E D0
				15 00 00 00 01 00 02 6F 03
				15 00 00 00 01 00 02 70 D8
				15 00 00 00 01 00 02 71 02
				15 00 00 00 01 00 02 72 1D
				15 00 00 00 01 00 02 73 02
				15 00 00 00 01 00 02 74 1E
				15 00 00 00 01 00 02 75 02
				15 00 00 00 01 00 02 76 1F
				15 00 00 00 01 00 02 77 02
				15 00 00 00 01 00 02 78 21
				15 00 00 00 01 00 02 79 02
				15 00 00 00 01 00 02 7A 22
				15 00 00 00 01 00 02 7B 02
				15 00 00 00 01 00 02 7C 24
				15 00 00 00 01 00 02 7D 02
				15 00 00 00 01 00 02 7E 26
				15 00 00 00 01 00 02 7F 02
				15 00 00 00 01 00 02 80 28
				15 00 00 00 01 00 02 81 02
				15 00 00 00 01 00 02 82 29
				15 00 00 00 01 00 02 83 02
				15 00 00 00 01 00 02 84 2F
				15 00 00 00 01 00 02 85 02
				15 00 00 00 01 00 02 86 36
				15 00 00 00 01 00 02 87 02
				15 00 00 00 01 00 02 88 43
				15 00 00 00 01 00 02 89 02
				15 00 00 00 01 00 02 8A 4F
				15 00 00 00 01 00 02 8B 02
				15 00 00 00 01 00 02 8C 6B
				15 00 00 00 01 00 02 8D 02
				15 00 00 00 01 00 02 8E 8B
				15 00 00 00 01 00 02 8F 02
				15 00 00 00 01 00 02 90 8C
				15 00 00 00 01 00 02 91 02
				15 00 00 00 01 00 02 92 B2
				15 00 00 00 01 00 02 93 02
				15 00 00 00 01 00 02 94 ED
				15 00 00 00 01 00 02 95 03
				15 00 00 00 01 00 02 96 15
				15 00 00 00 01 00 02 97 03
				15 00 00 00 01 00 02 98 46
				15 00 00 00 01 00 02 99 03
				15 00 00 00 01 00 02 9A 61
				15 00 00 00 01 00 02 9B 03
				15 00 00 00 01 00 02 9C 81
				15 00 00 00 01 00 02 9D 03
				15 00 00 00 01 00 02 9E 8C
				15 00 00 00 01 00 02 9F 03
				15 00 00 00 01 00 02 A0 96
				15 00 00 00 01 00 02 A2 03
				15 00 00 00 01 00 02 A3 A0
				15 00 00 00 01 00 02 A4 03
				15 00 00 00 01 00 02 A5 AE
				15 00 00 00 01 00 02 A6 03
				15 00 00 00 01 00 02 A7 BD
				15 00 00 00 01 00 02 A9 03
				15 00 00 00 01 00 02 AA CC
				15 00 00 00 01 00 02 AB 03
				15 00 00 00 01 00 02 AC D6
				15 00 00 00 01 00 02 AD 03
				15 00 00 00 01 00 02 AE D8
				15 00 00 00 01 00 02 AF 02
				15 00 00 00 01 00 02 B0 45
				15 00 00 00 01 00 02 B1 02
				15 00 00 00 01 00 02 B2 46
				15 00 00 00 01 00 02 B3 02
				15 00 00 00 01 00 02 B4 48
				15 00 00 00 01 00 02 B5 02
				15 00 00 00 01 00 02 B6 4A
				15 00 00 00 01 00 02 B7 02
				15 00 00 00 01 00 02 B8 4C
				15 00 00 00 01 00 02 B9 02
				15 00 00 00 01 00 02 BA 4E
				15 00 00 00 01 00 02 BB 02
				15 00 00 00 01 00 02 BC 50
				15 00 00 00 01 00 02 BD 02
				15 00 00 00 01 00 02 BE 53
				15 00 00 00 01 00 02 BF 02
				15 00 00 00 01 00 02 C0 54
				15 00 00 00 01 00 02 C1 02
				15 00 00 00 01 00 02 C2 5D
				15 00 00 00 01 00 02 C3 02
				15 00 00 00 01 00 02 C4 65
				15 00 00 00 01 00 02 C5 02
				15 00 00 00 01 00 02 C6 75
				15 00 00 00 01 00 02 C7 02
				15 00 00 00 01 00 02 C8 86
				15 00 00 00 01 00 02 C9 02
				15 00 00 00 01 00 02 CA A6
				15 00 00 00 01 00 02 CB 02
				15 00 00 00 01 00 02 CC C6
				15 00 00 00 01 00 02 CD 02
				15 00 00 00 01 00 02 CE C7
				15 00 00 00 01 00 02 CF 02
				15 00 00 00 01 00 02 D0 ED
				15 00 00 00 01 00 02 D1 03
				15 00 00 00 01 00 02 D2 14
				15 00 00 00 01 00 02 D3 03
				15 00 00 00 01 00 02 D4 2C
				15 00 00 00 01 00 02 D5 03
				15 00 00 00 01 00 02 D6 4D
				15 00 00 00 01 00 02 D7 03
				15 00 00 00 01 00 02 D8 66
				15 00 00 00 01 00 02 D9 03
				15 00 00 00 01 00 02 DA 85
				15 00 00 00 01 00 02 DB 03
				15 00 00 00 01 00 02 DC 8F
				15 00 00 00 01 00 02 DD 03
				15 00 00 00 01 00 02 DE 99
				15 00 00 00 01 00 02 DF 03
				15 00 00 00 01 00 02 E0 A2
				15 00 00 00 01 00 02 E1 03
				15 00 00 00 01 00 02 E2 B0
				15 00 00 00 01 00 02 E3 03
				15 00 00 00 01 00 02 E4 BE
				15 00 00 00 01 00 02 E5 03
				15 00 00 00 01 00 02 E6 CC
				15 00 00 00 01 00 02 E7 03
				15 00 00 00 01 00 02 E8 D7
				15 00 00 00 01 00 02 E9 03
				15 00 00 00 01 00 02 EA D8
				15 01 00 00 01 00 02 FF 10
				];
		qcom,mdss-dsi-dispparam-papermode-command-state = "dsi_hs_mode";
		qcom,mdss-dsi-dispparam-papermode1-command = [
				15 01 00 00 01 00 02 FF 22
				15 00 00 00 01 00 02 FB 01
				15 00 00 00 01 00 02 FA 00
				15 01 00 00 01 00 02 FF 20
				15 00 00 00 01 00 02 FB 01
				15 00 00 00 01 00 02 75 00
				15 00 00 00 01 00 02 76 1D
				15 00 00 00 01 00 02 77 00
				15 00 00 00 01 00 02 78 38
				15 00 00 00 01 00 02 79 00
				15 00 00 00 01 00 02 7A 67
				15 00 00 00 01 00 02 7B 00
				15 00 00 00 01 00 02 7C 89
				15 00 00 00 01 00 02 7D 00
				15 00 00 00 01 00 02 7E A7
				15 00 00 00 01 00 02 7F 00
				15 00 00 00 01 00 02 80 BE
				15 00 00 00 01 00 02 81 00
				15 00 00 00 01 00 02 82 D3
				15 00 00 00 01 00 02 83 00
				15 00 00 00 01 00 02 84 E4
				15 00 00 00 01 00 02 85 00
				15 00 00 00 01 00 02 86 F4
				15 00 00 00 01 00 02 87 01
				15 00 00 00 01 00 02 88 2A
				15 00 00 00 01 00 02 89 01
				15 00 00 00 01 00 02 8A 51
				15 00 00 00 01 00 02 8B 01
				15 00 00 00 01 00 02 8C 8C
				15 00 00 00 01 00 02 8D 01
				15 00 00 00 01 00 02 8E B9
				15 00 00 00 01 00 02 8F 01
				15 00 00 00 01 00 02 90 FC
				15 00 00 00 01 00 02 91 02
				15 00 00 00 01 00 02 92 31
				15 00 00 00 01 00 02 93 02
				15 00 00 00 01 00 02 94 33
				15 00 00 00 01 00 02 95 02
				15 00 00 00 01 00 02 96 66
				15 00 00 00 01 00 02 97 02
				15 00 00 00 01 00 02 98 AB
				15 00 00 00 01 00 02 99 02
				15 00 00 00 01 00 02 9A D7
				15 00 00 00 01 00 02 9B 03
				15 00 00 00 01 00 02 9C 0F
				15 00 00 00 01 00 02 9D 03
				15 00 00 00 01 00 02 9E 2F
				15 00 00 00 01 00 02 9F 03
				15 00 00 00 01 00 02 A0 58
				15 00 00 00 01 00 02 A2 03
				15 00 00 00 01 00 02 A3 63
				15 00 00 00 01 00 02 A4 03
				15 00 00 00 01 00 02 A5 70
				15 00 00 00 01 00 02 A6 03
				15 00 00 00 01 00 02 A7 80
				15 00 00 00 01 00 02 A9 03
				15 00 00 00 01 00 02 AA 90
				15 00 00 00 01 00 02 AB 03
				15 00 00 00 01 00 02 AC A3
				15 00 00 00 01 00 02 AD 03
				15 00 00 00 01 00 02 AE BB
				15 00 00 00 01 00 02 AF 03
				15 00 00 00 01 00 02 B0 D2
				15 00 00 00 01 00 02 B1 03
				15 00 00 00 01 00 02 B2 D8
				15 00 00 00 01 00 02 B3 00
				15 00 00 00 01 00 02 B4 57
				15 00 00 00 01 00 02 B5 00
				15 00 00 00 01 00 02 B6 72
				15 00 00 00 01 00 02 B7 00
				15 00 00 00 01 00 02 B8 A1
				15 00 00 00 01 00 02 B9 00
				15 00 00 00 01 00 02 BA C4
				15 00 00 00 01 00 02 BB 00
				15 00 00 00 01 00 02 BC E1
				15 00 00 00 01 00 02 BD 00
				15 00 00 00 01 00 02 BE F9
				15 00 00 00 01 00 02 BF 01
				15 00 00 00 01 00 02 C0 0D
				15 00 00 00 01 00 02 C1 01
				15 00 00 00 01 00 02 C2 1F
				15 00 00 00 01 00 02 C3 01
				15 00 00 00 01 00 02 C4 2E
				15 00 00 00 01 00 02 C5 01
				15 00 00 00 01 00 02 C6 64
				15 00 00 00 01 00 02 C7 01
				15 00 00 00 01 00 02 C8 8C
				15 00 00 00 01 00 02 C9 01
				15 00 00 00 01 00 02 CA C7
				15 00 00 00 01 00 02 CB 01
				15 00 00 00 01 00 02 CC F4
				15 00 00 00 01 00 02 CD 02
				15 00 00 00 01 00 02 CE 37
				15 00 00 00 01 00 02 CF 02
				15 00 00 00 01 00 02 D0 6C
				15 00 00 00 01 00 02 D1 02
				15 00 00 00 01 00 02 D2 6E
				15 00 00 00 01 00 02 D3 02
				15 00 00 00 01 00 02 D4 A1
				15 00 00 00 01 00 02 D5 02
				15 00 00 00 01 00 02 D6 D2
				15 00 00 00 01 00 02 D7 02
				15 00 00 00 01 00 02 D8 EE
				15 00 00 00 01 00 02 D9 03
				15 00 00 00 01 00 02 DA 16
				15 00 00 00 01 00 02 DB 03
				15 00 00 00 01 00 02 DC 34
				15 00 00 00 01 00 02 DD 03
				15 00 00 00 01 00 02 DE 5B
				15 00 00 00 01 00 02 DF 03
				15 00 00 00 01 00 02 E0 66
				15 00 00 00 01 00 02 E1 03
				15 00 00 00 01 00 02 E2 73
				15 00 00 00 01 00 02 E3 03
				15 00 00 00 01 00 02 E4 81
				15 00 00 00 01 00 02 E5 03
				15 00 00 00 01 00 02 E6 91
				15 00 00 00 01 00 02 E7 03
				15 00 00 00 01 00 02 E8 A4
				15 00 00 00 01 00 02 E9 03
				15 00 00 00 01 00 02 EA BC
				15 00 00 00 01 00 02 EB 03
				15 00 00 00 01 00 02 EC D3
				15 00 00 00 01 00 02 ED 03
				15 00 00 00 01 00 02 EE D8
				15 00 00 00 01 00 02 EF 00
				15 00 00 00 01 00 02 F0 9F
				15 00 00 00 01 00 02 F1 00
				15 00 00 00 01 00 02 F2 AB
				15 00 00 00 01 00 02 F3 00
				15 00 00 00 01 00 02 F4 C5
				15 00 00 00 01 00 02 F5 00
				15 00 00 00 01 00 02 F6 D8
				15 00 00 00 01 00 02 F7 00
				15 00 00 00 01 00 02 F8 E8
				15 00 00 00 01 00 02 F9 00
				15 00 00 00 01 00 02 FA F8
				15 01 00 00 01 00 02 FF 21
				15 00 00 00 01 00 02 FB 01
				15 00 00 00 01 00 02 00 01
				15 00 00 00 01 00 02 01 08
				15 00 00 00 01 00 02 02 01
				15 00 00 00 01 00 02 03 15
				15 00 00 00 01 00 02 04 01
				15 00 00 00 01 00 02 05 20
				15 00 00 00 01 00 02 06 01
				15 00 00 00 01 00 02 07 49
				15 00 00 00 01 00 02 08 01
				15 00 00 00 01 00 02 09 6A
				15 00 00 00 01 00 02 0A 01
				15 00 00 00 01 00 02 0B 9E
				15 00 00 00 01 00 02 0C 01
				15 00 00 00 01 00 02 0D C4
				15 00 00 00 01 00 02 0E 02
				15 00 00 00 01 00 02 0F 00
				15 00 00 00 01 00 02 10 02
				15 00 00 00 01 00 02 11 34
				15 00 00 00 01 00 02 12 02
				15 00 00 00 01 00 02 13 35
				15 00 00 00 01 00 02 14 02
				15 00 00 00 01 00 02 15 68
				15 00 00 00 01 00 02 16 02
				15 00 00 00 01 00 02 17 AD
				15 00 00 00 01 00 02 18 02
				15 00 00 00 01 00 02 19 DA
				15 00 00 00 01 00 02 1A 03
				15 00 00 00 01 00 02 1B 11
				15 00 00 00 01 00 02 1C 03
				15 00 00 00 01 00 02 1D 30
				15 00 00 00 01 00 02 1E 03
				15 00 00 00 01 00 02 1F 59
				15 00 00 00 01 00 02 20 03
				15 00 00 00 01 00 02 21 65
				15 00 00 00 01 00 02 22 03
				15 00 00 00 01 00 02 23 71
				15 00 00 00 01 00 02 24 03
				15 00 00 00 01 00 02 25 81
				15 00 00 00 01 00 02 26 03
				15 00 00 00 01 00 02 27 91
				15 00 00 00 01 00 02 28 03
				15 00 00 00 01 00 02 29 A5
				15 00 00 00 01 00 02 2A 03
				15 00 00 00 01 00 02 2B BB
				15 00 00 00 01 00 02 2D 03
				15 00 00 00 01 00 02 2F D3
				15 00 00 00 01 00 02 30 03
				15 00 00 00 01 00 02 31 D8
				15 00 00 00 01 00 02 32 00
				15 00 00 00 01 00 02 33 C6
				15 00 00 00 01 00 02 34 00
				15 00 00 00 01 00 02 35 D2
				15 00 00 00 01 00 02 36 00
				15 00 00 00 01 00 02 37 EC
				15 00 00 00 01 00 02 38 00
				15 00 00 00 01 00 02 39 FF
				15 00 00 00 01 00 02 3A 01
				15 00 00 00 01 00 02 3B 11
				15 00 00 00 01 00 02 3D 01
				15 00 00 00 01 00 02 3F 21
				15 00 00 00 01 00 02 40 01
				15 00 00 00 01 00 02 41 31
				15 00 00 00 01 00 02 42 01
				15 00 00 00 01 00 02 43 3E
				15 00 00 00 01 00 02 44 01
				15 00 00 00 01 00 02 45 4B
				15 00 00 00 01 00 02 46 01
				15 00 00 00 01 00 02 47 76
				15 00 00 00 01 00 02 48 01
				15 00 00 00 01 00 02 49 99
				15 00 00 00 01 00 02 4A 01
				15 00 00 00 01 00 02 4B CF
				15 00 00 00 01 00 02 4C 01
				15 00 00 00 01 00 02 4D F9
				15 00 00 00 01 00 02 4E 02
				15 00 00 00 01 00 02 4F 3B
				15 00 00 00 01 00 02 50 02
				15 00 00 00 01 00 02 51 6F
				15 00 00 00 01 00 02 52 02
				15 00 00 00 01 00 02 53 70
				15 00 00 00 01 00 02 54 02
				15 00 00 00 01 00 02 55 A3
				15 00 00 00 01 00 02 56 02
				15 00 00 00 01 00 02 58 D4
				15 00 00 00 01 00 02 59 02
				15 00 00 00 01 00 02 5A F1
				15 00 00 00 01 00 02 5B 03
				15 00 00 00 01 00 02 5C 18
				15 00 00 00 01 00 02 5D 03
				15 00 00 00 01 00 02 5E 35
				15 00 00 00 01 00 02 5F 03
				15 00 00 00 01 00 02 60 5C
				15 00 00 00 01 00 02 61 03
				15 00 00 00 01 00 02 62 68
				15 00 00 00 01 00 02 63 03
				15 00 00 00 01 00 02 64 74
				15 00 00 00 01 00 02 65 03
				15 00 00 00 01 00 02 66 82
				15 00 00 00 01 00 02 67 03
				15 00 00 00 01 00 02 68 92
				15 00 00 00 01 00 02 69 03
				15 00 00 00 01 00 02 6A A6
				15 00 00 00 01 00 02 6B 03
				15 00 00 00 01 00 02 6C BC
				15 00 00 00 01 00 02 6D 03
				15 00 00 00 01 00 02 6E D4
				15 00 00 00 01 00 02 6F 03
				15 00 00 00 01 00 02 70 D8
				15 00 00 00 01 00 02 71 01
				15 00 00 00 01 00 02 72 41
				15 00 00 00 01 00 02 73 01
				15 00 00 00 01 00 02 74 45
				15 00 00 00 01 00 02 75 01
				15 00 00 00 01 00 02 76 4E
				15 00 00 00 01 00 02 77 01
				15 00 00 00 01 00 02 78 56
				15 00 00 00 01 00 02 79 01
				15 00 00 00 01 00 02 7A 5F
				15 00 00 00 01 00 02 7B 01
				15 00 00 00 01 00 02 7C 65
				15 00 00 00 01 00 02 7D 01
				15 00 00 00 01 00 02 7E 6D
				15 00 00 00 01 00 02 7F 01
				15 00 00 00 01 00 02 80 73
				15 00 00 00 01 00 02 81 01
				15 00 00 00 01 00 02 82 7A
				15 00 00 00 01 00 02 83 01
				15 00 00 00 01 00 02 84 91
				15 00 00 00 01 00 02 85 01
				15 00 00 00 01 00 02 86 A5
				15 00 00 00 01 00 02 87 01
				15 00 00 00 01 00 02 88 C7
				15 00 00 00 01 00 02 89 01
				15 00 00 00 01 00 02 8A E5
				15 00 00 00 01 00 02 8B 02
				15 00 00 00 01 00 02 8C 16
				15 00 00 00 01 00 02 8D 02
				15 00 00 00 01 00 02 8E 43
				15 00 00 00 01 00 02 8F 02
				15 00 00 00 01 00 02 90 45
				15 00 00 00 01 00 02 91 02
				15 00 00 00 01 00 02 92 74
				15 00 00 00 01 00 02 93 02
				15 00 00 00 01 00 02 94 B6
				15 00 00 00 01 00 02 95 02
				15 00 00 00 01 00 02 96 E3
				15 00 00 00 01 00 02 97 03
				15 00 00 00 01 00 02 98 19
				15 00 00 00 01 00 02 99 03
				15 00 00 00 01 00 02 9A 38
				15 00 00 00 01 00 02 9B 03
				15 00 00 00 01 00 02 9C 60
				15 00 00 00 01 00 02 9D 03
				15 00 00 00 01 00 02 9E 6B
				15 00 00 00 01 00 02 9F 03
				15 00 00 00 01 00 02 A0 78
				15 00 00 00 01 00 02 A2 03
				15 00 00 00 01 00 02 A3 87
				15 00 00 00 01 00 02 A4 03
				15 00 00 00 01 00 02 A5 97
				15 00 00 00 01 00 02 A6 03
				15 00 00 00 01 00 02 A7 AA
				15 00 00 00 01 00 02 A9 03
				15 00 00 00 01 00 02 AA BE
				15 00 00 00 01 00 02 AB 03
				15 00 00 00 01 00 02 AC D2
				15 00 00 00 01 00 02 AD 03
				15 00 00 00 01 00 02 AE D8
				15 00 00 00 01 00 02 AF 01
				15 00 00 00 01 00 02 B0 5E
				15 00 00 00 01 00 02 B1 01
				15 00 00 00 01 00 02 B2 62
				15 00 00 00 01 00 02 B3 01
				15 00 00 00 01 00 02 B4 6D
				15 00 00 00 01 00 02 B5 01
				15 00 00 00 01 00 02 B6 75
				15 00 00 00 01 00 02 B7 01
				15 00 00 00 01 00 02 B8 7E
				15 00 00 00 01 00 02 B9 01
				15 00 00 00 01 00 02 BA 86
				15 00 00 00 01 00 02 BB 01
				15 00 00 00 01 00 02 BC 8E
				15 00 00 00 01 00 02 BD 01
				15 00 00 00 01 00 02 BE 95
				15 00 00 00 01 00 02 BF 01
				15 00 00 00 01 00 02 C0 9D
				15 00 00 00 01 00 02 C1 01
				15 00 00 00 01 00 02 C2 B6
				15 00 00 00 01 00 02 C3 01
				15 00 00 00 01 00 02 C4 CE
				15 00 00 00 01 00 02 C5 01
				15 00 00 00 01 00 02 C6 F5
				15 00 00 00 01 00 02 C7 02
				15 00 00 00 01 00 02 C8 18
				15 00 00 00 01 00 02 C9 02
				15 00 00 00 01 00 02 CA 51
				15 00 00 00 01 00 02 CB 02
				15 00 00 00 01 00 02 CC 7E
				15 00 00 00 01 00 02 CD 02
				15 00 00 00 01 00 02 CE 80
				15 00 00 00 01 00 02 CF 02
				15 00 00 00 01 00 02 D0 AF
				15 00 00 00 01 00 02 D1 02
				15 00 00 00 01 00 02 D2 DD
				15 00 00 00 01 00 02 D3 02
				15 00 00 00 01 00 02 D4 FA
				15 00 00 00 01 00 02 D5 03
				15 00 00 00 01 00 02 D6 20
				15 00 00 00 01 00 02 D7 03
				15 00 00 00 01 00 02 D8 3D
				15 00 00 00 01 00 02 D9 03
				15 00 00 00 01 00 02 DA 63
				15 00 00 00 01 00 02 DB 03
				15 00 00 00 01 00 02 DC 6E
				15 00 00 00 01 00 02 DD 03
				15 00 00 00 01 00 02 DE 7B
				15 00 00 00 01 00 02 DF 03
				15 00 00 00 01 00 02 E0 88
				15 00 00 00 01 00 02 E1 03
				15 00 00 00 01 00 02 E2 98
				15 00 00 00 01 00 02 E3 03
				15 00 00 00 01 00 02 E4 AB
				15 00 00 00 01 00 02 E5 03
				15 00 00 00 01 00 02 E6 BF
				15 00 00 00 01 00 02 E7 03
				15 00 00 00 01 00 02 E8 D3
				15 00 00 00 01 00 02 E9 03
				15 00 00 00 01 00 02 EA D8
				15 01 00 00 01 00 02 FF 10
				];
		qcom,mdss-dsi-dispparam-papermode1-command-state = "dsi_hs_mode";
		qcom,mdss-dsi-dispparam-papermode2-command = [
				15 01 00 00 01 00 02 FF 22
				15 00 00 00 01 00 02 FB 01
				15 00 00 00 01 00 02 FA 00
				15 01 00 00 01 00 02 FF 20
				15 00 00 00 01 00 02 FB 01
				15 00 00 00 01 00 02 75 00
				15 00 00 00 01 00 02 76 1D
				15 00 00 00 01 00 02 77 00
				15 00 00 00 01 00 02 78 38
				15 00 00 00 01 00 02 79 00
				15 00 00 00 01 00 02 7A 67
				15 00 00 00 01 00 02 7B 00
				15 00 00 00 01 00 02 7C 89
				15 00 00 00 01 00 02 7D 00
				15 00 00 00 01 00 02 7E A7
				15 00 00 00 01 00 02 7F 00
				15 00 00 00 01 00 02 80 BE
				15 00 00 00 01 00 02 81 00
				15 00 00 00 01 00 02 82 D3
				15 00 00 00 01 00 02 83 00
				15 00 00 00 01 00 02 84 E4
				15 00 00 00 01 00 02 85 00
				15 00 00 00 01 00 02 86 F4
				15 00 00 00 01 00 02 87 01
				15 00 00 00 01 00 02 88 2A
				15 00 00 00 01 00 02 89 01
				15 00 00 00 01 00 02 8A 51
				15 00 00 00 01 00 02 8B 01
				15 00 00 00 01 00 02 8C 8C
				15 00 00 00 01 00 02 8D 01
				15 00 00 00 01 00 02 8E B9
				15 00 00 00 01 00 02 8F 01
				15 00 00 00 01 00 02 90 FC
				15 00 00 00 01 00 02 91 02
				15 00 00 00 01 00 02 92 31
				15 00 00 00 01 00 02 93 02
				15 00 00 00 01 00 02 94 33
				15 00 00 00 01 00 02 95 02
				15 00 00 00 01 00 02 96 66
				15 00 00 00 01 00 02 97 02
				15 00 00 00 01 00 02 98 AB
				15 00 00 00 01 00 02 99 02
				15 00 00 00 01 00 02 9A D7
				15 00 00 00 01 00 02 9B 03
				15 00 00 00 01 00 02 9C 0F
				15 00 00 00 01 00 02 9D 03
				15 00 00 00 01 00 02 9E 2F
				15 00 00 00 01 00 02 9F 03
				15 00 00 00 01 00 02 A0 58
				15 00 00 00 01 00 02 A2 03
				15 00 00 00 01 00 02 A3 63
				15 00 00 00 01 00 02 A4 03
				15 00 00 00 01 00 02 A5 70
				15 00 00 00 01 00 02 A6 03
				15 00 00 00 01 00 02 A7 80
				15 00 00 00 01 00 02 A9 03
				15 00 00 00 01 00 02 AA 90
				15 00 00 00 01 00 02 AB 03
				15 00 00 00 01 00 02 AC A3
				15 00 00 00 01 00 02 AD 03
				15 00 00 00 01 00 02 AE BB
				15 00 00 00 01 00 02 AF 03
				15 00 00 00 01 00 02 B0 D2
				15 00 00 00 01 00 02 B1 03
				15 00 00 00 01 00 02 B2 D8
				15 00 00 00 01 00 02 B3 00
				15 00 00 00 01 00 02 B4 57
				15 00 00 00 01 00 02 B5 00
				15 00 00 00 01 00 02 B6 72
				15 00 00 00 01 00 02 B7 00
				15 00 00 00 01 00 02 B8 A1
				15 00 00 00 01 00 02 B9 00
				15 00 00 00 01 00 02 BA C4
				15 00 00 00 01 00 02 BB 00
				15 00 00 00 01 00 02 BC E1
				15 00 00 00 01 00 02 BD 00
				15 00 00 00 01 00 02 BE F9
				15 00 00 00 01 00 02 BF 01
				15 00 00 00 01 00 02 C0 0D
				15 00 00 00 01 00 02 C1 01
				15 00 00 00 01 00 02 C2 1F
				15 00 00 00 01 00 02 C3 01
				15 00 00 00 01 00 02 C4 2E
				15 00 00 00 01 00 02 C5 01
				15 00 00 00 01 00 02 C6 64
				15 00 00 00 01 00 02 C7 01
				15 00 00 00 01 00 02 C8 8C
				15 00 00 00 01 00 02 C9 01
				15 00 00 00 01 00 02 CA C7
				15 00 00 00 01 00 02 CB 01
				15 00 00 00 01 00 02 CC F4
				15 00 00 00 01 00 02 CD 02
				15 00 00 00 01 00 02 CE 37
				15 00 00 00 01 00 02 CF 02
				15 00 00 00 01 00 02 D0 6C
				15 00 00 00 01 00 02 D1 02
				15 00 00 00 01 00 02 D2 6E
				15 00 00 00 01 00 02 D3 02
				15 00 00 00 01 00 02 D4 A1
				15 00 00 00 01 00 02 D5 02
				15 00 00 00 01 00 02 D6 D2
				15 00 00 00 01 00 02 D7 02
				15 00 00 00 01 00 02 D8 EE
				15 00 00 00 01 00 02 D9 03
				15 00 00 00 01 00 02 DA 16
				15 00 00 00 01 00 02 DB 03
				15 00 00 00 01 00 02 DC 34
				15 00 00 00 01 00 02 DD 03
				15 00 00 00 01 00 02 DE 5B
				15 00 00 00 01 00 02 DF 03
				15 00 00 00 01 00 02 E0 66
				15 00 00 00 01 00 02 E1 03
				15 00 00 00 01 00 02 E2 73
				15 00 00 00 01 00 02 E3 03
				15 00 00 00 01 00 02 E4 81
				15 00 00 00 01 00 02 E5 03
				15 00 00 00 01 00 02 E6 91
				15 00 00 00 01 00 02 E7 03
				15 00 00 00 01 00 02 E8 A4
				15 00 00 00 01 00 02 E9 03
				15 00 00 00 01 00 02 EA BC
				15 00 00 00 01 00 02 EB 03
				15 00 00 00 01 00 02 EC D3
				15 00 00 00 01 00 02 ED 03
				15 00 00 00 01 00 02 EE D8
				15 00 00 00 01 00 02 EF 00
				15 00 00 00 01 00 02 F0 7D
				15 00 00 00 01 00 02 F1 00
				15 00 00 00 01 00 02 F2 8C
				15 00 00 00 01 00 02 F3 00
				15 00 00 00 01 00 02 F4 A7
				15 00 00 00 01 00 02 F5 00
				15 00 00 00 01 00 02 F6 BE
				15 00 00 00 01 00 02 F7 00
				15 00 00 00 01 00 02 F8 D3
				15 00 00 00 01 00 02 F9 00
				15 00 00 00 01 00 02 FA E5
				15 01 00 00 01 00 02 FF 21
				15 00 00 00 01 00 02 FB 01
				15 00 00 00 01 00 02 00 00
				15 00 00 00 01 00 02 01 F6
				15 00 00 00 01 00 02 02 01
				15 00 00 00 01 00 02 03 04
				15 00 00 00 01 00 02 04 01
				15 00 00 00 01 00 02 05 12
				15 00 00 00 01 00 02 06 01
				15 00 00 00 01 00 02 07 3E
				15 00 00 00 01 00 02 08 01
				15 00 00 00 01 00 02 09 61
				15 00 00 00 01 00 02 0A 01
				15 00 00 00 01 00 02 0B 96
				15 00 00 00 01 00 02 0C 01
				15 00 00 00 01 00 02 0D BF
				15 00 00 00 01 00 02 0E 01
				15 00 00 00 01 00 02 0F FE
				15 00 00 00 01 00 02 10 02
				15 00 00 00 01 00 02 11 32
				15 00 00 00 01 00 02 12 02
				15 00 00 00 01 00 02 13 34
				15 00 00 00 01 00 02 14 02
				15 00 00 00 01 00 02 15 66
				15 00 00 00 01 00 02 16 02
				15 00 00 00 01 00 02 17 AB
				15 00 00 00 01 00 02 18 02
				15 00 00 00 01 00 02 19 D7
				15 00 00 00 01 00 02 1A 03
				15 00 00 00 01 00 02 1B 0F
				15 00 00 00 01 00 02 1C 03
				15 00 00 00 01 00 02 1D 2F
				15 00 00 00 01 00 02 1E 03
				15 00 00 00 01 00 02 1F 58
				15 00 00 00 01 00 02 20 03
				15 00 00 00 01 00 02 21 64
				15 00 00 00 01 00 02 22 03
				15 00 00 00 01 00 02 23 71
				15 00 00 00 01 00 02 24 03
				15 00 00 00 01 00 02 25 80
				15 00 00 00 01 00 02 26 03
				15 00 00 00 01 00 02 27 91
				15 00 00 00 01 00 02 28 03
				15 00 00 00 01 00 02 29 A3
				15 00 00 00 01 00 02 2A 03
				15 00 00 00 01 00 02 2B BA
				15 00 00 00 01 00 02 2D 03
				15 00 00 00 01 00 02 2F D2
				15 00 00 00 01 00 02 30 03
				15 00 00 00 01 00 02 31 D8
				15 00 00 00 01 00 02 32 00
				15 00 00 00 01 00 02 33 A8
				15 00 00 00 01 00 02 34 00
				15 00 00 00 01 00 02 35 B8
				15 00 00 00 01 00 02 36 00
				15 00 00 00 01 00 02 37 D4
				15 00 00 00 01 00 02 38 00
				15 00 00 00 01 00 02 39 EB
				15 00 00 00 01 00 02 3A 01
				15 00 00 00 01 00 02 3B 00
				15 00 00 00 01 00 02 3D 01
				15 00 00 00 01 00 02 3F 13
				15 00 00 00 01 00 02 40 01
				15 00 00 00 01 00 02 41 23
				15 00 00 00 01 00 02 42 01
				15 00 00 00 01 00 02 43 32
				15 00 00 00 01 00 02 44 01
				15 00 00 00 01 00 02 45 40
				15 00 00 00 01 00 02 46 01
				15 00 00 00 01 00 02 47 6E
				15 00 00 00 01 00 02 48 01
				15 00 00 00 01 00 02 49 92
				15 00 00 00 01 00 02 4A 01
				15 00 00 00 01 00 02 4B CA
				15 00 00 00 01 00 02 4C 01
				15 00 00 00 01 00 02 4D F6
				15 00 00 00 01 00 02 4E 02
				15 00 00 00 01 00 02 4F 39
				15 00 00 00 01 00 02 50 02
				15 00 00 00 01 00 02 51 6D
				15 00 00 00 01 00 02 52 02
				15 00 00 00 01 00 02 53 6F
				15 00 00 00 01 00 02 54 02
				15 00 00 00 01 00 02 55 A1
				15 00 00 00 01 00 02 56 02
				15 00 00 00 01 00 02 58 D2
				15 00 00 00 01 00 02 59 02
				15 00 00 00 01 00 02 5A EE
				15 00 00 00 01 00 02 5B 03
				15 00 00 00 01 00 02 5C 16
				15 00 00 00 01 00 02 5D 03
				15 00 00 00 01 00 02 5E 34
				15 00 00 00 01 00 02 5F 03
				15 00 00 00 01 00 02 60 5B
				15 00 00 00 01 00 02 61 03
				15 00 00 00 01 00 02 62 67
				15 00 00 00 01 00 02 63 03
				15 00 00 00 01 00 02 64 74
				15 00 00 00 01 00 02 65 03
				15 00 00 00 01 00 02 66 82
				15 00 00 00 01 00 02 67 03
				15 00 00 00 01 00 02 68 92
				15 00 00 00 01 00 02 69 03
				15 00 00 00 01 00 02 6A A4
				15 00 00 00 01 00 02 6B 03
				15 00 00 00 01 00 02 6C BB
				15 00 00 00 01 00 02 6D 03
				15 00 00 00 01 00 02 6E D3
				15 00 00 00 01 00 02 6F 03
				15 00 00 00 01 00 02 70 D8
				15 00 00 00 01 00 02 71 01
				15 00 00 00 01 00 02 72 74
				15 00 00 00 01 00 02 73 01
				15 00 00 00 01 00 02 74 77
				15 00 00 00 01 00 02 75 01
				15 00 00 00 01 00 02 76 7D
				15 00 00 00 01 00 02 77 01
				15 00 00 00 01 00 02 78 83
				15 00 00 00 01 00 02 79 01
				15 00 00 00 01 00 02 7A 88
				15 00 00 00 01 00 02 7B 01
				15 00 00 00 01 00 02 7C 8E
				15 00 00 00 01 00 02 7D 01
				15 00 00 00 01 00 02 7E 93
				15 00 00 00 01 00 02 7F 01
				15 00 00 00 01 00 02 80 98
				15 00 00 00 01 00 02 81 01
				15 00 00 00 01 00 02 82 9D
				15 00 00 00 01 00 02 83 01
				15 00 00 00 01 00 02 84 AF
				15 00 00 00 01 00 02 85 01
				15 00 00 00 01 00 02 86 C0
				15 00 00 00 01 00 02 87 01
				15 00 00 00 01 00 02 88 DC
				15 00 00 00 01 00 02 89 01
				15 00 00 00 01 00 02 8A F5
				15 00 00 00 01 00 02 8B 02
				15 00 00 00 01 00 02 8C 21
				15 00 00 00 01 00 02 8D 02
				15 00 00 00 01 00 02 8E 4C
				15 00 00 00 01 00 02 8F 02
				15 00 00 00 01 00 02 90 4E
				15 00 00 00 01 00 02 91 02
				15 00 00 00 01 00 02 92 7B
				15 00 00 00 01 00 02 93 02
				15 00 00 00 01 00 02 94 BC
				15 00 00 00 01 00 02 95 02
				15 00 00 00 01 00 02 96 E8
				15 00 00 00 01 00 02 97 03
				15 00 00 00 01 00 02 98 1E
				15 00 00 00 01 00 02 99 03
				15 00 00 00 01 00 02 9A 3D
				15 00 00 00 01 00 02 9B 03
				15 00 00 00 01 00 02 9C 63
				15 00 00 00 01 00 02 9D 03
				15 00 00 00 01 00 02 9E 6F
				15 00 00 00 01 00 02 9F 03
				15 00 00 00 01 00 02 A0 7C
				15 00 00 00 01 00 02 A2 03
				15 00 00 00 01 00 02 A3 8A
				15 00 00 00 01 00 02 A4 03
				15 00 00 00 01 00 02 A5 9A
				15 00 00 00 01 00 02 A6 03
				15 00 00 00 01 00 02 A7 AC
				15 00 00 00 01 00 02 A9 03
				15 00 00 00 01 00 02 AA BF
				15 00 00 00 01 00 02 AB 03
				15 00 00 00 01 00 02 AC D2
				15 00 00 00 01 00 02 AD 03
				15 00 00 00 01 00 02 AE D8
				15 00 00 00 01 00 02 AF 01
				15 00 00 00 01 00 02 B0 93
				15 00 00 00 01 00 02 B1 01
				15 00 00 00 01 00 02 B2 97
				15 00 00 00 01 00 02 B3 01
				15 00 00 00 01 00 02 B4 9E
				15 00 00 00 01 00 02 B5 01
				15 00 00 00 01 00 02 B6 A4
				15 00 00 00 01 00 02 B7 01
				15 00 00 00 01 00 02 B8 AA
				15 00 00 00 01 00 02 B9 01
				15 00 00 00 01 00 02 BA B0
				15 00 00 00 01 00 02 BB 01
				15 00 00 00 01 00 02 BC B6
				15 00 00 00 01 00 02 BD 01
				15 00 00 00 01 00 02 BE BC
				15 00 00 00 01 00 02 BF 01
				15 00 00 00 01 00 02 C0 C2
				15 00 00 00 01 00 02 C1 01
				15 00 00 00 01 00 02 C2 D6
				15 00 00 00 01 00 02 C3 01
				15 00 00 00 01 00 02 C4 EA
				15 00 00 00 01 00 02 C5 02
				15 00 00 00 01 00 02 C6 0B
				15 00 00 00 01 00 02 C7 02
				15 00 00 00 01 00 02 C8 29
				15 00 00 00 01 00 02 C9 02
				15 00 00 00 01 00 02 CA 5C
				15 00 00 00 01 00 02 CB 02
				15 00 00 00 01 00 02 CC 87
				15 00 00 00 01 00 02 CD 02
				15 00 00 00 01 00 02 CE 89
				15 00 00 00 01 00 02 CF 02
				15 00 00 00 01 00 02 D0 B7
				15 00 00 00 01 00 02 D1 02
				15 00 00 00 01 00 02 D2 E3
				15 00 00 00 01 00 02 D3 02
				15 00 00 00 01 00 02 D4 FF
				15 00 00 00 01 00 02 D5 03
				15 00 00 00 01 00 02 D6 25
				15 00 00 00 01 00 02 D7 03
				15 00 00 00 01 00 02 D8 42
				15 00 00 00 01 00 02 D9 03
				15 00 00 00 01 00 02 DA 67
				15 00 00 00 01 00 02 DB 03
				15 00 00 00 01 00 02 DC 72
				15 00 00 00 01 00 02 DD 03
				15 00 00 00 01 00 02 DE 7E
				15 00 00 00 01 00 02 DF 03
				15 00 00 00 01 00 02 E0 8C
				15 00 00 00 01 00 02 E1 03
				15 00 00 00 01 00 02 E2 9B
				15 00 00 00 01 00 02 E3 03
				15 00 00 00 01 00 02 E4 AC
				15 00 00 00 01 00 02 E5 03
				15 00 00 00 01 00 02 E6 C0
				15 00 00 00 01 00 02 E7 03
				15 00 00 00 01 00 02 E8 D3
				15 00 00 00 01 00 02 E9 03
				15 00 00 00 01 00 02 EA D8
				15 01 00 00 01 00 02 FF 10
				];
		qcom,mdss-dsi-dispparam-papermode2-command-state = "dsi_hs_mode";
		qcom,mdss-dsi-dispparam-papermode3-command = [
				15 01 00 00 01 00 02 FF 22
				15 00 00 00 01 00 02 FB 01
				15 00 00 00 01 00 02 FA 00
				15 01 00 00 01 00 02 FF 20
				15 00 00 00 01 00 02 FB 01
				15 00 00 00 01 00 02 75 00
				15 00 00 00 01 00 02 76 1D
				15 00 00 00 01 00 02 77 00
				15 00 00 00 01 00 02 78 38
				15 00 00 00 01 00 02 79 00
				15 00 00 00 01 00 02 7A 67
				15 00 00 00 01 00 02 7B 00
				15 00 00 00 01 00 02 7C 89
				15 00 00 00 01 00 02 7D 00
				15 00 00 00 01 00 02 7E A7
				15 00 00 00 01 00 02 7F 00
				15 00 00 00 01 00 02 80 BE
				15 00 00 00 01 00 02 81 00
				15 00 00 00 01 00 02 82 D3
				15 00 00 00 01 00 02 83 00
				15 00 00 00 01 00 02 84 E4
				15 00 00 00 01 00 02 85 00
				15 00 00 00 01 00 02 86 F4
				15 00 00 00 01 00 02 87 01
				15 00 00 00 01 00 02 88 2A
				15 00 00 00 01 00 02 89 01
				15 00 00 00 01 00 02 8A 51
				15 00 00 00 01 00 02 8B 01
				15 00 00 00 01 00 02 8C 8C
				15 00 00 00 01 00 02 8D 01
				15 00 00 00 01 00 02 8E B9
				15 00 00 00 01 00 02 8F 01
				15 00 00 00 01 00 02 90 FC
				15 00 00 00 01 00 02 91 02
				15 00 00 00 01 00 02 92 31
				15 00 00 00 01 00 02 93 02
				15 00 00 00 01 00 02 94 33
				15 00 00 00 01 00 02 95 02
				15 00 00 00 01 00 02 96 66
				15 00 00 00 01 00 02 97 02
				15 00 00 00 01 00 02 98 AB
				15 00 00 00 01 00 02 99 02
				15 00 00 00 01 00 02 9A D7
				15 00 00 00 01 00 02 9B 03
				15 00 00 00 01 00 02 9C 0F
				15 00 00 00 01 00 02 9D 03
				15 00 00 00 01 00 02 9E 2F
				15 00 00 00 01 00 02 9F 03
				15 00 00 00 01 00 02 A0 58
				15 00 00 00 01 00 02 A2 03
				15 00 00 00 01 00 02 A3 63
				15 00 00 00 01 00 02 A4 03
				15 00 00 00 01 00 02 A5 70
				15 00 00 00 01 00 02 A6 03
				15 00 00 00 01 00 02 A7 80
				15 00 00 00 01 00 02 A9 03
				15 00 00 00 01 00 02 AA 90
				15 00 00 00 01 00 02 AB 03
				15 00 00 00 01 00 02 AC A3
				15 00 00 00 01 00 02 AD 03
				15 00 00 00 01 00 02 AE BB
				15 00 00 00 01 00 02 AF 03
				15 00 00 00 01 00 02 B0 D2
				15 00 00 00 01 00 02 B1 03
				15 00 00 00 01 00 02 B2 D8
				15 00 00 00 01 00 02 B3 00
				15 00 00 00 01 00 02 B4 57
				15 00 00 00 01 00 02 B5 00
				15 00 00 00 01 00 02 B6 72
				15 00 00 00 01 00 02 B7 00
				15 00 00 00 01 00 02 B8 A1
				15 00 00 00 01 00 02 B9 00
				15 00 00 00 01 00 02 BA C4
				15 00 00 00 01 00 02 BB 00
				15 00 00 00 01 00 02 BC E1
				15 00 00 00 01 00 02 BD 00
				15 00 00 00 01 00 02 BE F9
				15 00 00 00 01 00 02 BF 01
				15 00 00 00 01 00 02 C0 0D
				15 00 00 00 01 00 02 C1 01
				15 00 00 00 01 00 02 C2 1F
				15 00 00 00 01 00 02 C3 01
				15 00 00 00 01 00 02 C4 2E
				15 00 00 00 01 00 02 C5 01
				15 00 00 00 01 00 02 C6 64
				15 00 00 00 01 00 02 C7 01
				15 00 00 00 01 00 02 C8 8C
				15 00 00 00 01 00 02 C9 01
				15 00 00 00 01 00 02 CA C7
				15 00 00 00 01 00 02 CB 01
				15 00 00 00 01 00 02 CC F4
				15 00 00 00 01 00 02 CD 02
				15 00 00 00 01 00 02 CE 37
				15 00 00 00 01 00 02 CF 02
				15 00 00 00 01 00 02 D0 6C
				15 00 00 00 01 00 02 D1 02
				15 00 00 00 01 00 02 D2 6E
				15 00 00 00 01 00 02 D3 02
				15 00 00 00 01 00 02 D4 A1
				15 00 00 00 01 00 02 D5 02
				15 00 00 00 01 00 02 D6 D2
				15 00 00 00 01 00 02 D7 02
				15 00 00 00 01 00 02 D8 EE
				15 00 00 00 01 00 02 D9 03
				15 00 00 00 01 00 02 DA 16
				15 00 00 00 01 00 02 DB 03
				15 00 00 00 01 00 02 DC 34
				15 00 00 00 01 00 02 DD 03
				15 00 00 00 01 00 02 DE 5B
				15 00 00 00 01 00 02 DF 03
				15 00 00 00 01 00 02 E0 66
				15 00 00 00 01 00 02 E1 03
				15 00 00 00 01 00 02 E2 73
				15 00 00 00 01 00 02 E3 03
				15 00 00 00 01 00 02 E4 81
				15 00 00 00 01 00 02 E5 03
				15 00 00 00 01 00 02 E6 91
				15 00 00 00 01 00 02 E7 03
				15 00 00 00 01 00 02 E8 A4
				15 00 00 00 01 00 02 E9 03
				15 00 00 00 01 00 02 EA BC
				15 00 00 00 01 00 02 EB 03
				15 00 00 00 01 00 02 EC D3
				15 00 00 00 01 00 02 ED 03
				15 00 00 00 01 00 02 EE D8
				15 00 00 00 01 00 02 EF 00
				15 00 00 00 01 00 02 F0 93
				15 00 00 00 01 00 02 F1 00
				15 00 00 00 01 00 02 F2 A2
				15 00 00 00 01 00 02 F3 00
				15 00 00 00 01 00 02 F4 BA
				15 00 00 00 01 00 02 F5 00
				15 00 00 00 01 00 02 F6 D0
				15 00 00 00 01 00 02 F7 00
				15 00 00 00 01 00 02 F8 E2
				15 00 00 00 01 00 02 F9 00
				15 00 00 00 01 00 02 FA F4
				15 01 00 00 01 00 02 FF 21
				15 00 00 00 01 00 02 FB 01
				15 00 00 00 01 00 02 00 01
				15 00 00 00 01 00 02 01 02
				15 00 00 00 01 00 02 02 01
				15 00 00 00 01 00 02 03 10
				15 00 00 00 01 00 02 04 01
				15 00 00 00 01 00 02 05 1D
				15 00 00 00 01 00 02 06 01
				15 00 00 00 01 00 02 07 48
				15 00 00 00 01 00 02 08 01
				15 00 00 00 01 00 02 09 68
				15 00 00 00 01 00 02 0A 01
				15 00 00 00 01 00 02 0B 9D
				15 00 00 00 01 00 02 0C 01
				15 00 00 00 01 00 02 0D C4
				15 00 00 00 01 00 02 0E 02
				15 00 00 00 01 00 02 0F 02
				15 00 00 00 01 00 02 10 02
				15 00 00 00 01 00 02 11 36
				15 00 00 00 01 00 02 12 02
				15 00 00 00 01 00 02 13 38
				15 00 00 00 01 00 02 14 02
				15 00 00 00 01 00 02 15 6B
				15 00 00 00 01 00 02 16 02
				15 00 00 00 01 00 02 17 AD
				15 00 00 00 01 00 02 18 02
				15 00 00 00 01 00 02 19 DA
				15 00 00 00 01 00 02 1A 03
				15 00 00 00 01 00 02 1B 12
				15 00 00 00 01 00 02 1C 03
				15 00 00 00 01 00 02 1D 31
				15 00 00 00 01 00 02 1E 03
				15 00 00 00 01 00 02 1F 5A
				15 00 00 00 01 00 02 20 03
				15 00 00 00 01 00 02 21 66
				15 00 00 00 01 00 02 22 03
				15 00 00 00 01 00 02 23 72
				15 00 00 00 01 00 02 24 03
				15 00 00 00 01 00 02 25 81
				15 00 00 00 01 00 02 26 03
				15 00 00 00 01 00 02 27 92
				15 00 00 00 01 00 02 28 03
				15 00 00 00 01 00 02 29 A5
				15 00 00 00 01 00 02 2A 03
				15 00 00 00 01 00 02 2B BB
				15 00 00 00 01 00 02 2D 03
				15 00 00 00 01 00 02 2F D3
				15 00 00 00 01 00 02 30 03
				15 00 00 00 01 00 02 31 D8
				15 00 00 00 01 00 02 32 00
				15 00 00 00 01 00 02 33 BC
				15 00 00 00 01 00 02 34 00
				15 00 00 00 01 00 02 35 CA
				15 00 00 00 01 00 02 36 00
				15 00 00 00 01 00 02 37 E3
				15 00 00 00 01 00 02 38 00
				15 00 00 00 01 00 02 39 F9
				15 00 00 00 01 00 02 3A 01
				15 00 00 00 01 00 02 3B 0C
				15 00 00 00 01 00 02 3D 01
				15 00 00 00 01 00 02 3F 1E
				15 00 00 00 01 00 02 40 01
				15 00 00 00 01 00 02 41 2D
				15 00 00 00 01 00 02 42 01
				15 00 00 00 01 00 02 43 3B
				15 00 00 00 01 00 02 44 01
				15 00 00 00 01 00 02 45 48
				15 00 00 00 01 00 02 46 01
				15 00 00 00 01 00 02 47 75
				15 00 00 00 01 00 02 48 01
				15 00 00 00 01 00 02 49 98
				15 00 00 00 01 00 02 4A 01
				15 00 00 00 01 00 02 4B D0
				15 00 00 00 01 00 02 4C 01
				15 00 00 00 01 00 02 4D FA
				15 00 00 00 01 00 02 4E 02
				15 00 00 00 01 00 02 4F 3D
				15 00 00 00 01 00 02 50 02
				15 00 00 00 01 00 02 51 71
				15 00 00 00 01 00 02 52 02
				15 00 00 00 01 00 02 53 73
				15 00 00 00 01 00 02 54 02
				15 00 00 00 01 00 02 55 A6
				15 00 00 00 01 00 02 56 02
				15 00 00 00 01 00 02 58 D4
				15 00 00 00 01 00 02 59 02
				15 00 00 00 01 00 02 5A F1
				15 00 00 00 01 00 02 5B 03
				15 00 00 00 01 00 02 5C 18
				15 00 00 00 01 00 02 5D 03
				15 00 00 00 01 00 02 5E 36
				15 00 00 00 01 00 02 5F 03
				15 00 00 00 01 00 02 60 5E
				15 00 00 00 01 00 02 61 03
				15 00 00 00 01 00 02 62 69
				15 00 00 00 01 00 02 63 03
				15 00 00 00 01 00 02 64 75
				15 00 00 00 01 00 02 65 03
				15 00 00 00 01 00 02 66 83
				15 00 00 00 01 00 02 67 03
				15 00 00 00 01 00 02 68 93
				15 00 00 00 01 00 02 69 03
				15 00 00 00 01 00 02 6A A6
				15 00 00 00 01 00 02 6B 03
				15 00 00 00 01 00 02 6C BC
				15 00 00 00 01 00 02 6D 03
				15 00 00 00 01 00 02 6E D4
				15 00 00 00 01 00 02 6F 03
				15 00 00 00 01 00 02 70 D8
				15 00 00 00 01 00 02 71 01
				15 00 00 00 01 00 02 72 A0
				15 00 00 00 01 00 02 73 01
				15 00 00 00 01 00 02 74 A3
				15 00 00 00 01 00 02 75 01
				15 00 00 00 01 00 02 76 A8
				15 00 00 00 01 00 02 77 01
				15 00 00 00 01 00 02 78 AC
				15 00 00 00 01 00 02 79 01
				15 00 00 00 01 00 02 7A B0
				15 00 00 00 01 00 02 7B 01
				15 00 00 00 01 00 02 7C B4
				15 00 00 00 01 00 02 7D 01
				15 00 00 00 01 00 02 7E B8
				15 00 00 00 01 00 02 7F 01
				15 00 00 00 01 00 02 80 BC
				15 00 00 00 01 00 02 81 01
				15 00 00 00 01 00 02 82 C0
				15 00 00 00 01 00 02 83 01
				15 00 00 00 01 00 02 84 CE
				15 00 00 00 01 00 02 85 01
				15 00 00 00 01 00 02 86 DB
				15 00 00 00 01 00 02 87 01
				15 00 00 00 01 00 02 88 F4
				15 00 00 00 01 00 02 89 02
				15 00 00 00 01 00 02 8A 09
				15 00 00 00 01 00 02 8B 02
				15 00 00 00 01 00 02 8C 30
				15 00 00 00 01 00 02 8D 02
				15 00 00 00 01 00 02 8E 59
				15 00 00 00 01 00 02 8F 02
				15 00 00 00 01 00 02 90 5A
				15 00 00 00 01 00 02 91 02
				15 00 00 00 01 00 02 92 86
				15 00 00 00 01 00 02 93 02
				15 00 00 00 01 00 02 94 C6
				15 00 00 00 01 00 02 95 02
				15 00 00 00 01 00 02 96 F2
				15 00 00 00 01 00 02 97 03
				15 00 00 00 01 00 02 98 26
				15 00 00 00 01 00 02 99 03
				15 00 00 00 01 00 02 9A 45
				15 00 00 00 01 00 02 9B 03
				15 00 00 00 01 00 02 9C 6A
				15 00 00 00 01 00 02 9D 03
				15 00 00 00 01 00 02 9E 76
				15 00 00 00 01 00 02 9F 03
				15 00 00 00 01 00 02 A0 81
				15 00 00 00 01 00 02 A2 03
				15 00 00 00 01 00 02 A3 8F
				15 00 00 00 01 00 02 A4 03
				15 00 00 00 01 00 02 A5 9E
				15 00 00 00 01 00 02 A6 03
				15 00 00 00 01 00 02 A7 AF
				15 00 00 00 01 00 02 A9 03
				15 00 00 00 01 00 02 AA C2
				15 00 00 00 01 00 02 AB 03
				15 00 00 00 01 00 02 AC D4
				15 00 00 00 01 00 02 AD 03
				15 00 00 00 01 00 02 AE D8
				15 00 00 00 01 00 02 AF 01
				15 00 00 00 01 00 02 B0 C3
				15 00 00 00 01 00 02 B1 01
				15 00 00 00 01 00 02 B2 C5
				15 00 00 00 01 00 02 B3 01
				15 00 00 00 01 00 02 B4 CB
				15 00 00 00 01 00 02 B5 01
				15 00 00 00 01 00 02 B6 CF
				15 00 00 00 01 00 02 B7 01
				15 00 00 00 01 00 02 B8 D4
				15 00 00 00 01 00 02 B9 01
				15 00 00 00 01 00 02 BA D8
				15 00 00 00 01 00 02 BB 01
				15 00 00 00 01 00 02 BC DE
				15 00 00 00 01 00 02 BD 01
				15 00 00 00 01 00 02 BE E2
				15 00 00 00 01 00 02 BF 01
				15 00 00 00 01 00 02 C0 E6
				15 00 00 00 01 00 02 C1 01
				15 00 00 00 01 00 02 C2 F7
				15 00 00 00 01 00 02 C3 02
				15 00 00 00 01 00 02 C4 06
				15 00 00 00 01 00 02 C5 02
				15 00 00 00 01 00 02 C6 24
				15 00 00 00 01 00 02 C7 02
				15 00 00 00 01 00 02 C8 3E
				15 00 00 00 01 00 02 C9 02
				15 00 00 00 01 00 02 CA 6B
				15 00 00 00 01 00 02 CB 02
				15 00 00 00 01 00 02 CC 94
				15 00 00 00 01 00 02 CD 02
				15 00 00 00 01 00 02 CE 95
				15 00 00 00 01 00 02 CF 02
				15 00 00 00 01 00 02 D0 C1
				15 00 00 00 01 00 02 D1 02
				15 00 00 00 01 00 02 D2 ED
				15 00 00 00 01 00 02 D3 03
				15 00 00 00 01 00 02 D4 09
				15 00 00 00 01 00 02 D5 03
				15 00 00 00 01 00 02 D6 2C
				15 00 00 00 01 00 02 D7 03
				15 00 00 00 01 00 02 D8 4A
				15 00 00 00 01 00 02 D9 03
				15 00 00 00 01 00 02 DA 6D
				15 00 00 00 01 00 02 DB 03
				15 00 00 00 01 00 02 DC 79
				15 00 00 00 01 00 02 DD 03
				15 00 00 00 01 00 02 DE 83
				15 00 00 00 01 00 02 DF 03
				15 00 00 00 01 00 02 E0 91
				15 00 00 00 01 00 02 E1 03
				15 00 00 00 01 00 02 E2 9F
				15 00 00 00 01 00 02 E3 03
				15 00 00 00 01 00 02 E4 B0
				15 00 00 00 01 00 02 E5 03
				15 00 00 00 01 00 02 E6 C3
				15 00 00 00 01 00 02 E7 03
				15 00 00 00 01 00 02 E8 D4
				15 00 00 00 01 00 02 E9 03
				15 00 00 00 01 00 02 EA D8
				15 01 00 00 01 00 02 FF 10
				];
		qcom,mdss-dsi-dispparam-papermode3-command-state = "dsi_hs_mode";
		qcom,mdss-dsi-dispparam-papermode4-command = [
				15 01 00 00 01 00 02 FF 22
				15 00 00 00 01 00 02 FB 01
				15 00 00 00 01 00 02 FA 00
				15 01 00 00 01 00 02 FF 20
				15 00 00 00 01 00 02 FB 01
				15 00 00 00 01 00 02 75 00
				15 00 00 00 01 00 02 76 1D
				15 00 00 00 01 00 02 77 00
				15 00 00 00 01 00 02 78 38
				15 00 00 00 01 00 02 79 00
				15 00 00 00 01 00 02 7A 67
				15 00 00 00 01 00 02 7B 00
				15 00 00 00 01 00 02 7C 89
				15 00 00 00 01 00 02 7D 00
				15 00 00 00 01 00 02 7E A7
				15 00 00 00 01 00 02 7F 00
				15 00 00 00 01 00 02 80 BE
				15 00 00 00 01 00 02 81 00
				15 00 00 00 01 00 02 82 D3
				15 00 00 00 01 00 02 83 00
				15 00 00 00 01 00 02 84 E4
				15 00 00 00 01 00 02 85 00
				15 00 00 00 01 00 02 86 F4
				15 00 00 00 01 00 02 87 01
				15 00 00 00 01 00 02 88 2A
				15 00 00 00 01 00 02 89 01
				15 00 00 00 01 00 02 8A 51
				15 00 00 00 01 00 02 8B 01
				15 00 00 00 01 00 02 8C 8C
				15 00 00 00 01 00 02 8D 01
				15 00 00 00 01 00 02 8E B9
				15 00 00 00 01 00 02 8F 01
				15 00 00 00 01 00 02 90 FC
				15 00 00 00 01 00 02 91 02
				15 00 00 00 01 00 02 92 31
				15 00 00 00 01 00 02 93 02
				15 00 00 00 01 00 02 94 33
				15 00 00 00 01 00 02 95 02
				15 00 00 00 01 00 02 96 66
				15 00 00 00 01 00 02 97 02
				15 00 00 00 01 00 02 98 AB
				15 00 00 00 01 00 02 99 02
				15 00 00 00 01 00 02 9A D7
				15 00 00 00 01 00 02 9B 03
				15 00 00 00 01 00 02 9C 0F
				15 00 00 00 01 00 02 9D 03
				15 00 00 00 01 00 02 9E 2F
				15 00 00 00 01 00 02 9F 03
				15 00 00 00 01 00 02 A0 58
				15 00 00 00 01 00 02 A2 03
				15 00 00 00 01 00 02 A3 63
				15 00 00 00 01 00 02 A4 03
				15 00 00 00 01 00 02 A5 70
				15 00 00 00 01 00 02 A6 03
				15 00 00 00 01 00 02 A7 80
				15 00 00 00 01 00 02 A9 03
				15 00 00 00 01 00 02 AA 90
				15 00 00 00 01 00 02 AB 03
				15 00 00 00 01 00 02 AC A3
				15 00 00 00 01 00 02 AD 03
				15 00 00 00 01 00 02 AE BB
				15 00 00 00 01 00 02 AF 03
				15 00 00 00 01 00 02 B0 D2
				15 00 00 00 01 00 02 B1 03
				15 00 00 00 01 00 02 B2 D8
				15 00 00 00 01 00 02 B3 00
				15 00 00 00 01 00 02 B4 57
				15 00 00 00 01 00 02 B5 00
				15 00 00 00 01 00 02 B6 72
				15 00 00 00 01 00 02 B7 00
				15 00 00 00 01 00 02 B8 A1
				15 00 00 00 01 00 02 B9 00
				15 00 00 00 01 00 02 BA C4
				15 00 00 00 01 00 02 BB 00
				15 00 00 00 01 00 02 BC E1
				15 00 00 00 01 00 02 BD 00
				15 00 00 00 01 00 02 BE F9
				15 00 00 00 01 00 02 BF 01
				15 00 00 00 01 00 02 C0 0D
				15 00 00 00 01 00 02 C1 01
				15 00 00 00 01 00 02 C2 1F
				15 00 00 00 01 00 02 C3 01
				15 00 00 00 01 00 02 C4 2E
				15 00 00 00 01 00 02 C5 01
				15 00 00 00 01 00 02 C6 64
				15 00 00 00 01 00 02 C7 01
				15 00 00 00 01 00 02 C8 8C
				15 00 00 00 01 00 02 C9 01
				15 00 00 00 01 00 02 CA C7
				15 00 00 00 01 00 02 CB 01
				15 00 00 00 01 00 02 CC F4
				15 00 00 00 01 00 02 CD 02
				15 00 00 00 01 00 02 CE 37
				15 00 00 00 01 00 02 CF 02
				15 00 00 00 01 00 02 D0 6C
				15 00 00 00 01 00 02 D1 02
				15 00 00 00 01 00 02 D2 6E
				15 00 00 00 01 00 02 D3 02
				15 00 00 00 01 00 02 D4 A1
				15 00 00 00 01 00 02 D5 02
				15 00 00 00 01 00 02 D6 D2
				15 00 00 00 01 00 02 D7 02
				15 00 00 00 01 00 02 D8 EE
				15 00 00 00 01 00 02 D9 03
				15 00 00 00 01 00 02 DA 16
				15 00 00 00 01 00 02 DB 03
				15 00 00 00 01 00 02 DC 34
				15 00 00 00 01 00 02 DD 03
				15 00 00 00 01 00 02 DE 5B
				15 00 00 00 01 00 02 DF 03
				15 00 00 00 01 00 02 E0 66
				15 00 00 00 01 00 02 E1 03
				15 00 00 00 01 00 02 E2 73
				15 00 00 00 01 00 02 E3 03
				15 00 00 00 01 00 02 E4 81
				15 00 00 00 01 00 02 E5 03
				15 00 00 00 01 00 02 E6 91
				15 00 00 00 01 00 02 E7 03
				15 00 00 00 01 00 02 E8 A4
				15 00 00 00 01 00 02 E9 03
				15 00 00 00 01 00 02 EA BC
				15 00 00 00 01 00 02 EB 03
				15 00 00 00 01 00 02 EC D3
				15 00 00 00 01 00 02 ED 03
				15 00 00 00 01 00 02 EE D8
				15 00 00 00 01 00 02 EF 00
				15 00 00 00 01 00 02 F0 97
				15 00 00 00 01 00 02 F1 00
				15 00 00 00 01 00 02 F2 A5
				15 00 00 00 01 00 02 F3 00
				15 00 00 00 01 00 02 F4 BD
				15 00 00 00 01 00 02 F5 00
				15 00 00 00 01 00 02 F6 D2
				15 00 00 00 01 00 02 F7 00
				15 00 00 00 01 00 02 F8 E4
				15 00 00 00 01 00 02 F9 00
				15 00 00 00 01 00 02 FA F4
				15 01 00 00 01 00 02 FF 21
				15 00 00 00 01 00 02 FB 01
				15 00 00 00 01 00 02 00 01
				15 00 00 00 01 00 02 01 02
				15 00 00 00 01 00 02 02 01
				15 00 00 00 01 00 02 03 10
				15 00 00 00 01 00 02 04 01
				15 00 00 00 01 00 02 05 1D
				15 00 00 00 01 00 02 06 01
				15 00 00 00 01 00 02 07 48
				15 00 00 00 01 00 02 08 01
				15 00 00 00 01 00 02 09 69
				15 00 00 00 01 00 02 0A 01
				15 00 00 00 01 00 02 0B 9C
				15 00 00 00 01 00 02 0C 01
				15 00 00 00 01 00 02 0D C4
				15 00 00 00 01 00 02 0E 02
				15 00 00 00 01 00 02 0F 01
				15 00 00 00 01 00 02 10 02
				15 00 00 00 01 00 02 11 34
				15 00 00 00 01 00 02 12 02
				15 00 00 00 01 00 02 13 36
				15 00 00 00 01 00 02 14 02
				15 00 00 00 01 00 02 15 69
				15 00 00 00 01 00 02 16 02
				15 00 00 00 01 00 02 17 AC
				15 00 00 00 01 00 02 18 02
				15 00 00 00 01 00 02 19 D9
				15 00 00 00 01 00 02 1A 03
				15 00 00 00 01 00 02 1B 11
				15 00 00 00 01 00 02 1C 03
				15 00 00 00 01 00 02 1D 30
				15 00 00 00 01 00 02 1E 03
				15 00 00 00 01 00 02 1F 5A
				15 00 00 00 01 00 02 20 03
				15 00 00 00 01 00 02 21 66
				15 00 00 00 01 00 02 22 03
				15 00 00 00 01 00 02 23 72
				15 00 00 00 01 00 02 24 03
				15 00 00 00 01 00 02 25 81
				15 00 00 00 01 00 02 26 03
				15 00 00 00 01 00 02 27 92
				15 00 00 00 01 00 02 28 03
				15 00 00 00 01 00 02 29 A5
				15 00 00 00 01 00 02 2A 03
				15 00 00 00 01 00 02 2B BC
				15 00 00 00 01 00 02 2D 03
				15 00 00 00 01 00 02 2F D4
				15 00 00 00 01 00 02 30 03
				15 00 00 00 01 00 02 31 D8
				15 00 00 00 01 00 02 32 00
				15 00 00 00 01 00 02 33 BE
				15 00 00 00 01 00 02 34 00
				15 00 00 00 01 00 02 35 CD
				15 00 00 00 01 00 02 36 00
				15 00 00 00 01 00 02 37 E5
				15 00 00 00 01 00 02 38 00
				15 00 00 00 01 00 02 39 FA
				15 00 00 00 01 00 02 3A 01
				15 00 00 00 01 00 02 3B 0D
				15 00 00 00 01 00 02 3D 01
				15 00 00 00 01 00 02 3F 1E
				15 00 00 00 01 00 02 40 01
				15 00 00 00 01 00 02 41 2C
				15 00 00 00 01 00 02 42 01
				15 00 00 00 01 00 02 43 3B
				15 00 00 00 01 00 02 44 01
				15 00 00 00 01 00 02 45 49
				15 00 00 00 01 00 02 46 01
				15 00 00 00 01 00 02 47 76
				15 00 00 00 01 00 02 48 01
				15 00 00 00 01 00 02 49 98
				15 00 00 00 01 00 02 4A 01
				15 00 00 00 01 00 02 4B CE
				15 00 00 00 01 00 02 4C 01
				15 00 00 00 01 00 02 4D FA
				15 00 00 00 01 00 02 4E 02
				15 00 00 00 01 00 02 4F 3C
				15 00 00 00 01 00 02 50 02
				15 00 00 00 01 00 02 51 6F
				15 00 00 00 01 00 02 52 02
				15 00 00 00 01 00 02 53 71
				15 00 00 00 01 00 02 54 02
				15 00 00 00 01 00 02 55 A4
				15 00 00 00 01 00 02 56 02
				15 00 00 00 01 00 02 58 D3
				15 00 00 00 01 00 02 59 02
				15 00 00 00 01 00 02 5A EF
				15 00 00 00 01 00 02 5B 03
				15 00 00 00 01 00 02 5C 17
				15 00 00 00 01 00 02 5D 03
				15 00 00 00 01 00 02 5E 35
				15 00 00 00 01 00 02 5F 03
				15 00 00 00 01 00 02 60 5D
				15 00 00 00 01 00 02 61 03
				15 00 00 00 01 00 02 62 69
				15 00 00 00 01 00 02 63 03
				15 00 00 00 01 00 02 64 75
				15 00 00 00 01 00 02 65 03
				15 00 00 00 01 00 02 66 83
				15 00 00 00 01 00 02 67 03
				15 00 00 00 01 00 02 68 93
				15 00 00 00 01 00 02 69 03
				15 00 00 00 01 00 02 6A A6
				15 00 00 00 01 00 02 6B 03
				15 00 00 00 01 00 02 6C BC
				15 00 00 00 01 00 02 6D 03
				15 00 00 00 01 00 02 6E D4
				15 00 00 00 01 00 02 6F 03
				15 00 00 00 01 00 02 70 D8
				15 00 00 00 01 00 02 71 01
				15 00 00 00 01 00 02 72 C0
				15 00 00 00 01 00 02 73 01
				15 00 00 00 01 00 02 74 C2
				15 00 00 00 01 00 02 75 01
				15 00 00 00 01 00 02 76 C6
				15 00 00 00 01 00 02 77 01
				15 00 00 00 01 00 02 78 C9
				15 00 00 00 01 00 02 79 01
				15 00 00 00 01 00 02 7A CC
				15 00 00 00 01 00 02 7B 01
				15 00 00 00 01 00 02 7C CF
				15 00 00 00 01 00 02 7D 01
				15 00 00 00 01 00 02 7E D2
				15 00 00 00 01 00 02 7F 01
				15 00 00 00 01 00 02 80 D6
				15 00 00 00 01 00 02 81 01
				15 00 00 00 01 00 02 82 D9
				15 00 00 00 01 00 02 83 01
				15 00 00 00 01 00 02 84 E5
				15 00 00 00 01 00 02 85 01
				15 00 00 00 01 00 02 86 F0
				15 00 00 00 01 00 02 87 02
				15 00 00 00 01 00 02 88 04
				15 00 00 00 01 00 02 89 02
				15 00 00 00 01 00 02 8A 16
				15 00 00 00 01 00 02 8B 02
				15 00 00 00 01 00 02 8C 3B
				15 00 00 00 01 00 02 8D 02
				15 00 00 00 01 00 02 8E 62
				15 00 00 00 01 00 02 8F 02
				15 00 00 00 01 00 02 90 63
				15 00 00 00 01 00 02 91 02
				15 00 00 00 01 00 02 92 8E
				15 00 00 00 01 00 02 93 02
				15 00 00 00 01 00 02 94 CD
				15 00 00 00 01 00 02 95 02
				15 00 00 00 01 00 02 96 F7
				15 00 00 00 01 00 02 97 03
				15 00 00 00 01 00 02 98 2C
				15 00 00 00 01 00 02 99 03
				15 00 00 00 01 00 02 9A 49
				15 00 00 00 01 00 02 9B 03
				15 00 00 00 01 00 02 9C 6E
				15 00 00 00 01 00 02 9D 03
				15 00 00 00 01 00 02 9E 79
				15 00 00 00 01 00 02 9F 03
				15 00 00 00 01 00 02 A0 85
				15 00 00 00 01 00 02 A2 03
				15 00 00 00 01 00 02 A3 91
				15 00 00 00 01 00 02 A4 03
				15 00 00 00 01 00 02 A5 A0
				15 00 00 00 01 00 02 A6 03
				15 00 00 00 01 00 02 A7 B0
				15 00 00 00 01 00 02 A9 03
				15 00 00 00 01 00 02 AA C3
				15 00 00 00 01 00 02 AB 03
				15 00 00 00 01 00 02 AC D4
				15 00 00 00 01 00 02 AD 03
				15 00 00 00 01 00 02 AE D8
				15 00 00 00 01 00 02 AF 01
				15 00 00 00 01 00 02 B0 E4
				15 00 00 00 01 00 02 B1 01
				15 00 00 00 01 00 02 B2 E6
				15 00 00 00 01 00 02 B3 01
				15 00 00 00 01 00 02 B4 EA
				15 00 00 00 01 00 02 B5 01
				15 00 00 00 01 00 02 B6 EE
				15 00 00 00 01 00 02 B7 01
				15 00 00 00 01 00 02 B8 F1
				15 00 00 00 01 00 02 B9 01
				15 00 00 00 01 00 02 BA F5
				15 00 00 00 01 00 02 BB 01
				15 00 00 00 01 00 02 BC F9
				15 00 00 00 01 00 02 BD 01
				15 00 00 00 01 00 02 BE FD
				15 00 00 00 01 00 02 BF 02
				15 00 00 00 01 00 02 C0 00
				15 00 00 00 01 00 02 C1 02
				15 00 00 00 01 00 02 C2 0F
				15 00 00 00 01 00 02 C3 02
				15 00 00 00 01 00 02 C4 1C
				15 00 00 00 01 00 02 C5 02
				15 00 00 00 01 00 02 C6 34
				15 00 00 00 01 00 02 C7 02
				15 00 00 00 01 00 02 C8 4B
				15 00 00 00 01 00 02 C9 02
				15 00 00 00 01 00 02 CA 76
				15 00 00 00 01 00 02 CB 02
				15 00 00 00 01 00 02 CC 9D
				15 00 00 00 01 00 02 CD 02
				15 00 00 00 01 00 02 CE 9E
				15 00 00 00 01 00 02 CF 02
				15 00 00 00 01 00 02 D0 C9
				15 00 00 00 01 00 02 D1 02
				15 00 00 00 01 00 02 D2 F4
				15 00 00 00 01 00 02 D3 03
				15 00 00 00 01 00 02 D4 0E
				15 00 00 00 01 00 02 D5 03
				15 00 00 00 01 00 02 D6 33
				15 00 00 00 01 00 02 D7 03
				15 00 00 00 01 00 02 D8 4E
				15 00 00 00 01 00 02 D9 03
				15 00 00 00 01 00 02 DA 72
				15 00 00 00 01 00 02 DB 03
				15 00 00 00 01 00 02 DC 7C
				15 00 00 00 01 00 02 DD 03
				15 00 00 00 01 00 02 DE 87
				15 00 00 00 01 00 02 DF 03
				15 00 00 00 01 00 02 E0 93
				15 00 00 00 01 00 02 E1 03
				15 00 00 00 01 00 02 E2 A1
				15 00 00 00 01 00 02 E3 03
				15 00 00 00 01 00 02 E4 B1
				15 00 00 00 01 00 02 E5 03
				15 00 00 00 01 00 02 E6 C4
				15 00 00 00 01 00 02 E7 03
				15 00 00 00 01 00 02 E8 D4
				15 00 00 00 01 00 02 E9 03
				15 00 00 00 01 00 02 EA D8
				15 01 00 00 01 00 02 FF 10
				];
		qcom,mdss-dsi-dispparam-papermode4-command-state = "dsi_hs_mode";
		qcom,mdss-dsi-dispparam-papermode5-command = [
				15 01 00 00 01 00 02 FF 22
				15 00 00 00 01 00 02 FB 01
				15 00 00 00 01 00 02 FA 00
				15 01 00 00 01 00 02 FF 20
				15 00 00 00 01 00 02 FB 01
				15 00 00 00 01 00 02 75 00
				15 00 00 00 01 00 02 76 1D
				15 00 00 00 01 00 02 77 00
				15 00 00 00 01 00 02 78 38
				15 00 00 00 01 00 02 79 00
				15 00 00 00 01 00 02 7A 67
				15 00 00 00 01 00 02 7B 00
				15 00 00 00 01 00 02 7C 89
				15 00 00 00 01 00 02 7D 00
				15 00 00 00 01 00 02 7E A7
				15 00 00 00 01 00 02 7F 00
				15 00 00 00 01 00 02 80 BE
				15 00 00 00 01 00 02 81 00
				15 00 00 00 01 00 02 82 D3
				15 00 00 00 01 00 02 83 00
				15 00 00 00 01 00 02 84 E4
				15 00 00 00 01 00 02 85 00
				15 00 00 00 01 00 02 86 F4
				15 00 00 00 01 00 02 87 01
				15 00 00 00 01 00 02 88 2A
				15 00 00 00 01 00 02 89 01
				15 00 00 00 01 00 02 8A 51
				15 00 00 00 01 00 02 8B 01
				15 00 00 00 01 00 02 8C 8C
				15 00 00 00 01 00 02 8D 01
				15 00 00 00 01 00 02 8E B9
				15 00 00 00 01 00 02 8F 01
				15 00 00 00 01 00 02 90 FC
				15 00 00 00 01 00 02 91 02
				15 00 00 00 01 00 02 92 31
				15 00 00 00 01 00 02 93 02
				15 00 00 00 01 00 02 94 33
				15 00 00 00 01 00 02 95 02
				15 00 00 00 01 00 02 96 66
				15 00 00 00 01 00 02 97 02
				15 00 00 00 01 00 02 98 AB
				15 00 00 00 01 00 02 99 02
				15 00 00 00 01 00 02 9A D7
				15 00 00 00 01 00 02 9B 03
				15 00 00 00 01 00 02 9C 0F
				15 00 00 00 01 00 02 9D 03
				15 00 00 00 01 00 02 9E 2F
				15 00 00 00 01 00 02 9F 03
				15 00 00 00 01 00 02 A0 58
				15 00 00 00 01 00 02 A2 03
				15 00 00 00 01 00 02 A3 63
				15 00 00 00 01 00 02 A4 03
				15 00 00 00 01 00 02 A5 70
				15 00 00 00 01 00 02 A6 03
				15 00 00 00 01 00 02 A7 80
				15 00 00 00 01 00 02 A9 03
				15 00 00 00 01 00 02 AA 90
				15 00 00 00 01 00 02 AB 03
				15 00 00 00 01 00 02 AC A3
				15 00 00 00 01 00 02 AD 03
				15 00 00 00 01 00 02 AE BB
				15 00 00 00 01 00 02 AF 03
				15 00 00 00 01 00 02 B0 D2
				15 00 00 00 01 00 02 B1 03
				15 00 00 00 01 00 02 B2 D8
				15 00 00 00 01 00 02 B3 00
				15 00 00 00 01 00 02 B4 57
				15 00 00 00 01 00 02 B5 00
				15 00 00 00 01 00 02 B6 72
				15 00 00 00 01 00 02 B7 00
				15 00 00 00 01 00 02 B8 A1
				15 00 00 00 01 00 02 B9 00
				15 00 00 00 01 00 02 BA C4
				15 00 00 00 01 00 02 BB 00
				15 00 00 00 01 00 02 BC E1
				15 00 00 00 01 00 02 BD 00
				15 00 00 00 01 00 02 BE F9
				15 00 00 00 01 00 02 BF 01
				15 00 00 00 01 00 02 C0 0D
				15 00 00 00 01 00 02 C1 01
				15 00 00 00 01 00 02 C2 1F
				15 00 00 00 01 00 02 C3 01
				15 00 00 00 01 00 02 C4 2E
				15 00 00 00 01 00 02 C5 01
				15 00 00 00 01 00 02 C6 64
				15 00 00 00 01 00 02 C7 01
				15 00 00 00 01 00 02 C8 8C
				15 00 00 00 01 00 02 C9 01
				15 00 00 00 01 00 02 CA C7
				15 00 00 00 01 00 02 CB 01
				15 00 00 00 01 00 02 CC F4
				15 00 00 00 01 00 02 CD 02
				15 00 00 00 01 00 02 CE 37
				15 00 00 00 01 00 02 CF 02
				15 00 00 00 01 00 02 D0 6C
				15 00 00 00 01 00 02 D1 02
				15 00 00 00 01 00 02 D2 6E
				15 00 00 00 01 00 02 D3 02
				15 00 00 00 01 00 02 D4 A1
				15 00 00 00 01 00 02 D5 02
				15 00 00 00 01 00 02 D6 D2
				15 00 00 00 01 00 02 D7 02
				15 00 00 00 01 00 02 D8 EE
				15 00 00 00 01 00 02 D9 03
				15 00 00 00 01 00 02 DA 16
				15 00 00 00 01 00 02 DB 03
				15 00 00 00 01 00 02 DC 34
				15 00 00 00 01 00 02 DD 03
				15 00 00 00 01 00 02 DE 5B
				15 00 00 00 01 00 02 DF 03
				15 00 00 00 01 00 02 E0 66
				15 00 00 00 01 00 02 E1 03
				15 00 00 00 01 00 02 E2 73
				15 00 00 00 01 00 02 E3 03
				15 00 00 00 01 00 02 E4 81
				15 00 00 00 01 00 02 E5 03
				15 00 00 00 01 00 02 E6 91
				15 00 00 00 01 00 02 E7 03
				15 00 00 00 01 00 02 E8 A4
				15 00 00 00 01 00 02 E9 03
				15 00 00 00 01 00 02 EA BC
				15 00 00 00 01 00 02 EB 03
				15 00 00 00 01 00 02 EC D3
				15 00 00 00 01 00 02 ED 03
				15 00 00 00 01 00 02 EE D8
				15 00 00 00 01 00 02 EF 00
				15 00 00 00 01 00 02 F0 8A
				15 00 00 00 01 00 02 F1 00
				15 00 00 00 01 00 02 F2 99
				15 00 00 00 01 00 02 F3 00
				15 00 00 00 01 00 02 F4 B2
				15 00 00 00 01 00 02 F5 00
				15 00 00 00 01 00 02 F6 C7
				15 00 00 00 01 00 02 F7 00
				15 00 00 00 01 00 02 F8 DB
				15 00 00 00 01 00 02 F9 00
				15 00 00 00 01 00 02 FA EC
				15 01 00 00 01 00 02 FF 21
				15 00 00 00 01 00 02 FB 01
				15 00 00 00 01 00 02 00 00
				15 00 00 00 01 00 02 01 FB
				15 00 00 00 01 00 02 02 01
				15 00 00 00 01 00 02 03 09
				15 00 00 00 01 00 02 04 01
				15 00 00 00 01 00 02 05 17
				15 00 00 00 01 00 02 06 01
				15 00 00 00 01 00 02 07 43
				15 00 00 00 01 00 02 08 01
				15 00 00 00 01 00 02 09 64
				15 00 00 00 01 00 02 0A 01
				15 00 00 00 01 00 02 0B 99
				15 00 00 00 01 00 02 0C 01
				15 00 00 00 01 00 02 0D C1
				15 00 00 00 01 00 02 0E 01
				15 00 00 00 01 00 02 0F FF
				15 00 00 00 01 00 02 10 02
				15 00 00 00 01 00 02 11 33
				15 00 00 00 01 00 02 12 02
				15 00 00 00 01 00 02 13 35
				15 00 00 00 01 00 02 14 02
				15 00 00 00 01 00 02 15 67
				15 00 00 00 01 00 02 16 02
				15 00 00 00 01 00 02 17 AC
				15 00 00 00 01 00 02 18 02
				15 00 00 00 01 00 02 19 D8
				15 00 00 00 01 00 02 1A 03
				15 00 00 00 01 00 02 1B 10
				15 00 00 00 01 00 02 1C 03
				15 00 00 00 01 00 02 1D 30
				15 00 00 00 01 00 02 1E 03
				15 00 00 00 01 00 02 1F 59
				15 00 00 00 01 00 02 20 03
				15 00 00 00 01 00 02 21 65
				15 00 00 00 01 00 02 22 03
				15 00 00 00 01 00 02 23 71
				15 00 00 00 01 00 02 24 03
				15 00 00 00 01 00 02 25 80
				15 00 00 00 01 00 02 26 03
				15 00 00 00 01 00 02 27 90
				15 00 00 00 01 00 02 28 03
				15 00 00 00 01 00 02 29 A3
				15 00 00 00 01 00 02 2A 03
				15 00 00 00 01 00 02 2B BB
				15 00 00 00 01 00 02 2D 03
				15 00 00 00 01 00 02 2F D1
				15 00 00 00 01 00 02 30 03
				15 00 00 00 01 00 02 31 D8
				15 00 00 00 01 00 02 32 00
				15 00 00 00 01 00 02 33 B3
				15 00 00 00 01 00 02 34 00
				15 00 00 00 01 00 02 35 C3
				15 00 00 00 01 00 02 36 00
				15 00 00 00 01 00 02 37 DC
				15 00 00 00 01 00 02 38 00
				15 00 00 00 01 00 02 39 F2
				15 00 00 00 01 00 02 3A 01
				15 00 00 00 01 00 02 3B 06
				15 00 00 00 01 00 02 3D 01
				15 00 00 00 01 00 02 3F 18
				15 00 00 00 01 00 02 40 01
				15 00 00 00 01 00 02 41 27
				15 00 00 00 01 00 02 42 01
				15 00 00 00 01 00 02 43 36
				15 00 00 00 01 00 02 44 01
				15 00 00 00 01 00 02 45 43
				15 00 00 00 01 00 02 46 01
				15 00 00 00 01 00 02 47 71
				15 00 00 00 01 00 02 48 01
				15 00 00 00 01 00 02 49 94
				15 00 00 00 01 00 02 4A 01
				15 00 00 00 01 00 02 4B CC
				15 00 00 00 01 00 02 4C 01
				15 00 00 00 01 00 02 4D F8
				15 00 00 00 01 00 02 4E 02
				15 00 00 00 01 00 02 4F 3A
				15 00 00 00 01 00 02 50 02
				15 00 00 00 01 00 02 51 6E
				15 00 00 00 01 00 02 52 02
				15 00 00 00 01 00 02 53 70
				15 00 00 00 01 00 02 54 02
				15 00 00 00 01 00 02 55 A2
				15 00 00 00 01 00 02 56 02
				15 00 00 00 01 00 02 58 D3
				15 00 00 00 01 00 02 59 02
				15 00 00 00 01 00 02 5A EF
				15 00 00 00 01 00 02 5B 03
				15 00 00 00 01 00 02 5C 17
				15 00 00 00 01 00 02 5D 03
				15 00 00 00 01 00 02 5E 35
				15 00 00 00 01 00 02 5F 03
				15 00 00 00 01 00 02 60 5C
				15 00 00 00 01 00 02 61 03
				15 00 00 00 01 00 02 62 67
				15 00 00 00 01 00 02 63 03
				15 00 00 00 01 00 02 64 74
				15 00 00 00 01 00 02 65 03
				15 00 00 00 01 00 02 66 82
				15 00 00 00 01 00 02 67 03
				15 00 00 00 01 00 02 68 92
				15 00 00 00 01 00 02 69 03
				15 00 00 00 01 00 02 6A A5
				15 00 00 00 01 00 02 6B 03
				15 00 00 00 01 00 02 6C BC
				15 00 00 00 01 00 02 6D 03
				15 00 00 00 01 00 02 6E D1
				15 00 00 00 01 00 02 6F 03
				15 00 00 00 01 00 02 70 D8
				15 00 00 00 01 00 02 71 01
				15 00 00 00 01 00 02 72 DC
				15 00 00 00 01 00 02 73 01
				15 00 00 00 01 00 02 74 DD
				15 00 00 00 01 00 02 75 01
				15 00 00 00 01 00 02 76 E0
				15 00 00 00 01 00 02 77 01
				15 00 00 00 01 00 02 78 E3
				15 00 00 00 01 00 02 79 01
				15 00 00 00 01 00 02 7A E6
				15 00 00 00 01 00 02 7B 01
				15 00 00 00 01 00 02 7C E8
				15 00 00 00 01 00 02 7D 01
				15 00 00 00 01 00 02 7E EB
				15 00 00 00 01 00 02 7F 01
				15 00 00 00 01 00 02 80 ED
				15 00 00 00 01 00 02 81 01
				15 00 00 00 01 00 02 82 F0
				15 00 00 00 01 00 02 83 01
				15 00 00 00 01 00 02 84 FA
				15 00 00 00 01 00 02 85 02
				15 00 00 00 01 00 02 86 03
				15 00 00 00 01 00 02 87 02
				15 00 00 00 01 00 02 88 15
				15 00 00 00 01 00 02 89 02
				15 00 00 00 01 00 02 8A 26
				15 00 00 00 01 00 02 8B 02
				15 00 00 00 01 00 02 8C 47
				15 00 00 00 01 00 02 8D 02
				15 00 00 00 01 00 02 8E 6C
				15 00 00 00 01 00 02 8F 02
				15 00 00 00 01 00 02 90 6D
				15 00 00 00 01 00 02 91 02
				15 00 00 00 01 00 02 92 96
				15 00 00 00 01 00 02 93 02
				15 00 00 00 01 00 02 94 D4
				15 00 00 00 01 00 02 95 02
				15 00 00 00 01 00 02 96 FE
				15 00 00 00 01 00 02 97 03
				15 00 00 00 01 00 02 98 32
				15 00 00 00 01 00 02 99 03
				15 00 00 00 01 00 02 9A 4F
				15 00 00 00 01 00 02 9B 03
				15 00 00 00 01 00 02 9C 72
				15 00 00 00 01 00 02 9D 03
				15 00 00 00 01 00 02 9E 7D
				15 00 00 00 01 00 02 9F 03
				15 00 00 00 01 00 02 A0 8A
				15 00 00 00 01 00 02 A2 03
				15 00 00 00 01 00 02 A3 95
				15 00 00 00 01 00 02 A4 03
				15 00 00 00 01 00 02 A5 A3
				15 00 00 00 01 00 02 A6 03
				15 00 00 00 01 00 02 A7 B3
				15 00 00 00 01 00 02 A9 03
				15 00 00 00 01 00 02 AA C5
				15 00 00 00 01 00 02 AB 03
				15 00 00 00 01 00 02 AC D5
				15 00 00 00 01 00 02 AD 03
				15 00 00 00 01 00 02 AE D8
				15 00 00 00 01 00 02 AF 02
				15 00 00 00 01 00 02 B0 01
				15 00 00 00 01 00 02 B1 02
				15 00 00 00 01 00 02 B2 02
				15 00 00 00 01 00 02 B3 02
				15 00 00 00 01 00 02 B4 06
				15 00 00 00 01 00 02 B5 02
				15 00 00 00 01 00 02 B6 09
				15 00 00 00 01 00 02 B7 02
				15 00 00 00 01 00 02 B8 0C
				15 00 00 00 01 00 02 B9 02
				15 00 00 00 01 00 02 BA 10
				15 00 00 00 01 00 02 BB 02
				15 00 00 00 01 00 02 BC 13
				15 00 00 00 01 00 02 BD 02
				15 00 00 00 01 00 02 BE 15
				15 00 00 00 01 00 02 BF 02
				15 00 00 00 01 00 02 C0 19
				15 00 00 00 01 00 02 C1 02
				15 00 00 00 01 00 02 C2 25
				15 00 00 00 01 00 02 C3 02
				15 00 00 00 01 00 02 C4 30
				15 00 00 00 01 00 02 C5 02
				15 00 00 00 01 00 02 C6 47
				15 00 00 00 01 00 02 C7 02
				15 00 00 00 01 00 02 C8 5B
				15 00 00 00 01 00 02 C9 02
				15 00 00 00 01 00 02 CA 82
				15 00 00 00 01 00 02 CB 02
				15 00 00 00 01 00 02 CC A7
				15 00 00 00 01 00 02 CD 02
				15 00 00 00 01 00 02 CE A8
				15 00 00 00 01 00 02 CF 02
				15 00 00 00 01 00 02 D0 D1
				15 00 00 00 01 00 02 D1 02
				15 00 00 00 01 00 02 D2 FB
				15 00 00 00 01 00 02 D3 03
				15 00 00 00 01 00 02 D4 15
				15 00 00 00 01 00 02 D5 03
				15 00 00 00 01 00 02 D6 38
				15 00 00 00 01 00 02 D7 03
				15 00 00 00 01 00 02 D8 54
				15 00 00 00 01 00 02 D9 03
				15 00 00 00 01 00 02 DA 76
				15 00 00 00 01 00 02 DB 03
				15 00 00 00 01 00 02 DC 80
				15 00 00 00 01 00 02 DD 03
				15 00 00 00 01 00 02 DE 8C
				15 00 00 00 01 00 02 DF 03
				15 00 00 00 01 00 02 E0 97
				15 00 00 00 01 00 02 E1 03
				15 00 00 00 01 00 02 E2 A4
				15 00 00 00 01 00 02 E3 03
				15 00 00 00 01 00 02 E4 B4
				15 00 00 00 01 00 02 E5 03
				15 00 00 00 01 00 02 E6 C6
				15 00 00 00 01 00 02 E7 03
				15 00 00 00 01 00 02 E8 D5
				15 00 00 00 01 00 02 E9 03
				15 00 00 00 01 00 02 EA D8
				15 01 00 00 01 00 02 FF 10
				];
		qcom,mdss-dsi-dispparam-papermode5-command-state = "dsi_hs_mode";
		qcom,mdss-dsi-dispparam-papermode6-command = [
				15 01 00 00 01 00 02 FF 22
				15 00 00 00 01 00 02 FB 01
				15 00 00 00 01 00 02 FA 00
				15 01 00 00 01 00 02 FF 20
				15 00 00 00 01 00 02 FB 01
				15 00 00 00 01 00 02 75 00
				15 00 00 00 01 00 02 76 1D
				15 00 00 00 01 00 02 77 00
				15 00 00 00 01 00 02 78 38
				15 00 00 00 01 00 02 79 00
				15 00 00 00 01 00 02 7A 67
				15 00 00 00 01 00 02 7B 00
				15 00 00 00 01 00 02 7C 89
				15 00 00 00 01 00 02 7D 00
				15 00 00 00 01 00 02 7E A7
				15 00 00 00 01 00 02 7F 00
				15 00 00 00 01 00 02 80 BE
				15 00 00 00 01 00 02 81 00
				15 00 00 00 01 00 02 82 D3
				15 00 00 00 01 00 02 83 00
				15 00 00 00 01 00 02 84 E4
				15 00 00 00 01 00 02 85 00
				15 00 00 00 01 00 02 86 F4
				15 00 00 00 01 00 02 87 01
				15 00 00 00 01 00 02 88 2A
				15 00 00 00 01 00 02 89 01
				15 00 00 00 01 00 02 8A 51
				15 00 00 00 01 00 02 8B 01
				15 00 00 00 01 00 02 8C 8C
				15 00 00 00 01 00 02 8D 01
				15 00 00 00 01 00 02 8E B9
				15 00 00 00 01 00 02 8F 01
				15 00 00 00 01 00 02 90 FC
				15 00 00 00 01 00 02 91 02
				15 00 00 00 01 00 02 92 31
				15 00 00 00 01 00 02 93 02
				15 00 00 00 01 00 02 94 33
				15 00 00 00 01 00 02 95 02
				15 00 00 00 01 00 02 96 66
				15 00 00 00 01 00 02 97 02
				15 00 00 00 01 00 02 98 AB
				15 00 00 00 01 00 02 99 02
				15 00 00 00 01 00 02 9A D7
				15 00 00 00 01 00 02 9B 03
				15 00 00 00 01 00 02 9C 0F
				15 00 00 00 01 00 02 9D 03
				15 00 00 00 01 00 02 9E 2F
				15 00 00 00 01 00 02 9F 03
				15 00 00 00 01 00 02 A0 58
				15 00 00 00 01 00 02 A2 03
				15 00 00 00 01 00 02 A3 63
				15 00 00 00 01 00 02 A4 03
				15 00 00 00 01 00 02 A5 70
				15 00 00 00 01 00 02 A6 03
				15 00 00 00 01 00 02 A7 80
				15 00 00 00 01 00 02 A9 03
				15 00 00 00 01 00 02 AA 90
				15 00 00 00 01 00 02 AB 03
				15 00 00 00 01 00 02 AC A3
				15 00 00 00 01 00 02 AD 03
				15 00 00 00 01 00 02 AE BB
				15 00 00 00 01 00 02 AF 03
				15 00 00 00 01 00 02 B0 D2
				15 00 00 00 01 00 02 B1 03
				15 00 00 00 01 00 02 B2 D8
				15 00 00 00 01 00 02 B3 00
				15 00 00 00 01 00 02 B4 57
				15 00 00 00 01 00 02 B5 00
				15 00 00 00 01 00 02 B6 72
				15 00 00 00 01 00 02 B7 00
				15 00 00 00 01 00 02 B8 A1
				15 00 00 00 01 00 02 B9 00
				15 00 00 00 01 00 02 BA C4
				15 00 00 00 01 00 02 BB 00
				15 00 00 00 01 00 02 BC E1
				15 00 00 00 01 00 02 BD 00
				15 00 00 00 01 00 02 BE F9
				15 00 00 00 01 00 02 BF 01
				15 00 00 00 01 00 02 C0 0D
				15 00 00 00 01 00 02 C1 01
				15 00 00 00 01 00 02 C2 1F
				15 00 00 00 01 00 02 C3 01
				15 00 00 00 01 00 02 C4 2E
				15 00 00 00 01 00 02 C5 01
				15 00 00 00 01 00 02 C6 64
				15 00 00 00 01 00 02 C7 01
				15 00 00 00 01 00 02 C8 8C
				15 00 00 00 01 00 02 C9 01
				15 00 00 00 01 00 02 CA C7
				15 00 00 00 01 00 02 CB 01
				15 00 00 00 01 00 02 CC F4
				15 00 00 00 01 00 02 CD 02
				15 00 00 00 01 00 02 CE 37
				15 00 00 00 01 00 02 CF 02
				15 00 00 00 01 00 02 D0 6C
				15 00 00 00 01 00 02 D1 02
				15 00 00 00 01 00 02 D2 6E
				15 00 00 00 01 00 02 D3 02
				15 00 00 00 01 00 02 D4 A1
				15 00 00 00 01 00 02 D5 02
				15 00 00 00 01 00 02 D6 D2
				15 00 00 00 01 00 02 D7 02
				15 00 00 00 01 00 02 D8 EE
				15 00 00 00 01 00 02 D9 03
				15 00 00 00 01 00 02 DA 16
				15 00 00 00 01 00 02 DB 03
				15 00 00 00 01 00 02 DC 34
				15 00 00 00 01 00 02 DD 03
				15 00 00 00 01 00 02 DE 5B
				15 00 00 00 01 00 02 DF 03
				15 00 00 00 01 00 02 E0 66
				15 00 00 00 01 00 02 E1 03
				15 00 00 00 01 00 02 E2 73
				15 00 00 00 01 00 02 E3 03
				15 00 00 00 01 00 02 E4 81
				15 00 00 00 01 00 02 E5 03
				15 00 00 00 01 00 02 E6 91
				15 00 00 00 01 00 02 E7 03
				15 00 00 00 01 00 02 E8 A4
				15 00 00 00 01 00 02 E9 03
				15 00 00 00 01 00 02 EA BC
				15 00 00 00 01 00 02 EB 03
				15 00 00 00 01 00 02 EC D3
				15 00 00 00 01 00 02 ED 03
				15 00 00 00 01 00 02 EE D8
				15 00 00 00 01 00 02 EF 00
				15 00 00 00 01 00 02 F0 86
				15 00 00 00 01 00 02 F1 00
				15 00 00 00 01 00 02 F2 95
				15 00 00 00 01 00 02 F3 00
				15 00 00 00 01 00 02 F4 AF
				15 00 00 00 01 00 02 F5 00
				15 00 00 00 01 00 02 F6 C5
				15 00 00 00 01 00 02 F7 00
				15 00 00 00 01 00 02 F8 D9
				15 00 00 00 01 00 02 F9 00
				15 00 00 00 01 00 02 FA EA
				15 01 00 00 01 00 02 FF 21
				15 00 00 00 01 00 02 FB 01
				15 00 00 00 01 00 02 00 00
				15 00 00 00 01 00 02 01 F9
				15 00 00 00 01 00 02 02 01
				15 00 00 00 01 00 02 03 08
				15 00 00 00 01 00 02 04 01
				15 00 00 00 01 00 02 05 16
				15 00 00 00 01 00 02 06 01
				15 00 00 00 01 00 02 07 42
				15 00 00 00 01 00 02 08 01
				15 00 00 00 01 00 02 09 64
				15 00 00 00 01 00 02 0A 01
				15 00 00 00 01 00 02 0B 98
				15 00 00 00 01 00 02 0C 01
				15 00 00 00 01 00 02 0D C0
				15 00 00 00 01 00 02 0E 01
				15 00 00 00 01 00 02 0F FE
				15 00 00 00 01 00 02 10 02
				15 00 00 00 01 00 02 11 33
				15 00 00 00 01 00 02 12 02
				15 00 00 00 01 00 02 13 34
				15 00 00 00 01 00 02 14 02
				15 00 00 00 01 00 02 15 67
				15 00 00 00 01 00 02 16 02
				15 00 00 00 01 00 02 17 AB
				15 00 00 00 01 00 02 18 02
				15 00 00 00 01 00 02 19 D8
				15 00 00 00 01 00 02 1A 03
				15 00 00 00 01 00 02 1B 10
				15 00 00 00 01 00 02 1C 03
				15 00 00 00 01 00 02 1D 2F
				15 00 00 00 01 00 02 1E 03
				15 00 00 00 01 00 02 1F 58
				15 00 00 00 01 00 02 20 03
				15 00 00 00 01 00 02 21 64
				15 00 00 00 01 00 02 22 03
				15 00 00 00 01 00 02 23 71
				15 00 00 00 01 00 02 24 03
				15 00 00 00 01 00 02 25 80
				15 00 00 00 01 00 02 26 03
				15 00 00 00 01 00 02 27 91
				15 00 00 00 01 00 02 28 03
				15 00 00 00 01 00 02 29 A4
				15 00 00 00 01 00 02 2A 03
				15 00 00 00 01 00 02 2B BB
				15 00 00 00 01 00 02 2D 03
				15 00 00 00 01 00 02 2F D3
				15 00 00 00 01 00 02 30 03
				15 00 00 00 01 00 02 31 D8
				15 00 00 00 01 00 02 32 00
				15 00 00 00 01 00 02 33 B1
				15 00 00 00 01 00 02 34 00
				15 00 00 00 01 00 02 35 C0
				15 00 00 00 01 00 02 36 00
				15 00 00 00 01 00 02 37 D9
				15 00 00 00 01 00 02 38 00
				15 00 00 00 01 00 02 39 F0
				15 00 00 00 01 00 02 3A 01
				15 00 00 00 01 00 02 3B 05
				15 00 00 00 01 00 02 3D 01
				15 00 00 00 01 00 02 3F 16
				15 00 00 00 01 00 02 40 01
				15 00 00 00 01 00 02 41 26
				15 00 00 00 01 00 02 42 01
				15 00 00 00 01 00 02 43 34
				15 00 00 00 01 00 02 44 01
				15 00 00 00 01 00 02 45 43
				15 00 00 00 01 00 02 46 01
				15 00 00 00 01 00 02 47 70
				15 00 00 00 01 00 02 48 01
				15 00 00 00 01 00 02 49 94
				15 00 00 00 01 00 02 4A 01
				15 00 00 00 01 00 02 4B CB
				15 00 00 00 01 00 02 4C 01
				15 00 00 00 01 00 02 4D F7
				15 00 00 00 01 00 02 4E 02
				15 00 00 00 01 00 02 4F 39
				15 00 00 00 01 00 02 50 02
				15 00 00 00 01 00 02 51 6E
				15 00 00 00 01 00 02 52 02
				15 00 00 00 01 00 02 53 6F
				15 00 00 00 01 00 02 54 02
				15 00 00 00 01 00 02 55 A2
				15 00 00 00 01 00 02 56 02
				15 00 00 00 01 00 02 58 D2
				15 00 00 00 01 00 02 59 02
				15 00 00 00 01 00 02 5A EF
				15 00 00 00 01 00 02 5B 03
				15 00 00 00 01 00 02 5C 16
				15 00 00 00 01 00 02 5D 03
				15 00 00 00 01 00 02 5E 34
				15 00 00 00 01 00 02 5F 03
				15 00 00 00 01 00 02 60 5C
				15 00 00 00 01 00 02 61 03
				15 00 00 00 01 00 02 62 67
				15 00 00 00 01 00 02 63 03
				15 00 00 00 01 00 02 64 74
				15 00 00 00 01 00 02 65 03
				15 00 00 00 01 00 02 66 82
				15 00 00 00 01 00 02 67 03
				15 00 00 00 01 00 02 68 93
				15 00 00 00 01 00 02 69 03
				15 00 00 00 01 00 02 6A A5
				15 00 00 00 01 00 02 6B 03
				15 00 00 00 01 00 02 6C BB
				15 00 00 00 01 00 02 6D 03
				15 00 00 00 01 00 02 6E D3
				15 00 00 00 01 00 02 6F 03
				15 00 00 00 01 00 02 70 D8
				15 00 00 00 01 00 02 71 01
				15 00 00 00 01 00 02 72 F5
				15 00 00 00 01 00 02 73 01
				15 00 00 00 01 00 02 74 F6
				15 00 00 00 01 00 02 75 01
				15 00 00 00 01 00 02 76 F8
				15 00 00 00 01 00 02 77 01
				15 00 00 00 01 00 02 78 FA
				15 00 00 00 01 00 02 79 01
				15 00 00 00 01 00 02 7A FC
				15 00 00 00 01 00 02 7B 01
				15 00 00 00 01 00 02 7C FE
				15 00 00 00 01 00 02 7D 02
				15 00 00 00 01 00 02 7E 01
				15 00 00 00 01 00 02 7F 02
				15 00 00 00 01 00 02 80 03
				15 00 00 00 01 00 02 81 02
				15 00 00 00 01 00 02 82 05
				15 00 00 00 01 00 02 83 02
				15 00 00 00 01 00 02 84 0D
				15 00 00 00 01 00 02 85 02
				15 00 00 00 01 00 02 86 16
				15 00 00 00 01 00 02 87 02
				15 00 00 00 01 00 02 88 25
				15 00 00 00 01 00 02 89 02
				15 00 00 00 01 00 02 8A 34
				15 00 00 00 01 00 02 8B 02
				15 00 00 00 01 00 02 8C 53
				15 00 00 00 01 00 02 8D 02
				15 00 00 00 01 00 02 8E 76
				15 00 00 00 01 00 02 8F 02
				15 00 00 00 01 00 02 90 77
				15 00 00 00 01 00 02 91 02
				15 00 00 00 01 00 02 92 A0
				15 00 00 00 01 00 02 93 02
				15 00 00 00 01 00 02 94 DC
				15 00 00 00 01 00 02 95 03
				15 00 00 00 01 00 02 96 05
				15 00 00 00 01 00 02 97 03
				15 00 00 00 01 00 02 98 39
				15 00 00 00 01 00 02 99 03
				15 00 00 00 01 00 02 9A 55
				15 00 00 00 01 00 02 9B 03
				15 00 00 00 01 00 02 9C 78
				15 00 00 00 01 00 02 9D 03
				15 00 00 00 01 00 02 9E 82
				15 00 00 00 01 00 02 9F 03
				15 00 00 00 01 00 02 A0 8D
				15 00 00 00 01 00 02 A2 03
				15 00 00 00 01 00 02 A3 9A
				15 00 00 00 01 00 02 A4 03
				15 00 00 00 01 00 02 A5 A7
				15 00 00 00 01 00 02 A6 03
				15 00 00 00 01 00 02 A7 B6
				15 00 00 00 01 00 02 A9 03
				15 00 00 00 01 00 02 AA C7
				15 00 00 00 01 00 02 AB 03
				15 00 00 00 01 00 02 AC D5
				15 00 00 00 01 00 02 AD 03
				15 00 00 00 01 00 02 AE D8
				15 00 00 00 01 00 02 AF 02
				15 00 00 00 01 00 02 B0 1B
				15 00 00 00 01 00 02 B1 02
				15 00 00 00 01 00 02 B2 1C
				15 00 00 00 01 00 02 B3 02
				15 00 00 00 01 00 02 B4 1F
				15 00 00 00 01 00 02 B5 02
				15 00 00 00 01 00 02 B6 22
				15 00 00 00 01 00 02 B7 02
				15 00 00 00 01 00 02 B8 24
				15 00 00 00 01 00 02 B9 02
				15 00 00 00 01 00 02 BA 27
				15 00 00 00 01 00 02 BB 02
				15 00 00 00 01 00 02 BC 2A
				15 00 00 00 01 00 02 BD 02
				15 00 00 00 01 00 02 BE 2C
				15 00 00 00 01 00 02 BF 02
				15 00 00 00 01 00 02 C0 2F
				15 00 00 00 01 00 02 C1 02
				15 00 00 00 01 00 02 C2 39
				15 00 00 00 01 00 02 C3 02
				15 00 00 00 01 00 02 C4 44
				15 00 00 00 01 00 02 C5 02
				15 00 00 00 01 00 02 C6 57
				15 00 00 00 01 00 02 C7 02
				15 00 00 00 01 00 02 C8 6A
				15 00 00 00 01 00 02 C9 02
				15 00 00 00 01 00 02 CA 8E
				15 00 00 00 01 00 02 CB 02
				15 00 00 00 01 00 02 CC B1
				15 00 00 00 01 00 02 CD 02
				15 00 00 00 01 00 02 CE B2
				15 00 00 00 01 00 02 CF 02
				15 00 00 00 01 00 02 D0 DB
				15 00 00 00 01 00 02 D1 03
				15 00 00 00 01 00 02 D2 03
				15 00 00 00 01 00 02 D3 03
				15 00 00 00 01 00 02 D4 1C
				15 00 00 00 01 00 02 D5 03
				15 00 00 00 01 00 02 D6 3F
				15 00 00 00 01 00 02 D7 03
				15 00 00 00 01 00 02 D8 5A
				15 00 00 00 01 00 02 D9 03
				15 00 00 00 01 00 02 DA 7B
				15 00 00 00 01 00 02 DB 03
				15 00 00 00 01 00 02 DC 85
				15 00 00 00 01 00 02 DD 03
				15 00 00 00 01 00 02 DE 90
				15 00 00 00 01 00 02 DF 03
				15 00 00 00 01 00 02 E0 9C
				15 00 00 00 01 00 02 E1 03
				15 00 00 00 01 00 02 E2 A9
				15 00 00 00 01 00 02 E3 03
				15 00 00 00 01 00 02 E4 B7
				15 00 00 00 01 00 02 E5 03
				15 00 00 00 01 00 02 E6 C7
				15 00 00 00 01 00 02 E7 03
				15 00 00 00 01 00 02 E8 D5
				15 00 00 00 01 00 02 E9 03
				15 00 00 00 01 00 02 EA D8
				15 01 00 00 01 00 02 FF 10
				];
		qcom,mdss-dsi-dispparam-papermode6-command-state = "dsi_hs_mode";
		qcom,mdss-dsi-dispparam-papermode7-command = [
				15 01 00 00 01 00 02 FF 22
				15 00 00 00 01 00 02 FB 01
				15 00 00 00 01 00 02 FA 00
				15 01 00 00 01 00 02 FF 20
				15 00 00 00 01 00 02 FB 01
				15 00 00 00 01 00 02 75 00
				15 00 00 00 01 00 02 76 1D
				15 00 00 00 01 00 02 77 00
				15 00 00 00 01 00 02 78 38
				15 00 00 00 01 00 02 79 00
				15 00 00 00 01 00 02 7A 67
				15 00 00 00 01 00 02 7B 00
				15 00 00 00 01 00 02 7C 89
				15 00 00 00 01 00 02 7D 00
				15 00 00 00 01 00 02 7E A7
				15 00 00 00 01 00 02 7F 00
				15 00 00 00 01 00 02 80 BE
				15 00 00 00 01 00 02 81 00
				15 00 00 00 01 00 02 82 D3
				15 00 00 00 01 00 02 83 00
				15 00 00 00 01 00 02 84 E4
				15 00 00 00 01 00 02 85 00
				15 00 00 00 01 00 02 86 F4
				15 00 00 00 01 00 02 87 01
				15 00 00 00 01 00 02 88 2A
				15 00 00 00 01 00 02 89 01
				15 00 00 00 01 00 02 8A 51
				15 00 00 00 01 00 02 8B 01
				15 00 00 00 01 00 02 8C 8C
				15 00 00 00 01 00 02 8D 01
				15 00 00 00 01 00 02 8E B9
				15 00 00 00 01 00 02 8F 01
				15 00 00 00 01 00 02 90 FC
				15 00 00 00 01 00 02 91 02
				15 00 00 00 01 00 02 92 31
				15 00 00 00 01 00 02 93 02
				15 00 00 00 01 00 02 94 33
				15 00 00 00 01 00 02 95 02
				15 00 00 00 01 00 02 96 66
				15 00 00 00 01 00 02 97 02
				15 00 00 00 01 00 02 98 AB
				15 00 00 00 01 00 02 99 02
				15 00 00 00 01 00 02 9A D7
				15 00 00 00 01 00 02 9B 03
				15 00 00 00 01 00 02 9C 0F
				15 00 00 00 01 00 02 9D 03
				15 00 00 00 01 00 02 9E 2F
				15 00 00 00 01 00 02 9F 03
				15 00 00 00 01 00 02 A0 58
				15 00 00 00 01 00 02 A2 03
				15 00 00 00 01 00 02 A3 63
				15 00 00 00 01 00 02 A4 03
				15 00 00 00 01 00 02 A5 70
				15 00 00 00 01 00 02 A6 03
				15 00 00 00 01 00 02 A7 80
				15 00 00 00 01 00 02 A9 03
				15 00 00 00 01 00 02 AA 90
				15 00 00 00 01 00 02 AB 03
				15 00 00 00 01 00 02 AC A3
				15 00 00 00 01 00 02 AD 03
				15 00 00 00 01 00 02 AE BB
				15 00 00 00 01 00 02 AF 03
				15 00 00 00 01 00 02 B0 D2
				15 00 00 00 01 00 02 B1 03
				15 00 00 00 01 00 02 B2 D8
				15 00 00 00 01 00 02 B3 00
				15 00 00 00 01 00 02 B4 57
				15 00 00 00 01 00 02 B5 00
				15 00 00 00 01 00 02 B6 72
				15 00 00 00 01 00 02 B7 00
				15 00 00 00 01 00 02 B8 A1
				15 00 00 00 01 00 02 B9 00
				15 00 00 00 01 00 02 BA C4
				15 00 00 00 01 00 02 BB 00
				15 00 00 00 01 00 02 BC E1
				15 00 00 00 01 00 02 BD 00
				15 00 00 00 01 00 02 BE F9
				15 00 00 00 01 00 02 BF 01
				15 00 00 00 01 00 02 C0 0D
				15 00 00 00 01 00 02 C1 01
				15 00 00 00 01 00 02 C2 1F
				15 00 00 00 01 00 02 C3 01
				15 00 00 00 01 00 02 C4 2E
				15 00 00 00 01 00 02 C5 01
				15 00 00 00 01 00 02 C6 64
				15 00 00 00 01 00 02 C7 01
				15 00 00 00 01 00 02 C8 8C
				15 00 00 00 01 00 02 C9 01
				15 00 00 00 01 00 02 CA C7
				15 00 00 00 01 00 02 CB 01
				15 00 00 00 01 00 02 CC F4
				15 00 00 00 01 00 02 CD 02
				15 00 00 00 01 00 02 CE 37
				15 00 00 00 01 00 02 CF 02
				15 00 00 00 01 00 02 D0 6C
				15 00 00 00 01 00 02 D1 02
				15 00 00 00 01 00 02 D2 6E
				15 00 00 00 01 00 02 D3 02
				15 00 00 00 01 00 02 D4 A1
				15 00 00 00 01 00 02 D5 02
				15 00 00 00 01 00 02 D6 D2
				15 00 00 00 01 00 02 D7 02
				15 00 00 00 01 00 02 D8 EE
				15 00 00 00 01 00 02 D9 03
				15 00 00 00 01 00 02 DA 16
				15 00 00 00 01 00 02 DB 03
				15 00 00 00 01 00 02 DC 34
				15 00 00 00 01 00 02 DD 03
				15 00 00 00 01 00 02 DE 5B
				15 00 00 00 01 00 02 DF 03
				15 00 00 00 01 00 02 E0 66
				15 00 00 00 01 00 02 E1 03
				15 00 00 00 01 00 02 E2 73
				15 00 00 00 01 00 02 E3 03
				15 00 00 00 01 00 02 E4 81
				15 00 00 00 01 00 02 E5 03
				15 00 00 00 01 00 02 E6 91
				15 00 00 00 01 00 02 E7 03
				15 00 00 00 01 00 02 E8 A4
				15 00 00 00 01 00 02 E9 03
				15 00 00 00 01 00 02 EA BC
				15 00 00 00 01 00 02 EB 03
				15 00 00 00 01 00 02 EC D3
				15 00 00 00 01 00 02 ED 03
				15 00 00 00 01 00 02 EE D8
				15 00 00 00 01 00 02 EF 00
				15 00 00 00 01 00 02 F0 87
				15 00 00 00 01 00 02 F1 00
				15 00 00 00 01 00 02 F2 97
				15 00 00 00 01 00 02 F3 00
				15 00 00 00 01 00 02 F4 B0
				15 00 00 00 01 00 02 F5 00
				15 00 00 00 01 00 02 F6 C5
				15 00 00 00 01 00 02 F7 00
				15 00 00 00 01 00 02 F8 D9
				15 00 00 00 01 00 02 F9 00
				15 00 00 00 01 00 02 FA EB
				15 01 00 00 01 00 02 FF 21
				15 00 00 00 01 00 02 FB 01
				15 00 00 00 01 00 02 00 00
				15 00 00 00 01 00 02 01 FA
				15 00 00 00 01 00 02 02 01
				15 00 00 00 01 00 02 03 08
				15 00 00 00 01 00 02 04 01
				15 00 00 00 01 00 02 05 15
				15 00 00 00 01 00 02 06 01
				15 00 00 00 01 00 02 07 41
				15 00 00 00 01 00 02 08 01
				15 00 00 00 01 00 02 09 63
				15 00 00 00 01 00 02 0A 01
				15 00 00 00 01 00 02 0B 97
				15 00 00 00 01 00 02 0C 01
				15 00 00 00 01 00 02 0D C0
				15 00 00 00 01 00 02 0E 01
				15 00 00 00 01 00 02 0F FE
				15 00 00 00 01 00 02 10 02
				15 00 00 00 01 00 02 11 32
				15 00 00 00 01 00 02 12 02
				15 00 00 00 01 00 02 13 33
				15 00 00 00 01 00 02 14 02
				15 00 00 00 01 00 02 15 66
				15 00 00 00 01 00 02 16 02
				15 00 00 00 01 00 02 17 AB
				15 00 00 00 01 00 02 18 02
				15 00 00 00 01 00 02 19 D7
				15 00 00 00 01 00 02 1A 03
				15 00 00 00 01 00 02 1B 0F
				15 00 00 00 01 00 02 1C 03
				15 00 00 00 01 00 02 1D 2F
				15 00 00 00 01 00 02 1E 03
				15 00 00 00 01 00 02 1F 58
				15 00 00 00 01 00 02 20 03
				15 00 00 00 01 00 02 21 64
				15 00 00 00 01 00 02 22 03
				15 00 00 00 01 00 02 23 71
				15 00 00 00 01 00 02 24 03
				15 00 00 00 01 00 02 25 7F
				15 00 00 00 01 00 02 26 03
				15 00 00 00 01 00 02 27 91
				15 00 00 00 01 00 02 28 03
				15 00 00 00 01 00 02 29 A4
				15 00 00 00 01 00 02 2A 03
				15 00 00 00 01 00 02 2B BC
				15 00 00 00 01 00 02 2D 03
				15 00 00 00 01 00 02 2F D3
				15 00 00 00 01 00 02 30 03
				15 00 00 00 01 00 02 31 D8
				15 00 00 00 01 00 02 32 00
				15 00 00 00 01 00 02 33 B1
				15 00 00 00 01 00 02 34 00
				15 00 00 00 01 00 02 35 C1
				15 00 00 00 01 00 02 36 00
				15 00 00 00 01 00 02 37 DB
				15 00 00 00 01 00 02 38 00
				15 00 00 00 01 00 02 39 F0
				15 00 00 00 01 00 02 3A 01
				15 00 00 00 01 00 02 3B 05
				15 00 00 00 01 00 02 3D 01
				15 00 00 00 01 00 02 3F 17
				15 00 00 00 01 00 02 40 01
				15 00 00 00 01 00 02 41 26
				15 00 00 00 01 00 02 42 01
				15 00 00 00 01 00 02 43 35
				15 00 00 00 01 00 02 44 01
				15 00 00 00 01 00 02 45 42
				15 00 00 00 01 00 02 46 01
				15 00 00 00 01 00 02 47 70
				15 00 00 00 01 00 02 48 01
				15 00 00 00 01 00 02 49 94
				15 00 00 00 01 00 02 4A 01
				15 00 00 00 01 00 02 4B CB
				15 00 00 00 01 00 02 4C 01
				15 00 00 00 01 00 02 4D F6
				15 00 00 00 01 00 02 4E 02
				15 00 00 00 01 00 02 4F 39
				15 00 00 00 01 00 02 50 02
				15 00 00 00 01 00 02 51 6D
				15 00 00 00 01 00 02 52 02
				15 00 00 00 01 00 02 53 6E
				15 00 00 00 01 00 02 54 02
				15 00 00 00 01 00 02 55 A1
				15 00 00 00 01 00 02 56 02
				15 00 00 00 01 00 02 58 D2
				15 00 00 00 01 00 02 59 02
				15 00 00 00 01 00 02 5A EE
				15 00 00 00 01 00 02 5B 03
				15 00 00 00 01 00 02 5C 16
				15 00 00 00 01 00 02 5D 03
				15 00 00 00 01 00 02 5E 34
				15 00 00 00 01 00 02 5F 03
				15 00 00 00 01 00 02 60 5B
				15 00 00 00 01 00 02 61 03
				15 00 00 00 01 00 02 62 67
				15 00 00 00 01 00 02 63 03
				15 00 00 00 01 00 02 64 74
				15 00 00 00 01 00 02 65 03
				15 00 00 00 01 00 02 66 81
				15 00 00 00 01 00 02 67 03
				15 00 00 00 01 00 02 68 93
				15 00 00 00 01 00 02 69 03
				15 00 00 00 01 00 02 6A A5
				15 00 00 00 01 00 02 6B 03
				15 00 00 00 01 00 02 6C BD
				15 00 00 00 01 00 02 6D 03
				15 00 00 00 01 00 02 6E D3
				15 00 00 00 01 00 02 6F 03
				15 00 00 00 01 00 02 70 D8
				15 00 00 00 01 00 02 71 02
				15 00 00 00 01 00 02 72 0A
				15 00 00 00 01 00 02 73 02
				15 00 00 00 01 00 02 74 0B
				15 00 00 00 01 00 02 75 02
				15 00 00 00 01 00 02 76 0D
				15 00 00 00 01 00 02 77 02
				15 00 00 00 01 00 02 78 0F
				15 00 00 00 01 00 02 79 02
				15 00 00 00 01 00 02 7A 11
				15 00 00 00 01 00 02 7B 02
				15 00 00 00 01 00 02 7C 13
				15 00 00 00 01 00 02 7D 02
				15 00 00 00 01 00 02 7E 15
				15 00 00 00 01 00 02 7F 02
				15 00 00 00 01 00 02 80 17
				15 00 00 00 01 00 02 81 02
				15 00 00 00 01 00 02 82 19
				15 00 00 00 01 00 02 83 02
				15 00 00 00 01 00 02 84 20
				15 00 00 00 01 00 02 85 02
				15 00 00 00 01 00 02 86 27
				15 00 00 00 01 00 02 87 02
				15 00 00 00 01 00 02 88 35
				15 00 00 00 01 00 02 89 02
				15 00 00 00 01 00 02 8A 42
				15 00 00 00 01 00 02 8B 02
				15 00 00 00 01 00 02 8C 5F
				15 00 00 00 01 00 02 8D 02
				15 00 00 00 01 00 02 8E 81
				15 00 00 00 01 00 02 8F 02
				15 00 00 00 01 00 02 90 82
				15 00 00 00 01 00 02 91 02
				15 00 00 00 01 00 02 92 A9
				15 00 00 00 01 00 02 93 02
				15 00 00 00 01 00 02 94 E5
				15 00 00 00 01 00 02 95 03
				15 00 00 00 01 00 02 96 0E
				15 00 00 00 01 00 02 97 03
				15 00 00 00 01 00 02 98 3F
				15 00 00 00 01 00 02 99 03
				15 00 00 00 01 00 02 9A 5C
				15 00 00 00 01 00 02 9B 03
				15 00 00 00 01 00 02 9C 7D
				15 00 00 00 01 00 02 9D 03
				15 00 00 00 01 00 02 9E 87
				15 00 00 00 01 00 02 9F 03
				15 00 00 00 01 00 02 A0 91
				15 00 00 00 01 00 02 A2 03
				15 00 00 00 01 00 02 A3 9E
				15 00 00 00 01 00 02 A4 03
				15 00 00 00 01 00 02 A5 AC
				15 00 00 00 01 00 02 A6 03
				15 00 00 00 01 00 02 A7 B9
				15 00 00 00 01 00 02 A9 03
				15 00 00 00 01 00 02 AA C8
				15 00 00 00 01 00 02 AB 03
				15 00 00 00 01 00 02 AC D4
				15 00 00 00 01 00 02 AD 03
				15 00 00 00 01 00 02 AE D8
				15 00 00 00 01 00 02 AF 02
				15 00 00 00 01 00 02 B0 31
				15 00 00 00 01 00 02 B1 02
				15 00 00 00 01 00 02 B2 32
				15 00 00 00 01 00 02 B3 02
				15 00 00 00 01 00 02 B4 35
				15 00 00 00 01 00 02 B5 02
				15 00 00 00 01 00 02 B6 37
				15 00 00 00 01 00 02 B7 02
				15 00 00 00 01 00 02 B8 3A
				15 00 00 00 01 00 02 B9 02
				15 00 00 00 01 00 02 BA 3C
				15 00 00 00 01 00 02 BB 02
				15 00 00 00 01 00 02 BC 3F
				15 00 00 00 01 00 02 BD 02
				15 00 00 00 01 00 02 BE 41
				15 00 00 00 01 00 02 BF 02
				15 00 00 00 01 00 02 C0 43
				15 00 00 00 01 00 02 C1 02
				15 00 00 00 01 00 02 C2 4C
				15 00 00 00 01 00 02 C3 02
				15 00 00 00 01 00 02 C4 56
				15 00 00 00 01 00 02 C5 02
				15 00 00 00 01 00 02 C6 67
				15 00 00 00 01 00 02 C7 02
				15 00 00 00 01 00 02 C8 79
				15 00 00 00 01 00 02 C9 02
				15 00 00 00 01 00 02 CA 9A
				15 00 00 00 01 00 02 CB 02
				15 00 00 00 01 00 02 CC BC
				15 00 00 00 01 00 02 CD 02
				15 00 00 00 01 00 02 CE BD
				15 00 00 00 01 00 02 CF 02
				15 00 00 00 01 00 02 D0 E4
				15 00 00 00 01 00 02 D1 03
				15 00 00 00 01 00 02 D2 0C
				15 00 00 00 01 00 02 D3 03
				15 00 00 00 01 00 02 D4 25
				15 00 00 00 01 00 02 D5 03
				15 00 00 00 01 00 02 D6 46
				15 00 00 00 01 00 02 D7 03
				15 00 00 00 01 00 02 D8 61
				15 00 00 00 01 00 02 D9 03
				15 00 00 00 01 00 02 DA 80
				15 00 00 00 01 00 02 DB 03
				15 00 00 00 01 00 02 DC 8A
				15 00 00 00 01 00 02 DD 03
				15 00 00 00 01 00 02 DE 93
				15 00 00 00 01 00 02 DF 03
				15 00 00 00 01 00 02 E0 A0
				15 00 00 00 01 00 02 E1 03
				15 00 00 00 01 00 02 E2 AD
				15 00 00 00 01 00 02 E3 03
				15 00 00 00 01 00 02 E4 BA
				15 00 00 00 01 00 02 E5 03
				15 00 00 00 01 00 02 E6 C9
				15 00 00 00 01 00 02 E7 03
				15 00 00 00 01 00 02 E8 D4
				15 00 00 00 01 00 02 E9 03
				15 00 00 00 01 00 02 EA D8
				15 01 00 00 01 00 02 FF 10
				];
		qcom,mdss-dsi-dispparam-papermode7-command-state = "dsi_hs_mode";
		qcom,mdss-dsi-dispparam-srgb-command = [
				15 01 00 00 01 00 02 FF 22
				15 00 00 00 01 00 02 FB 01
				15 00 00 00 01 00 02 FA 01
				15 01 00 00 01 00 02 FF 10
				15 01 00 00 01 00 02 55 80
				15 01 00 00 01 00 02 26 02
				];
		qcom,mdss-dsi-dispparam-srgb-command-state = "dsi_hs_mode";
		qcom,mdss-dsi-dispparam-default-command = [
				15 01 00 00 01 00 02 FF 21
				15 00 00 00 01 00 02 FB 00
				15 01 00 00 01 00 02 FF 22
				15 00 00 00 01 00 02 FB 01
				15 00 00 00 01 00 02 FA 00
				15 01 00 00 01 00 02 FF 10
				05 01 00 00 10 00 02 11 00
				15 01 00 00 01 00 02 55 00
				15 01 00 00 01 00 02 26 01
				];
		qcom,mdss-dsi-dispparam-default-command-state = "dsi_hs_mode";
		qcom,mdss-dsi-dispparam-normal2-command = [
				15 01 00 00 01 00 02 FF 21
				15 00 00 00 01 00 02 FB 00
				15 01 00 00 01 00 02 FF 22
				15 00 00 00 01 00 02 FB 01
				15 00 00 00 01 00 02 FA 00
				15 01 00 00 01 00 02 FF 10
				05 01 00 00 10 00 02 11 00
				15 01 00 00 01 00 02 55 00
				15 01 00 00 01 00 02 26 01
				];
		qcom,mdss-dsi-dispparam-normal2-command-state = "dsi_hs_mode";
	};
};
