/* Copyright (c) 2014-2019, The Linux Foundation. All rights reserved.
 *
 * This program is free software; you can redistribute it and/or modify
 * it under the terms of the GNU General Public License version 2 and
 * only version 2 as published by the Free Software Foundation.
 *
 * This program is distributed in the hope that it will be useful,
 * but WITHOUT ANY WARRANTY; without even the implied warranty of
 * MERCHANTABILITY or FITNESS FOR A PARTICULAR PURPOSE.  See the
 * GNU General Public License for more details.
 */

&android_vendor {
	fsmgr_flags = "wait,slotselect,avb";
};

&android_vbmeta {
	parts = "vbmeta,boot,system,vendor,dtbo";
};

&peripheral_mem {
	reg = <0 0x8ea00000 0 0x2b00000>;
};

&cont_splash_mem_hdmi {
	reg = <0 0xbdd00000 0 0x23ff000>;
};
