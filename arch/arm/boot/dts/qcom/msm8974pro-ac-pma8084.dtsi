/* Copyright (c) 2013, The Linux Foundation. All rights reserved.
 *
 * This program is free software; you can redistribute it and/or modify
 * it under the terms of the GNU General Public License version 2 and
 * only version 2 as published by the Free Software Foundation.
 *
 * This program is distributed in the hope that it will be useful,
 * but WITHOUT ANY WARRANTY; without even the implied warranty of
 * MERCHANTABILITY or FITNESS FOR A PARTICULAR PURPOSE.  See the
 * GNU General Public License for more details.
 */

#include "msm8974pro-pma8084.dtsi"

/ {
	qcom,msm-id = <194 0x10000>,
		      <210 0x10000>,
		      <213 0x10000>,
		      <216 0x10000>;
};

&sdhc_1 {
	reg = <0xf9824900 0x1a0>, <0xf9824000 0x800>;
};
