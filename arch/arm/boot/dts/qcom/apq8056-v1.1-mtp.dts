/*
 * Copyright (c) 2015, The Linux Foundation. All rights reserved.
 *
 * This program is free software; you can redistribute it and/or modify
 * it under the terms of the GNU General Public License version 2 and
 * only version 2 as published by the Free Software Foundation.
 *
 * This program is distributed in the hope that it will be useful,
 * but WITHOUT ANY WARRANTY; without even the implied warranty of
 * MERCHANTABILITY or FITNESS FOR A PARTICULAR PURPOSE.  See the
 * GNU General Public License for more details.
 */


/dts-v1/;

#include "apq8056-v1.1.dtsi"
#include "msm8956-mtp.dtsi"

/ {
	model = "Qualcomm Technologies, Inc. APQ 8056v1.1 MTP";
	compatible = "qcom,apq8056-mtp", "qcom,apq8056", "qcom,mtp";
	qcom,board-id = <8 0>;
};
