/* Copyright (c) 2014-2015, The Linux Foundation. All rights reserved.
 *
 * This program is free software; you can redistribute it and/or modify
 * it under the terms of the GNU General Public License version 2 and
 * only version 2 as published by the Free Software Foundation.
 *
 * This program is distributed in the hope that it will be useful,
 * but WITHOUT ANY WARRANTY; without even the implied warranty of
 * MERCHANTABILITY or FITNESS FOR A PARTICULAR PURPOSE.  See the
 * GNU General Public License for more details.
 */


/dts-v1/;

#include "msm8996-v3.dtsi"
#include "msm8996-sim.dtsi"

/ {
	model = "Qualcomm Technologies, Inc. MSM 8996 v3 SIM";
	compatible = "qcom,msm8996-sim", "qcom,msm8996", "qcom,sim";
	qcom,board-id = <16 0>;
};
