/*
 * Copyright (c) 2016, The Linux Foundation. All rights reserved.
 *
 * This program is free software; you can redistribute it and/or modify
 * it under the terms of the GNU General Public License version 2 and
 * only version 2 as published by the Free Software Foundation.
 *
 * This program is distributed in the hope that it will be useful,
 * but WITHOUT ANY WARRANTY; without even the implied warranty of
 * MERCHANTABILITY or FITNESS FOR A PARTICULAR PURPOSE.  See the
 * GNU General Public License for more details.
 */

/dts-v1/;

#include "msm8917.dtsi"
#include "msm8917-qgp-tmo.dtsi"

/ {
	model = "Qualcomm Technologies, Inc. MSM8917-PMI8937 QGP TMO";
	compatible = "qcom,msm8917-qgp-tmo", "qcom,msm8917-qrd",
		   "qcom,msm8917", "qcom,qrd";
	qcom,board-id= <0x1000b 0x0a>;
};
