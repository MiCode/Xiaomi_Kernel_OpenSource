/* Copyright (c) 2018, The Linux Foundation. All rights reserved.
 *
 * This program is free software; you can redistribute it and/or modify
 * it under the terms of the GNU General Public License version 2 and
 * only version 2 as published by the Free Software Foundation.
 *
 * This program is distributed in the hope that it will be useful,
 * but WITHOUT ANY WARRANTY; without even the implied warranty of
 * MERCHANTABILITY or FITNESS FOR A PARTICULAR PURPOSE.  See the
 * GNU General Public License for more details.
 */

#include "sdxpoorwills-mtp.dtsi"

&sdhc_1 {
	qcom,vdd-io-voltage-level = <1800000 1800000>;

	qcom,core_3_0v_support;
	qcom,nonremovable;

	pinctrl-0 = <&sdc1_clk_on &sdc1_cmd_on &sdc1_data_on
					&sdc1_wlan_gpio_active>;
	pinctrl-1 = <&sdc1_clk_off &sdc1_cmd_off &sdc1_data_off
					&sdc1_wlan_gpio_sleep>;

	#address-cells = <0>;
	interrupt-parent = <&sdhc_1>;
	interrupts = <0 1 2>;
	#interrupt-cells = <1>;
	interrupt-map-mask = <0xffffffff>;
	interrupt-map = <0 &intc 0 210 0
			1 &intc 0 227 0
			2 &tlmm 82 0x4>;
	interrupt-names = "hc_irq", "pwr_irq", "sdiowakeup_irq";

	/delete-property/ qcom,devfreq,freq-table;
	/delete-property/ cd-gpios;
};
