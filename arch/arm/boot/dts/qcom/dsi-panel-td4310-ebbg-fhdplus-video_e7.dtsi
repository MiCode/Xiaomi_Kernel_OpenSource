/* Copyright (c) 2012-2015, The Linux Foundation. All rights reserved.
 * Copyright (C) 2019 XiaoMi, Inc.
 *
 * This program is free software; you can redistribute it and/or modify
 * it under the terms of the GNU General Public License version 2 and
 * only version 2 as published by the Free Software Foundation.
 *
 * This program is distributed in the hope that it will be useful,
 * but WITHOUT ANY WARRANTY; without even the implied warranty of
 * MERCHANTABILITY or FITNESS FOR A PARTICULAR PURPOSE.  See the
 * GNU General Public License for more details.
 */

&mdss_mdp {
	dsi_td4310_ebbg_fhdplus_e7_vid: qcom,mdss_dsi_td4310_ebbg_fhdplus_video_e7 {
		qcom,mdss-dsi-panel-name = "td4310 ebbg fhdplus e7 video mode dsi panel";
		qcom,mdss-dsi-panel-type = "dsi_video_mode";
		qcom,mdss-dsi-panel-framerate = <60>;
		qcom,mdss-dsi-virtual-channel-id = <0>;
		qcom,mdss-dsi-stream = <0>;
		qcom,mdss-dsi-panel-width = <1080>;
		qcom,mdss-dsi-panel-height = <2160>;
		qcom,mdss-dsi-h-front-porch = <130>;
		qcom,mdss-dsi-h-back-porch = <26>;
		qcom,mdss-dsi-h-pulse-width = <2>;
		qcom,mdss-dsi-h-sync-skew = <0>;
		qcom,mdss-dsi-v-back-porch = <54>;
		qcom,mdss-dsi-v-front-porch = <4>;
		qcom,mdss-dsi-v-pulse-width = <10>;
		qcom,mdss-dsi-h-left-border = <0>;
		qcom,mdss-dsi-h-right-border = <0>;
		qcom,mdss-dsi-v-top-border = <0>;
		qcom,mdss-dsi-v-bottom-border = <0>;
		qcom,mdss-dsi-bpp = <24>;
		qcom,mdss-dsi-underflow-color = <0xff>;
		qcom,mdss-dsi-border-color = <0>;


		qcom,mdss-white-command-00 = [
			29 01 00 00 00 00 02 B0 04
			29 01 00 00 00 00 02 D6 01
			29 01 00 00 00 00 27 C7 00 10 1C 2C 3A 45 5D 6F 7D 8A 3E 4B 5B 71 7B 88 98 A5 B1 00 10 1C 2C 3A 45 5D 6F 7D 8A 3E 4B 5B 71 7B 88 98 A5 B1
			29 01 00 00 00 00 15 C8 01 00 03 01 03 FC 00 00 03 FE FE FC 00 00 01 FE FB FC 00 00
		];
		qcom,mdss-dsi-on-command = [
			39 01 00 00 78 00 02 11 00
			29 01 00 00 00 00 02 B0 04
			29 01 00 00 00 00 02 D6 01
			29 01 00 00 00 00 27 C7 00 10 1C 2C 3A 45 5D 6F 7D 8A 3E 4B 5B 71 7B 88 98 A5 B1 00 10 1C 2C 3A 45 5D 6F 7D 8A 3E 4B 5B 71 7B 88 98 A5 B1
			29 01 00 00 00 00 15 C8 01 00 03 01 03 FC 00 00 03 FE FE FC 00 00 01 FE FB FC 00 00
			39 01 00 00 00 00 02 51 ff
			39 01 00 00 00 00 02 53 24
			39 01 00 00 00 00 02 55 00
			39 01 00 00 00 00 02 35 00
			39 01 00 00 14 00 02 29 00
		];
		qcom,mdss-white-command-01 = [
			29 01 00 00 00 00 02 B0 04
			29 01 00 00 00 00 02 D6 01
			29 01 00 00 00 00 27 C7 00 11 1D 2D 3B 46 5E 6F 7D 8A 3D 4A 5A 70 7B 88 98 A4 B1 00 11 1D 2D 3B 46 5E 6F 7D 8A 3D 4A 5A 70 7B 88 98 A4 B1
			29 01 00 00 00 00 38 C8 01 00 F9 02 01 BB 00 00 01 05 03 FC 00 00 FC 03 FF B1 00 00 FA 02 01 BD 00 00 01 05 03 FC 00 00 FC 04 FE E3 00 00 FA 02 FF FB 00 00 01 05 03 FC 00 00 FC 03 FE 9F 00
		];
		qcom,mdss-dsi-on-command-01 = [
			39 01 00 00 78 00 02 11 00
			29 01 00 00 00 00 02 B0 04
			29 01 00 00 00 00 02 D6 01
			29 01 00 00 00 00 27 C7 00 11 1D 2D 3B 46 5E 6F 7D 8A 3D 4A 5A 70 7B 88 98 A4 B1 00 11 1D 2D 3B 46 5E 6F 7D 8A 3D 4A 5A 70 7B 88 98 A4 B1
			29 01 00 00 00 00 38 C8 01 00 F9 02 01 BB 00 00 01 05 03 FC 00 00 FC 03 FF B1 00 00 FA 02 01 BD 00 00 01 05 03 FC 00 00 FC 04 FE E3 00 00 FA 02 FF FB 00 00 01 05 03 FC 00 00 FC 03 FE 9F 00
			39 01 00 00 00 00 02 51 ff
			39 01 00 00 00 00 02 53 24
			39 01 00 00 00 00 02 55 00
			39 01 00 00 00 00 02 35 00
			39 01 00 00 14 00 02 29 00
		];
		qcom,mdss-white-command-02 = [
			29 01 00 00 00 00 02 B0 04
			29 01 00 00 00 00 02 D6 01
			29 01 00 00 00 00 27 C7 00 11 1D 2D 3B 46 5E 6F 7D 8A 3D 4A 5A 70 7B 88 98 A4 B1 00 11 1D 2D 3B 46 5E 6F 7D 8A 3D 4A 5A 70 7B 88 98 A4 B1
			29 01 00 00 00 00 38 C8 01 00 FA 02 01 DD 00 00 01 05 03 FC 00 00 FB 04 FD D5 00 00 F9 02 FF D4 00 00 FE 05 03 EE 00 00 FC 03 FE FC 00 00 F9 02 FF FC 00 00 01 04 02 DD 00 00 FC 03 FE A4 00
		];
		qcom,mdss-dsi-on-command-02 = [
			39 01 00 00 78 00 02 11 00
			29 01 00 00 00 00 02 B0 04
			29 01 00 00 00 00 02 D6 01
			29 01 00 00 00 00 27 C7 00 11 1D 2D 3B 46 5E 6F 7D 8A 3D 4A 5A 70 7B 88 98 A4 B1 00 11 1D 2D 3B 46 5E 6F 7D 8A 3D 4A 5A 70 7B 88 98 A4 B1
			29 01 00 00 00 00 38 C8 01 00 FA 02 01 DD 00 00 01 05 03 FC 00 00 FB 04 FD D5 00 00 F9 02 FF D4 00 00 FE 05 03 EE 00 00 FC 03 FE FC 00 00 F9 02 FF FC 00 00 01 04 02 DD 00 00 FC 03 FE A4 00
			39 01 00 00 00 00 02 51 ff
			39 01 00 00 00 00 02 53 24
			39 01 00 00 00 00 02 55 00
			39 01 00 00 00 00 02 35 00
			39 01 00 00 14 00 02 29 00
		];
		qcom,mdss-white-command-03 = [
			29 01 00 00 00 00 02 B0 04
			29 01 00 00 00 00 02 D6 01
			29 01 00 00 00 00 27 C7 00 11 1D 2D 3B 46 5E 6F 7D 8A 3D 4A 5A 70 7B 88 98 A4 B1 00 11 1D 2D 3B 46 5E 6F 7D 8A 3D 4A 5A 70 7B 88 98 A4 B1
			29 01 00 00 00 00 38 C8 01 00 F9 02 FF FC 00 00 FE 04 01 D4 00 00 FD 03 FE F7 00 00 FA 02 FF D3 00 00 FE 04 01 A5 00 00 FC 03 FE FC 00 00 F9 02 FF FC 00 00 01 03 02 9A 00 00 FC 03 01 AA 00
		];
		qcom,mdss-dsi-on-command-03 = [
			39 01 00 00 78 00 02 11 00
			29 01 00 00 00 00 02 B0 04
			29 01 00 00 00 00 02 D6 01
			29 01 00 00 00 00 27 C7 00 11 1D 2D 3B 46 5E 6F 7D 8A 3D 4A 5A 70 7B 88 98 A4 B1 00 11 1D 2D 3B 46 5E 6F 7D 8A 3D 4A 5A 70 7B 88 98 A4 B1
			29 01 00 00 00 00 38 C8 01 00 F9 02 FF FC 00 00 FE 04 01 D4 00 00 FD 03 FE F7 00 00 FA 02 FF D3 00 00 FE 04 01 A5 00 00 FC 03 FE FC 00 00 F9 02 FF FC 00 00 01 03 02 9A 00 00 FC 03 01 AA 00
			39 01 00 00 00 00 02 51 ff
			39 01 00 00 00 00 02 53 24
			39 01 00 00 00 00 02 55 00
			39 01 00 00 00 00 02 35 00
			39 01 00 00 14 00 02 29 00
		];
		qcom,mdss-white-command-04 = [
			29 01 00 00 00 00 02 B0 04
			29 01 00 00 00 00 02 D6 01
			29 01 00 00 00 00 27 C7 00 11 1D 2D 3B 46 5E 6F 7D 8A 3D 4A 5A 70 7B 88 98 A4 B1 00 11 1D 2D 3B 46 5E 6F 7D 8A 3D 4A 5A 70 7B 88 98 A4 B1
			29 01 00 00 00 00 38 C8 01 00 F9 02 FF FC 00 00 FF 04 02 AE 00 00 FD 03 FD F9 00 00 FA 02 FF D3 00 00 FF 03 02 80 00 00 FC 03 FE FC 00 00 F9 02 FF FC 00 00 01 03 01 79 00 00 FC 03 FF AE 00
		];
		qcom,mdss-dsi-on-command-04 = [
			39 01 00 00 78 00 02 11 00
			29 01 00 00 00 00 02 B0 04
			29 01 00 00 00 00 02 D6 01
			29 01 00 00 00 00 27 C7 00 11 1D 2D 3B 46 5E 6F 7D 8A 3D 4A 5A 70 7B 88 98 A4 B1 00 11 1D 2D 3B 46 5E 6F 7D 8A 3D 4A 5A 70 7B 88 98 A4 B1
			29 01 00 00 00 00 38 C8 01 00 F9 02 FF FC 00 00 FF 04 02 AE 00 00 FD 03 FD F9 00 00 FA 02 FF D3 00 00 FF 03 02 80 00 00 FC 03 FE FC 00 00 F9 02 FF FC 00 00 01 03 01 79 00 00 FC 03 FF AE 00
			39 01 00 00 00 00 02 51 ff
			39 01 00 00 00 00 02 53 24
			39 01 00 00 00 00 02 55 00
			39 01 00 00 00 00 02 35 00
			39 01 00 00 14 00 02 29 00
		];
		qcom,mdss-white-command-05 = [
			29 01 00 00 00 00 02 B0 04
			29 01 00 00 00 00 02 D6 01
			29 01 00 00 00 00 27 C7 00 11 1D 2D 3B 46 5E 6F 7D 8A 3D 4A 5A 70 7B 88 98 A4 B1 00 11 1D 2D 3B 46 5E 6F 7D 8A 3D 4A 5A 70 7B 88 98 A4 B1
			29 01 00 00 00 00 38 C8 01 00 F9 02 FF FC 00 00 01 03 01 87 00 00 FD 03 01 83 00 00 F9 02 FF FC 00 00 FF 03 02 7C 00 00 FD 03 01 AD 00 00 F9 02 FF FC 00 00 FF 03 02 59 00 00 FD 02 02 46 00
		];
		qcom,mdss-dsi-on-command-05 = [
			39 01 00 00 78 00 02 11 00
			29 01 00 00 00 00 02 B0 04
			29 01 00 00 00 00 02 D6 01
			29 01 00 00 00 00 27 C7 00 11 1D 2D 3B 46 5E 6F 7D 8A 3D 4A 5A 70 7B 88 98 A4 B1 00 11 1D 2D 3B 46 5E 6F 7D 8A 3D 4A 5A 70 7B 88 98 A4 B1
			29 01 00 00 00 00 38 C8 01 00 F9 02 FF FC 00 00 01 03 01 87 00 00 FD 03 01 83 00 00 F9 02 FF FC 00 00 FF 03 02 7C 00 00 FD 03 01 AD 00 00 F9 02 FF FC 00 00 FF 03 02 59 00 00 FD 02 02 46 00
			39 01 00 00 00 00 02 51 ff
			39 01 00 00 00 00 02 53 24
			39 01 00 00 00 00 02 55 00
			39 01 00 00 00 00 02 35 00
			39 01 00 00 14 00 02 29 00
		];
		qcom,mdss-white-command-06 = [
			29 01 00 00 00 00 02 B0 04
			29 01 00 00 00 00 02 D6 01
			29 01 00 00 00 00 27 C7 00 11 1D 2D 3B 46 5E 6F 7D 8A 3D 4A 5A 70 7B 88 98 A4 B1 00 11 1D 2D 3B 46 5E 6F 7D 8A 3D 4A 5A 70 7B 88 98 A4 B1
			29 01 00 00 00 00 38 C8 01 00 F9 02 FF FC 00 00 01 04 02 BB 00 00 FC 03 FF B9 00 00 F9 02 FF FC 00 00 FE 04 01 B3 00 00 FC 04 FE E4 00 00 F9 02 FF FC 00 00 01 03 01 88 00 00 FC 03 01 73 00
		];
		qcom,mdss-dsi-on-command-06 = [
			39 01 00 00 78 00 02 11 00
			29 01 00 00 00 00 02 B0 04
			29 01 00 00 00 00 02 D6 01
			29 01 00 00 00 00 27 C7 00 11 1D 2D 3B 46 5E 6F 7D 8A 3D 4A 5A 70 7B 88 98 A4 B1 00 11 1D 2D 3B 46 5E 6F 7D 8A 3D 4A 5A 70 7B 88 98 A4 B1
			29 01 00 00 00 00 38 C8 01 00 F9 02 FF FC 00 00 01 04 02 BB 00 00 FC 03 FF B9 00 00 F9 02 FF FC 00 00 FE 04 01 B3 00 00 FC 04 FE E4 00 00 F9 02 FF FC 00 00 01 03 01 88 00 00 FC 03 01 73 00
			39 01 00 00 00 00 02 51 ff
			39 01 00 00 00 00 02 53 24
			39 01 00 00 00 00 02 55 00
			39 01 00 00 00 00 02 35 00
			39 01 00 00 14 00 02 29 00
		];
		qcom,mdss-white-command-07 = [
			29 01 00 00 00 00 02 B0 04
			29 01 00 00 00 00 02 D6 01
			29 01 00 00 00 00 27 C7 00 11 1D 2D 3B 46 5E 6F 7D 8A 3D 4A 5A 70 7B 88 98 A4 B1 00 11 1D 2D 3B 46 5E 6F 7D 8A 3D 4A 5A 70 7B 88 98 A4 B1
			29 01 00 00 00 00 38 C8 01 00 F9 02 FF BF 00 00 01 05 03 FC 00 00 FD 03 FF FA 00 00 F9 02 01 91 00 00 FE 04 01 CE 00 00 FC 03 FE FC 00 00 F9 02 FF FC 00 00 01 05 04 F4 00 00 FC 04 FE E0 00
		];
		qcom,mdss-dsi-on-command-07 = [
			39 01 00 00 78 00 02 11 00
			29 01 00 00 00 00 02 B0 04
			29 01 00 00 00 00 02 D6 01
			29 01 00 00 00 00 27 C7 00 11 1D 2D 3B 46 5E 6F 7D 8A 3D 4A 5A 70 7B 88 98 A4 B1 00 11 1D 2D 3B 46 5E 6F 7D 8A 3D 4A 5A 70 7B 88 98 A4 B1
			29 01 00 00 00 00 38 C8 01 00 F9 02 FF BF 00 00 01 05 03 FC 00 00 FD 03 FF FA 00 00 F9 02 01 91 00 00 FE 04 01 CE 00 00 FC 03 FE FC 00 00 F9 02 FF FC 00 00 01 05 04 F4 00 00 FC 04 FE E0 00
			39 01 00 00 00 00 02 51 ff
			39 01 00 00 00 00 02 53 24
			39 01 00 00 00 00 02 55 00
			39 01 00 00 00 00 02 35 00
			39 01 00 00 14 00 02 29 00
		];
		qcom,mdss-white-command-08 = [
			29 01 00 00 00 00 02 B0 04
			29 01 00 00 00 00 02 D6 01
			29 01 00 00 00 00 27 C7 00 11 1D 2D 3B 46 5E 6F 7D 8A 3D 4A 5A 70 7B 88 98 A4 B1 00 11 1D 2D 3B 46 5E 6F 7D 8A 3D 4A 5A 70 7B 88 98 A4 B1
			29 01 00 00 00 00 38 C8 01 00 F9 02 02 78 00 00 01 05 03 FC 00 00 FD 03 FE F9 00 00 FA 01 03 4E 00 00 FF 04 01 D0 00 00 FC 03 FE FC 00 00 F9 02 FF C2 00 00 01 05 03 FC 00 00 FC 04 FE E7 00
		];
		qcom,mdss-dsi-on-command-08 = [
			39 01 00 00 78 00 02 11 00
			29 01 00 00 00 00 02 B0 04
			29 01 00 00 00 00 02 D6 01
			29 01 00 00 00 00 27 C7 00 11 1D 2D 3B 46 5E 6F 7D 8A 3D 4A 5A 70 7B 88 98 A4 B1 00 11 1D 2D 3B 46 5E 6F 7D 8A 3D 4A 5A 70 7B 88 98 A4 B1
			29 01 00 00 00 00 38 C8 01 00 F9 02 02 78 00 00 01 05 03 FC 00 00 FD 03 FE F9 00 00 FA 01 03 4E 00 00 FF 04 01 D0 00 00 FC 03 FE FC 00 00 F9 02 FF C2 00 00 01 05 03 FC 00 00 FC 04 FE E7 00
			39 01 00 00 00 00 02 51 ff
			39 01 00 00 00 00 02 53 24
			39 01 00 00 00 00 02 55 00
			39 01 00 00 00 00 02 35 00
			39 01 00 00 14 00 02 29 00
		];
		qcom,mdss-white-command-09 = [
			29 01 00 00 00 00 02 B0 04
			29 01 00 00 00 00 02 D6 01
			29 01 00 00 00 00 27 C7 00 11 1D 2D 3B 46 5E 6F 7D 8A 3D 4A 5A 70 7B 88 98 A4 B1 00 11 1D 2D 3B 46 5E 6F 7D 8A 3D 4A 5A 70 7B 88 98 A4 B1
			29 01 00 00 00 00 38 C8 01 00 F9 02 FF FC 00 00 01 04 01 C7 00 00 FC 03 01 7A 00 00 F9 02 FF FC 00 00 FF 04 01 BF 00 00 FC 03 FE A7 00 00 F9 02 FF FC 00 00 FF 03 01 96 00 00 FD 02 02 3A 00
		];
		qcom,mdss-dsi-on-command-09 = [
			39 01 00 00 78 00 02 11 00
			29 01 00 00 00 00 02 B0 04
			29 01 00 00 00 00 02 D6 01
			29 01 00 00 00 00 27 C7 00 11 1D 2D 3B 46 5E 6F 7D 8A 3D 4A 5A 70 7B 88 98 A4 B1 00 11 1D 2D 3B 46 5E 6F 7D 8A 3D 4A 5A 70 7B 88 98 A4 B1
			29 01 00 00 00 00 38 C8 01 00 F9 02 FF FC 00 00 01 04 01 C7 00 00 FC 03 01 7A 00 00 F9 02 FF FC 00 00 FF 04 01 BF 00 00 FC 03 FE A7 00 00 F9 02 FF FC 00 00 FF 03 01 96 00 00 FD 02 02 3A 00
			39 01 00 00 00 00 02 51 ff
			39 01 00 00 00 00 02 53 24
			39 01 00 00 00 00 02 55 00
			39 01 00 00 00 00 02 35 00
			39 01 00 00 14 00 02 29 00
		];
		qcom,mdss-white-command-10 = [
			29 01 00 00 00 00 02 B0 04
			29 01 00 00 00 00 02 D6 01
			29 01 00 00 00 00 27 C7 00 11 1D 2D 3B 46 5E 6F 7D 8A 3D 4A 5A 70 7B 88 98 A4 B1 00 11 1D 2D 3B 46 5E 6F 7D 8A 3D 4A 5A 70 7B 88 98 A4 B1
			29 01 00 00 00 00 38 C8 01 00 F9 02 FF FC 00 00 01 03 02 A7 00 00 FC 03 01 7F 00 00 F9 02 FF FC 00 00 01 03 02 9E 00 00 FC 03 FF AA 00 00 F9 02 FF FC 00 00 01 03 02 77 00 00 FD 02 03 40 00
		];
		qcom,mdss-dsi-on-command-10 = [
			39 01 00 00 78 00 02 11 00
			29 01 00 00 00 00 02 B0 04
			29 01 00 00 00 00 02 D6 01
			29 01 00 00 00 00 27 C7 00 11 1D 2D 3B 46 5E 6F 7D 8A 3D 4A 5A 70 7B 88 98 A4 B1 00 11 1D 2D 3B 46 5E 6F 7D 8A 3D 4A 5A 70 7B 88 98 A4 B1
			29 01 00 00 00 00 38 C8 01 00 F9 02 FF FC 00 00 01 03 02 A7 00 00 FC 03 01 7F 00 00 F9 02 FF FC 00 00 01 03 02 9E 00 00 FC 03 FF AA 00 00 F9 02 FF FC 00 00 01 03 02 77 00 00 FD 02 03 40 00
			39 01 00 00 00 00 02 51 ff
			39 01 00 00 00 00 02 53 24
			39 01 00 00 00 00 02 55 00
			39 01 00 00 00 00 02 35 00
			39 01 00 00 14 00 02 29 00
		];
		qcom,mdss-white-command-11 = [
			29 01 00 00 00 00 02 B0 04
			29 01 00 00 00 00 02 D6 01
			29 01 00 00 00 00 27 C7 00 11 1D 2D 3B 46 5E 6F 7D 8A 3D 4A 5A 70 7B 88 98 A4 B1 00 11 1D 2D 3B 46 5E 6F 7D 8A 3D 4A 5A 70 7B 88 98 A4 B1
			29 01 00 00 00 00 38 C8 01 00 F9 02 FF FC 00 00 FF 03 01 67 00 00 FD 03 01 87 00 00 F9 02 FF FC 00 00 FE 03 01 5B 00 00 FC 03 FE B1 00 00 F9 02 FF FC 00 00 01 02 02 3B 00 00 FC 03 01 4B 00
		];
		qcom,mdss-dsi-on-command-11 = [
			39 01 00 00 78 00 02 11 00
			29 01 00 00 00 00 02 B0 04
			29 01 00 00 00 00 02 D6 01
			29 01 00 00 00 00 27 C7 00 11 1D 2D 3B 46 5E 6F 7D 8A 3D 4A 5A 70 7B 88 98 A4 B1 00 11 1D 2D 3B 46 5E 6F 7D 8A 3D 4A 5A 70 7B 88 98 A4 B1
			29 01 00 00 00 00 38 C8 01 00 F9 02 FF FC 00 00 FF 03 01 67 00 00 FD 03 01 87 00 00 F9 02 FF FC 00 00 FE 03 01 5B 00 00 FC 03 FE B1 00 00 F9 02 FF FC 00 00 01 02 02 3B 00 00 FC 03 01 4B 00
			39 01 00 00 00 00 02 51 ff
			39 01 00 00 00 00 02 53 24
			39 01 00 00 00 00 02 55 00
			39 01 00 00 00 00 02 35 00
			39 01 00 00 14 00 02 29 00
		];
		qcom,mdss-white-command-12 = [
			29 01 00 00 00 00 02 B0 04
			29 01 00 00 00 00 02 D6 01
			29 01 00 00 00 00 27 C7 00 11 1D 2D 3B 46 5E 6F 7D 8A 3D 4A 5A 70 7B 88 98 A4 B1 00 11 1D 2D 3B 46 5E 6F 7D 8A 3D 4A 5A 70 7B 88 98 A4 B1
			29 01 00 00 00 00 38 C8 01 00 F9 02 FF FC 00 00 01 02 03 46 00 00 FD 03 02 8B 00 00 F9 02 FF FC 00 00 01 02 02 39 00 00 FC 03 FE B5 00 00 F9 02 FF FC 00 00 FF 02 01 1E 00 00 FC 03 02 50 00
		];
		qcom,mdss-dsi-on-command-12 = [
			39 01 00 00 78 00 02 11 00
			29 01 00 00 00 00 02 B0 04
			29 01 00 00 00 00 02 D6 01
			29 01 00 00 00 00 27 C7 00 11 1D 2D 3B 46 5E 6F 7D 8A 3D 4A 5A 70 7B 88 98 A4 B1 00 11 1D 2D 3B 46 5E 6F 7D 8A 3D 4A 5A 70 7B 88 98 A4 B1
			29 01 00 00 00 00 38 C8 01 00 F9 02 FF FC 00 00 01 02 03 46 00 00 FD 03 02 8B 00 00 F9 02 FF FC 00 00 01 02 02 39 00 00 FC 03 FE B5 00 00 F9 02 FF FC 00 00 FF 02 01 1E 00 00 FC 03 02 50 00
			39 01 00 00 00 00 02 51 ff
			39 01 00 00 00 00 02 53 24
			39 01 00 00 00 00 02 55 00
			39 01 00 00 00 00 02 35 00
			39 01 00 00 14 00 02 29 00
		];
		qcom,mdss-white-command-13 = [
			29 01 00 00 00 00 02 B0 04
			29 01 00 00 00 00 02 D6 01
			29 01 00 00 00 00 27 C7 00 11 1D 2D 3B 46 5E 6F 7D 8A 3D 4A 5A 70 7B 88 98 A4 B1 00 11 1D 2D 3B 46 5E 6F 7D 8A 3D 4A 5A 70 7B 88 98 A4 B1
			29 01 00 00 00 00 38 C8 01 00 F9 02 01 FA 00 00 01 05 03 FC 00 00 FC 03 FE B1 00 00 F9 02 FF FC 00 00 01 05 03 F8 00 00 FC 04 FE E0 00 00 F9 02 FF FC 00 00 FF 04 01 C7 00 00 FC 03 02 68 00
		];
		qcom,mdss-dsi-on-command-13 = [
			39 01 00 00 78 00 02 11 00
			29 01 00 00 00 00 02 B0 04
			29 01 00 00 00 00 02 D6 01
			29 01 00 00 00 00 27 C7 00 11 1D 2D 3B 46 5E 6F 7D 8A 3D 4A 5A 70 7B 88 98 A4 B1 00 11 1D 2D 3B 46 5E 6F 7D 8A 3D 4A 5A 70 7B 88 98 A4 B1
			29 01 00 00 00 00 38 C8 01 00 F9 02 01 FA 00 00 01 05 03 FC 00 00 FC 03 FE B1 00 00 F9 02 FF FC 00 00 01 05 03 F8 00 00 FC 04 FE E0 00 00 F9 02 FF FC 00 00 FF 04 01 C7 00 00 FC 03 02 68 00
			39 01 00 00 00 00 02 51 ff
			39 01 00 00 00 00 02 53 24
			39 01 00 00 00 00 02 55 00
			39 01 00 00 00 00 02 35 00
			39 01 00 00 14 00 02 29 00
		];
		qcom,mdss-white-command-14 = [
			29 01 00 00 00 00 02 B0 04
			29 01 00 00 00 00 02 D6 01
			29 01 00 00 00 00 27 C7 00 11 1D 2D 3B 46 5E 6F 7D 8A 3D 4A 5A 70 7B 88 98 A4 B1 00 11 1D 2D 3B 46 5E 6F 7D 8A 3D 4A 5A 70 7B 88 98 A4 B1
			29 01 00 00 00 00 38 C8 01 00 F9 02 FF FC 00 00 FE 05 01 DD 00 00 FC 03 FE B6 00 00 F9 02 FF FC 00 00 01 04 01 D7 00 00 FC 04 FE E2 00 00 F9 02 FF FC 00 00 FF 04 01 A7 00 00 FC 03 02 6D 00
		];
		qcom,mdss-dsi-on-command-14 = [
			39 01 00 00 78 00 02 11 00
			29 01 00 00 00 00 02 B0 04
			29 01 00 00 00 00 02 D6 01
			29 01 00 00 00 00 27 C7 00 11 1D 2D 3B 46 5E 6F 7D 8A 3D 4A 5A 70 7B 88 98 A4 B1 00 11 1D 2D 3B 46 5E 6F 7D 8A 3D 4A 5A 70 7B 88 98 A4 B1
			29 01 00 00 00 00 38 C8 01 00 F9 02 FF FC 00 00 FE 05 01 DD 00 00 FC 03 FE B6 00 00 F9 02 FF FC 00 00 01 04 01 D7 00 00 FC 04 FE E2 00 00 F9 02 FF FC 00 00 FF 04 01 A7 00 00 FC 03 02 6D 00
			39 01 00 00 00 00 02 51 ff
			39 01 00 00 00 00 02 53 24
			39 01 00 00 00 00 02 55 00
			39 01 00 00 00 00 02 35 00
			39 01 00 00 14 00 02 29 00
		];
		qcom,mdss-white-command-15 = [
			29 01 00 00 00 00 02 B0 04
			29 01 00 00 00 00 02 D6 01
			29 01 00 00 00 00 27 C7 00 11 1D 2D 3B 46 5E 6F 7D 8A 3D 4A 5A 70 7B 88 98 A4 B1 00 11 1D 2D 3B 46 5E 6F 7D 8A 3D 4A 5A 70 7B 88 98 A4 B1
			29 01 00 00 00 00 38 C8 01 00 F9 02 FF FC 00 00 01 03 02 9A 00 00 FC 03 FF BC 00 00 F9 02 FF FC 00 00 FF 03 01 90 00 00 FC 04 FD E7 00 00 F9 02 FF FC 00 00 FF 03 02 68 00 00 FC 03 01 77 00
		];
		qcom,mdss-dsi-on-command-15 = [
			39 01 00 00 78 00 02 11 00
			29 01 00 00 00 00 02 B0 04
			29 01 00 00 00 00 02 D6 01
			29 01 00 00 00 00 27 C7 00 11 1D 2D 3B 46 5E 6F 7D 8A 3D 4A 5A 70 7B 88 98 A4 B1 00 11 1D 2D 3B 46 5E 6F 7D 8A 3D 4A 5A 70 7B 88 98 A4 B1
			29 01 00 00 00 00 38 C8 01 00 F9 02 FF FC 00 00 01 03 02 9A 00 00 FC 03 FF BC 00 00 F9 02 FF FC 00 00 FF 03 01 90 00 00 FC 04 FD E7 00 00 F9 02 FF FC 00 00 FF 03 02 68 00 00 FC 03 01 77 00
			39 01 00 00 00 00 02 51 ff
			39 01 00 00 00 00 02 53 24
			39 01 00 00 00 00 02 55 00
			39 01 00 00 00 00 02 35 00
			39 01 00 00 14 00 02 29 00
		];
		qcom,mdss-white-command-16 = [
			29 01 00 00 00 00 02 B0 04
			29 01 00 00 00 00 02 D6 01
			29 01 00 00 00 00 27 C7 00 11 1D 2D 3B 46 5E 6F 7D 8A 3D 4A 5A 70 7B 88 98 A4 B1 00 11 1D 2D 3B 46 5E 6F 7D 8A 3D 4A 5A 70 7B 88 98 A4 B1
			29 01 00 00 00 00 38 C8 01 00 F9 02 FF FC 00 00 FF 03 01 78 00 00 FC 03 FE C0 00 00 F9 02 FF FC 00 00 01 03 02 6B 00 00 FC 04 FE E9 00 00 F9 02 FF FC 00 00 01 02 03 48 00 00 FD 03 02 7B 00
		];
		qcom,mdss-dsi-on-command-16 = [
			39 01 00 00 78 00 02 11 00
			29 01 00 00 00 00 02 B0 04
			29 01 00 00 00 00 02 D6 01
			29 01 00 00 00 00 27 C7 00 11 1D 2D 3B 46 5E 6F 7D 8A 3D 4A 5A 70 7B 88 98 A4 B1 00 11 1D 2D 3B 46 5E 6F 7D 8A 3D 4A 5A 70 7B 88 98 A4 B1
			29 01 00 00 00 00 38 C8 01 00 F9 02 FF FC 00 00 FF 03 01 78 00 00 FC 03 FE C0 00 00 F9 02 FF FC 00 00 01 03 02 6B 00 00 FC 04 FE E9 00 00 F9 02 FF FC 00 00 01 02 03 48 00 00 FD 03 02 7B 00
			39 01 00 00 00 00 02 51 ff
			39 01 00 00 00 00 02 53 24
			39 01 00 00 00 00 02 55 00
			39 01 00 00 00 00 02 35 00
			39 01 00 00 14 00 02 29 00
		];
		qcom,mdss-white-command-17 = [
			29 01 00 00 00 00 02 B0 04
			29 01 00 00 00 00 02 D6 01
			29 01 00 00 00 00 27 C7 00 11 1D 2D 3B 46 5E 6F 7D 8A 3D 4A 5A 70 7B 88 98 A4 B1 00 11 1D 2D 3B 46 5E 6F 7D 8A 3D 4A 5A 70 7B 88 98 A4 B1
			29 01 00 00 00 00 38 C8 01 00 F9 02 02 79 00 00 01 05 03 FC 00 00 FC 03 FF B2 00 00 F9 02 02 78 00 00 01 05 03 FC 00 00 FC 04 FE E2 00 00 FA 02 01 BD 00 00 01 05 03 FC 00 00 FC 03 FD A1 00
		];
		qcom,mdss-dsi-on-command-17 = [
			39 01 00 00 78 00 02 11 00
			29 01 00 00 00 00 02 B0 04
			29 01 00 00 00 00 02 D6 01
			29 01 00 00 00 00 27 C7 00 11 1D 2D 3B 46 5E 6F 7D 8A 3D 4A 5A 70 7B 88 98 A4 B1 00 11 1D 2D 3B 46 5E 6F 7D 8A 3D 4A 5A 70 7B 88 98 A4 B1
			29 01 00 00 00 00 38 C8 01 00 F9 02 02 79 00 00 01 05 03 FC 00 00 FC 03 FF B2 00 00 F9 02 02 78 00 00 01 05 03 FC 00 00 FC 04 FE E2 00 00 FA 02 01 BD 00 00 01 05 03 FC 00 00 FC 03 FD A1 00
			39 01 00 00 00 00 02 51 ff
			39 01 00 00 00 00 02 53 24
			39 01 00 00 00 00 02 55 00
			39 01 00 00 00 00 02 35 00
			39 01 00 00 14 00 02 29 00
		];
		qcom,mdss-white-command-18 = [
			29 01 00 00 00 00 02 B0 04
			29 01 00 00 00 00 02 D6 01
			29 01 00 00 00 00 27 C7 00 11 1D 2D 3B 46 5E 6F 7D 8A 3D 4A 5A 70 7B 88 98 A4 B1 00 11 1D 2D 3B 46 5E 6F 7D 8A 3D 4A 5A 70 7B 88 98 A4 B1
			29 01 00 00 00 00 38 C8 01 00 F9 02 01 9C 00 00 01 05 03 FC 00 00 FB 04 FD D5 00 00 FA 02 02 8F 00 00 FE 05 03 F0 00 00 FC 03 FE FC 00 00 F9 02 01 DF 00 00 01 05 03 FC 00 00 FC 03 FE C4 00
		];
		qcom,mdss-dsi-on-command-18 = [
			39 01 00 00 78 00 02 11 00
			29 01 00 00 00 00 02 B0 04
			29 01 00 00 00 00 02 D6 01
			29 01 00 00 00 00 27 C7 00 11 1D 2D 3B 46 5E 6F 7D 8A 3D 4A 5A 70 7B 88 98 A4 B1 00 11 1D 2D 3B 46 5E 6F 7D 8A 3D 4A 5A 70 7B 88 98 A4 B1
			29 01 00 00 00 00 38 C8 01 00 F9 02 01 9C 00 00 01 05 03 FC 00 00 FB 04 FD D5 00 00 FA 02 02 8F 00 00 FE 05 03 F0 00 00 FC 03 FE FC 00 00 F9 02 01 DF 00 00 01 05 03 FC 00 00 FC 03 FE C4 00
			39 01 00 00 00 00 02 51 ff
			39 01 00 00 00 00 02 53 24
			39 01 00 00 00 00 02 55 00
			39 01 00 00 00 00 02 35 00
			39 01 00 00 14 00 02 29 00
		];
		qcom,mdss-white-command-19 = [
			29 01 00 00 00 00 02 B0 04
			29 01 00 00 00 00 02 D6 01
			29 01 00 00 00 00 27 C7 00 11 1D 2D 3B 46 5E 6F 7D 8A 3D 4A 5A 70 7B 88 98 A4 B1 00 11 1D 2D 3B 46 5E 6F 7D 8A 3D 4A 5A 70 7B 88 98 A4 B1
			29 01 00 00 00 00 38 C8 01 00 F9 02 01 C0 00 00 01 04 02 DA 00 00 FC 03 FE FC 00 00 F9 02 02 92 00 00 FE 04 02 A8 00 00 FC 03 FE FC 00 00 F9 02 FF FC 00 00 01 04 01 D3 00 00 FC 04 FF E2 00
		];
		qcom,mdss-dsi-on-command-19 = [
			39 01 00 00 78 00 02 11 00
			29 01 00 00 00 00 02 B0 04
			29 01 00 00 00 00 02 D6 01
			29 01 00 00 00 00 27 C7 00 11 1D 2D 3B 46 5E 6F 7D 8A 3D 4A 5A 70 7B 88 98 A4 B1 00 11 1D 2D 3B 46 5E 6F 7D 8A 3D 4A 5A 70 7B 88 98 A4 B1
			29 01 00 00 00 00 38 C8 01 00 F9 02 01 C0 00 00 01 04 02 DA 00 00 FC 03 FE FC 00 00 F9 02 02 92 00 00 FE 04 02 A8 00 00 FC 03 FE FC 00 00 F9 02 FF FC 00 00 01 04 01 D3 00 00 FC 04 FF E2 00
			39 01 00 00 00 00 02 51 ff
			39 01 00 00 00 00 02 53 24
			39 01 00 00 00 00 02 55 00
			39 01 00 00 00 00 02 35 00
			39 01 00 00 14 00 02 29 00
		];
		qcom,mdss-white-command-20 = [
			29 01 00 00 00 00 02 B0 04
			29 01 00 00 00 00 02 D6 01
			29 01 00 00 00 00 27 C7 00 11 1D 2D 3B 46 5E 6F 7D 8A 3D 4A 5A 70 7B 88 98 A4 B1 00 11 1D 2D 3B 46 5E 6F 7D 8A 3D 4A 5A 70 7B 88 98 A4 B1
			29 01 00 00 00 00 38 C8 01 00 F9 02 01 C0 00 00 FF 04 01 B5 00 00 FB 03 FE FC 00 00 F9 02 01 94 00 00 01 03 01 85 00 00 FC 03 FE FC 00 00 F9 02 FF FC 00 00 FF 04 02 AF 00 00 FB 04 FD E5 00
		];
		qcom,mdss-dsi-on-command-20 = [
			39 01 00 00 78 00 02 11 00
			29 01 00 00 00 00 02 B0 04
			29 01 00 00 00 00 02 D6 01
			29 01 00 00 00 00 27 C7 00 11 1D 2D 3B 46 5E 6F 7D 8A 3D 4A 5A 70 7B 88 98 A4 B1 00 11 1D 2D 3B 46 5E 6F 7D 8A 3D 4A 5A 70 7B 88 98 A4 B1
			29 01 00 00 00 00 38 C8 01 00 F9 02 01 C0 00 00 FF 04 01 B5 00 00 FB 03 FE FC 00 00 F9 02 01 94 00 00 01 03 01 85 00 00 FC 03 FE FC 00 00 F9 02 FF FC 00 00 FF 04 02 AF 00 00 FB 04 FD E5 00
			39 01 00 00 00 00 02 51 ff
			39 01 00 00 00 00 02 53 24
			39 01 00 00 00 00 02 55 00
			39 01 00 00 00 00 02 35 00
			39 01 00 00 14 00 02 29 00
		];
		qcom,mdss-white-command-21 = [
			29 01 00 00 00 00 02 B0 04
			29 01 00 00 00 00 02 D6 01
			29 01 00 00 00 00 27 C7 00 11 1D 2D 3B 46 5E 6F 7D 8A 3D 4A 5A 70 7B 88 98 A4 B1 00 11 1D 2D 3B 46 5E 6F 7D 8A 3D 4A 5A 70 7B 88 98 A4 B1
			29 01 00 00 00 00 38 C8 01 00 FA 01 02 37 00 00 01 05 03 FC 00 00 FC 03 FE B3 00 00 F9 01 01 34 00 00 01 05 03 FC 00 00 FD 03 FF E2 00 00 F9 02 02 7C 00 00 01 05 03 FC 00 00 FC 03 FE A2 00
		];
		qcom,mdss-dsi-on-command-21 = [
			39 01 00 00 78 00 02 11 00
			29 01 00 00 00 00 02 B0 04
			29 01 00 00 00 00 02 D6 01
			29 01 00 00 00 00 27 C7 00 11 1D 2D 3B 46 5E 6F 7D 8A 3D 4A 5A 70 7B 88 98 A4 B1 00 11 1D 2D 3B 46 5E 6F 7D 8A 3D 4A 5A 70 7B 88 98 A4 B1
			29 01 00 00 00 00 38 C8 01 00 FA 01 02 37 00 00 01 05 03 FC 00 00 FC 03 FE B3 00 00 F9 01 01 34 00 00 01 05 03 FC 00 00 FD 03 FF E2 00 00 F9 02 02 7C 00 00 01 05 03 FC 00 00 FC 03 FE A2 00
			39 01 00 00 00 00 02 51 ff
			39 01 00 00 00 00 02 53 24
			39 01 00 00 00 00 02 55 00
			39 01 00 00 00 00 02 35 00
			39 01 00 00 14 00 02 29 00
		];
		qcom,mdss-white-command-22 = [
			29 01 00 00 00 00 02 B0 04
			29 01 00 00 00 00 02 D6 01
			29 01 00 00 00 00 27 C7 00 11 1D 2D 3B 46 5E 6F 7D 8A 3D 4A 5A 70 7B 88 98 A4 B1 00 11 1D 2D 3B 46 5E 6F 7D 8A 3D 4A 5A 70 7B 88 98 A4 B1
			29 01 00 00 00 00 38 C8 01 00 FA 01 02 57 00 00 01 05 03 FC 00 00 FC 03 FE D5 00 00 FA 01 03 4A 00 00 01 05 03 F1 00 00 FC 03 FE FC 00 00 FA 01 01 A0 00 00 01 05 03 FC 00 00 FC 03 FE C4 00
		];
		qcom,mdss-dsi-on-command-22 = [
			39 01 00 00 78 00 02 11 00
			29 01 00 00 00 00 02 B0 04
			29 01 00 00 00 00 02 D6 01
			29 01 00 00 00 00 27 C7 00 11 1D 2D 3B 46 5E 6F 7D 8A 3D 4A 5A 70 7B 88 98 A4 B1 00 11 1D 2D 3B 46 5E 6F 7D 8A 3D 4A 5A 70 7B 88 98 A4 B1
			29 01 00 00 00 00 38 C8 01 00 FA 01 02 57 00 00 01 05 03 FC 00 00 FC 03 FE D5 00 00 FA 01 03 4A 00 00 01 05 03 F1 00 00 FC 03 FE FC 00 00 FA 01 01 A0 00 00 01 05 03 FC 00 00 FC 03 FE C4 00
			39 01 00 00 00 00 02 51 ff
			39 01 00 00 00 00 02 53 24
			39 01 00 00 00 00 02 55 00
			39 01 00 00 00 00 02 35 00
			39 01 00 00 14 00 02 29 00
		];
		qcom,mdss-white-command-23 = [
			29 01 00 00 00 00 02 B0 04
			29 01 00 00 00 00 02 D6 01
			29 01 00 00 00 00 27 C7 00 11 1D 2D 3B 46 5E 6F 7D 8A 3D 4A 5A 70 7B 88 98 A4 B1 00 11 1D 2D 3B 46 5E 6F 7D 8A 3D 4A 5A 70 7B 88 98 A4 B1
			29 01 00 00 00 00 38 C8 01 00 F9 02 02 7C 00 00 01 04 02 DC 00 00 FC 03 FE FC 00 00 FA 01 03 51 00 00 FF 04 02 AB 00 00 FC 03 FE FC 00 00 F9 02 FF D4 00 00 01 04 02 EC 00 00 FC 03 FE FC 00
		];
		qcom,mdss-dsi-on-command-23 = [
			39 01 00 00 78 00 02 11 00
			29 01 00 00 00 00 02 B0 04
			29 01 00 00 00 00 02 D6 01
			29 01 00 00 00 00 27 C7 00 11 1D 2D 3B 46 5E 6F 7D 8A 3D 4A 5A 70 7B 88 98 A4 B1 00 11 1D 2D 3B 46 5E 6F 7D 8A 3D 4A 5A 70 7B 88 98 A4 B1
			29 01 00 00 00 00 38 C8 01 00 F9 02 02 7C 00 00 01 04 02 DC 00 00 FC 03 FE FC 00 00 FA 01 03 51 00 00 FF 04 02 AB 00 00 FC 03 FE FC 00 00 F9 02 FF D4 00 00 01 04 02 EC 00 00 FC 03 FE FC 00
			39 01 00 00 00 00 02 51 ff
			39 01 00 00 00 00 02 53 24
			39 01 00 00 00 00 02 55 00
			39 01 00 00 00 00 02 35 00
			39 01 00 00 14 00 02 29 00
		];
		qcom,mdss-white-command-24 = [
			29 01 00 00 00 00 02 B0 04
			29 01 00 00 00 00 02 D6 01
			29 01 00 00 00 00 27 C7 00 11 1D 2D 3B 46 5E 6F 7D 8A 3D 4A 5A 70 7B 88 98 A4 B1 00 11 1D 2D 3B 46 5E 6F 7D 8A 3D 4A 5A 70 7B 88 98 A4 B1
			29 01 00 00 00 00 38 C8 01 00 F9 02 02 7E 00 00 01 04 02 B7 00 00 FC 03 FE FC 00 00 FA 01 02 55 00 00 01 03 01 89 00 00 FD 03 FE FC 00 00 FA 02 01 D3 00 00 FF 04 01 C7 00 00 FC 03 FE FC 00
		];
		qcom,mdss-dsi-on-command-24 = [
			39 01 00 00 78 00 02 11 00
			29 01 00 00 00 00 02 B0 04
			29 01 00 00 00 00 02 D6 01
			29 01 00 00 00 00 27 C7 00 11 1D 2D 3B 46 5E 6F 7D 8A 3D 4A 5A 70 7B 88 98 A4 B1 00 11 1D 2D 3B 46 5E 6F 7D 8A 3D 4A 5A 70 7B 88 98 A4 B1
			29 01 00 00 00 00 38 C8 01 00 F9 02 02 7E 00 00 01 04 02 B7 00 00 FC 03 FE FC 00 00 FA 01 02 55 00 00 01 03 01 89 00 00 FD 03 FE FC 00 00 FA 02 01 D3 00 00 FF 04 01 C7 00 00 FC 03 FE FC 00
			39 01 00 00 00 00 02 51 ff
			39 01 00 00 00 00 02 53 24
			39 01 00 00 00 00 02 55 00
			39 01 00 00 00 00 02 35 00
			39 01 00 00 14 00 02 29 00
		];
		qcom,mdss-dsi-off-command = [
			39 01 00 00 14 00 02 28 00
			39 01 00 00 78 00 02 10 00
		];
		qcom,mdss-dsi-CABC_on-command = [
			15 01 00 00 00 00 02 55 01
			29 00 00 00 00 00 02 b0 04
			29 01 00 00 00 00 08 B8 89 51 15 00 02 00 00
			29 01 00 00 00 00 1A CE dd 05 0F 10 24 45 66 85 9C AC C4 C6 eE F0 f2 fb ff 02 00 04 04 24 04 69 5a
			29 01 00 00 00 00 0A F9 64 FF E0 BE 00 8D BF 80 00
		];
		qcom,mdss-dsi-CABC_off-command = [
			15 01 00 00 00 00 02 55 00
		];
		qcom,mdss-dsi-CE_on-command = [
			//29 01 00 00 00 00 2C CA 1D FC E4 B8 03 FF 05 F5 EF FB E1 F8 05 0C 16 11 FD F7 FD FA FD 00 FF 00 00 FF 00 00 FF 00 FF 00 07 FF 05 FF 00 00 FF 2A 00 FF FF
			29 01 00 00 00 00 2C CA 1D FC FC FC 0D F0 03 18 00 18 12 0F 07 15 00 FB 0A 0B 0C 03 00 FD FF 00 00 FC 02 01 80 9F 6C 50 97 62 4C 00 B9 87 72 BF 89 70 00
		];
		qcom,mdss-dsi-CE_off-command = [
			29 01 00 00 00 00 2C CA 1C FC FC FC 00 00 00 00 00 00 00 00 00 00 00 00 00 00 00 00 00 00 00 00 00 00 00 00 00 00 00 00 00 00 00 00 00 00 00 00 00 00 00
		];
		qcom,mdss-dsi-cold_gamma-command = [
			39 01 00 00 00 00 02 84 7F
		];
		qcom,mdss-dsi-warm_gamma-command = [
			39 01 00 00 00 00 02 84 80
		];
		qcom,mdss-dsi-default_gamma-command = [
			29 01 00 00 00 00 02 B0 04
			29 01 00 00 00 00 02 D6 01
			29 01 00 00 00 00 27 c7 00 10 1C 2C 3A 45 5D 6F 7D 8A 3E 4B 5B 71 7B 88 98 A5 B1 00 10 1C 2C 3A 45 5D 6F 7D 8A 3E 4B 5B 71 7B 88 98 A5 B1
			29 01 00 00 00 00 15 C8 01 00 03 01 03 FC 00 00 03 FE FE FC 00 00 01 FE FB FC 00 00
		];

		qcom,mdss-dsi-sRGB_on-command = [
		15 01 00 00 00 00 02 B0 00
		29 01 00 00 00 00 2C CA 1D FC D8 80 1B EB F1 CA E7 D5 F5 DC EE 25 FD E9 1F 2B FF 08 F7 27 FF 00 00 F6 25 1E FF 00 FF 00 55 FA 3C FF 00 00 FF 01 35 E6 FF
		];
		qcom,mdss-dsi-sRGB_off-command = [
		29 01 00 00 00 00 2C CA 1C FC FC FC 00 00 00 00 00 00 00 00 00 00 00 00 00 00 00 00 00 00 00 00 00 00 00 00 00 00 00 00 00 00 00 00 00 00 00 00 00 00 00
		];

		qcom,mdss-dsi-on-command-state = "dsi_lp_mode";
		qcom,mdss-dsi-off-command-state = "dsi_hs_mode";
		qcom,mdss-dsi-CABC_on-command-state = "dsi_lp_mode";
		qcom,mdss-dsi-CABC_off-command-state = "dsi_lp_mode";
		qcom,mdss-dsi-CE_on-command-state = "dsi_lp_mode";
		qcom,mdss-dsi-CE_off-command-state = "dsi_lp_mode";
		qcom,mdss-dsi-cold_gamma-command-state = "dsi_lp_mode";
		qcom,mdss-dsi-warm_gamma-command-state = "dsi_lp_mode";
		qcom,mdss-dsi-default_gamma-command-state = "dsi_lp_mode";
		qcom,mdss-dsi-sRGB_on-command-state = "dsi_lp_mode";
		qcom,mdss-dsi-sRGB_off-command-state = "dsi_lp_mode";
		qcom,mdss-white-command-state = "dsi_lp_mode";
		qcom,mdss-dsi-h-sync-pulse = <1>;
		qcom,mdss-dsi-traffic-mode = "burst_mode";
		qcom,mdss-dsi-bllp-eof-power-mode;
		qcom,mdss-dsi-bllp-power-mode;
		qcom,mdss-dsi-lane-0-state;
		qcom,mdss-dsi-lane-1-state;
		qcom,mdss-dsi-lane-2-state;
		qcom,mdss-dsi-lane-3-state;
		qcom,mdss-dsi-panel-timings = [7d 25 1d 00 37 33
			22 27 1e 03 04 00];
		qcom,mdss-dsi-t-clk-post = <0x0E>;
		qcom,mdss-dsi-t-clk-pre = <0x34>;
		qcom,mdss-dsi-bl-min-level = <1>;
		qcom,mdss-dsi-bl-max-level = <4095>;
		qcom,mdss-dsi-dma-trigger = "trigger_sw";
		qcom,mdss-dsi-mdp-trigger = "none";
		qcom,mdss-dsi-bl-pmic-control-type = "bl_ctrl_wled";
		qcom,mdss-dsi-reset-sequence = <1 5>, <0 5>, <1 30>;
                //qcom,mdss-dsi-tx-eot-append;
		qcom,esd-check-enabled;
		qcom,mdss-dsi-panel-status-command = [06 01 00 01 05 00 01 0A];
		qcom,mdss-dsi-panel-status-command-mode = "dsi_lp_mode";
		qcom,mdss-dsi-panel-status-check-mode = "TE_check_NT35596";
		qcom,mdss-dsi-panel-status-read-length = <1>;
		qcom,mdss-dsi-panel-status-value = <0x9C>;
		qcom,mdss-dsi-panel-max-error-count = <3>;
		qcom,mdss-pan-physical-width-dimension = <69>;
		qcom,mdss-pan-physical-height-dimension = <122>;
	};
};
