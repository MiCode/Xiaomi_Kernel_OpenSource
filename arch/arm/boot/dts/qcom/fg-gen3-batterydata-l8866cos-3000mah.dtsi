
qcom,l8866cos_3000mah {
	qcom, = <24>;
	/* #3797542_LC_D2S_coslight_3000mAH_FG_averaged_MasterSlave_Jan11th2019*/
	qcom,max-voltage-uv = <4400000>;
	qcom,fastchg-current-ma = <2900>;
	qcom,fg-cc-cv-threshold-mv = <4390>;
	qcom,nom-batt-capacity-mah = <3000>;
	qcom,batt-id-kohm = <100>;
	qcom,battery-beta = <3380>;
	qcom,battery-full-design = <3010>;
	qcom,battery-type = "3797542_lc_d2s_coslight_3000mah_fg_averaged_masterslave_jan11th2019";
	qcom,checksum = <0xC544>;
	qcom,gui-version = "PM660GUI - 0.0.0.45";
	qcom,fg-profile-data = [
		 F6 1F 37 05
		 B1 0A 2B 06
		 F7 1C 97 01
		 DD 04 B2 03
		 C0 17 C8 23
		 87 44 2D 5A
		 83 00 00 00
		 11 00 00 00
		 00 00 EE AC
		 EA CD 27 B2
		 29 00 08 00
		 44 DA 11 E5
		 42 05 CE 01
		 E9 0C FB F5
		 F0 D4 59 23
		 3C 06 09 20
		 27 00 14 00
		 25 20 15 05
		 DE 0A ED 05
		 C9 1C DE 02
		 39 0C 06 12
		 83 18 D7 23
		 E5 4D 31 5B
		 6F 00 00 00
		 0E 00 00 00
		 00 00 D8 D5
		 00 A4 46 D2
		 1B 00 00 00
		 5F EA 11 E5
		 82 06 1E F3
		 FB E4 4E 0A
		 39 03 5F 22
		 BD 33 CC FF
		 07 10 00 00
		 76 0B 66 46
		 1B 00 40 00
		 CA 01 0A FA
		 FF 00 00 00
		 00 00 00 00
		 00 00 00 00
		 00 00 00 00
		 00 00 00 00
		 00 00 00 00
		 00 00 00 00
		 00 00 00 00
		 00 00 00 00
		 00 00 00 00
		 00 00 00 00
		 00 00 00 00
		 00 00 00 00
		 00 00 00 00
		 00 00 00 00
		 00 00 00 00
		 00 00 00 00
		 00 00 00 00
		 00 00 00 00
	];
};
