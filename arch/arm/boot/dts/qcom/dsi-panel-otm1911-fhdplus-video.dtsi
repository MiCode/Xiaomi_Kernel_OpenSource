/* Copyright (c) 2012-2015, The Linux Foundation. All rights reserved.
 * Copyright (C) 2019 XiaoMi, Inc.
 *
 * This program is free software; you can redistribute it and/or modify
 * it under the terms of the GNU General Public License version 2 and
 * only version 2 as published by the Free Software Foundation.
 *
 * This program is distributed in the hope that it will be useful,
 * but WITHOUT ANY WARRANTY; without even the implied warranty of
 * MERCHANTABILITY or FITNESS FOR A PARTICULAR PURPOSE.  See the
 * GNU General Public License for more details.
 */

&mdss_mdp {
	dsi_otm1911_fhdplus_vid: qcom,mdss_dsi_otm1911_fhdplus_video {
		qcom,mdss-dsi-panel-name = "otm1911 fhdplus video mode dsi panel";
		qcom,mdss-dsi-panel-type = "dsi_video_mode";
		qcom,mdss-dsi-panel-framerate = <60>;
		qcom,mdss-dsi-virtual-channel-id = <0>;
		qcom,mdss-dsi-stream = <0>;
		qcom,mdss-dsi-panel-width = <1080>;
		qcom,mdss-dsi-panel-height = <2280>;
		qcom,mdss-dsi-h-front-porch = <24>;
		qcom,mdss-dsi-h-back-porch = <24>;
		qcom,mdss-dsi-h-pulse-width = <20>;
		qcom,mdss-dsi-h-sync-skew = <0>;
		qcom,mdss-dsi-v-back-porch = <38>;
		qcom,mdss-dsi-v-front-porch = <47>;
		qcom,mdss-dsi-v-pulse-width = <2>;
		qcom,mdss-dsi-h-left-border = <0>;
		qcom,mdss-dsi-h-right-border = <0>;
		qcom,mdss-dsi-v-top-border = <0>;
		qcom,mdss-dsi-v-bottom-border = <0>;
		qcom,mdss-dsi-bpp = <24>;
		qcom,mdss-dsi-underflow-color = <0xff>;
		qcom,mdss-dsi-border-color = <0>;
		qcom,mdss-dsi-on-command = [
			39 01 00 00 00 00 02 00 00
			39 01 00 00 00 00 04 ff 19 11 01
			39 01 00 00 00 00 02 00 80
			39 01 00 00 00 00 03 ff 19 11
			39 01 00 00 00 00 02 00 b0
			39 01 00 00 00 00 05 b3 04 38 08 e8
			39 01 00 00 00 00 02 00 80
			39 01 00 00 00 00 02 C9 8E
			39 01 00 00 00 00 02 00 80
			39 01 00 00 00 00 0D CA F0 D9 C8 BA AF A6 9E 98 92 8D 88 84
			39 01 00 00 00 00 02 00 90
			39 01 00 00 00 00 0A CA FD FF 98 FB FF 33 F6 FF 66
			39 01 00 00 00 00 02 00 A0
			39 01 00 00 00 00 0D D6 0a 0b 0b 0b 0b 0c 0f 13 0f 13 11 0e
			39 01 00 00 00 00 02 00 B0
			39 01 00 00 00 00 0D D6 9a 8d 82 83 83 83 80 6b 80 85 88 8a
			39 01 00 00 00 00 02 00 C0
			39 01 00 00 00 00 0D D6 8d 86 91 90 89 81 80 83 80 8a 86 84
			39 01 00 00 00 00 02 00 D0
			39 01 00 00 00 00 0D D6 88 84 80 80 80 80 80 80 80 80 80 80
			39 01 00 00 00 00 02 00 B0
			39 01 00 00 00 00 02 CA 00
			39 01 00 00 00 00 02 00 B2
			39 01 00 00 00 00 02 CA 0A
			39 01 00 00 00 00 03 51 ff 0C
			39 01 00 00 00 00 02 53 2C
			39 01 00 00 00 00 02 55 00
			39 01 00 00 00 00 02 35 00
			39 01 00 00 78 00 02 11 00
			39 01 00 00 14 00 02 29 00];

		qcom,mdss-dsi-off-command = [
			39 01 00 00 00 00 04 ff 19 11 01
			39 01 00 00 00 00 02 00 80
			39 01 00 00 00 00 03 ff 19 11
			39 01 00 00 00 00 02 00 90
			39 01 00 00 00 00 02 b3 34
			39 01 00 00 14 00 02 28 00
			39 01 00 00 78 00 02 10 00];

		qcom,mdss-dsi-CABC_on-command = [
			39 01 00 00 00 00 02 00 00
			39 01 00 00 00 00 02 55 01];

		qcom,mdss-dsi-CABC_off-command = [
			39 01 00 00 00 00 02 00 00
			39 01 00 00 00 00 02 55 00];

		qcom,mdss-dsi-CE_on-command = [
			39 01 00 00 00 00 02 00 00
			39 01 00 00 00 00 02 91 80];

		qcom,mdss-dsi-CE_off-command = [
			39 01 00 00 00 00 02 00 00
			39 01 00 00 00 00 02 91 00];

		qcom,mdss-dsi-on-command-state = "dsi_lp_mode";
		qcom,mdss-dsi-off-command-state = "dsi_lp_mode";
		qcom,mdss-dsi-CE_on-command-state = "dsi_hs_mode";
		qcom,mdss-dsi-CE_off-command-state = "dsi_hs_mode";
		qcom,mdss-dsi-CABC_on-command-state = "dsi_hs_mode";
		qcom,mdss-dsi-CABC_off-command-state = "dsi_hs_mode";

		qcom,mdss-dsi-h-sync-pulse = <1>;
		qcom,mdss-dsi-traffic-mode = "burst_mode";
		qcom,mdss-dsi-bllp-eof-power-mode;
		qcom,mdss-dsi-bllp-power-mode;
		qcom,mdss-dsi-lane-0-state;
		qcom,mdss-dsi-lane-1-state;
		qcom,mdss-dsi-lane-2-state;
		qcom,mdss-dsi-lane-3-state;
		qcom,mdss-dsi-panel-timings = [f7 3c 28 00 6e 70
			22 40 31 03 04 00];
		qcom,mdss-dsi-panel-timings-phy-v2 = [25 1f 09 0a 06 03 04 a0
			25 1f 09 0a 06 03 04 a0
			25 1f 09 0a 06 03 04 a0
			25 1f 09 0a 06 03 04 a0
			25 1e 08 0a 06 03 04 a0];
		qcom,mdss-dsi-t-clk-post = <0x0E>;
		qcom,mdss-dsi-t-clk-pre = <0x34>;
		qcom,mdss-dsi-bl-min-level = <1>;
		qcom,mdss-dsi-bl-max-level = <4095>;
		qcom,mdss-brightness-max-level = <4095>;
		qcom,mdss-brightness-max-level-global = <255>;
		qcom,mdss-dsi-dma-trigger = "trigger_sw";
		qcom,mdss-dsi-mdp-trigger = "none";
		qcom,mdss-dsi-bl-pmic-control-type = "bl_ctrl_wled";
		qcom,mdss-dsi-reset-sequence = <1 10>, <0 2>, <1 15>;
		qcom,mdss-dsi-lp11-init;
		//qcom,mdss-dsi-tx-eot-append;
		qcom,esd-check-enabled;
		qcom,mdss-dsi-panel-status-command = [06 01 00 01 05 00 01 0A];
		qcom,mdss-dsi-panel-status-command-mode = "dsi_lp_mode";
		qcom,mdss-dsi-panel-status-check-mode = "TE_check_NT35596";
		qcom,mdss-dsi-panel-status-read-length = <1>;
		qcom,mdss-dsi-panel-status-value = <0x9C>;
		qcom,mdss-dsi-panel-max-error-count = <3>;
		qcom,mdss-pan-physical-width-dimension = <69>;
		qcom,mdss-pan-physical-height-dimension = <122>;
	};
};
