/* Copyright (c) 2015, The Linux Foundation. All rights reserved.
 *
 * This program is free software; you can redistribute it and/or modify
 * it under the terms of the GNU General Public License version 2 and
 * only version 2 as published by the Free Software Foundation.
 *
 * This program is distributed in the hope that it will be useful,
 * but WITHOUT ANY WARRANTY; without even the implied warranty of
 * MERCHANTABILITY or FITNESS FOR A PARTICULAR PURPOSE.  See the
 * GNU General Public License for more details.
 */

/*---------------------------------------------------------------------------
 * This file is autogenerated file using gcdb parser. Please do not edit it.
 * Update input XML file to add a new entry or update variable in this file
 * VERSION = "1.0"
 *---------------------------------------------------------------------------*/
&mdss_mdp {
	dsi_r61318_hd_video: qcom,mdss_dsi_r61318_hd_video {
		qcom,mdss-dsi-panel-name = "r61318 hd video mode dsi panel";
		qcom,mdss-dsi-panel-controller = <&mdss_dsi0>;
		qcom,mdss-dsi-panel-type = "dsi_video_mode";
		qcom,mdss-dsi-panel-destination = "display_1";
		qcom,mdss-dsi-panel-framerate = <60>;
		qcom,mdss-dsi-virtual-channel-id = <0>;
		qcom,mdss-dsi-stream = <0>;
		qcom,mdss-dsi-panel-width = <720>;
		qcom,mdss-dsi-panel-height = <1280>;
		qcom,mdss-dsi-h-front-porch = <40>;
		qcom,mdss-dsi-h-back-porch = <30>;
		qcom,mdss-dsi-h-pulse-width = <12>;
		qcom,mdss-dsi-h-sync-skew = <0>;
		qcom,mdss-dsi-v-back-porch = <9>;
		qcom,mdss-dsi-v-front-porch = <18>;
		qcom,mdss-dsi-v-pulse-width = <3>;
		qcom,mdss-dsi-h-left-border = <0>;
		qcom,mdss-dsi-h-right-border = <0>;
		qcom,mdss-dsi-v-top-border = <0>;
		qcom,mdss-dsi-v-bottom-border = <0>;
		qcom,mdss-dsi-bpp = <24>;
		qcom,mdss-dsi-color-order = "rgb_swap_rgb";
		qcom,mdss-dsi-underflow-color = <0xff>;
		qcom,mdss-dsi-border-color = <0>;
		qcom,mdss-dsi-on-command = [29 01 00 00 00 00 02 B0 00
			29 01 00 00 00 00 02 B3 00
			29 01 00 00 00 00 02 B6 32
			39 01 00 00 00 00 02 36 0A
			29 01 00 00 00 00 07 C0 20 B2 0D 10 02 80
			29 01 00 00 00 00 08 C1 35 85 85 85 10 10 33
			29 01 00 00 00 00 04 C3 20 0F 00
			29 01 00 00 00 00 04 C4 BC D2 00
			29 01 00 00 00 00 04 C5 06 03 1D
			29 01 00 00 00 00 02 C6 21
			29 01 00 00 00 00 1D C8 60 0E 08 62 90 52 95 54 49 29 84 90 A2 4A 29 45 15 42 48 A9 A4 A4 AA 85 0c 11 c0 31
			29 01 00 00 00 00 1F CA 02 0A 0F 15 1B 20 23 1F 24 24 21 1A 15 0F 01 02 0A 0F 15 1B 20 23 1F 24 24 21 1A 15 0F 01
			29 01 00 00 00 00 02 CD 00
			29 01 00 00 00 00 02 E5 02
			29 01 00 00 00 00 04 D0 05 89 1A
			29 01 00 00 00 00 02 D1 03
			29 01 00 00 00 00 03 D2 81 1F
			29 01 00 00 00 00 02 D4 4D
			29 01 00 00 00 00 03 D5 34 34
			29 01 00 00 00 00 03 D5 34 34
			29 01 00 00 00 00 02 BB 2E
			39 01 00 00 00 00 02 53 2C
			05 01 00 00 78 00 02 11 00
			05 01 00 00 32 00 02 29 00];
		qcom,mdss-dsi-off-command = [05 01 00 00 32 00 02 28 00
					05 01 00 00 78 00 02 10 00];
		qcom,mdss-dsi-on-command-state = "dsi_lp_mode";
		qcom,mdss-dsi-off-command-state = "dsi_hs_mode";
		qcom,mdss-dsi-h-sync-pulse = <1>;
		qcom,mdss-dsi-traffic-mode = "burst_mode";
		qcom,mdss-dsi-lane-map = "lane_map_0123";
		qcom,mdss-dsi-bllp-eof-power-mode;
		qcom,mdss-dsi-bllp-power-mode;
		qcom,mdss-dsi-lane-0-state;
		qcom,mdss-dsi-lane-1-state;
		qcom,mdss-dsi-lane-2-state;
		qcom,mdss-dsi-lane-3-state;
		qcom,mdss-dsi-panel-timings = [ab 1c 14 00 2a 27 18 1e 21 03 04 00];
		qcom,mdss-dsi-t-clk-post = <0x20>;
		qcom,mdss-dsi-t-clk-pre = <0x2e>;
		qcom,mdss-dsi-bl-min-level = <1>;
		qcom,mdss-dsi-bl-max-level = <255>;
		qcom,mdss-dsi-dma-trigger = "trigger_sw";
		qcom,mdss-dsi-mdp-trigger = "none";
		qcom,mdss-dsi-min-refresh-rate = <50>;
		qcom,mdss-dsi-bl-pmic-control-type = "bl_ctrl_dcs";
		qcom,mdss-dsi-reset-sequence = <1 20>, <0 20>, <1 20>;
	};
};
