/* Copyright (c) 2015, The Linux Foundation. All rights reserved.
 *
 * This program is free software; you can redistribute it and/or modify
 * it under the terms of the GNU General Public License version 2 and
 * only version 2 as published by the Free Software Foundation.
 *
 * This program is distributed in the hope that it will be useful,
 * but WITHOUT ANY WARRANTY; without even the implied warranty of
 * MERCHANTABILITY or FITNESS FOR A PARTICULAR PURPOSE.  See the
 * GNU General Public License for more details.
 */

/dts-v1/;

#include "mdm9640-v2-cdp.dtsi"

/ {
	model = "Qualcomm Technologies, Inc. MSM 9640 V2 eMMC CDP";
	compatible = "qcom,mdm9640-cdp", "qcom,mdm9640", "qcom,cdp";
	qcom,board-id = <1 0x00030000>;

        qcom,rmtfs_sharedmem@00000000 {
            compatible = "qcom,sharedmem-uio";
            reg = <0x00000000 0x00100000>;
            reg-names = "rmtfs";
            qcom,client-id = <0x00000001>;
        };
};

&usb3 {
	qcom,skip-charger-detection;
};

&sdhc_1 {
	vdd-supply = <&sd_slot_vreg>;
	qcom,vdd-always-on;
	qcom,vdd-voltage-level = <2950000 2950000>;
	qcom,vdd-current-level = <9000 800000>;

	vdd-io-supply = <&pmd9635_l6>;
	qcom,vdd-io-always-on;
	qcom,vdd-io-voltage-level = <1800000 1800000>;
	qcom,vdd-io-current-level = <200 60000>;

	pinctrl-names = "active", "sleep";
	pinctrl-0 = <&sdc1_clk_on &sdc1_cmd_on &sdc1_data_on>;
	pinctrl-1 = <&sdc1_clk_off &sdc1_cmd_off &sdc1_data_off>;

	qcom,bus-width = <4>;
	qcom,clk-rates = <400000 25000000 50000000 100000000>;
	qcom,bus-speed-mode = "DDR_1p8v";
	qcom,nonremovable;

	status = "ok";
};
