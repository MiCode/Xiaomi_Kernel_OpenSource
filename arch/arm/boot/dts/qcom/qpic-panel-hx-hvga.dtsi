/* Copyright (c) 2014, The Linux Foundation. All rights reserved.
 *
 * This program is free software; you can redistribute it and/or modify
 * it under the terms of the GNU General Public License version 2 and
 * only version 2 as published by the Free Software Foundation.
 *
 * This program is distributed in the hope that it will be useful,
 * but WITHOUT ANY WARRANTY; without even the implied warranty of
 * MERCHANTABILITY or FITNESS FOR A PARTICULAR PURPOSE.  See the
 * GNU General Public License for more details.
 */

&soc {
	qcom,mdss_lcdc_hx_hvga {
		compatible = "qcom,mdss-qpic-panel";
		label = "hx8357 hvga lcdc panel";
		qcom,mdss-pan-res = <320 480>;
		qcom,mdss-pan-bpp = <18>;
		qcom,refresh_rate = <60>;
	};
};
