/* Copyright (c) 2015, The Linux Foundation. All rights reserved.
 * Copyright (C) 2017 XiaoMi, Inc.
 *
 * This program is free software; you can redistribute it and/or modify
 * it under the terms of the GNU General Public License version 2 and
 * only version 2 as published by the Free Software Foundation.
 *
 * This program is distributed in the hope that it will be useful,
 * but WITHOUT ANY WARRANTY; without even the implied warranty of
 * MERCHANTABILITY or FITNESS FOR A PARTICULAR PURPOSE.  See the
 * GNU General Public License for more details.
 */
&mdss_mdp {
	dsi_auo_r61322_1080p_vid: qcom,mdss_dsi_auo_r61322_1080p_video {
		qcom,mdss-dsi-panel-name = "auo r61322 1080p video mode dsi panel";
		qcom,mdss-dsi-panel-type = "dsi_video_mode";
		qcom,mdss-dsi-panel-id = <1>;
		qcom,mdss-dsi-panel-framerate = <60>;
		qcom,mdss-dsi-virtual-channel-id = <0>;
		qcom,mdss-dsi-stream = <0>;
		qcom,mdss-dsi-panel-width = <1080>;
		qcom,mdss-dsi-panel-height = <1920>;
		qcom,mdss-dsi-h-front-porch = <150>;
		qcom,mdss-dsi-h-back-porch = <40>;
		qcom,mdss-dsi-h-pulse-width = <10>;
		qcom,mdss-dsi-h-sync-skew = <0>;
		qcom,mdss-dsi-v-back-porch = <21>;
		qcom,mdss-dsi-v-front-porch = <24>;
		qcom,mdss-dsi-v-pulse-width = <2>;
		qcom,mdss-dsi-h-left-border = <0>;
		qcom,mdss-dsi-h-right-border = <0>;
		qcom,mdss-dsi-v-top-border = <0>;
		qcom,mdss-dsi-v-bottom-border = <0>;
		qcom,mdss-dsi-bpp = <24>;
		qcom,mdss-dsi-underflow-color = <0x0>;
		qcom,mdss-dsi-border-color = <0>;
		qcom,mdss-dsi-h-sync-pulse = <0>;
		qcom,mdss-dsi-traffic-mode = "burst_mode";
		qcom,mdss-dsi-bllp-eof-power-mode;
		qcom,mdss-dsi-bllp-power-mode;
		qcom,mdss-dsi-lp11-init;
		qcom,mdss-dsi-lane-0-state;
		qcom,mdss-dsi-lane-1-state;
		qcom,mdss-dsi-lane-2-state;
		qcom,mdss-dsi-lane-3-state;
		qcom,mdss-dsi-panel-timings = [e8 4f 3b 00 ac a6 3d 52 42 03 04 00];
		qcom,mdss-dsi-t-clk-post = <0x0D>;
		qcom,mdss-dsi-t-clk-pre = <0x30>;
		qcom,mdss-dsi-bl-min-level = <1>;
		qcom,mdss-dsi-bl-max-level = <4095>;
		qcom,mdss-brightness-max-level = <4095>;
		qcom,mdss-dsi-dma-trigger = "trigger_sw";
		qcom,mdss-dsi-mdp-trigger = "none";
		qcom,mdss-dsi-on-command = [
			29 00 00 00 00 00 02 B0 00
			29 00 00 00 00 00 02 D6 01
			29 00 00 00 00 00 09 B3 14 40 00 00 00 00 00 00
			29 00 00 00 00 00 03 B4 0C 00
			29 00 00 00 00 00 03 B6 0B D3
			29 00 00 00 00 00 2B C1 0C 60 80 00 00 00 00 00 00 00 00 00 00 00 00 00 00 00 00 01 00 00 00 10 02 0F 10 00 88 00 00 01 00 00 00 62 30 40 A5 0F 04 20
			29 00 00 00 00 00 0A C2 20 F0 07 80 17 18 00 00 00
			29 00 00 00 00 00 16 C4 70 00 03 00 00 00 00 00 00 00 00 00 00 00 00 05 01 00 00 01 02
			29 00 00 00 00 00 0C C6 78 28 4B 1E 41 00 00 00 00 00 00
			29 00 00 00 00 00 0E CB FF FF 0F FF FF 0F 00 00 00 00 00 00 00
			29 00 00 00 00 00 02 CC 23
			29 00 00 00 00 00 2A CD 01 04 04 04 04 01 03 02 10 0F 0E 0D 0C 0B 0A 09 00 12 04 04 04 04 04 04 12 00 09 0A 0B 0C 0D 0E 0F 10 02 03 01 04 04 04 04
			29 00 00 00 00 00 04 C3 00 00 00
			29 00 00 00 00 00 0E D0 11 59 BB 68 D9 4C 99 11 19 8C CD 14 00
			29 00 00 00 00 00 1E D3 A3 33 BB DD D5 33 33 33 00 00 0A 91 91 21 21 3B 3B 33 33 37 60 FD FE 07 10 00 00 00 52
			29 00 00 00 00 00 18 D7 10 F0 04 2A 04 10 00 80 03 1D C0 00 DC 10 10 60 10 07 00 00 00 00 00
			29 00 00 00 00 00 20 EB 10 55 55 44 50 55 55 55 55 51 11 44 44 44 10 21 0E 00 00 00 00 00 00 44 44 44 44 33 37 44 05
			29 00 00 00 00 00 1F C7 16 23 2A 33 3F 4B 54 61 44 4C 57 63 6A 70 77 0E 23 2A 33 3F 4B 54 61 44 4C 57 63 6A 70 77
			29 00 00 00 00 00 14 C8 00 00 FF 05 FF EC 00 00 01 04 FE FC 00 00 01 05 09 FA 00
			29 00 00 00 00 00 07 B8 07 87 26 18 00 32
			29 00 00 00 00 00 07 B9 07 75 61 20 16 87
			29 00 00 00 00 00 07 BA 07 70 81 20 45 B4
			29 00 00 00 00 00 04 BB 01 1E 14
			29 00 00 00 00 00 04 BC 01 50 32
			29 00 00 00 00 00 04 BD 00 B4 A0
			29 00 00 00 00 00 21 CA 00 80 80 80 80 80 80 80 08 20 80 80 0A 4A 37 A0 55 F8 0C 0C 20 10 3F 3F 00 00 10 10 3F 3F 3F 3F
			29 00 00 00 00 00 02 B0 03
			39 00 00 00 00 00 02 51 FF
			39 00 00 00 00 00 02 53 24
			39 00 00 00 00 00 02 55 00
			05 01 00 00 14 00 02 29 00
			05 01 00 00 78 00 02 11 00];
		qcom,mdss-dsi-off-command = [
			05 01 00 00 14 00 02 28 00
			05 01 00 00 32 00 02 10 00];
		qcom,mdss-dsi-on-command-state = "dsi_hs_mode";
		qcom,mdss-dsi-off-command-state = "dsi_hs_mode";
		qcom,mdss-dsi-bl-pmic-control-type = "bl_ctrl_wled";
		qcom,mdss-dsi-reset-sequence = <0 5>, <1 10>;
		qcom,mdss-dsi-reset-off-delay = <1>;
		qcom,mdss-dsi-tx-eot-append;
		qcom,cont-splash-enabled;
		qcom,panel-supply-entries = <&dsi_panel_pwr_supply>;
		qcom,mdss-pan-physical-width-dimension = <80>;
		qcom,mdss-pan-physical-height-dimension = <142>;
		qcom,mdss-night-brightness = <9 27 44 62>;
		qcom,dispparam-enabled;
		qcom,mdss-panel-on-dimming-delay = <120>;
		qcom,mdss-dsi-dispparam-dimmingon-command = [39 01 00 00 01 00 02 53 2C];
		qcom,mdss-dsi-dispparam-ceon-command = [
			29 00 00 00 00 00 02 B0 00
			29 00 00 00 00 00 21 CA 01 00 89 A8 B0 9C 90 90 08 20 80 80 4A 4A 4A 4A 80 80 02 0B 00 00 00 00 00 00 10 10 3F 3F 3F 3F
			29 01 00 00 00 00 02 B0 03
			];
		qcom,mdss-dsi-dispparam-ceon-command-state = "dsi_hs_mode";
		qcom,mdss-dsi-dispparam-ceoff-command = [
			29 00 00 00 00 00 02 B0 00
			29 00 00 00 00 00 02 CA 00
			29 01 00 00 00 00 02 B0 03
			];
		qcom,mdss-dsi-dispparam-ceoff-command-state = "dsi_hs_mode";
		qcom,mdss-dsi-dispparam-cabcon-command = [
			29 00 00 00 00 00 02 B0 04
			15 00 00 00 00 00 02 55 01
			29 00 00 00 00 00 07 B8 07 87 09 00 28 88
			29 00 00 00 00 00 19 CE 2D 40 4C 5A 69 77 84 93 A2 B1 C1 D1 E0 F0 F1 F2 FF 04 00 0f 0f 42 04 00
			29 00 00 00 00 00 14 C8 00 00 00 00 00 FC 00 00 00 00 00 FC 00 00 00 00 00 FC 00
			29 00 00 00 00 00 0C F9 20 3F E0 00 00 07 FF 00 00 07 FF
			29 01 00 00 00 00 02 B0 03
			];
		qcom,mdss-dsi-dispparam-cabcon-command-state = "dsi_hs_mode";
		qcom,mdss-dsi-dispparam-cabcguion-command = [
			29 00 00 00 00 00 02 B0 04
			15 00 00 00 00 00 02 55 01
			29 00 00 00 00 00 07 B8 07 87 09 00 28 88
			29 00 00 00 00 00 19 CE 2D 40 4C 5A 69 77 84 93 A2 B1 C1 D1 E0 F0 F1 F2 FF 04 00 0f 0f 42 04 00
			29 00 00 00 00 00 14 C8 00 00 00 00 00 FC 00 00 00 00 00 FC 00 00 00 00 00 FC 00
			29 00 00 00 00 00 0C F9 20 3F E0 00 00 07 FF 00 00 07 FF
			29 01 00 00 00 00 02 B0 03
			];
		qcom,mdss-dsi-dispparam-cabcguion-command-state = "dsi_hs_mode";
		qcom,mdss-dsi-dispparam-cabcstillon-command = [
			29 00 00 00 00 00 02 B0 04
			15 00 00 00 00 00 02 55 02
			29 00 00 00 00 00 07 B9 07 8C 00 00 17 FE
			29 00 00 00 00 00 19 CE 2D 40 4C 5A 69 77 84 93 A2 B1 C1 D1 E0 F0 F1 F2 FF 04 00 0f 0f 42 04 00
			29 00 00 00 00 00 14 C8 00 00 00 00 00 FC 00 00 00 00 00 FC 00 00 00 00 00 FC 00
			29 00 00 00 00 00 0C F9 20 3F E0 00 00 07 FF 00 00 07 FF
			29 01 00 00 00 00 02 B0 03
			];
		qcom,mdss-dsi-dispparam-cabcstillon-command-state = "dsi_hs_mode";
		qcom,mdss-dsi-dispparam-cabcmovieon-command = [
			29 00 00 00 00 00 02 B0 04
			15 00 00 00 00 00 02 55 03
			29 00 00 00 00 00 07 BA 07 8A 03 00 1D BA
			29 00 00 00 00 00 19 CE 2D 40 4C 5A 69 77 84 93 A2 B1 C1 D1 E0 F0 F1 F2 FF 04 00 0f 0f 42 04 00
			29 00 00 00 00 00 14 C8 00 00 00 00 00 FC 00 00 00 00 00 FC 00 00 00 00 00 FC 00
			29 00 00 00 00 00 0C F9 20 3F E0 00 00 07 FF 00 00 07 FF
			29 01 00 00 00 00 02 B0 03
			];
		qcom,mdss-dsi-dispparam-cabcmovieon-command-state = "dsi_hs_mode";
		qcom,mdss-dsi-dispparam-cabcoff-command = [
			39 01 00 00 01 00 02 55 00
			];
		qcom,mdss-dsi-dispparam-cabcoff-command-state = "dsi_hs_mode";
		qcom,mdss-dsi-dispparam-papermode2-command = [
			29 00 00 00 00 00 02 B0 00
			29 00 00 00 00 00 14 C8 01 00 FD 02 07 FC 00 00 FC 01 01 C3 00 00 F8 01 01 86 00
			29 01 00 00 00 00 02 B0 03
			];
		qcom,mdss-dsi-dispparam-papermode2-command-state = "dsi_hs_mode";
		qcom,mdss-dsi-dispparam-default-command = [
			29 00 00 00 00 00 02 B0 00
			29 00 00 00 00 00 14 C8 00 00 FF 05 FF EC 00 00 01 04 FE FC 00 00 01 05 09 FA 00
			29 01 00 00 00 00 02 B0 03
			];
		qcom,mdss-dsi-dispparam-default-command-state = "dsi_hs_mode";
	};
};
