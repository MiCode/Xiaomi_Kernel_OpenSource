/* Copyright (c) 2018, The Linux Foundation. All rights reserved.
 *
 * This program is free software; you can redistribute it and/or modify
 * it under the terms of the GNU General Public License version 2 and
 * only version 2 as published by the Free Software Foundation.
 *
 * This program is distributed in the hope that it will be useful,
 * but WITHOUT ANY WARRANTY; without even the implied warranty of
 * MERCHANTABILITY or FITNESS FOR A PARTICULAR PURPOSE.  See the
 * GNU General Public License for more details.
 */

#include "sdxpoorwills-mtp.dtsi"
#include "sdxpoorwills-memory-256.dtsi"

&soc {
	vreg_sd_mmc: vreg_sd_mmc {
		gpio = <&tlmm 76 GPIO_ACTIVE_HIGH>;
	};
};

&sdhc_1 {
	cd-gpios = <&tlmm 21 0x1>;
};

&soc {
	bluetooth: bt_qca6174 {
		compatible = "qca,qca6174";
		qca,bt-reset-gpio = <&pmxpoorwills_gpios 4 0>; /* BT_EN */
		qca,bt-vdd-pa-supply = <&vreg_wlan>;
	};
};
