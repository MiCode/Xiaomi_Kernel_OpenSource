/*
 * Synaptics DSX touchscreen driver
 *
 * Copyright (C) 2012-2016 Synaptics Incorporated. All rights reserved.
 *
 * Copyright (C) 2012 Alexandra Chin <alexandra.chin@tw.synaptics.com>
 * Copyright (C) 2012 Scott Lin <scott.lin@tw.synaptics.com>
 * Copyright (C) 2018 XiaoMi, Inc.
 *
 * This program is free software; you can redistribute it and/or modify
 * it under the terms of the GNU General Public License as published by
 * the Free Software Foundation; either version 2 of the License, or
 * (at your option) any later version.
 *
 * This program is distributed in the hope that it will be useful,
 * but WITHOUT ANY WARRANTY; without even the implied warranty of
 * MERCHANTABILITY or FITNESS FOR A PARTICULAR PURPOSE. See the
 * GNU General Public License for more details.
 *
 * INFORMATION CONTAINED IN THIS DOCUMENT IS PROVIDED "AS-IS," AND SYNAPTICS
 * EXPRESSLY DISCLAIMS ALL EXPRESS AND IMPLIED WARRANTIES, INCLUDING ANY
 * IMPLIED WARRANTIES OF MERCHANTABILITY AND FITNESS FOR A PARTICULAR PURPOSE,
 * AND ANY WARRANTIES OF NON-INFRINGEMENT OF ANY INTELLECTUAL PROPERTY RIGHTS.
 * IN NO EVENT SHALL SYNAPTICS BE LIABLE FOR ANY DIRECT, INDIRECT, INCIDENTAL,
 * SPECIAL, PUNITIVE, OR CONSEQUENTIAL DAMAGES ARISING OUT OF OR IN CONNECTION
 * WITH THE USE OF THE INFORMATION CONTAINED IN THIS DOCUMENT, HOWEVER CAUSED
 * AND BASED ON ANY THEORY OF LIABILITY, WHETHER IN AN ACTION OF CONTRACT,
 * NEGLIGENCE OR OTHER TORTIOUS ACTION, AND EVEN IF SYNAPTICS WAS ADVISED OF
 * THE POSSIBILITY OF SUCH DAMAGE. IF A TRIBUNAL OF COMPETENT JURISDICTION DOES
 * NOT PERMIT THE DISCLAIMER OF DIRECT DAMAGES OR ANY OTHER DAMAGES, SYNAPTICS'
 * TOTAL CUMULATIVE LIABILITY TO ANY PARTY SHALL NOT EXCEED ONE HUNDRED U.S.
 * DOLLARS.
 */

&i2c_1{
	/* Novatek device tree node */
	status = "ok";
	novatek@62 {
		compatible = "novatek,NVT-ts";
		reg = <0x62>;
		interrupt-parent = <&tlmm>;
		interrupts = <67 0x2008>;
		vcc_i2c-supply=<&pm660_l11>;
		pinctrl-names = "pmx_ts_active", "pmx_ts_suspend";
		pinctrl-0 = <&ts_active>;
		pinctrl-1 = <&ts_int_suspend &ts_reset_suspend>;
		novatek,reset-gpio = <&tlmm 66 0x00>;
		novatek,irq-gpio = <&tlmm 67 0x2001>;

		/* MP */
		novatek,mp-support-dt;


		novatek-mp-criteria-5906@0 {
			#address-cells = <1>;
			#size-cells = <0>;
			compatible = "novatek-mp-criteria-5906";

			/* MP Config*/
			IC_X_CFG_SIZE = <18>;
			IC_Y_CFG_SIZE = <32>;
			IC_KEY_CFG_SIZE = <4>;
			X_Channel = <18>;
			Y_Channel = <32>;
			AIN_X = <17 16 15 14 13 12 11 10 9 8 7 6 5 4 3 2 1 0>;
			AIN_Y = <31 30 29 28 27 26 25 24 23 22 21 20 19 18 17 16 15
					14 13 12 11 10 9 8 7 6 5 4 3 2 1 0>;
			AIN_KEY = <0 1 2 0xFF>;

			/* MP Criteria */
			PS_Config_Lmt_Short_Rawdata_P = <14000>;
			PS_Config_Lmt_Short_Rawdata_N = <11000>;
			PS_Config_Lmt_Key_Short_Rawdata_P = <14000>;
			PS_Config_Lmt_Key_Short_Rawdata_N = <11000>;
			PS_Config_Lmt_Short_Diff_P = <6300>;
			PS_Config_Lmt_Short_Diff_N = <0>;
			PS_Config_Lmt_Key_Short_Diff_P = <6300>;
			PS_Config_Lmt_Key_Short_Diff_N = <0>;
			PS_Config_Lmt_Short_Base_P = <2000>;
			PS_Config_Lmt_Short_Base_N = <(-2000)>;
			PS_Config_Lmt_Key_Short_Base_P = <2000>;
			PS_Config_Lmt_Key_Short_Base_N = <(-2000)>;

			PS_Config_Lmt_Open_Rawdata_P = <
					7345 7376 7389 7403 7418 7442 7453 7432 7406 7365 7395 7412 7435 7452 7435 7420 7406 7392
					7342 7378 7393 7407 7425 7450 7458 7436 7407 7365 7393 7412 7437 7450 7433 7418 7402 7380
					7331 7365 7379 7394 7411 7438 7442 7420 7392 7377 7405 7425 7451 7462 7445 7428 7412 7387
					7333 7371 7387 7402 7420 7446 7448 7426 7397 7362 7389 7408 7434 7444 7425 7409 7393 7367
					7346 7385 7404 7420 7438 7464 7465 7442 7413 7379 7406 7427 7453 7459 7441 7425 7408 7376
					7334 7370 7390 7405 7423 7451 7447 7425 7395 7389 7417 7438 7466 7469 7450 7434 7417 7382
					7343 7380 7404 7420 7438 7466 7460 7437 7407 7381 7408 7429 7455 7458 7438 7422 7403 7367
					7351 7387 7413 7429 7448 7477 7467 7444 7413 7384 7412 7433 7460 7458 7440 7424 7403 7366
					7343 7377 7407 7424 7442 7470 7459 7435 7406 7408 7437 7459 7488 7483 7464 7447 7420 7381
					7351 7386 7417 7437 7456 7486 7470 7446 7416 7394 7423 7443 7472 7467 7446 7429 7399 7363
					7360 7396 7429 7452 7470 7502 7483 7459 7427 7412 7441 7464 7493 7482 7463 7444 7412 7374
					7348 7384 7416 7440 7460 7489 7466 7444 7413 7422 7453 7475 7506 7492 7473 7450 7416 7378
					7358 7396 7428 7458 7478 7509 7484 7459 7428 7417 7447 7470 7500 7486 7464 7437 7404 7366
					7372 7410 7443 7477 7497 7528 7500 7474 7441 7428 7459 7483 7515 7495 7474 7443 7410 7371
					7359 7397 7430 7463 7489 7515 7486 7461 7429 7451 7484 7509 7542 7517 7494 7459 7425 7385
					7373 7411 7445 7480 7507 7534 7503 7477 7443 7440 7472 7497 7530 7505 7476 7442 7408 7369
					7387 7427 7462 7499 7530 7556 7524 7496 7461 7462 7495 7522 7554 7525 7493 7457 7422 7381
					7369 7407 7441 7476 7516 7553 7525 7497 7462 7493 7530 7559 7582 7533 7495 7459 7423 7382
					7385 7425 7461 7497 7538 7574 7550 7520 7483 7493 7530 7559 7576 7529 7488 7452 7417 7375
					7403 7445 7482 7522 7564 7599 7577 7544 7505 7514 7553 7585 7594 7543 7502 7464 7427 7384
					7400 7441 7478 7517 7562 7591 7572 7540 7502 7548 7590 7621 7627 7573 7531 7489 7450 7406
					7421 7464 7504 7546 7592 7621 7600 7569 7526 7545 7587 7613 7615 7564 7519 7479 7440 7395
					7444 7490 7531 7575 7623 7650 7630 7598 7553 7577 7621 7647 7646 7589 7544 7502 7461 7413
					7442 7489 7531 7575 7626 7647 7626 7598 7553 7615 7664 7686 7682 7621 7572 7527 7485 7435
					7469 7518 7563 7611 7664 7684 7661 7636 7587 7624 7668 7690 7681 7620 7570 7525 7483 7432
					7501 7554 7602 7653 7711 7729 7702 7678 7625 7664 7706 7731 7717 7653 7599 7552 7507 7452
					7496 7549 7597 7650 7710 7721 7694 7671 7622 7714 7756 7784 7764 7694 7637 7586 7538 7479
					7325 7362 7392 7425 7461 7466 7454 7445 7416 7453 7471 7481 7460 7418 7384 7354 7325 7285
					7379 7422 7458 7497 7541 7545 7529 7516 7485 7527 7549 7564 7540 7490 7450 7414 7380 7334
					7419 7467 7508 7552 7604 7604 7583 7568 7537 7612 7641 7662 7633 7573 7526 7483 7444 7391
					7492 7549 7597 7652 7714 7714 7686 7665 7630 7678 7712 7738 7706 7636 7582 7534 7490 7432
					7652 7728 7798 7877 7968 7965 7917 7879 7823 7890 7941 7985 7944 7848 7770 7702 7641 7558>;

			PS_Config_Lmt_Open_Rawdata_N = <
					6834 6852 6860 6867 6876 6890 6896 6884 6869 6846 6863 6873 6886 6896 6886 6878 6869 6861
					6833 6853 6862 6870 6880 6895 6900 6887 6870 6846 6862 6873 6887 6895 6885 6876 6867 6854
					6826 6846 6854 6863 6872 6888 6890 6878 6861 6853 6869 6880 6895 6902 6892 6882 6873 6858
					6828 6849 6858 6867 6877 6892 6894 6881 6864 6844 6860 6871 6885 6891 6880 6871 6862 6847
					6835 6858 6868 6878 6888 6903 6903 6890 6873 6854 6870 6881 6897 6900 6890 6880 6870 6852
					6828 6848 6860 6869 6879 6895 6893 6880 6863 6859 6876 6888 6904 6905 6895 6886 6875 6855
					6833 6854 6868 6878 6888 6904 6900 6887 6870 6855 6871 6882 6898 6899 6888 6879 6868 6847
					6838 6858 6874 6883 6894 6910 6905 6891 6874 6857 6873 6885 6901 6899 6889 6880 6868 6847
					6833 6853 6870 6880 6890 6906 6900 6886 6869 6871 6887 6900 6916 6913 6903 6893 6877 6855
					6838 6858 6876 6887 6898 6915 6906 6892 6875 6863 6879 6891 6907 6904 6892 6883 6866 6845
					6843 6864 6882 6896 6906 6924 6914 6900 6882 6873 6890 6902 6919 6913 6902 6891 6873 6851
					6836 6857 6875 6889 6901 6917 6904 6891 6874 6879 6896 6909 6927 6919 6908 6895 6875 6853
					6842 6863 6882 6899 6911 6929 6914 6900 6882 6876 6893 6906 6924 6915 6903 6887 6868 6847
					6850 6872 6891 6910 6921 6939 6923 6909 6890 6882 6900 6914 6932 6921 6909 6891 6871 6849
					6843 6864 6883 6902 6917 6932 6916 6901 6883 6895 6914 6929 6948 6933 6920 6900 6880 6857
					6850 6872 6892 6912 6928 6943 6925 6910 6891 6889 6907 6922 6941 6926 6910 6890 6871 6848
					6859 6882 6902 6923 6941 6955 6937 6921 6901 6901 6921 6936 6955 6938 6920 6899 6879 6855
					6848 6870 6889 6910 6933 6954 6938 6922 6902 6919 6940 6957 6971 6943 6920 6900 6879 6855
					6858 6880 6901 6922 6945 6966 6952 6935 6914 6920 6941 6958 6967 6940 6917 6896 6875 6852
					6868 6892 6913 6936 6960 6981 6967 6949 6926 6931 6954 6972 6978 6948 6925 6903 6882 6857
					6866 6890 6911 6933 6959 6976 6965 6947 6925 6951 6975 6993 6997 6965 6941 6917 6895 6869
					6878 6903 6926 6950 6976 6993 6981 6963 6939 6949 6974 6988 6990 6960 6934 6912 6889 6863
					6891 6917 6941 6967 6994 7010 6998 6980 6954 6967 6993 7008 7007 6975 6949 6924 6901 6873
					6890 6917 6941 6966 6996 7008 6996 6980 6954 6990 7017 7030 7028 6993 6965 6939 6915 6886
					6905 6934 6959 6987 7018 7029 7016 7002 6974 6995 7020 7033 7027 6992 6964 6938 6914 6884
					6924 6954 6982 7012 7045 7055 7039 7026 6995 7018 7042 7056 7048 7011 6981 6953 6927 6896
					6921 6952 6979 7009 7044 7050 7035 7022 6994 7046 7070 7087 7075 7035 7002 6973 6945 6911
					6823 6844 6862 6880 6901 6904 6897 6892 6875 6896 6907 6912 6900 6876 6857 6840 6823 6800
					6854 6879 6899 6922 6947 6949 6940 6932 6915 6939 6952 6960 6946 6918 6895 6874 6855 6828
					6877 6905 6928 6953 6983 6983 6971 6962 6944 6988 7005 7016 7000 6965 6938 6914 6891 6861
					6919 6951 6979 7011 7046 7046 7031 7018 6998 7026 7045 7060 7042 7002 6971 6943 6917 6884
					7011 7055 7095 7140 7192 7191 7163 7141 7109 7148 7177 7202 7178 7123 7079 7040 7004 6957>;

			PS_Config_Lmt_FW_Rawdata_P = <
					1300 1300 1300 1300 1300 1300 1300 1300 1300 1300 1300 1300 1300 1300 1300 1300 1300 1300
					1300 1300 1300 1300 1300 1300 1300 1300 1300 1300 1300 1300 1300 1300 1300 1300 1300 1300
					1300 1300 1300 1300 1300 1300 1300 1300 1300 1300 1300 1300 1300 1300 1300 1300 1300 1300
					1300 1300 1300 1300 1300 1300 1300 1300 1300 1300 1300 1300 1300 1300 1300 1300 1300 1300
					1300 1300 1300 1300 1300 1300 1300 1300 1300 1300 1300 1300 1300 1300 1300 1300 1300 1300
					1300 1300 1300 1300 1300 1300 1300 1300 1300 1300 1300 1300 1300 1300 1300 1300 1300 1300
					1300 1300 1300 1300 1300 1300 1300 1300 1300 1300 1300 1300 1300 1300 1300 1300 1300 1300
					1300 1300 1300 1300 1300 1300 1300 1300 1300 1300 1300 1300 1300 1300 1300 1300 1300 1300
					1300 1300 1300 1300 1300 1300 1300 1300 1300 1300 1300 1300 1300 1300 1300 1300 1300 1300
					1300 1300 1300 1300 1300 1300 1300 1300 1300 1300 1300 1300 1300 1300 1300 1300 1300 1300
					1300 1300 1300 1300 1300 1300 1300 1300 1300 1300 1300 1300 1300 1300 1300 1300 1300 1300
					1300 1300 1300 1300 1300 1300 1300 1300 1300 1300 1300 1300 1300 1300 1300 1300 1300 1300
					1300 1300 1300 1300 1300 1300 1300 1300 1300 1300 1300 1300 1300 1300 1300 1300 1300 1300
					1300 1300 1300 1300 1300 1300 1300 1300 1300 1300 1300 1300 1300 1300 1300 1300 1300 1300
					1300 1300 1300 1300 1300 1300 1300 1300 1300 1300 1300 1300 1300 1300 1300 1300 1300 1300
					1300 1300 1300 1300 1300 1300 1300 1300 1300 1300 1300 1300 1300 1300 1300 1300 1300 1300
					1300 1300 1300 1300 1300 1300 1300 1300 1300 1300 1300 1300 1300 1300 1300 1300 1300 1300
					1300 1300 1300 1300 1300 1300 1300 1300 1300 1300 1300 1300 1300 1300 1300 1300 1300 1300
					1300 1300 1300 1300 1300 1300 1300 1300 1300 1300 1300 1300 1300 1300 1300 1300 1300 1300
					1300 1300 1300 1300 1300 1300 1300 1300 1300 1300 1300 1300 1300 1300 1300 1300 1300 1300
					1300 1300 1300 1300 1300 1300 1300 1300 1300 1300 1300 1300 1300 1300 1300 1300 1300 1300
					1300 1300 1300 1300 1300 1300 1300 1300 1300 1300 1300 1300 1300 1300 1300 1300 1300 1300
					1300 1300 1300 1300 1300 1300 1300 1300 1300 1300 1300 1300 1300 1300 1300 1300 1300 1300
					1300 1300 1300 1300 1300 1300 1300 1300 1300 1300 1300 1300 1300 1300 1300 1300 1300 1300
					1300 1300 1300 1300 1300 1300 1300 1300 1300 1300 1300 1300 1300 1300 1300 1300 1300 1300
					1300 1300 1300 1300 1300 1300 1300 1300 1300 1300 1300 1300 1300 1300 1300 1300 1300 1300
					1300 1300 1300 1300 1300 1300 1300 1300 1300 1300 1300 1300 1300 1300 1300 1300 1300 1300
					1300 1300 1300 1300 1300 1300 1300 1300 1300 1300 1300 1300 1300 1300 1300 1300 1300 1300
					1300 1300 1300 1300 1300 1300 1300 1300 1300 1300 1300 1300 1300 1300 1300 1300 1300 1300
					1300 1300 1300 1300 1300 1300 1300 1300 1300 1300 1300 1300 1300 1300 1300 1300 1300 1300
					1300 1300 1300 1300 1300 1300 1300 1300 1300 1300 1300 1300 1300 1300 1300 1300 1300 1300
					1300 1300 1300 1300 1300 1300 1300 1300 1300 1300 1300 1300 1300 1300 1300 1300 1300 1300>;
			PS_Config_Lmt_FW_Rawdata_N= <
					500 500 500 500 500 500 500 500 500 500 500 500 500 500 500 500 500 500
					500 500 500 500 500 500 500 500 500 500 500 500 500 500 500 500 500 500
					500 500 500 500 500 500 500 500 500 500 500 500 500 500 500 500 500 500
					500 500 500 500 500 500 500 500 500 500 500 500 500 500 500 500 500 500
					500 500 500 500 500 500 500 500 500 500 500 500 500 500 500 500 500 500
					500 500 500 500 500 500 500 500 500 500 500 500 500 500 500 500 500 500
					500 500 500 500 500 500 500 500 500 500 500 500 500 500 500 500 500 500
					500 500 500 500 500 500 500 500 500 500 500 500 500 500 500 500 500 500
					500 500 500 500 500 500 500 500 500 500 500 500 500 500 500 500 500 500
					500 500 500 500 500 500 500 500 500 500 500 500 500 500 500 500 500 500
					500 500 500 500 500 500 500 500 500 500 500 500 500 500 500 500 500 500
					500 500 500 500 500 500 500 500 500 500 500 500 500 500 500 500 500 500
					500 500 500 500 500 500 500 500 500 500 500 500 500 500 500 500 500 500
					500 500 500 500 500 500 500 500 500 500 500 500 500 500 500 500 500 500
					500 500 500 500 500 500 500 500 500 500 500 500 500 500 500 500 500 500
					500 500 500 500 500 500 500 500 500 500 500 500 500 500 500 500 500 500
					500 500 500 500 500 500 500 500 500 500 500 500 500 500 500 500 500 500
					500 500 500 500 500 500 500 500 500 500 500 500 500 500 500 500 500 500
					500 500 500 500 500 500 500 500 500 500 500 500 500 500 500 500 500 500
					500 500 500 500 500 500 500 500 500 500 500 500 500 500 500 500 500 500
					500 500 500 500 500 500 500 500 500 500 500 500 500 500 500 500 500 500
					500 500 500 500 500 500 500 500 500 500 500 500 500 500 500 500 500 500
					500 500 500 500 500 500 500 500 500 500 500 500 500 500 500 500 500 500
					500 500 500 500 500 500 500 500 500 500 500 500 500 500 500 500 500 500
					500 500 500 500 500 500 500 500 500 500 500 500 500 500 500 500 500 500
					500 500 500 500 500 500 500 500 500 500 500 500 500 500 500 500 500 500
					500 500 500 500 500 500 500 500 500 500 500 500 500 500 500 500 500 500
					500 500 500 500 500 500 500 500 500 500 500 500 500 500 500 500 500 500
					500 500 500 500 500 500 500 500 500 500 500 500 500 500 500 500 500 500
					500 500 500 500 500 500 500 500 500 500 500 500 500 500 500 500 500 500
					500 500 500 500 500 500 500 500 500 500 500 500 500 500 500 500 500 500
					500 500 500 500 500 500 500 500 500 500 500 500 500 500 500 500 500 500>;

			PS_Config_Lmt_FW_CC_P =<132>;
			PS_Config_Lmt_FW_CC_N =<74>;
			PS_Config_Lmt_Key_FW_CC_P =<38>;
			PS_Config_Lmt_Key_FW_CC_N =<9>;
			PS_Config_Lmt_FW_CC_I_P =<25>;
			PS_Config_Lmt_FW_CC_I_N =<0>;
			PS_Config_Lmt_FW_CC_Q_P =<25>;
			PS_Config_Lmt_FW_CC_Q_N =<0>;
			PS_Config_Lmt_Key_FW_CC_I_P =<25>;
			PS_Config_Lmt_Key_FW_CC_I_N =<0>;
			PS_Config_Lmt_Key_FW_CC_Q_P =<25>;
			PS_Config_Lmt_Key_FW_CC_Q_N =<0>;

			PS_Config_Lmt_FW_Diff_P =<35>;
			PS_Config_Lmt_FW_Diff_N =<(-35)>;
			PS_Config_Lmt_Key_FW_Diff_P =<35>;
			PS_Config_Lmt_Key_FW_Diff_N =<(-35)>;

		 PS_Config_Diff_Test_Frame =<50>;
		};

		novatek-mp-criteria-5909@1 {
			#address-cells = <1>;
			#size-cells = <0>;
			compatible = "novatek-mp-criteria-5909";

			/* MP Config*/
			IC_X_CFG_SIZE = <18>;
			IC_Y_CFG_SIZE = <32>;
			IC_KEY_CFG_SIZE = <4>;
			X_Channel = <18>;
			Y_Channel = <32>;
			AIN_X = <17 16 15 14 13 12 11 10 9 8 7 6 5 4 3 2 1 0>;
			AIN_Y = <31 30 29 28 27 26 25 24 23 22 21 20 19 18 17 16 15
					14 13 12 11 10 9 8 7 6 5 4 3 2 1 0>;
			AIN_KEY = <0 1 2 0xFF>;

			/* MP Criteria */
			PS_Config_Lmt_Short_Rawdata_P = <14000>;
			PS_Config_Lmt_Short_Rawdata_N = <11000>;
			PS_Config_Lmt_Key_Short_Rawdata_P = <14000>;
			PS_Config_Lmt_Key_Short_Rawdata_N = <11000>;
			PS_Config_Lmt_Short_Diff_P = <6300>;
			PS_Config_Lmt_Short_Diff_N = <0>;
			PS_Config_Lmt_Key_Short_Diff_P = <6300>;
			PS_Config_Lmt_Key_Short_Diff_N = <0>;
			PS_Config_Lmt_Short_Base_P = <2000>;
			PS_Config_Lmt_Short_Base_N = <(-2000)>;
			PS_Config_Lmt_Key_Short_Base_P = <2000>;
			PS_Config_Lmt_Key_Short_Base_N = <(-2000)>;

			PS_Config_Lmt_Open_Rawdata_P = <
					8865 8928 8907 8874 8869 8826 8848 8857 8895 8860 8870 8858 8833 8834 8844 8869 8868 8894
					8742 8785 8768 8735 8735 8691 8714 8720 8755 8716 8717 8708 8686 8686 8693 8715 8709 8731
					8699 8719 8707 8679 8682 8654 8664 8669 8704 8655 8655 8646 8627 8625 8635 8651 8647 8670
					8693 8726 8711 8685 8691 8657 8677 8684 8719 8683 8680 8673 8650 8661 8661 8672 8670 8674
					8657 8696 8670 8646 8651 8615 8638 8647 8680 8640 8634 8628 8604 8609 8614 8626 8630 8622
					8688 8716 8690 8667 8674 8646 8663 8671 8704 8645 8637 8633 8609 8613 8620 8627 8636 8629
					8624 8654 8624 8607 8613 8587 8604 8613 8645 8619 8612 8606 8583 8598 8597 8602 8610 8603
					8638 8653 8633 8615 8621 8597 8614 8623 8656 8619 8611 8605 8584 8591 8594 8599 8596 8595
					8602 8609 8605 8577 8585 8563 8580 8588 8620 8566 8557 8552 8530 8535 8537 8554 8536 8539
					8611 8617 8616 8588 8596 8575 8593 8602 8633 8592 8581 8575 8553 8572 8564 8581 8562 8568
					8549 8554 8551 8527 8530 8514 8533 8542 8571 8542 8530 8525 8504 8513 8511 8530 8512 8513
					8566 8565 8558 8539 8553 8530 8547 8558 8585 8536 8523 8518 8498 8504 8503 8517 8505 8508
					8505 8502 8488 8487 8487 8472 8492 8501 8523 8500 8486 8482 8461 8482 8476 8476 8473 8476
					8498 8495 8484 8486 8476 8466 8486 8494 8512 8490 8477 8472 8451 8462 8470 8464 8464 8463
					8454 8450 8441 8443 8445 8423 8443 8452 8469 8426 8414 8409 8390 8398 8407 8396 8401 8399
					8436 8432 8423 8428 8422 8411 8430 8438 8455 8434 8421 8416 8396 8418 8415 8406 8411 8408
					8374 8376 8369 8361 8364 8356 8375 8386 8405 8370 8359 8352 8335 8349 8340 8344 8354 8353
					8382 8381 8376 8368 8378 8372 8377 8388 8408 8374 8357 8351 8345 8345 8339 8344 8356 8354
					8324 8325 8320 8313 8312 8305 8325 8336 8353 8329 8312 8307 8290 8312 8297 8300 8312 8309
					8308 8309 8308 8301 8295 8291 8323 8323 8339 8317 8300 8307 8278 8292 8285 8291 8305 8297
					8257 8256 8259 8254 8256 8243 8274 8273 8286 8249 8233 8238 8211 8222 8217 8224 8236 8226
					8232 8233 8237 8232 8227 8221 8251 8250 8262 8249 8230 8238 8212 8233 8219 8228 8242 8227
					8168 8170 8175 8170 8161 8158 8178 8187 8197 8184 8167 8165 8146 8163 8154 8165 8178 8162
					8164 8169 8173 8169 8169 8155 8172 8197 8192 8158 8152 8135 8121 8138 8128 8139 8153 8133
					8090 8096 8100 8097 8087 8083 8100 8124 8119 8113 8108 8089 8076 8093 8083 8097 8110 8089
					8075 8083 8089 8083 8071 8069 8087 8111 8103 8092 8087 8068 8054 8072 8062 8078 8092 8068
					8027 8036 8043 8038 8033 8023 8039 8057 8054 8027 8022 8007 7991 8007 7996 8013 8026 7999
					7984 7993 8001 7992 7979 7977 7994 8005 8015 8020 7995 7987 7973 7987 7979 7997 8012 7980
					7933 7942 7949 7940 7925 7926 7942 7954 7967 7960 7930 7921 7906 7921 7912 7932 7947 7912
					7928 7937 7945 7933 7929 7920 7934 7946 7960 7946 7916 7907 7890 7907 7899 7920 7934 7894
					7890 7900 7907 7892 7880 7879 7895 7907 7918 7913 7884 7875 7866 7874 7868 7890 7907 7865
					7935 7948 7952 7933 7912 7920 7937 7951 7943 7940 7929 7917 7899 7917 7918 7941 7959 7892>;


			PS_Config_Lmt_Open_Rawdata_N = <
					7609 7643 7632 7614 7611 7588 7600 7605 7626 7607 7612 7605 7592 7593 7598 7611 7611 7625
					7543 7566 7557 7539 7539 7515 7528 7531 7550 7529 7529 7525 7513 7513 7517 7528 7525 7537
					7520 7531 7524 7509 7511 7495 7501 7504 7522 7496 7496 7491 7481 7480 7485 7494 7492 7504
					7516 7534 7526 7512 7516 7497 7508 7512 7531 7511 7509 7506 7493 7499 7499 7505 7504 7506
					7497 7518 7504 7491 7494 7475 7487 7492 7509 7488 7485 7482 7469 7471 7474 7480 7483 7478
					7514 7529 7515 7503 7506 7491 7500 7504 7522 7491 7486 7484 7472 7473 7477 7481 7486 7482
					7479 7495 7479 7470 7474 7459 7469 7473 7491 7477 7473 7470 7457 7466 7465 7468 7472 7468
					7487 7495 7484 7475 7478 7465 7474 7479 7497 7477 7472 7469 7458 7462 7463 7466 7464 7464
					7467 7471 7469 7454 7458 7446 7456 7460 7477 7448 7443 7440 7429 7431 7433 7442 7432 7434
					7473 7476 7475 7460 7465 7453 7463 7467 7484 7462 7456 7453 7441 7451 7447 7456 7446 7449
					7439 7441 7440 7427 7429 7420 7430 7435 7451 7435 7429 7426 7415 7419 7419 7429 7419 7420
					7448 7448 7444 7434 7441 7429 7438 7444 7458 7432 7425 7422 7411 7415 7414 7422 7415 7417
					7415 7414 7406 7406 7406 7398 7408 7413 7425 7413 7405 7403 7392 7403 7400 7400 7398 7400
					7412 7410 7404 7405 7399 7394 7405 7409 7419 7407 7400 7397 7386 7392 7396 7393 7393 7392
					7388 7386 7381 7382 7383 7371 7382 7387 7396 7373 7366 7364 7353 7358 7362 7357 7359 7358
					7378 7376 7371 7374 7370 7364 7375 7379 7388 7377 7370 7367 7357 7369 7367 7362 7365 7363
					7345 7346 7342 7338 7339 7335 7345 7351 7361 7343 7336 7333 7324 7331 7326 7328 7334 7333
					7349 7348 7346 7342 7347 7344 7346 7352 7363 7345 7336 7332 7329 7329 7326 7329 7335 7334
					7318 7318 7316 7312 7312 7308 7319 7324 7333 7321 7311 7309 7299 7311 7303 7305 7312 7310
					7309 7310 7309 7305 7302 7300 7317 7317 7326 7314 7305 7308 7293 7301 7297 7300 7307 7303
					7282 7281 7283 7280 7281 7274 7291 7290 7298 7277 7269 7271 7257 7263 7260 7264 7271 7265
					7269 7269 7271 7268 7266 7263 7279 7278 7285 7277 7267 7271 7257 7269 7261 7266 7273 7266
					7234 7235 7237 7235 7230 7229 7239 7244 7250 7242 7233 7232 7222 7231 7226 7232 7239 7231
					7231 7235 7237 7234 7234 7227 7236 7249 7247 7228 7225 7216 7209 7218 7212 7218 7226 7215
					7192 7195 7197 7196 7190 7188 7197 7210 7207 7204 7202 7192 7184 7193 7188 7195 7202 7191
					7184 7188 7191 7188 7182 7181 7190 7203 7199 7193 7190 7180 7172 7182 7177 7185 7193 7180
					7158 7163 7167 7164 7161 7156 7164 7174 7172 7158 7155 7147 7139 7147 7141 7151 7158 7143
					7135 7140 7144 7139 7132 7131 7140 7146 7151 7154 7141 7136 7129 7137 7132 7142 7150 7133
					7108 7112 7116 7111 7103 7104 7112 7118 7126 7122 7106 7101 7093 7101 7096 7107 7115 7096
					7105 7109 7114 7107 7105 7100 7108 7114 7122 7114 7098 7093 7084 7093 7089 7100 7108 7086
					7084 7089 7093 7085 7079 7078 7087 7093 7099 7097 7081 7076 7071 7075 7072 7084 7093 7071
					7108 7115 7118 7107 7096 7100 7109 7117 7113 7111 7105 7098 7089 7099 7099 7112 7121 7085>;

			PS_Config_Lmt_FW_Rawdata_P = <
					1600 1600 1600 1600 1600 1600 1600 1600 1600 1600 1600 1600 1600 1600 1600 1600 1600 1600
					1600 1600 1600 1600 1600 1600 1600 1600 1600 1600 1600 1600 1600 1600 1600 1600 1600 1600
					1600 1600 1600 1600 1600 1600 1600 1600 1600 1600 1600 1600 1600 1600 1600 1600 1600 1600
					1600 1600 1600 1600 1600 1600 1600 1600 1600 1600 1600 1600 1600 1600 1600 1600 1600 1600
					1600 1600 1600 1600 1600 1600 1600 1600 1600 1600 1600 1600 1600 1600 1600 1600 1600 1600
					1600 1600 1600 1600 1600 1600 1600 1600 1600 1600 1600 1600 1600 1600 1600 1600 1600 1600
					1600 1600 1600 1600 1600 1600 1600 1600 1600 1600 1600 1600 1600 1600 1600 1600 1600 1600
					1600 1600 1600 1600 1600 1600 1600 1600 1600 1600 1600 1600 1600 1600 1600 1600 1600 1600
					1600 1600 1600 1600 1600 1600 1600 1600 1600 1600 1600 1600 1600 1600 1600 1600 1600 1600
					1600 1600 1600 1600 1600 1600 1600 1600 1600 1600 1600 1600 1600 1600 1600 1600 1600 1600
					1600 1600 1600 1600 1600 1600 1600 1600 1600 1600 1600 1600 1600 1600 1600 1600 1600 1600
					1600 1600 1600 1600 1600 1600 1600 1600 1600 1600 1600 1600 1600 1600 1600 1600 1600 1600
					1600 1600 1600 1600 1600 1600 1600 1600 1600 1600 1600 1600 1600 1600 1600 1600 1600 1600
					1600 1600 1600 1600 1600 1600 1600 1600 1600 1600 1600 1600 1600 1600 1600 1600 1600 1600
					1600 1600 1600 1600 1600 1600 1600 1600 1600 1600 1600 1600 1600 1600 1600 1600 1600 1600
					1600 1600 1600 1600 1600 1600 1600 1600 1600 1600 1600 1600 1600 1600 1600 1600 1600 1600
					1600 1600 1600 1600 1600 1600 1600 1600 1600 1600 1600 1600 1600 1600 1600 1600 1600 1600
					1600 1600 1600 1600 1600 1600 1600 1600 1600 1600 1600 1600 1600 1600 1600 1600 1600 1600
					1600 1600 1600 1600 1600 1600 1600 1600 1600 1600 1600 1600 1600 1600 1600 1600 1600 1600
					1600 1600 1600 1600 1600 1600 1600 1600 1600 1600 1600 1600 1600 1600 1600 1600 1600 1600
					1600 1600 1600 1600 1600 1600 1600 1600 1600 1600 1600 1600 1600 1600 1600 1600 1600 1600
					1600 1600 1600 1600 1600 1600 1600 1600 1600 1600 1600 1600 1600 1600 1600 1600 1600 1600
					1600 1600 1600 1600 1600 1600 1600 1600 1600 1600 1600 1600 1600 1600 1600 1600 1600 1600
					1600 1600 1600 1600 1600 1600 1600 1600 1600 1600 1600 1600 1600 1600 1600 1600 1600 1600
					1600 1600 1600 1600 1600 1600 1600 1600 1600 1600 1600 1600 1600 1600 1600 1600 1600 1600
					1600 1600 1600 1600 1600 1600 1600 1600 1600 1600 1600 1600 1600 1600 1600 1600 1600 1600
					1600 1600 1600 1600 1600 1600 1600 1600 1600 1600 1600 1600 1600 1600 1600 1600 1600 1600
					1600 1600 1600 1600 1600 1600 1600 1600 1600 1600 1600 1600 1600 1600 1600 1600 1600 1600
					1600 1600 1600 1600 1600 1600 1600 1600 1600 1600 1600 1600 1600 1600 1600 1600 1600 1600
					1600 1600 1600 1600 1600 1600 1600 1600 1600 1600 1600 1600 1600 1600 1600 1600 1600 1600
					1600 1600 1600 1600 1600 1600 1600 1600 1600 1600 1600 1600 1600 1600 1600 1600 1600 1600
					1600 1600 1600 1600 1600 1600 1600 1600 1600 1600 1600 1600 1600 1600 1600 1600 1600 1600>;

			PS_Config_Lmt_FW_Rawdata_N= <
					800 800 800 800 800 800 800 800 800 800 800 800 800 800 800 800 800 800
					800 800 800 800 800 800 800 800 800 800 800 800 800 800 800 800 800 800
					800 800 800 800 800 800 800 800 800 800 800 800 800 800 800 800 800 800
					800 800 800 800 800 800 800 800 800 800 800 800 800 800 800 800 800 800
					800 800 800 800 800 800 800 800 800 800 800 800 800 800 800 800 800 800
					800 800 800 800 800 800 800 800 800 800 800 800 800 800 800 800 800 800
					800 800 800 800 800 800 800 800 800 800 800 800 800 800 800 800 800 800
					800 800 800 800 800 800 800 800 800 800 800 800 800 800 800 800 800 800
					800 800 800 800 800 800 800 800 800 800 800 800 800 800 800 800 800 800
					800 800 800 800 800 800 800 800 800 800 800 800 800 800 800 800 800 800
					800 800 800 800 800 800 800 800 800 800 800 800 800 800 800 800 800 800
					800 800 800 800 800 800 800 800 800 800 800 800 800 800 800 800 800 800
					800 800 800 800 800 800 800 800 800 800 800 800 800 800 800 800 800 800
					800 800 800 800 800 800 800 800 800 800 800 800 800 800 800 800 800 800
					800 800 800 800 800 800 800 800 800 800 800 800 800 800 800 800 800 800
					800 800 800 800 800 800 800 800 800 800 800 800 800 800 800 800 800 800
					800 800 800 800 800 800 800 800 800 800 800 800 800 800 800 800 800 800
					800 800 800 800 800 800 800 800 800 800 800 800 800 800 800 800 800 800
					800 800 800 800 800 800 800 800 800 800 800 800 800 800 800 800 800 800
					800 800 800 800 800 800 800 800 800 800 800 800 800 800 800 800 800 800
					800 800 800 800 800 800 800 800 800 800 800 800 800 800 800 800 800 800
					800 800 800 800 800 800 800 800 800 800 800 800 800 800 800 800 800 800
					800 800 800 800 800 800 800 800 800 800 800 800 800 800 800 800 800 800
					800 800 800 800 800 800 800 800 800 800 800 800 800 800 800 800 800 800
					800 800 800 800 800 800 800 800 800 800 800 800 800 800 800 800 800 800
					800 800 800 800 800 800 800 800 800 800 800 800 800 800 800 800 800 800
					800 800 800 800 800 800 800 800 800 800 800 800 800 800 800 800 800 800
					800 800 800 800 800 800 800 800 800 800 800 800 800 800 800 800 800 800
					800 800 800 800 800 800 800 800 800 800 800 800 800 800 800 800 800 800
					800 800 800 800 800 800 800 800 800 800 800 800 800 800 800 800 800 800
					800 800 800 800 800 800 800 800 800 800 800 800 800 800 800 800 800 800
					800 800 800 800 800 800 800 800 800 800 800 800 800 800 800 800 800 800>;

			PS_Config_Lmt_FW_CC_P =<118>;
			PS_Config_Lmt_FW_CC_N = <62>;
			PS_Config_Lmt_Key_FW_CC_P = <38>;
			PS_Config_Lmt_Key_FW_CC_N = <9>;
			PS_Config_Lmt_FW_CC_I_P = <25>;
			PS_Config_Lmt_FW_CC_I_N = <0>;
			PS_Config_Lmt_FW_CC_Q_P = <25>;
			PS_Config_Lmt_FW_CC_Q_N = <0>;
			PS_Config_Lmt_Key_FW_CC_I_P = <25>;
			PS_Config_Lmt_Key_FW_CC_I_N = <0>;
			PS_Config_Lmt_Key_FW_CC_Q_P = <25>;
			PS_Config_Lmt_Key_FW_CC_Q_N = <0>;

			PS_Config_Lmt_FW_Diff_P = <35>;
			PS_Config_Lmt_FW_Diff_N = <(-35)>;
			PS_Config_Lmt_Key_FW_Diff_P = <35>;
			PS_Config_Lmt_Key_FW_Diff_N = <(-35)>;

			PS_Config_Diff_Test_Frame = <50>;

//#endif /* #if NVT_TOUCH_MP */
		};
	};
};
