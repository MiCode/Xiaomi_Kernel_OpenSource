/* Copyright (c) 2013, The Linux Foundation. All rights reserved.
 * Copyright (C) 2018 XiaoMi, Inc.
 *
 * This program is free software; you can redistribute it and/or modify
 * it under the terms of the GNU General Public License version 2 and
 * only version 2 as published by the Free Software Foundation.
 *
 * This program is distributed in the hope that it will be useful,
 * but WITHOUT ANY WARRANTY; without even the implied warranty of
 * MERCHANTABILITY or FITNESS FOR A PARTICULAR PURPOSE.  See the
 * GNU General Public License for more details.
 */

/*---------------------------------------------------------------------------
 * This file is autogenerated file using gcdb parser. Please do not edit it.
 * Update input XML file to add a new entry or update variable in this file
 * VERSION = "1.0"
 *---------------------------------------------------------------------------*/
&mdss_mdp {
	dsi_ili9881c_ebbgDJN_720p_video: qcom,mdss_dsi_ili9881c_ebbgDJN_720p_video {
		qcom,mdss-dsi-panel-name = "ili9881c_HD720p_video_EbbgDJN";
		qcom,mdss-dsi-panel-controller = <&mdss_dsi0>;
		qcom,mdss-dsi-panel-type = "dsi_video_mode";
		qcom,mdss-dsi-panel-destination = "display_1";
		qcom,mdss-dsi-panel-framerate = <60>;
		qcom,mdss-dsi-virtual-channel-id = <0>;
		qcom,mdss-dsi-stream = <0>;
		qcom,mdss-dsi-panel-width = <720>;
		qcom,mdss-dsi-panel-height = <1280>;
		qcom,mdss-pan-physical-width-dimension = <62>;
		qcom,mdss-pan-physical-height-dimension = <110>;
		qcom,mdss-dsi-h-front-porch = <114>;
		qcom,mdss-dsi-h-back-porch = <180>;
		qcom,mdss-dsi-h-pulse-width = <8>;
		qcom,mdss-dsi-h-sync-skew = <0>;
		qcom,mdss-dsi-v-back-porch = <18>;
		qcom,mdss-dsi-v-front-porch = <10>;
		qcom,mdss-dsi-v-pulse-width = <4>;
		qcom,mdss-dsi-h-left-border = <0>;
		qcom,mdss-dsi-h-right-border = <0>;
		qcom,mdss-dsi-v-top-border = <0>;
		qcom,mdss-dsi-v-bottom-border = <0>;
		qcom,mdss-dsi-bpp = <24>;
		qcom,mdss-dsi-underflow-color = <0x00>;
		qcom,mdss-dsi-border-color = <0>;
		qcom,mdss-dsi-on-command = [39 00 00 00 00 00 05 FF 98 81 00 FF
				39 00 00 00 00 00 04 FF 98 81 04
				39 00 00 00 00 00 04 FF 98 81 04
				39 00 00 00 00 00 02 E5 00
				39 00 00 00 0A 00 04 FF 98 81 00
				39 00 00 00 0A 00 04 FF 98 81 00
				39 00 00 00 B4 00 02 11 00
				39 00 00 00 00 00 02 29 00
				39 00 00 00 0A 00 02 35 00
				39 00 00 00 00 00 03 51 0F FF
				39 00 00 00 00 00 02 53 2C
				39 00 00 00 00 00 02 55 00
				39 00 00 00 00 00 02 68 05
				39 00 00 00 00 00 03 5E 00 FF
				39 00 00 00 00 00 04 FF 98 81 03
				39 00 00 00 00 00 04 FF 98 81 03
				39 00 00 00 00 00 02 2C 0C
				39 00 00 00 00 00 04 FF 98 81 02
				39 00 00 00 00 00 04 FF 98 81 02
				39 00 00 00 00 00 02 04 16
				39 00 00 00 00 00 02 05 22
				39 00 00 00 00 00 02 06 40
				39 00 00 00 00 00 02 07 04
				39 01 00 00 00 00 04 FF 98 81 00
				39 01 00 00 00 00 04 FF 98 81 00
		];
		qcom,mdss-dsi-off-command = [
				39 00 00 00 00 00 04 FF 98 81 00
				39 00 00 00 00 00 04 FF 98 81 00
				05 00 00 00 0A 00 02 28 00
				05 01 00 00 96 00 02 10 00];
		qcom,mdss-dsi-on-command-state = "dsi_hs_mode";
		qcom,mdss-dsi-off-command-state = "dsi_hs_mode";
		qcom,mdss-dsi-panel-warm-command = [39 00 00 00 00 00 04 FF 98 81 01
				39 00 00 00 00 00 04 FF 98 81 01
				39 00 00 00 00 00 02 A0 00
				39 00 00 00 00 00 02 A1 1A
				39 00 00 00 00 00 02 A2 29
				39 00 00 00 00 00 02 A3 15
				39 00 00 00 00 00 02 A4 18
				39 00 00 00 00 00 02 A5 2B
				39 00 00 00 00 00 02 A6 1F
				39 00 00 00 00 00 02 A7 20
				39 00 00 00 00 00 02 A8 8D
				39 00 00 00 00 00 02 A9 1C
				39 00 00 00 00 00 02 AA 28
				39 00 00 00 00 00 02 AB 76
				39 00 00 00 00 00 02 AC 1A
				39 00 00 00 00 00 02 AD 1A
				39 00 00 00 00 00 02 AE 4F
				39 00 00 00 00 00 02 AF 23
				39 00 00 00 00 00 02 B0 29
				39 00 00 00 00 00 02 B1 4F
				39 00 00 00 00 00 02 B2 5D
				39 00 00 00 00 00 02 B3 32
				39 00 00 00 00 00 02 C0 00
				39 00 00 00 00 00 02 C1 1A
				39 00 00 00 00 00 02 C2 29
				39 00 00 00 00 00 02 C3 15
				39 00 00 00 00 00 02 C4 18
				39 00 00 00 00 00 02 C5 2B
				39 00 00 00 00 00 02 C6 1F
				39 00 00 00 00 00 02 C7 20
				39 00 00 00 00 00 02 C8 8D
				39 00 00 00 00 00 02 C9 1C
				39 00 00 00 00 00 02 CA 28
				39 00 00 00 00 00 02 CB 76
				39 00 00 00 00 00 02 CC 1A
				39 00 00 00 00 00 02 CD 1A
				39 00 00 00 00 00 02 CE 4F
				39 00 00 00 00 00 02 CF 23
				39 00 00 00 00 00 02 D0 29
				39 00 00 00 00 00 02 D1 4F
				39 00 00 00 00 00 02 D2 5D
				39 01 00 00 00 00 02 D3 32
				39 00 00 00 00 00 04 FF 98 81 05
				39 00 00 00 00 00 04 FF 98 81 05
				39 00 00 00 00 00 02 85 48
				39 00 00 00 00 00 02 00 00
				39 00 00 00 00 00 02 01 00
				39 00 00 00 00 00 02 02 00
				39 00 00 00 00 00 02 03 17
				39 00 00 00 00 00 02 04 00
				39 00 00 00 00 00 02 05 28
				39 00 00 00 00 00 02 06 00
				39 00 00 00 00 00 02 07 39
				39 00 00 00 00 00 02 08 00
				39 00 00 00 00 00 02 09 4C
				39 00 00 00 00 00 02 0A 00
				39 00 00 00 00 00 02 0B 5F
				39 00 00 00 00 00 02 0C 00
				39 00 00 00 00 00 02 0D 73
				39 00 00 00 00 00 02 0E 00
				39 00 00 00 00 00 02 0F 83
				39 00 00 00 00 00 02 10 00
				39 00 00 00 00 00 02 11 93
				39 00 00 00 00 00 02 12 00
				39 00 00 00 00 00 02 13 A6
				39 00 00 00 00 00 02 14 00
				39 00 00 00 00 00 02 15 B6
				39 00 00 00 00 00 02 16 00
				39 00 00 00 00 00 02 17 C6
				39 00 00 00 00 00 02 18 00
				39 00 00 00 00 00 02 19 D7
				39 00 00 00 00 00 02 1A 00
				39 00 00 00 00 00 02 1B E6
				39 00 00 00 00 00 02 1C 00
				39 00 00 00 00 00 02 1D F7
				39 00 00 00 00 00 02 1E 01
				39 00 00 00 00 00 02 1F 08
				39 00 00 00 00 00 02 20 01
				39 00 00 00 00 00 02 21 18
				39 00 00 00 00 00 02 22 01
				39 00 00 00 00 00 02 23 28
				39 00 00 00 00 00 02 24 01
				39 00 00 00 00 00 02 25 37
				39 00 00 00 00 00 02 26 01
				39 00 00 00 00 00 02 27 48
				39 00 00 00 00 00 02 28 01
				39 00 00 00 00 00 02 29 58
				39 00 00 00 00 00 02 2A 01
				39 00 00 00 00 00 02 2B 69
				39 00 00 00 00 00 02 2C 01
				39 00 00 00 00 00 02 2D 79
				39 00 00 00 00 00 02 2E 01
				39 00 00 00 00 00 02 2F 89
				39 00 00 00 00 00 02 30 01
				39 00 00 00 00 00 02 31 98
				39 00 00 00 00 00 02 32 01
				39 00 00 00 00 00 02 33 A8
				39 00 00 00 00 00 02 34 01
				39 00 00 00 00 00 02 35 B7
				39 00 00 00 00 00 02 36 01
				39 00 00 00 00 00 02 37 D6
				39 00 00 00 00 00 02 38 01
				39 00 00 00 00 00 02 39 F5
				39 00 00 00 00 00 02 3A 02
				39 00 00 00 00 00 02 3B 14
				39 00 00 00 00 00 02 3C 02
				39 00 00 00 00 00 02 3D 34
				39 00 00 00 00 00 02 3E 02
				39 00 00 00 00 00 02 3F 53
				39 00 00 00 00 00 02 40 02
				39 00 00 00 00 00 02 41 71
				39 00 00 00 00 00 02 42 02
				39 00 00 00 00 00 02 43 91
				39 00 00 00 00 00 02 44 02
				39 00 00 00 00 00 02 45 AC
				39 00 00 00 00 00 02 46 02
				39 00 00 00 00 00 02 47 C9
				39 00 00 00 00 00 02 48 02
				39 00 00 00 00 00 02 49 E6
				39 00 00 00 00 00 02 4A 03
				39 00 00 00 00 00 02 4B 04
				39 00 00 00 00 00 02 4C 03
				39 00 00 00 00 00 02 4D 26
				39 00 00 00 00 00 02 4E 03
				39 00 00 00 00 00 02 4F 43
				39 00 00 00 00 00 02 50 03
				39 00 00 00 00 00 02 51 63
				39 00 00 00 00 00 02 52 03
				39 00 00 00 00 00 02 53 81
				39 00 00 00 00 00 02 54 03
				39 00 00 00 00 00 02 55 A1
				39 00 00 00 00 00 02 56 03
				39 00 00 00 00 00 02 57 BF
				39 00 00 00 00 00 02 58 03
				39 00 00 00 00 00 02 59 E5
				39 00 00 00 00 00 02 5A 03
				39 01 00 00 00 00 02 5B FF
				39 00 00 00 00 00 04 FF 98 81 06
				39 00 00 00 00 00 04 FF 98 81 06
				39 00 00 00 00 00 02 00 00
				39 00 00 00 00 00 02 01 00
				39 00 00 00 00 00 02 02 00
				39 00 00 00 00 00 02 03 12
				39 00 00 00 00 00 02 04 00
				39 00 00 00 00 00 02 05 24
				39 00 00 00 00 00 02 06 00
				39 00 00 00 00 00 02 07 33
				39 00 00 00 00 00 02 08 00
				39 00 00 00 00 00 02 09 42
				39 00 00 00 00 00 02 0A 00
				39 00 00 00 00 00 02 0B 52
				39 00 00 00 00 00 02 0C 00
				39 00 00 00 00 00 02 0D 62
				39 00 00 00 00 00 02 0E 00
				39 00 00 00 00 00 02 0F 72
				39 00 00 00 00 00 02 10 00
				39 00 00 00 00 00 02 11 80
				39 00 00 00 00 00 02 12 00
				39 00 00 00 00 00 02 13 8E
				39 00 00 00 00 00 02 14 00
				39 00 00 00 00 00 02 15 9D
				39 00 00 00 00 00 02 16 00
				39 00 00 00 00 00 02 17 AD
				39 00 00 00 00 00 02 18 00
				39 00 00 00 00 00 02 19 BB
				39 00 00 00 00 00 02 1A 00
				39 00 00 00 00 00 02 1B C8
				39 00 00 00 00 00 02 1C 00
				39 00 00 00 00 00 02 1D D7
				39 00 00 00 00 00 02 1E 00
				39 00 00 00 00 00 02 1F E8
				39 00 00 00 00 00 02 20 00
				39 00 00 00 00 00 02 21 F8
				39 00 00 00 00 00 02 22 01
				39 00 00 00 00 00 02 23 07
				39 00 00 00 00 00 02 24 01
				39 00 00 00 00 00 02 25 16
				39 00 00 00 00 00 02 26 01
				39 00 00 00 00 00 02 27 23
				39 00 00 00 00 00 02 28 01
				39 00 00 00 00 00 02 29 30
				39 00 00 00 00 00 02 2A 01
				39 00 00 00 00 00 02 2B 3E
				39 00 00 00 00 00 02 2C 01
				39 00 00 00 00 00 02 2D 4C
				39 00 00 00 00 00 02 2E 01
				39 00 00 00 00 00 02 2F 5A
				39 00 00 00 00 00 02 30 01
				39 00 00 00 00 00 02 31 68
				39 00 00 00 00 00 02 32 01
				39 00 00 00 00 00 02 33 77
				39 00 00 00 00 00 02 34 01
				39 00 00 00 00 00 02 35 85
				39 00 00 00 00 00 02 36 01
				39 00 00 00 00 00 02 37 A0
				39 00 00 00 00 00 02 38 01
				39 00 00 00 00 00 02 39 BB
				39 00 00 00 00 00 02 3A 01
				39 00 00 00 00 00 02 3B D6
				39 00 00 00 00 00 02 3C 01
				39 00 00 00 00 00 02 3D F1
				39 00 00 00 00 00 02 3E 02
				39 00 00 00 00 00 02 3F 0C
				39 00 00 00 00 00 02 40 02
				39 00 00 00 00 00 02 41 28
				39 00 00 00 00 00 02 42 02
				39 00 00 00 00 00 02 43 45
				39 00 00 00 00 00 02 44 02
				39 00 00 00 00 00 02 45 5E
				39 00 00 00 00 00 02 46 02
				39 00 00 00 00 00 02 47 78
				39 00 00 00 00 00 02 48 02
				39 00 00 00 00 00 02 49 95
				39 00 00 00 00 00 02 4A 02
				39 00 00 00 00 00 02 4B B3
				39 00 00 00 00 00 02 4C 02
				39 00 00 00 00 00 02 4D CC
				39 00 00 00 00 00 02 4E 02
				39 00 00 00 00 00 02 4F E6
				39 00 00 00 00 00 02 50 03
				39 00 00 00 00 00 02 51 00
				39 00 00 00 00 00 02 52 03
				39 00 00 00 00 00 02 53 1E
				39 00 00 00 00 00 02 54 03
				39 00 00 00 00 00 02 55 39
				39 00 00 00 00 00 02 56 03
				39 00 00 00 00 00 02 57 53
				39 00 00 00 00 00 02 58 03
				39 00 00 00 00 00 02 59 70
				39 00 00 00 00 00 02 5A 03
				39 01 00 00 00 00 02 5B 8A
				39 00 00 00 00 00 04 FF 98 81 07
				39 00 00 00 00 00 04 FF 98 81 07
				39 00 00 00 00 00 02 00 00
				39 00 00 00 00 00 02 01 00
				39 00 00 00 00 00 02 02 00
				39 00 00 00 00 00 02 03 0E
				39 00 00 00 00 00 02 04 00
				39 00 00 00 00 00 02 05 24
				39 00 00 00 00 00 02 06 00
				39 00 00 00 00 00 02 07 34
				39 00 00 00 00 00 02 08 00
				39 00 00 00 00 00 02 09 41
				39 00 00 00 00 00 02 0A 00
				39 00 00 00 00 00 02 0B 4C
				39 00 00 00 00 00 02 0C 00
				39 00 00 00 00 00 02 0D 56
				39 00 00 00 00 00 02 0E 00
				39 00 00 00 00 00 02 0F 64
				39 00 00 00 00 00 02 10 00
				39 00 00 00 00 00 02 11 73
				39 00 00 00 00 00 02 12 00
				39 00 00 00 00 00 02 13 81
				39 00 00 00 00 00 02 14 00
				39 00 00 00 00 00 02 15 8D
				39 00 00 00 00 00 02 16 00
				39 00 00 00 00 00 02 17 9B
				39 00 00 00 00 00 02 18 00
				39 00 00 00 00 00 02 19 AA
				39 00 00 00 00 00 02 1A 00
				39 00 00 00 00 00 02 1B B8
				39 00 00 00 00 00 02 1C 00
				39 00 00 00 00 00 02 1D C4
				39 00 00 00 00 00 02 1E 00
				39 00 00 00 00 00 02 1F D1
				39 00 00 00 00 00 02 20 00
				39 00 00 00 00 00 02 21 E0
				39 00 00 00 00 00 02 22 00
				39 00 00 00 00 00 02 23 EF
				39 00 00 00 00 00 02 24 00
				39 00 00 00 00 00 02 25 FD
				39 00 00 00 00 00 02 26 01
				39 00 00 00 00 00 02 27 0B
				39 00 00 00 00 00 02 28 01
				39 00 00 00 00 00 02 29 18
				39 00 00 00 00 00 02 2A 01
				39 00 00 00 00 00 02 2B 24
				39 00 00 00 00 00 02 2C 01
				39 00 00 00 00 00 02 2D 31
				39 00 00 00 00 00 02 2E 01
				39 00 00 00 00 00 02 2F 3D
				39 00 00 00 00 00 02 30 01
				39 00 00 00 00 00 02 31 4A
				39 00 00 00 00 00 02 32 01
				39 00 00 00 00 00 02 33 58
				39 00 00 00 00 00 02 34 01
				39 00 00 00 00 00 02 35 65
				39 00 00 00 00 00 02 36 01
				39 00 00 00 00 00 02 37 7F
				39 00 00 00 00 00 02 38 01
				39 00 00 00 00 00 02 39 98
				39 00 00 00 00 00 02 3A 01
				39 00 00 00 00 00 02 3B B1
				39 00 00 00 00 00 02 3C 01
				39 00 00 00 00 00 02 3D C9
				39 00 00 00 00 00 02 3E 01
				39 00 00 00 00 00 02 3F E2
				39 00 00 00 00 00 02 40 01
				39 00 00 00 00 00 02 41 FA
				39 00 00 00 00 00 02 42 02
				39 00 00 00 00 00 02 43 14
				39 00 00 00 00 00 02 44 02
				39 00 00 00 00 00 02 45 2D
				39 00 00 00 00 00 02 46 02
				39 00 00 00 00 00 02 47 47
				39 00 00 00 00 00 02 48 02
				39 00 00 00 00 00 02 49 5E
				39 00 00 00 00 00 02 4A 02
				39 00 00 00 00 00 02 4B 76
				39 00 00 00 00 00 02 4C 02
				39 00 00 00 00 00 02 4D 90
				39 00 00 00 00 00 02 4E 02
				39 00 00 00 00 00 02 4F AB
				39 00 00 00 00 00 02 50 02
				39 00 00 00 00 00 02 51 C4
				39 00 00 00 00 00 02 52 02
				39 00 00 00 00 00 02 53 DA
				39 00 00 00 00 00 02 54 02
				39 00 00 00 00 00 02 55 F2
				39 00 00 00 00 00 02 56 03
				39 00 00 00 00 00 02 57 0C
				39 00 00 00 00 00 02 58 03
				39 00 00 00 00 00 02 59 27
				39 00 00 00 00 00 02 5A 03
				39 00 00 00 00 00 02 5B 3E
				39 00 00 00 00 00 04 FF 98 81 00
				39 01 00 00 00 00 04 FF 98 81 00];

		qcom,mdss-dsi-panel-cool-command = [39 00 00 00 00 00 04 FF 98 81 01
				39 00 00 00 00 00 04 FF 98 81 01
				39 00 00 00 00 00 02 A0 00
				39 00 00 00 00 00 02 A1 1C
				39 00 00 00 00 00 02 A2 2B
				39 00 00 00 00 00 02 A3 15
				39 00 00 00 00 00 02 A4 19
				39 00 00 00 00 00 02 A5 2C
				39 00 00 00 00 00 02 A6 20
				39 00 00 00 00 00 02 A7 21
				39 00 00 00 00 00 02 A8 95
				39 00 00 00 00 00 02 A9 1C
				39 00 00 00 00 00 02 AA 27
				39 00 00 00 00 00 02 AB 7F
				39 00 00 00 00 00 02 AC 1C
				39 00 00 00 00 00 02 AD 1D
				39 00 00 00 00 00 02 AE 52
				39 00 00 00 00 00 02 AF 27
				39 00 00 00 00 00 02 B0 2B
				39 00 00 00 00 00 02 B1 56
				39 00 00 00 00 00 02 B2 63
				39 00 00 00 00 00 02 B3 32
				39 00 00 00 00 00 02 C0 00
				39 00 00 00 00 00 02 C1 1C
				39 00 00 00 00 00 02 C2 2B
				39 00 00 00 00 00 02 C3 15
				39 00 00 00 00 00 02 C4 19
				39 00 00 00 00 00 02 C5 2C
				39 00 00 00 00 00 02 C6 20
				39 00 00 00 00 00 02 C7 21
				39 00 00 00 00 00 02 C8 95
				39 00 00 00 00 00 02 C9 1C
				39 00 00 00 00 00 02 CA 27
				39 00 00 00 00 00 02 CB 7F
				39 00 00 00 00 00 02 CC 1C
				39 00 00 00 00 00 02 CD 1D
				39 00 00 00 00 00 02 CE 52
				39 00 00 00 00 00 02 CF 27
				39 00 00 00 00 00 02 D0 2B
				39 00 00 00 00 00 02 D1 56
				39 00 00 00 00 00 02 D2 63
				39 01 00 00 00 00 02 D3 32
				39 00 00 00 00 00 04 FF 98 81 05
				39 00 00 00 00 00 04 FF 98 81 05
				39 00 00 00 00 00 02 85 48
				39 00 00 00 00 00 02 00 00
				39 00 00 00 00 00 02 01 00
				39 00 00 00 00 00 02 02 00
				39 00 00 00 00 00 02 03 18
				39 00 00 00 00 00 02 04 00
				39 00 00 00 00 00 02 05 29
				39 00 00 00 00 00 02 06 00
				39 00 00 00 00 00 02 07 3A
				39 00 00 00 00 00 02 08 00
				39 00 00 00 00 00 02 09 4C
				39 00 00 00 00 00 02 0A 00
				39 00 00 00 00 00 02 0B 5E
				39 00 00 00 00 00 02 0C 00
				39 00 00 00 00 00 02 0D 71
				39 00 00 00 00 00 02 0E 00
				39 00 00 00 00 00 02 0F 82
				39 00 00 00 00 00 02 10 00
				39 00 00 00 00 00 02 11 92
				39 00 00 00 00 00 02 12 00
				39 00 00 00 00 00 02 13 A4
				39 00 00 00 00 00 02 14 00
				39 00 00 00 00 00 02 15 B4
				39 00 00 00 00 00 02 16 00
				39 00 00 00 00 00 02 17 C5
				39 00 00 00 00 00 02 18 00
				39 00 00 00 00 00 02 19 D6
				39 00 00 00 00 00 02 1A 00
				39 00 00 00 00 00 02 1B E9
				39 00 00 00 00 00 02 1C 00
				39 00 00 00 00 00 02 1D FB
				39 00 00 00 00 00 02 1E 01
				39 00 00 00 00 00 02 1F 08
				39 00 00 00 00 00 02 20 01
				39 00 00 00 00 00 02 21 18
				39 00 00 00 00 00 02 22 01
				39 00 00 00 00 00 02 23 28
				39 00 00 00 00 00 02 24 01
				39 00 00 00 00 00 02 25 37
				39 00 00 00 00 00 02 26 01
				39 00 00 00 00 00 02 27 46
				39 00 00 00 00 00 02 28 01
				39 00 00 00 00 00 02 29 57
				39 00 00 00 00 00 02 2A 01
				39 00 00 00 00 00 02 2B 67
				39 00 00 00 00 00 02 2C 01
				39 00 00 00 00 00 02 2D 78
				39 00 00 00 00 00 02 2E 01
				39 00 00 00 00 00 02 2F 88
				39 00 00 00 00 00 02 30 01
				39 00 00 00 00 00 02 31 97
				39 00 00 00 00 00 02 32 01
				39 00 00 00 00 00 02 33 A7
				39 00 00 00 00 00 02 34 01
				39 00 00 00 00 00 02 35 B6
				39 00 00 00 00 00 02 36 01
				39 00 00 00 00 00 02 37 D5
				39 00 00 00 00 00 02 38 01
				39 00 00 00 00 00 02 39 F4
				39 00 00 00 00 00 02 3A 02
				39 00 00 00 00 00 02 3B 13
				39 00 00 00 00 00 02 3C 02
				39 00 00 00 00 00 02 3D 34
				39 00 00 00 00 00 02 3E 02
				39 00 00 00 00 00 02 3F 53
				39 00 00 00 00 00 02 40 02
				39 00 00 00 00 00 02 41 70
				39 00 00 00 00 00 02 42 02
				39 00 00 00 00 00 02 43 8F
				39 00 00 00 00 00 02 44 02
				39 00 00 00 00 00 02 45 B0
				39 00 00 00 00 00 02 46 02
				39 00 00 00 00 00 02 47 CE
				39 00 00 00 00 00 02 48 02
				39 00 00 00 00 00 02 49 EB
				39 00 00 00 00 00 02 4A 03
				39 00 00 00 00 00 02 4B 0B
				39 00 00 00 00 00 02 4C 03
				39 00 00 00 00 00 02 4D 2D
				39 00 00 00 00 00 02 4E 03
				39 00 00 00 00 00 02 4F 49
				39 00 00 00 00 00 02 50 03
				39 00 00 00 00 00 02 51 6A
				39 00 00 00 00 00 02 52 03
				39 00 00 00 00 00 02 53 87
				39 00 00 00 00 00 02 54 03
				39 00 00 00 00 00 02 55 A7
				39 00 00 00 00 00 02 56 03
				39 00 00 00 00 00 02 57 C6
				39 00 00 00 00 00 02 58 03
				39 00 00 00 00 00 02 59 E2
				39 00 00 00 00 00 02 5A 00
				39 01 00 00 00 00 02 5B 00
				39 00 00 00 00 00 04 FF 98 81 06
				39 00 00 00 00 00 04 FF 98 81 06
				39 00 00 00 00 00 02 00 00
				39 00 00 00 00 00 02 01 00
				39 00 00 00 00 00 02 02 00
				39 00 00 00 00 00 02 03 13
				39 00 00 00 00 00 02 04 00
				39 00 00 00 00 00 02 05 25
				39 00 00 00 00 00 02 06 00
				39 00 00 00 00 00 02 07 36
				39 00 00 00 00 00 02 08 00
				39 00 00 00 00 00 02 09 46
				39 00 00 00 00 00 02 0A 00
				39 00 00 00 00 00 02 0B 57
				39 00 00 00 00 00 02 0C 00
				39 00 00 00 00 00 02 0D 67
				39 00 00 00 00 00 02 0E 00
				39 00 00 00 00 00 02 0F 78
				39 00 00 00 00 00 02 10 00
				39 00 00 00 00 00 02 11 87
				39 00 00 00 00 00 02 12 00
				39 00 00 00 00 00 02 13 96
				39 00 00 00 00 00 02 14 00
				39 00 00 00 00 00 02 15 A7
				39 00 00 00 00 00 02 16 00
				39 00 00 00 00 00 02 17 B7
				39 00 00 00 00 00 02 18 00
				39 00 00 00 00 00 02 19 C6
				39 00 00 00 00 00 02 1A 00
				39 00 00 00 00 00 02 1B D5
				39 00 00 00 00 00 02 1C 00
				39 00 00 00 00 00 02 1D E6
				39 00 00 00 00 00 02 1E 00
				39 00 00 00 00 00 02 1F F7
				39 00 00 00 00 00 02 20 01
				39 00 00 00 00 00 02 21 08
				39 00 00 00 00 00 02 22 01
				39 00 00 00 00 00 02 23 17
				39 00 00 00 00 00 02 24 01
				39 00 00 00 00 00 02 25 25
				39 00 00 00 00 00 02 26 01
				39 00 00 00 00 00 02 27 33
				39 00 00 00 00 00 02 28 01
				39 00 00 00 00 00 02 29 42
				39 00 00 00 00 00 02 2A 01
				39 00 00 00 00 00 02 2B 51
				39 00 00 00 00 00 02 2C 01
				39 00 00 00 00 00 02 2D 61
				39 00 00 00 00 00 02 2E 01
				39 00 00 00 00 00 02 2F 70
				39 00 00 00 00 00 02 30 01
				39 00 00 00 00 00 02 31 7F
				39 00 00 00 00 00 02 32 01
				39 00 00 00 00 00 02 33 8E
				39 00 00 00 00 00 02 34 01
				39 00 00 00 00 00 02 35 9C
				39 00 00 00 00 00 02 36 01
				39 00 00 00 00 00 02 37 B9
				39 00 00 00 00 00 02 38 01
				39 00 00 00 00 00 02 39 D6
				39 00 00 00 00 00 02 3A 01
				39 00 00 00 00 00 02 3B F4
				39 00 00 00 00 00 02 3C 02
				39 00 00 00 00 00 02 3D 13
				39 00 00 00 00 00 02 3E 02
				39 00 00 00 00 00 02 3F 32
				39 00 00 00 00 00 02 40 02
				39 00 00 00 00 00 02 41 4F
				39 00 00 00 00 00 02 42 02
				39 00 00 00 00 00 02 43 6A
				39 00 00 00 00 00 02 44 02
				39 00 00 00 00 00 02 45 87
				39 00 00 00 00 00 02 46 02
				39 00 00 00 00 00 02 47 A6
				39 00 00 00 00 00 02 48 02
				39 00 00 00 00 00 02 49 C4
				39 00 00 00 00 00 02 4A 02
				39 00 00 00 00 00 02 4B DE
				39 00 00 00 00 00 02 4C 02
				39 00 00 00 00 00 02 4D FB
				39 00 00 00 00 00 02 4E 03
				39 00 00 00 00 00 02 4F 1A
				39 00 00 00 00 00 02 50 03
				39 00 00 00 00 00 02 51 37
				39 00 00 00 00 00 02 52 03
				39 00 00 00 00 00 02 53 53
				39 00 00 00 00 00 02 54 03
				39 00 00 00 00 00 02 55 72
				39 00 00 00 00 00 02 56 03
				39 00 00 00 00 00 02 57 8E
				39 00 00 00 00 00 02 58 03
				39 00 00 00 00 00 02 59 AB
				39 00 00 00 00 00 02 5A 03
				39 01 00 00 00 00 02 5B C9
				39 00 00 00 00 00 04 FF 98 81 07
				39 00 00 00 00 00 04 FF 98 81 07
				39 00 00 00 00 00 02 00 00
				39 00 00 00 00 00 02 01 00
				39 00 00 00 00 00 02 02 00
				39 00 00 00 00 00 02 03 0D
				39 00 00 00 00 00 02 04 00
				39 00 00 00 00 00 02 05 22
				39 00 00 00 00 00 02 06 00
				39 00 00 00 00 00 02 07 35
				39 00 00 00 00 00 02 08 00
				39 00 00 00 00 00 02 09 46
				39 00 00 00 00 00 02 0A 00
				39 00 00 00 00 00 02 0B 54
				39 00 00 00 00 00 02 0C 00
				39 00 00 00 00 00 02 0D 61
				39 00 00 00 00 00 02 0E 00
				39 00 00 00 00 00 02 0F 71
				39 00 00 00 00 00 02 10 00
				39 00 00 00 00 00 02 11 82
				39 00 00 00 00 00 02 12 00
				39 00 00 00 00 00 02 13 91
				39 00 00 00 00 00 02 14 00
				39 00 00 00 00 00 02 15 A2
				39 00 00 00 00 00 02 16 00
				39 00 00 00 00 00 02 17 B2
				39 00 00 00 00 00 02 18 00
				39 00 00 00 00 00 02 19 C1
				39 00 00 00 00 00 02 1A 00
				39 00 00 00 00 00 02 1B D0
				39 00 00 00 00 00 02 1C 00
				39 00 00 00 00 00 02 1D E2
				39 00 00 00 00 00 02 1E 00
				39 00 00 00 00 00 02 1F F2
				39 00 00 00 00 00 02 20 01
				39 00 00 00 00 00 02 21 03
				39 00 00 00 00 00 02 22 01
				39 00 00 00 00 00 02 23 12
				39 00 00 00 00 00 02 24 01
				39 00 00 00 00 00 02 25 20
				39 00 00 00 00 00 02 26 01
				39 00 00 00 00 00 02 27 2E
				39 00 00 00 00 00 02 28 01
				39 00 00 00 00 00 02 29 3B
				39 00 00 00 00 00 02 2A 01
				39 00 00 00 00 00 02 2B 4B
				39 00 00 00 00 00 02 2C 01
				39 00 00 00 00 00 02 2D 5A
				39 00 00 00 00 00 02 2E 01
				39 00 00 00 00 00 02 2F 69
				39 00 00 00 00 00 02 30 01
				39 00 00 00 00 00 02 31 78
				39 00 00 00 00 00 02 32 01
				39 00 00 00 00 00 02 33 87
				39 00 00 00 00 00 02 34 01
				39 00 00 00 00 00 02 35 95
				39 00 00 00 00 00 02 36 01
				39 00 00 00 00 00 02 37 B1
				39 00 00 00 00 00 02 38 01
				39 00 00 00 00 00 02 39 CE
				39 00 00 00 00 00 02 3A 01
				39 00 00 00 00 00 02 3B EC
				39 00 00 00 00 00 02 3C 02
				39 00 00 00 00 00 02 3D 0A
				39 00 00 00 00 00 02 3E 02
				39 00 00 00 00 00 02 3F 29
				39 00 00 00 00 00 02 40 02
				39 00 00 00 00 00 02 41 47
				39 00 00 00 00 00 02 42 02
				39 00 00 00 00 00 02 43 61
				39 00 00 00 00 00 02 44 02
				39 00 00 00 00 00 02 45 7D
				39 00 00 00 00 00 02 46 02
				39 00 00 00 00 00 02 47 9B
				39 00 00 00 00 00 02 48 02
				39 00 00 00 00 00 02 49 BA
				39 00 00 00 00 00 02 4A 02
				39 00 00 00 00 00 02 4B D4
				39 00 00 00 00 00 02 4C 02
				39 00 00 00 00 00 02 4D EF
				39 00 00 00 00 00 02 4E 03
				39 00 00 00 00 00 02 4F 0C
				39 00 00 00 00 00 02 50 03
				39 00 00 00 00 00 02 51 2C
				39 00 00 00 00 00 02 52 03
				39 00 00 00 00 00 02 53 46
				39 00 00 00 00 00 02 54 03
				39 00 00 00 00 00 02 55 64
				39 00 00 00 00 00 02 56 03
				39 00 00 00 00 00 02 57 80
				39 00 00 00 00 00 02 58 03
				39 00 00 00 00 00 02 59 9E
				39 00 00 00 00 00 02 5A 03
				39 00 00 00 00 00 02 5B BA
				39 00 00 00 00 00 04 FF 98 81 00
				39 01 00 00 00 00 04 FF 98 81 00];
		qcom,mdss-dsi-panel-nature-command = [39 01 00 00 00 00 04 FF 98 81 04
				39 00 00 00 00 00 04 FF 98 81 04
				39 00 00 00 00 00 02 E5 02
				39 00 00 00 00 00 04 FF 98 81 00
				39 01 00 00 00 00 04 FF 98 81 00
				39 01 00 00 00 00 02 11 00
				39 01 00 00 00 00 04 FF 98 81 03
				39 01 00 00 00 00 04 FF 98 81 03
				39 01 00 00 00 00 02 2C 0C
				39 01 00 00 00 00 04 FF 98 81 00
				39 01 00 00 00 00 04 FF 98 81 00];

		qcom,mdss-dsi-panel-gamma-command-state = "dsi_hs_mode";

		qcom,mdss-dsi-init-last;
		qcom,mdss-dsi-panel-ce-std-command = [39 01 00 00 00 00 04 FF 98 81 02
				39 01 00 00 00 00 04 FF 98 81 02
				39 01 00 00 00 00 02 10 06
				39 01 00 00 00 00 04 FF 98 81 00
				39 01 00 00 00 00 04 FF 98 81 00
				39 01 00 00 00 00 02 55 00];
		qcom,mdss-dsi-panel-ce-vivid-command = [39 00 00 00 00 00 04 FF 98 81 02
				39 00 00 00 00 00 04 FF 98 81 02
				39 00 00 00 00 00 02 10 16
				39 00 00 00 00 00 02 68 02
				39 00 00 00 00 00 02 69 03
				39 00 00 00 00 00 02 6A 03
				39 00 00 00 00 00 02 6B 03
				39 00 00 00 00 00 02 6C 00
				39 00 00 00 00 00 02 6D 04
				39 00 00 00 00 00 02 6E 04
				39 00 00 00 00 00 02 6F 05
				39 00 00 00 00 00 02 70 05
				39 00 00 00 00 00 02 71 05
				39 00 00 00 00 00 02 72 03
				39 00 00 00 00 00 02 73 01
				39 00 00 00 00 00 02 74 01
				39 00 00 00 00 00 02 75 02
				39 00 00 00 00 00 02 76 04
				39 00 00 00 00 00 02 77 02
				39 00 00 00 00 00 02 78 02
				39 00 00 00 00 00 02 79 02
				39 00 00 00 00 00 02 7A 02
				39 00 00 00 00 00 02 7B 02
				39 00 00 00 00 00 02 7C 02
				39 00 00 00 00 00 02 7D 02
				39 00 00 00 00 00 02 7E 02
				39 00 00 00 00 00 02 7F 02
				39 00 00 00 00 00 04 FF 98 81 00
				39 00 00 00 00 00 04 FF 98 81 00
				39 01 00 00 00 00 02 55 01];

		qcom,mdss-dsi-panel-ce-command-state = "dsi_hs_mode";

		qcom,mdss-dsi-h-sync-pulse = <1>;
		qcom,mdss-dsi-traffic-mode = "burst_mode";
		qcom,mdss-dsi-bllp-eof-power-mode;
		qcom,mdss-dsi-bllp-power-mode;
		qcom,mdss-dsi-lane-0-state;
		qcom,mdss-dsi-lane-1-state;
		qcom,mdss-dsi-lane-2-state;
		qcom,mdss-dsi-lane-3-state;

		qcom,mdss-dsi-panel-timings = [8B 1E 14 00 44 48 18 30 19 03 04 00];
		qcom,mdss-dsi-t-clk-post = <0x04>;
		qcom,mdss-dsi-t-clk-pre = <0x1C>;
		qcom,mdss-dsi-bl-min-level = <1>;
		qcom,mdss-dsi-bl-max-level = <4095>;
		qcom,mdss-dsi-dma-trigger = "trigger_sw";
		qcom,mdss-dsi-mdp-trigger = "none";
		qcom,mdss-dsi-bl-pmic-control-type = "bl_ctrl_wled";
		qcom,mdss-dsi-lp11-init;
		qcom,mdss-dsi-init-delay-us = <20000>;
		qcom,mdss-dsi-reset-sequence = <1 5>, <0 10>, <1 80>;

		qcom,esd-check-enabled;

		qcom,mdss-dsi-panel-status-command = [06 01 00 01 05 00 02 0A 08
				06 01 00 01 05 00 02 0D 08];
		qcom,mdss-dsi-panel-status-command-state = "dsi_hs_mode";
		qcom,mdss-dsi-panel-status-check-mode = "reg_read";
		qcom,mdss-dsi-panel-status-valid-params = <1 1>;
		qcom,mdss-dsi-panel-status-value = <0x9c 0x00>;
		qcom,mdss-dsi-panel-status-read-length = <1 1>;
	};
};
