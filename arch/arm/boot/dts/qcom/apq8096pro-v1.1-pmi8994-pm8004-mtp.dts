/* Copyright (c) 2016, The Linux Foundation. All rights reserved.
 *
 * This program is free software; you can redistribute it and/or modify
 * it under the terms of the GNU General Public License version 2 and
 * only version 2 as published by the Free Software Foundation.
 *
 * This program is distributed in the hope that it will be useful,
 * but WITHOUT ANY WARRANTY; without even the implied warranty of
 * MERCHANTABILITY or FITNESS FOR A PARTICULAR PURPOSE.  See the
 * GNU General Public License for more details.
 */

/dts-v1/;

#include "apq8096pro-v1.1.dtsi"
#include "msm8996-pm8994-pmi8994-pm8004.dtsi"
#include "msm8996-mtp.dtsi"

/ {
	model = "Qualcomm Technologies, Inc. APQ 8096pro v1.1 \
					+ PMI8994 + PM8004 MTP";
	compatible = "qcom,apq8096-mtp", "qcom,apq8096", "qcom,mtp";
	qcom,board-id = <8 0>;
};
