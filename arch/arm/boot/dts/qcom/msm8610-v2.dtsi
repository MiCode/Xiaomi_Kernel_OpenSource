/* Copyright (c) 2013-2014, The Linux Foundation. All rights reserved.
 *
 * This program is free software; you can redistribute it and/or modify
 * it under the terms of the GNU General Public License version 2 and
 * only version 2 as published by the Free Software Foundation.
 *
 * This program is distributed in the hope that it will be useful,
 * but WITHOUT ANY WARRANTY; without even the implied warranty of
 * MERCHANTABILITY or FITNESS FOR A PARTICULAR PURPOSE.  See the
 * GNU General Public License for more details.
 */

/*
 * As a general rule, only version-specific property overrides should be placed
 * inside this file. However, device definitions should be placed inside the
 * msm8610.dtsi file.
 */

#include "msm8610.dtsi"
#include "msm8610-v2-pm.dtsi"

/ {
	qcom,msm-id = <147 0x10001>, <165 0x10001>, <161 0x10001>, <162 0x10001>,
				  <163 0x10001>, <164 0x10001>, <166 0x10001>,
                                  <225 0x10001>, <226 0x10001>;
};

&soc {
	qcom,clock-a7@f9011050 {
		compatible = "qcom,clock-a7-8226";
		reg = <0xf9011050 0x8>,
		      <0xfc4b80b8 0x8>;
		reg-names = "rcg-base", "efuse";
		clock-names = "clk-4", "clk-5";
		qcom,speed1-bin-v2 =
			<         0 0>,
			< 384000000 1>,
			< 787200000 2>,
			<1094400000 3>;
	};
};

