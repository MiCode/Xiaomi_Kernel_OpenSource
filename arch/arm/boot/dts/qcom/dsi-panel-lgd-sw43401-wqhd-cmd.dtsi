/* Copyright (c) 2015, The Linux Foundation. All rights reserved.
 * Copyright (C) 2018 XiaoMi, Inc.
 *
 * This program is free software; you can redistribute it and/or modify
 * it under the terms of the GNU General Public License version 2 and
 * only version 2 as published by the Free Software Foundation.
 *
 * This program is distributed in the hope that it will be useful,
 * but WITHOUT ANY WARRANTY; without even the implied warranty of
 * MERCHANTABILITY or FITNESS FOR A PARTICULAR PURPOSE.  See the
 * GNU General Public License for more details.
 */

/*---------------------------------------------------------------------------
 * This file is autogenerated file using gcdb parser. Please do not edit it.
 * Update input XML file to add a new entry or update variable in this file
 * VERSION = "1.0"
 *---------------------------------------------------------------------------*/
&soc {
	dsi_lgd_sw43401_wqhd_cmd: qcom,mdss_dsi_lgd_sw43401_wqhd_cmd {
		qcom,mdss-dsi-panel-name = "lgd sw43401 cmd wqhd oled panel";
		qcom,mdss-dsi-panel-sleepwrmod = <0>;
		qcom,mdss-dsi-panel-id = <4>;
		qcom,mdss-dsi-panel-model = "LGD SW43401 WQHD DSC CMD";
		qcom,mdss-dsi-panel-type = "dsi_cmd_mode";
		qcom,mdss-dsi-panel-framerate = <60>;
		qcom,mdss-dsi-virtual-channel-id = <0>;
		qcom,mdss-dsi-stream = <0>;
		qcom,mdss-dsi-panel-width = <1440>;
		qcom,mdss-dsi-panel-height = <2560>;
		qcom,mdss-dsi-h-front-porch = <144>;
		qcom,mdss-dsi-h-back-porch = <144>;
		qcom,mdss-dsi-h-pulse-width = <64>;
		qcom,mdss-dsi-h-sync-skew = <0>;
		qcom,mdss-dsi-v-back-porch = <48>;
		qcom,mdss-dsi-v-front-porch = <40>;
		qcom,mdss-dsi-v-pulse-width = <8>;
		qcom,mdss-dsi-h-left-border = <0>;
		qcom,mdss-dsi-h-right-border = <0>;
		qcom,mdss-dsi-v-top-border = <0>;
		qcom,mdss-dsi-v-bottom-border = <0>;
		qcom,mdss-dsi-bpp = <24>;
		qcom,mdss-dsi-color-order = <0>;
		qcom,mdss-dsi-underflow-color = <0xff>;
		qcom,mdss-dsi-border-color = <0>;
		qcom,mdss-dsi-on-command = [
				15 01 00 00 00 00 02 B0 5A
				39 01 00 00 00 00 06 f3 13 01 07 00 31
				05 01 00 00 78 00 02 11 00
				39 01 00 00 00 00 03 51 00 00  /* b3 */
				15 01 00 00 00 00 02 53 20
				15 01 00 00 00 00 02 55 00
				05 01 00 00 00 00 02 35 00
				15 01 00 00 00 00 02 B0 5A
				15 01 00 00 00 00 02 B2 5D
				39 01 00 00 00 00 03 B3 00 00
				05 01 00 00 05 00 02 29 00
				];
		qcom,mdss-dsi-off-command = [
				05 01 00 00 02 00 02 28 00
				05 01 00 00 80 00 02 10 00];
		qcom,mdss-dsi-on-command-state = "dsi_lp_mode";
		qcom,mdss-dsi-off-command-state = "dsi_hs_mode";
		qcom,mdss-dsi-h-sync-pulse = <0>;
		qcom,mdss-dsi-traffic-mode = "non_burst_sync_event";
		qcom,mdss-dsi-bllp-eof-power-mode;
		qcom,mdss-dsi-bllp-power-mode;
		qcom,mdss-dsi-lp11-init;
		qcom,mdss-dsi-lane-0-state;
		qcom,mdss-dsi-lane-1-state;
		qcom,mdss-dsi-lane-2-state;
		qcom,mdss-dsi-lane-3-state;
		qcom,mdss-dsi-panel-timings = [00 18 05 05 09 0f 05 06 04 03 04 00];
		qcom,mdss-dsi-t-clk-post = <0x05>;
		qcom,mdss-dsi-t-clk-pre = <0x1b>;
		qcom,mdss-dsi-bl-min-level = <1>;
		qcom,mdss-dsi-bl-max-level = <255>;
		qcom,mdss-dsi-dma-trigger = "trigger_sw";
		qcom,mdss-dsi-mdp-trigger = "none";
		qcom,mdss-dsi-bl-pmic-control-type = "bl_ctrl_dcs";
		qcom,mdss-dsi-reset-sequence = <1 10>, <0 1>, <1 25>;
		qcom,mdss-pan-physical-width-dimension = <68>;
		qcom,mdss-pan-physical-height-dimension = <121>;
		qcom,mdss-dsi-hor-line-idle =  <0 1440 512>;
		qcom,mdss-dsi-tx-eot-append;
		qcom,esd-check-enabled;
		qcom,mdss-dsi-panel-status-check-mode = "reg_multi_read";
		qcom,mdss-dsi-panel-status-command = [
				06 01 00 00 00 00 02 0A 9c];
		qcom,mdss-dsi-panel-status-command-state = "dsi_lp_mode";
		qcom,mdss-dsi-panel-orientation = "180";
		qcom,panel-supply-entries = <&dsi_panel_pwr_supply_amoled>;
		qcom,dispparam-enabled;
		qcom,mdss-dsi-aod-mode;
		qcom,mdss-dsi-aodon-command = [
				05 01 00 00 00 00 02 28 00
				39 01 00 00 00 00 03 51 00 00
				15 01 00 00 00 00 02 53 20
				15 01 00 00 01 00 02 B0 5A
				15 01 00 00 01 00 02 B1 8E
				39 01 00 00 00 00 08 E1 00 63 03 83 0F 00 00
				39 01 00 00 00 00 0a E2 06 D2 F4 80 80 80 5C 5C 5C
				39 01 00 00 00 00 04 E5 91 E0 91
				39 01 00 00 3c 00 08 E9 26 02 06 82 02 06 82
				15 01 00 00 00 00 02 B8 26
				05 01 00 00 05 00 02 29 00
		];
		qcom,mdss-dsi-aodon-command-state = "dsi_lp_mode";
		qcom,mdss-dsi-aodoff-command = [
				05 01 00 00 00 00 02 28 00
				05 01 00 00 64 00 02 10 00
				15 01 00 00 00 00 02 B0 5A
				39 01 00 00 00 00 06 f3 13 01 07 00 31
				05 01 00 00 78 00 02 11 00
				39 01 00 00 00 00 03 51 00 00
				15 01 00 00 00 00 02 53 20
				15 01 00 00 00 00 02 55 0c
				05 01 00 00 78 00 02 35 00
				15 01 00 00 01 00 02 B0 5A
				15 01 00 00 01 00 02 B2 5D
				39 01 00 00 00 00 03 B3 00 00
				05 01 00 00 05 00 02 29 00
			];
		qcom,mdss-dsi-aodoff-command-state = "dsi_lp_mode";
		qcom,mdss-dsi-vr-on-command = [
				15 01 00 00 00 00 02 B0 5A
				39 01 00 00 00 00 04 E8 0E 11 06
				39 01 00 00 00 00 08 E9 26 27 F0 30 27 F0 30
				39 01 00 00 00 00 03 51 FF C0];
		qcom,mdss-dsi-vr-on-command-state = "dsi_lp_mode";
		qcom,mdss-dsi-vr-off-command = [
				05 01 00 00 00 00 02 28 00
				05 01 00 00 64 00 02 10 00
				15 01 00 00 00 00 02 B0 5A
				39 01 00 00 00 00 06 f3 13 01 07 00 31
				05 01 00 00 78 00 02 11 00
				39 01 00 00 00 00 03 51 64 00
				15 01 00 00 00 00 02 53 20
				15 01 00 00 00 00 02 55 0c
				05 01 00 00 78 00 02 35 00
				15 01 00 00 01 00 02 B0 5A
				15 01 00 00 01 00 02 B2 5D
				39 01 00 00 00 00 03 B3 00 00
				05 01 00 00 05 00 02 29 00];
		qcom,mdss-dsi-vr-off-command-state = "dsi_lp_mode";
		qcom,mdss-dsi-te-pin-select = <1>;
		qcom,mdss-dsi-te-dcs-command = <1>;
		qcom,mdss-dsi-te-check-enable;
		qcom,mdss-dsi-te-using-te-pin;
		qcom,mdss-dsi-wr-mem-start = <0x2c>;
		qcom,mdss-dsi-wr-mem-continue = <0x3c>;
		qcom,compression-mode = "dsc";
		qcom,config-select = <&dsi_lgd_dsc_cmd_config0>;
		dsi_lgd_dsc_cmd_config0: config0 {
			qcom,lm-split = <720 720>;
			qcom,mdss-dsc-encoders = <2>;
			qcom,mdss-dsc-slice-height = <1280>;
			qcom,mdss-dsc-slice-width = <720>;
			qcom,mdss-dsc-slice-per-pkt = <2>;
			qcom,mdss-dsc-bit-per-component = <8>;
			qcom,mdss-dsc-bit-per-pixel = <8>;
			qcom,mdss-dsc-block-prediction-enable;
		};
	};
};
