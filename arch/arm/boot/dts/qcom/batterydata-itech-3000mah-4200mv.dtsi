/* Copyright (c) 2015, The Linux Foundation. All rights reserved.
 *
 * This program is free software; you can redistribute it and/or modify
 * it under the terms of the GNU General Public License version 2 and
 * only version 2 as published by the Free Software Foundation.
 *
 * This program is distributed in the hope that it will be useful,
 * but WITHOUT ANY WARRANTY; without even the implied warranty of
 * MERCHANTABILITY or FITNESS FOR A PARTICULAR PURPOSE.  See the
 * GNU General Public License for more details.
 */

qcom,itech-3000mah-4200mv {
	/* #Itech_B00761LF_3000mAh_averaged_MasterSlave_Feb27th2015*/
	qcom,max-voltage-uv = <4200000>;
	qcom,v-cutoff-uv = <3400000>;
	qcom,chg-term-ua = <100000>;
	qcom,batt-id-kohm = <150>;
	qcom,battery-beta = <3500>;
	qcom,fastchg-current-ma = <3000>;
	qcom,fg-cc-cv-threshold-mv = <4190>;
	qcom,battery-type = "itech_3000mah_4200mv";
	qcom,checksum = <0x5194>;
	qcom,fg-profile-data = [
		 CD 83 23 77
		 F1 7A 88 74
		 78 83 DB 7C
		 10 90 29 96
		 29 82 9B 98
		 DF B5 FF C0
		 58 18 F5 83
		 5F 7C C3 7B
		 1A 75 57 83
		 B3 61 0A 80
		 0B 8C 85 82
		 98 93 8A B5
		 6C C1 5E 11
		 D5 0B B3 58
		 FB 6A 71 FD
		 27 46 A8 37
		 AF 41 00 00
		 5F 46 E4 2B
		 5E 34 00 00
		 00 00 00 00
		 00 00 00 00
		 AF 71 DA 70
		 0B 76 8E 78
		 A4 76 8B 69
		 9F 6C 14 78
		 77 75 60 63
		 E2 75 4F C3
		 0F 66 58 13
		 54 A0 71 0C
		 28 00 FF 36
		 F0 11 30 03
		 00 00 00 00
	];
};
