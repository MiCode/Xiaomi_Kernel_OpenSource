/* Copyright (c) 2014, The Linux Foundation. All rights reserved.
 *
 * This program is free software; you can redistribute it and/or modify
 * it under the terms of the GNU General Public License version 2 and
 * only version 2 as published by the Free Software Foundation.
 *
 * This program is distributed in the hope that it will be useful,
 * but WITHOUT ANY WARRANTY; without even the implied warranty of
 * MERCHANTABILITY or FITNESS FOR A PARTICULAR PURPOSE.  See the
 * GNU General Public License for more details.
 */

/*---------------------------------------------------------------------------
 * This file is autogenerated file using gcdb parser. Please do not edit it.
 * Update input XML file to add a new entry or update variable in this file
 * VERSION = "1.0"
 *---------------------------------------------------------------------------*/
&mdss_mdp {
	dsi_tianma_720p_video: qcom,mdss_dsi_tianma_720p_video {
		qcom,mdss-dsi-panel-name = "tianma(otm1283a) 720p video mode dsi panel";
		qcom,mdss-dsi-panel-controller = <&mdss_dsi0>;
		qcom,mdss-dsi-panel-type = "dsi_video_mode";
		qcom,mdss-dsi-panel-destination = "display_1";
		qcom,mdss-dsi-panel-framerate = <60>;
		qcom,mdss-dsi-virtual-channel-id = <0>;
		qcom,mdss-dsi-stream = <0>;
		qcom,mdss-dsi-panel-width = <720>;
		qcom,mdss-dsi-panel-height = <1280>;
		qcom,mdss-dsi-h-front-porch = <52>;
		qcom,mdss-dsi-h-back-porch = <100>;
		qcom,mdss-dsi-h-pulse-width = <24>;
		qcom,mdss-dsi-h-sync-skew = <0>;
		qcom,mdss-dsi-v-back-porch = <20>;
		qcom,mdss-dsi-v-front-porch = <8>;
		qcom,mdss-dsi-v-pulse-width = <4>;
		qcom,mdss-dsi-h-left-border = <0>;
		qcom,mdss-dsi-h-right-border = <0>;
		qcom,mdss-dsi-v-top-border = <0>;
		qcom,mdss-dsi-v-bottom-border = <0>;
		qcom,mdss-dsi-bpp = <24>;
		qcom,mdss-dsi-color-order = "rgb_swap_rgb";
		qcom,mdss-dsi-underflow-color = <0xff>;
		qcom,mdss-dsi-border-color = <0>;
		qcom,mdss-dsi-on-command = [29 01 00 00 00 00 02 00 00
			29 01 00 00 00 00 04 ff 12 83 01
			29 01 00 00 00 00 02 00 80
			29 01 00 00 00 00 03 ff 12 83
			29 01 00 00 00 00 02 00 80
			29 01 00 00 00 00 0a c0 00 64 00 0e 12 00 64 0e 12
			29 01 00 00 00 00 02 00 b4
			29 01 00 00 00 00 02 c0 55
			29 01 00 00 00 00 02 00 80
			29 01 00 00 00 00 02 c4 30
			29 01 00 00 00 00 02 00 8a
			29 01 00 00 00 00 02 c4 40
			29 01 00 00 00 00 02 00 81
			29 01 00 00 00 00 02 c1 55
			29 01 00 00 00 00 02 00 a0
			29 01 00 00 00 00 02 c1 00
			29 01 00 00 00 00 02 00 81
			29 01 00 00 00 00 02 c4 82
			29 01 00 00 00 00 02 00 90
			29 01 00 00 00 00 02 c4 49
			29 01 00 00 00 00 02 00 82
			29 01 00 00 00 00 02 c4 02
			29 01 00 00 00 00 02 00 c6
			29 01 00 00 00 00 02 b0 03
			29 01 00 00 00 00 02 00 a0
			29 01 00 00 00 00 0f c4 05 10 06 02 05 15 10 05 10 07 02 05 15 10
			29 01 00 00 00 00 02 00 b0
			29 01 00 00 00 00 03 c4 00 00
			29 01 00 00 00 00 02 00 bb
			29 01 00 00 00 00 02 c5 80
			29 01 00 00 00 00 02 00 91
			29 01 00 00 00 00 03 c5 16 50
			29 01 00 00 00 00 02 00 00
			29 01 00 00 00 00 03 d8 ae ae
			29 01 00 00 00 00 02 00 b0
			29 01 00 00 00 00 03 c5 04 b8
			29 01 00 00 00 00 02 00 90
			29 01 00 00 00 00 05 f5 02 11 02 11
			29 01 00 00 00 00 02 00 90
			29 01 00 00 00 00 02 c5 50
			29 01 00 00 00 00 02 00 94
			29 01 00 00 00 00 02 c5 66
			29 01 00 00 00 00 02 00 b2
			29 01 00 00 00 00 03 f5 00 00
			29 01 00 00 00 00 02 00 b4
			29 01 00 00 00 00 03 f5 00 00
			29 01 00 00 00 00 02 00 b6
			29 01 00 00 00 00 03 f5 00 00
			29 01 00 00 00 00 02 00 b8
			29 01 00 00 00 00 03 f5 00 00
			29 01 00 00 00 00 02 00 94
			29 01 00 00 00 00 02 f5 02
			29 01 00 00 00 00 02 00 ba
			29 01 00 00 00 00 02 f5 03
			29 01 00 00 00 00 02 00 b4
			29 01 00 00 00 00 02 c5 c0
			29 01 00 00 00 00 02 00 80
			29 01 00 00 00 00 02 c4 00
			29 01 00 00 00 00 02 00 80
			29 01 00 00 00 00 0c cb 00 00 00 00 00 00 00 00 00 00 00
			29 01 00 00 00 00 02 00 90
			29 01 00 00 00 00 10 cb 00 00 00 00 00 00 00 00 00 00 00 00 00 00 00
			29 01 00 00 00 00 02 00 a0
			29 01 00 00 00 00 10 cb 00 00 00 00 00 00 00 00 00 00 00 00 00 00 00
			29 01 00 00 00 00 02 00 b0
			29 01 00 00 00 00 10 cb 00 00 00 00 00 00 00 00 00 00 00 00 00 00 00
			29 01 00 00 00 00 02 00 c0
			29 01 00 00 00 00 10 cb 05 05 05 05 05 05 00 00 00 00 00 00 00 00 00
			29 01 00 00 00 00 02 00 d0
			29 01 00 00 00 00 10 cb 00 00 00 00 05 05 05 05 05 05 05 05 05 00 00
			29 01 00 00 00 00 02 00 e0
			29 01 00 00 00 00 0f cb 00 00 00 00 00 00 00 00 00 00 00 05 05 05
			29 01 00 00 00 00 02 00 f0
			29 01 00 00 00 00 0c cb ff cf 00 03 c0 f0 ff 0c 30 00 0c
			29 01 00 00 00 00 02 00 80
			29 01 00 00 00 00 10 cc 0c 0a 10 0e 02 04 00 00 00 00 00 00 00 00 00
			29 01 00 00 00 00 02 00 90
			29 01 00 00 00 00 10 cc 00 00 00 00 06 2d 2e 0b 09 0f 0d 01 03 00 00
			29 01 00 00 00 00 02 00 a0
			29 01 00 00 00 00 0f cc 00 00 00 00 00 00 00 00 00 00 00 05 2d 2e
			29 01 00 00 00 00 02 00 b0
			29 01 00 00 00 00 10 cc 0d 0f 09 0b 03 01 00 00 00 00 00 00 00 00 00
			29 01 00 00 00 00 02 00 c0
			29 01 00 00 00 00 10 cc 00 00 00 00 05 2e 2d 0e 10 0a 0c 04 02 00 00
			29 01 00 00 00 00 02 00 d0
			29 01 00 00 00 00 0f cc 00 00 00 00 00 00 00 00 00 00 00 06 2e 2d
			29 01 00 00 00 00 02 00 80
			29 01 00 00 00 00 0d ce 8b 03 18 8a 03 18 89 03 18 88 03 18
			29 01 00 00 00 00 02 00 90
			29 01 00 00 00 00 0f ce 38 10 18 38 0f 18 00 00 00 00 00 00 00 00
			29 01 00 00 00 00 02 00 a0
			29 01 00 00 00 00 0f ce 38 07 05 00 00 18 00 38 06 05 01 00 18 00
			29 01 00 00 00 00 02 00 b0
			29 01 00 00 00 00 0f ce 38 05 05 02 00 18 00 38 04 05 03 00 18 00
			29 01 00 00 00 00 02 00 c0
			29 01 00 00 00 00 0f ce 38 03 05 04 00 18 00 38 02 05 05 00 18 00
			29 01 00 00 00 00 02 00 d0
			29 01 00 00 00 00 0f ce 38 01 05 06 00 18 00 38 00 05 07 00 18 00
			29 01 00 00 00 00 02 00 80
			29 01 00 00 00 00 0f cf 00 00 00 00 00 00 00 00 00 00 00 00 00 00
			29 01 00 00 00 00 02 00 90
			29 01 00 00 00 00 0f cf 00 00 00 00 00 00 00 00 00 00 00 00 00 00
			29 01 00 00 00 00 02 00 a0
			29 01 00 00 00 00 0f cf 00 00 00 00 00 00 00 00 00 00 00 00 00 00
			29 01 00 00 00 00 02 00 b0
			29 01 00 00 00 00 0f cf 00 00 00 00 00 00 00 00 00 00 00 00 00 00
			29 01 00 00 00 00 02 00 c0
			29 01 00 00 00 00 0c cf 01 01 20 20 00 00 01 81 00 03 08
			29 01 00 00 00 00 02 00 b5
			29 01 00 00 00 00 07 c5 38 20 bf 38 20 bf
			29 01 00 00 00 00 02 00 00
			29 01 00 00 00 00 11 e1 05 14 1a 0d 06 15 0c 0a 03 07 05 07 0e 14 11 02
			29 01 00 00 00 00 02 00 00
			29 01 00 00 00 00 11 e2 05 14 1a 0d 06 15 0c 0a 03 07 05 07 0e 14 11 02
			29 01 00 00 00 00 02 00 92
			29 01 00 00 00 00 03 ff 30 02
			29 01 00 00 c8 00 02 11 00
			29 01 00 00 0a 00 02 29 00
			29 01 00 00 0a 00 02 35 00
			29 01 00 00 00 00 02 51 ff
			29 01 00 00 00 00 02 53 24
			29 01 00 00 0a 00 02 55 00];
		qcom,mdss-dsi-off-command = [05 01 00 00 00 00 02 28 00
					05 01 00 00 78 00 02 10 00];
		qcom,mdss-dsi-on-command-state = "dsi_lp_mode";
		qcom,mdss-dsi-off-command-state = "dsi_hs_mode";
		qcom,mdss-dsi-h-sync-pulse = <1>;
		qcom,mdss-dsi-traffic-mode = "burst_mode";
		qcom,mdss-dsi-lane-map = "lane_map_0123";
		qcom,mdss-dsi-bllp-eof-power-mode;
		qcom,mdss-dsi-bllp-power-mode;
		qcom,mdss-dsi-lane-0-state;
		qcom,mdss-dsi-lane-1-state;
		qcom,mdss-dsi-lane-2-state;
		qcom,mdss-dsi-lane-3-state;
		qcom,mdss-dsi-panel-timings = [92 1A 12 00 3E 42 16 1E 14 03 04 00];
		qcom,mdss-dsi-t-clk-post = <0x04>;
		qcom,mdss-dsi-t-clk-pre = <0x1C>;
		qcom,mdss-dsi-bl-min-level = <1>;
		qcom,mdss-dsi-bl-max-level = <255>;
		qcom,mdss-dsi-dma-trigger = "trigger_sw";
		qcom,mdss-dsi-mdp-trigger = "none";
		qcom,mdss-dsi-bl-pmic-control-type = "bl_ctrl_dcs";
		qcom,mdss-dsi-reset-sequence = <1 1>, <0 50>, <1 50>;
	};
};
