/* Copyright (c) 2017-2018, The Linux Foundation. All rights reserved.
 *
 * This program is free software; you can redistribute it and/or modify
 * it under the terms of the GNU General Public License version 2 and
 * only version 2 as published by the Free Software Foundation.
 *
 * This program is distributed in the hope that it will be useful,
 * but WITHOUT ANY WARRANTY; without even the implied warranty of
 * MERCHANTABILITY or FITNESS FOR A PARTICULAR PURPOSE.  See the
 * GNU General Public License for more details.
 */


/dts-v1/;
/plugin/;

#include <dt-bindings/clock/msm-clocks-8998.h>
#include <dt-bindings/regulator/qcom,rpm-smd-regulator.h>
#include <dt-bindings/interrupt-controller/arm-gic.h>

#include "msm8998-mdss-panels.dtsi"
#include "msm8998-mtp.dtsi"

/ {
	model = "Qualcomm Technologies, Inc. MSM 8998 v2.1 MTP";
	compatible = "qcom,msm8998-mtp", "qcom,msm8998", "qcom,mtp";
	qcom,msm-id = <292 0x20001>;
	qcom,board-id = <8 0>;
};
&snd_934x {
	qcom,msm-mbhc-moist-cfg = <0>, <0>, <3>;
	qcom,msm-mbhc-usbc-audio-supported = <1>;
};
