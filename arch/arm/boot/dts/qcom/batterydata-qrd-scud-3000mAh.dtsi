
qcom,3002485_huaqin_d2scud_3080mah_averaged_masterslave_jul3rd2017 {
	qcom,max-voltage-uv = <4380000>;
	qcom,nom-batt-capacity-mah = <3080>;
	qcom,batt-id-kohm = <24>;
	qcom,battery-beta = <3380>;
	qcom,battery-type = "huaqin_d2_scud_3080mah";
	qcom,chg-rslow-comp-c1 = <4675933>;
	qcom,chg-rslow-comp-c2 = <9539708>;
	qcom,chg-rs-to-rslow = <1472887>;
	qcom,chg-rslow-comp-thr = <0xC1>;
	qcom,checksum = <0xF351>;
	qcom,gui-version = "PMI8950GUI - 2.0.0.16";
	qcom,fg-profile-data = [
			D2 83 3D 7C
			9C 80 55 76
			51 83 10 4A
			C5 81 7F 8D
			13 82 DF 9A
			4F BE E4 CB
			56 0E E3 83
			2E 7C 65 80
			B3 75 56 83
			16 68 93 80
			48 8D 45 82
			22 9A 9D BD
			F0 CA 53 0D
			2C 0C F9 59
			14 70 A5 FD
			AE 41 1E 47
			7A 44 00 00
			3A 46 15 3A
			FD 36 00 00
			00 00 00 00
			00 00 00 00
			BB 73 8D 70
			34 8C 21 7C
			F5 7D C2 73
			FE 6E D4 70
			C6 75 BE 69
			92 66 50 A0
			3B 47 60 2A
			5D A0 71 0C
			28 00 FF 36
			F0 11 30 03
			00 00 00 0C
	];
};
