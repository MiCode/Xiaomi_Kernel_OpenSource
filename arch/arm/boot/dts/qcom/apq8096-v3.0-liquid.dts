/* Copyright (c) 2015, The Linux Foundation. All rights reserved.
 *
 * This program is free software; you can redistribute it and/or modify
 * it under the terms of the GNU General Public License version 2 and
 * only version 2 as published by the Free Software Foundation.
 *
 * This program is distributed in the hope that it will be useful,
 * but WITHOUT ANY WARRANTY; without even the implied warranty of
 * MERCHANTABILITY or FITNESS FOR A PARTICULAR PURPOSE.  See the
 * GNU General Public License for more details.
 */


/dts-v1/;

#include "apq8096-v3.0.dtsi"
#include "msm8996-liquid.dtsi"

/ {
	model = "Qualcomm Technologies, Inc. APQ 8096 v3.0 LiQUID";
	compatible = "qcom,apq8096-liquid", "qcom,apq8096", "qcom,liquid";
	qcom,board-id = <9 0>;
};
