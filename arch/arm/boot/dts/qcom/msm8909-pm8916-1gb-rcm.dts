/*
 * Copyright (c) 2015,2018, The Linux Foundation. All rights reserved.
 *
 * This program is free software; you can redistribute it and/or modify
 * it under the terms of the GNU General Public License version 2 and
 * only version 2 as published by the Free Software Foundation.
 *
 * This program is distributed in the hope that it will be useful,
 * but WITHOUT ANY WARRANTY; without even the implied warranty of
 * MERCHANTABILITY or FITNESS FOR A PARTICULAR PURPOSE.  See the
 * GNU General Public License for more details.
 */

/dts-v1/;

#include "msm8909-cdp.dtsi"
#include "msm8909-pm8916-cdp.dtsi"
#include "msm8909-mtp_qseev4.dtsi"

/ {
	model = "Qualcomm Technologies, Inc. MSM8909-PM8916 1GB RCM";
	compatible = "qcom,msm8909-cdp", "qcom,msm8909", "qcom,cdp";
	qcom,board-id= <21 0x1>;
};
