/* Copyright (c) 2013, The Linux Foundation. All rights reserved.
 * Copyright (C) 2018 XiaoMi, Inc.
 *
 * This program is free software; you can redistribute it and/or modify
 * it under the terms of the GNU General Public License version 2 and
 * only version 2 as published by the Free Software Foundation.
 *
 * This program is distributed in the hope that it will be useful,
 * but WITHOUT ANY WARRANTY; without even the implied warranty of
 * MERCHANTABILITY or FITNESS FOR A PARTICULAR PURPOSE.  See the
 * GNU General Public License for more details.
 */

/*---------------------------------------------------------------------------
 * This file is autogenerated file using gcdb parser. Please do not edit it.
 * Update input XML file to add a new entry or update variable in this file
 * VERSION = "1.0"
 *---------------------------------------------------------------------------*/
&mdss_mdp {
	dsi_ili9881c_ebbgDJN_720p_video: qcom,mdss_dsi_ili9881c_ebbgDJN_c3b_720p_video {
		qcom,mdss-dsi-panel-name = "ili9881c_HD720p_video_EbbgDJN_c3b";
		qcom,mdss-dsi-panel-controller = <&mdss_dsi0>;
		qcom,mdss-dsi-panel-type = "dsi_video_mode";
		qcom,mdss-dsi-panel-destination = "display_1";
		qcom,mdss-dsi-panel-framerate = <60>;
		qcom,mdss-dsi-virtual-channel-id = <0>;
		qcom,mdss-dsi-stream = <0>;
		qcom,mdss-dsi-panel-width = <720>;
		qcom,mdss-dsi-panel-height = <1280>;
		qcom,mdss-pan-physical-width-dimension = <62>;
		qcom,mdss-pan-physical-height-dimension = <110>;
		qcom,mdss-dsi-h-front-porch = <112>;
		qcom,mdss-dsi-h-back-porch = <180>;
		qcom,mdss-dsi-h-pulse-width = <8>;
		qcom,mdss-dsi-h-sync-skew = <0>;
		qcom,mdss-dsi-v-back-porch = <18>;
		qcom,mdss-dsi-v-front-porch = <12>;
		qcom,mdss-dsi-v-pulse-width = <4>;
		qcom,mdss-dsi-h-left-border = <0>;
		qcom,mdss-dsi-h-right-border = <0>;
		qcom,mdss-dsi-v-top-border = <0>;
		qcom,mdss-dsi-v-bottom-border = <0>;
		qcom,mdss-dsi-bpp = <24>;
		qcom,mdss-dsi-underflow-color = <0x00>;
		qcom,mdss-dsi-border-color = <0>;
		qcom,mdss-dsi-on-command = [39 01 00 00 00 00 04 FF 98 81 04
				39 01 00 00 00 00 04 FF 98 81 04
				39 01 00 00 00 00 02 E5 00
				39 01 00 00 0A 00 04 FF 98 81 00
				39 01 00 00 96 00 02 11 00
				39 01 00 00 00 00 02 29 00
				39 01 00 00 0A 00 02 35 00
				39 00 00 00 00 00 04 FF 98 81 03
				39 00 00 00 00 00 02 2C 0C
				39 01 00 00 00 00 04 FF 98 81 00];
		qcom,mdss-dsi-off-command = [39 00 00 00 00 00 04 FF 98 81 00
				05 00 00 00 0A 00 02 28 00
				05 01 00 00 96 00 02 10 00];
		qcom,mdss-dsi-on-command-state = "dsi_lp_mode";
		qcom,mdss-dsi-off-command-state = "dsi_lp_mode";
		qcom,mdss-dsi-panel-warm-command = [39 00 00 00 00 00 04 FF 98 81 01
				39 00 00 00 00 00 04 FF 98 81 01
				39 00 00 00 00 00 02 A0 00
				39 00 00 00 00 00 02 A1 17
				39 00 00 00 00 00 02 A2 27
				39 00 00 00 00 00 02 A3 14
				39 00 00 00 00 00 02 A4 17
				39 00 00 00 00 00 02 A5 29
				39 00 00 00 00 00 02 A6 1F
				39 00 00 00 00 00 02 A7 20
				39 00 00 00 00 00 02 A8 89
				39 00 00 00 00 00 02 A9 1D
				39 00 00 00 00 00 02 AA 29
				39 00 00 00 00 00 02 AB 74
				39 00 00 00 00 00 02 AC 1B
				39 00 00 00 00 00 02 AD 1A
				39 00 00 00 00 00 02 AE 4F
				39 00 00 00 00 00 02 AF 23
				39 00 00 00 00 00 02 B0 27
				39 00 00 00 00 00 02 B1 4F
				39 00 00 00 00 00 02 B2 5D
				39 00 00 00 00 00 02 B3 32
				39 00 00 00 00 00 02 C0 00
				39 00 00 00 00 00 02 C1 17
				39 00 00 00 00 00 02 C2 27
				39 00 00 00 00 00 02 C3 14
				39 00 00 00 00 00 02 C4 17
				39 00 00 00 00 00 02 C5 29
				39 00 00 00 00 00 02 C6 1F
				39 00 00 00 00 00 02 C7 20
				39 00 00 00 00 00 02 C8 89
				39 00 00 00 00 00 02 C9 1D
				39 00 00 00 00 00 02 CA 29
				39 00 00 00 00 00 02 CB 74
				39 00 00 00 00 00 02 CC 1B
				39 00 00 00 00 00 02 CD 1A
				39 00 00 00 00 00 02 CE 4F
				39 00 00 00 00 00 02 CF 23
				39 00 00 00 00 00 02 D0 27
				39 00 00 00 00 00 02 D1 4F
				39 00 00 00 00 00 02 D2 5D
				39 01 00 00 00 00 02 D3 32
				39 00 00 00 00 00 04 FF 98 81 05
				39 00 00 00 00 00 04 FF 98 81 05
				39 00 00 00 00 00 02 85 48
				39 00 00 00 00 00 02 00 00
				39 00 00 00 00 00 02 01 00
				39 00 00 00 00 00 02 02 00
				39 00 00 00 00 00 02 03 13
				39 00 00 00 00 00 02 04 00
				39 00 00 00 00 00 02 05 22
				39 00 00 00 00 00 02 06 00
				39 00 00 00 00 00 02 07 30
				39 00 00 00 00 00 02 08 00
				39 00 00 00 00 00 02 09 42
				39 00 00 00 00 00 02 0A 00
				39 00 00 00 00 00 02 0B 53
				39 00 00 00 00 00 02 0C 00
				39 00 00 00 00 00 02 0D 65
				39 00 00 00 00 00 02 0E 00
				39 00 00 00 00 00 02 0F 76
				39 00 00 00 00 00 02 10 00
				39 00 00 00 00 00 02 11 85
				39 00 00 00 00 00 02 12 00
				39 00 00 00 00 00 02 13 95
				39 00 00 00 00 00 02 14 00
				39 00 00 00 00 00 02 15 A5
				39 00 00 00 00 00 02 16 00
				39 00 00 00 00 00 02 17 B7
				39 00 00 00 00 00 02 18 00
				39 00 00 00 00 00 02 19 C6
				39 00 00 00 00 00 02 1A 00
				39 00 00 00 00 00 02 1B D6
				39 00 00 00 00 00 02 1C 00
				39 00 00 00 00 00 02 1D E6
				39 00 00 00 00 00 02 1E 00
				39 00 00 00 00 00 02 1F F6
				39 00 00 00 00 00 02 20 01
				39 00 00 00 00 00 02 21 05
				39 00 00 00 00 00 02 22 01
				39 00 00 00 00 00 02 23 16
				39 00 00 00 00 00 02 24 01
				39 00 00 00 00 00 02 25 24
				39 00 00 00 00 00 02 26 01
				39 00 00 00 00 00 02 27 32
				39 00 00 00 00 00 02 28 01
				39 00 00 00 00 00 02 29 41
				39 00 00 00 00 00 02 2A 01
				39 00 00 00 00 00 02 2B 51
				39 00 00 00 00 00 02 2C 01
				39 00 00 00 00 00 02 2D 62
				39 00 00 00 00 00 02 2E 01
				39 00 00 00 00 00 02 2F 72
				39 00 00 00 00 00 02 30 01
				39 00 00 00 00 00 02 31 82
				39 01 00 00 00 00 02 32 01
				39 00 00 00 00 00 02 33 94
				39 00 00 00 00 00 02 34 01
				39 00 00 00 00 00 02 35 A4
				39 00 00 00 00 00 02 36 01
				39 00 00 00 00 00 02 37 C3
				39 00 00 00 00 00 02 38 01
				39 00 00 00 00 00 02 39 E2
				39 00 00 00 00 00 02 3A 02
				39 00 00 00 00 00 02 3B 02
				39 00 00 00 00 00 02 3C 02
				39 00 00 00 00 00 02 3D 1D
				39 00 00 00 00 00 02 3E 02
				39 00 00 00 00 00 02 3F 3F
				39 00 00 00 00 00 02 40 02
				39 00 00 00 00 00 02 41 5C
				39 00 00 00 00 00 02 42 02
				39 00 00 00 00 00 02 43 7B
				39 00 00 00 00 00 02 44 02
				39 00 00 00 00 00 02 45 9C
				39 00 00 00 00 00 02 46 02
				39 00 00 00 00 00 02 47 BE
				39 00 00 00 00 00 02 48 02
				39 00 00 00 00 00 02 49 DA
				39 00 00 00 00 00 02 4A 02
				39 00 00 00 00 00 02 4B FA
				39 00 00 00 00 00 02 4C 03
				39 00 00 00 00 00 02 4D 1C
				39 00 00 00 00 00 02 4E 03
				39 00 00 00 00 00 02 4F 3C
				39 00 00 00 00 00 02 50 03
				39 00 00 00 00 00 02 51 5B
				39 00 00 00 00 00 02 52 03
				39 00 00 00 00 00 02 53 7B
				39 00 00 00 00 00 02 54 03
				39 00 00 00 00 00 02 55 A0
				39 00 00 00 00 00 02 56 03
				39 00 00 00 00 00 02 57 BC
				39 00 00 00 00 00 02 58 03
				39 00 00 00 00 00 02 59 DB
				39 00 00 00 00 00 02 5A 00
				39 01 00 00 00 00 02 5B 01
				39 00 00 00 00 00 04 FF 98 81 06
				39 00 00 00 00 00 04 FF 98 81 06
				39 00 00 00 00 00 02 00 00
				39 00 00 00 00 00 02 01 00
				39 00 00 00 00 00 02 02 00
				39 00 00 00 00 00 02 03 0D
				39 00 00 00 00 00 02 04 00
				39 00 00 00 00 00 02 05 1C
				39 00 00 00 00 00 02 06 00
				39 00 00 00 00 00 02 07 29
				39 00 00 00 00 00 02 08 00
				39 00 00 00 00 00 02 09 36
				39 00 00 00 00 00 02 0A 00
				39 00 00 00 00 00 02 0B 45
				39 00 00 00 00 00 02 0C 00
				39 00 00 00 00 00 02 0D 54
				39 00 00 00 00 00 02 0E 00
				39 00 00 00 00 00 02 0F 62
				39 00 00 00 00 00 02 10 00
				39 00 00 00 00 00 02 11 70
				39 00 00 00 00 00 02 12 00
				39 00 00 00 00 00 02 13 7D
				39 00 00 00 00 00 02 14 00
				39 00 00 00 00 00 02 15 8A
				39 00 00 00 00 00 02 16 00
				39 00 00 00 00 00 02 17 98
				39 00 00 00 00 00 02 18 00
				39 00 00 00 00 00 02 19 A7
				39 00 00 00 00 00 02 1A 00
				39 00 00 00 00 00 02 1B B5
				39 00 00 00 00 00 02 1C 00
				39 00 00 00 00 00 02 1D C2
				39 00 00 00 00 00 02 1E 00
				39 00 00 00 00 00 02 1F D0
				39 00 00 00 00 00 02 20 00
				39 00 00 00 00 00 02 21 DF
				39 00 00 00 00 00 02 22 00
				39 00 00 00 00 00 02 23 EE
				39 00 00 00 00 00 02 24 00
				39 00 00 00 00 00 02 25 FD
				39 00 00 00 00 00 02 26 01
				39 00 00 00 00 00 02 27 0B
				39 00 00 00 00 00 02 28 01
				39 00 00 00 00 00 02 29 18
				39 00 00 00 00 00 02 2A 01
				39 00 00 00 00 00 02 2B 24
				39 00 00 00 00 00 02 2C 01
				39 00 00 00 00 00 02 2D 31
				39 00 00 00 00 00 02 2E 01
				39 00 00 00 00 00 02 2F 3C
				39 00 00 00 00 00 02 30 01
				39 00 00 00 00 00 02 31 4A
				39 01 00 00 00 00 02 32 01
				39 00 00 00 00 00 02 33 59
				39 00 00 00 00 00 02 34 01
				39 00 00 00 00 00 02 35 67
				39 00 00 00 00 00 02 36 01
				39 00 00 00 00 00 02 37 83
				39 00 00 00 00 00 02 38 01
				39 00 00 00 00 00 02 39 9E
				39 00 00 00 00 00 02 3A 01
				39 00 00 00 00 00 02 3B B9
				39 00 00 00 00 00 02 3C 01
				39 00 00 00 00 00 02 3D D4
				39 00 00 00 00 00 02 3E 01
				39 00 00 00 00 00 02 3F EE
				39 00 00 00 00 00 02 40 02
				39 00 00 00 00 00 02 41 0A
				39 00 00 00 00 00 02 42 02
				39 00 00 00 00 00 02 43 26
				39 00 00 00 00 00 02 44 02
				39 00 00 00 00 00 02 45 43
				39 00 00 00 00 00 02 46 02
				39 00 00 00 00 00 02 47 5C
				39 00 00 00 00 00 02 48 02
				39 00 00 00 00 00 02 49 77
				39 00 00 00 00 00 02 4A 02
				39 00 00 00 00 00 02 4B 92
				39 00 00 00 00 00 02 4C 02
				39 00 00 00 00 00 02 4D AF
				39 00 00 00 00 00 02 4E 02
				39 00 00 00 00 00 02 4F CA
				39 00 00 00 00 00 02 50 02
				39 00 00 00 00 00 02 51 E4
				39 00 00 00 00 00 02 52 02
				39 00 00 00 00 00 02 53 FF
				39 00 00 00 00 00 02 54 03
				39 00 00 00 00 00 02 55 21
				39 00 00 00 00 00 02 56 03
				39 00 00 00 00 00 02 57 39
				39 00 00 00 00 00 02 58 03
				39 00 00 00 00 00 02 59 55
				39 00 00 00 00 00 02 5A 03
				39 01 00 00 00 00 02 5B 70
				39 00 00 00 00 00 04 FF 98 81 07
				39 00 00 00 00 00 04 FF 98 81 07
				39 00 00 00 00 00 02 00 00
				39 00 00 00 00 00 02 01 00
				39 00 00 00 00 00 02 02 00
				39 00 00 00 00 00 02 03 0A
				39 00 00 00 00 00 02 04 00
				39 00 00 00 00 00 02 05 13
				39 00 00 00 00 00 02 06 00
				39 00 00 00 00 00 02 07 25
				39 00 00 00 00 00 02 08 00
				39 00 00 00 00 00 02 09 30
				39 00 00 00 00 00 02 0A 00
				39 00 00 00 00 00 02 0B 3B
				39 00 00 00 00 00 02 0C 00
				39 00 00 00 00 00 02 0D 43
				39 00 00 00 00 00 02 0E 00
				39 00 00 00 00 00 02 0F 51
				39 00 00 00 00 00 02 10 00
				39 00 00 00 00 00 02 11 5F
				39 00 00 00 00 00 02 12 00
				39 00 00 00 00 00 02 13 6D
				39 00 00 00 00 00 02 14 00
				39 00 00 00 00 00 02 15 7B
				39 00 00 00 00 00 02 16 00
				39 00 00 00 00 00 02 17 87
				39 00 00 00 00 00 02 18 00
				39 00 00 00 00 00 02 19 94
				39 00 00 00 00 00 02 1A 00
				39 00 00 00 00 00 02 1B A2
				39 00 00 00 00 00 02 1C 00
				39 00 00 00 00 00 02 1D B0
				39 00 00 00 00 00 02 1E 00
				39 00 00 00 00 00 02 1F BC
				39 00 00 00 00 00 02 20 00
				39 00 00 00 00 00 02 21 C9
				39 00 00 00 00 00 02 22 00
				39 00 00 00 00 00 02 23 D6
				39 00 00 00 00 00 02 24 00
				39 00 00 00 00 00 02 25 E4
				39 00 00 00 00 00 02 26 00
				39 00 00 00 00 00 02 27 F2
				39 00 00 00 00 00 02 28 00
				39 00 00 00 00 00 02 29 FF
				39 00 00 00 00 00 02 2A 01
				39 00 00 00 00 00 02 2B 0B
				39 00 00 00 00 00 02 2C 01
				39 00 00 00 00 00 02 2D 18
				39 00 00 00 00 00 02 2E 01
				39 00 00 00 00 00 02 2F 23
				39 00 00 00 00 00 02 30 01
				39 00 00 00 00 00 02 31 2F
				39 01 00 00 00 00 02 32 01
				39 00 00 00 00 00 02 33 39
				39 00 00 00 00 00 02 34 01
				39 00 00 00 00 00 02 35 46
				39 00 00 00 00 00 02 36 01
				39 00 00 00 00 00 02 37 60
				39 00 00 00 00 00 02 38 01
				39 00 00 00 00 00 02 39 79
				39 00 00 00 00 00 02 3A 01
				39 00 00 00 00 00 02 3B 93
				39 00 00 00 00 00 02 3C 01
				39 00 00 00 00 00 02 3D AD
				39 00 00 00 00 00 02 3E 01
				39 00 00 00 00 00 02 3F C5
				39 00 00 00 00 00 02 40 01
				39 00 00 00 00 00 02 41 DD
				39 00 00 00 00 00 02 42 01
				39 00 00 00 00 00 02 43 F6
				39 00 00 00 00 00 02 44 02
				39 00 00 00 00 00 02 45 0F
				39 00 00 00 00 00 02 46 02
				39 00 00 00 00 00 02 47 29
				39 00 00 00 00 00 02 48 02
				39 00 00 00 00 00 02 49 43
				39 00 00 00 00 00 02 4A 02
				39 00 00 00 00 00 02 4B 5A
				39 00 00 00 00 00 02 4C 02
				39 00 00 00 00 00 02 4D 73
				39 00 00 00 00 00 02 4E 02
				39 00 00 00 00 00 02 4F 8C
				39 00 00 00 00 00 02 50 02
				39 00 00 00 00 00 02 51 A6
				39 00 00 00 00 00 02 52 02
				39 00 00 00 00 00 02 53 C0
				39 00 00 00 00 00 02 54 02
				39 00 00 00 00 00 02 55 DB
				39 00 00 00 00 00 02 56 02
				39 00 00 00 00 00 02 57 EF
				39 00 00 00 00 00 02 58 03
				39 00 00 00 00 00 02 59 0B
				39 00 00 00 00 00 02 5A 03
				39 00 00 00 00 00 02 5B 25
				39 00 00 00 00 00 04 FF 98 81 00
				39 01 00 00 00 00 04 FF 98 81 00];
		qcom,mdss-dsi-panel-cool-command = [
				39 00 00 00 00 00 04 FF 98 81 01
				39 00 00 00 00 00 04 FF 98 81 01
				39 00 00 00 00 00 02 A0 00
				39 00 00 00 00 00 02 A1 19
				39 00 00 00 00 00 02 A2 29
				39 00 00 00 00 00 02 A3 14
				39 00 00 00 00 00 02 A4 18
				39 00 00 00 00 00 02 A5 2A
				39 00 00 00 00 00 02 A6 20
				39 00 00 00 00 00 02 A7 20
				39 00 00 00 00 00 02 A8 91
				39 00 00 00 00 00 02 A9 1C
				39 00 00 00 00 00 02 AA 28
				39 00 00 00 00 00 02 AB 7E
				39 00 00 00 00 00 02 AC 1C
				39 00 00 00 00 00 02 AD 1C
				39 00 00 00 00 00 02 AE 51
				39 00 00 00 00 00 02 AF 26
				39 00 00 00 00 00 02 B0 2B
				39 00 00 00 00 00 02 B1 57
				39 00 00 00 00 00 02 B2 66
				39 00 00 00 00 00 02 B3 32
				39 00 00 00 00 00 02 C0 00
				39 00 00 00 00 00 02 C1 19
				39 00 00 00 00 00 02 C2 29
				39 00 00 00 00 00 02 C3 14
				39 00 00 00 00 00 02 C4 18
				39 00 00 00 00 00 02 C5 2A
				39 00 00 00 00 00 02 C6 20
				39 00 00 00 00 00 02 C7 20
				39 00 00 00 00 00 02 C8 91
				39 00 00 00 00 00 02 C9 1C
				39 00 00 00 00 00 02 CA 28
				39 00 00 00 00 00 02 CB 7E
				39 00 00 00 00 00 02 CC 1C
				39 00 00 00 00 00 02 CD 1C
				39 00 00 00 00 00 02 CE 51
				39 00 00 00 00 00 02 CF 26
				39 00 00 00 00 00 02 D0 2B
				39 00 00 00 00 00 02 D1 57
				39 00 00 00 00 00 02 D2 66
				39 01 00 00 00 00 02 D3 32
				39 00 00 00 00 00 04 FF 98 81 05
				39 00 00 00 00 00 04 FF 98 81 05
				39 00 00 00 00 00 02 85 48
				39 00 00 00 00 00 02 00 00
				39 00 00 00 00 00 02 01 00
				39 00 00 00 00 00 02 02 00
				39 00 00 00 00 00 02 03 17
				39 00 00 00 00 00 02 04 00
				39 00 00 00 00 00 02 05 27
				39 00 00 00 00 00 02 06 00
				39 00 00 00 00 00 02 07 35
				39 00 00 00 00 00 02 08 00
				39 00 00 00 00 00 02 09 44
				39 00 00 00 00 00 02 0A 00
				39 00 00 00 00 00 02 0B 53
				39 00 00 00 00 00 02 0C 00
				39 00 00 00 00 00 02 0D 65
				39 00 00 00 00 00 02 0E 00
				39 00 00 00 00 00 02 0F 76
				39 00 00 00 00 00 02 10 00
				39 00 00 00 00 00 02 11 81
				39 00 00 00 00 00 02 12 00
				39 00 00 00 00 00 02 13 91
				39 00 00 00 00 00 02 14 00
				39 00 00 00 00 00 02 15 A5
				39 00 00 00 00 00 02 16 00
				39 00 00 00 00 00 02 17 B5
				39 00 00 00 00 00 02 18 00
				39 00 00 00 00 00 02 19 C4
				39 00 00 00 00 00 02 1A 00
				39 00 00 00 00 00 02 1B D6
				39 00 00 00 00 00 02 1C 00
				39 00 00 00 00 00 02 1D E9
				39 00 00 00 00 00 02 1E 00
				39 00 00 00 00 00 02 1F FA
				39 00 00 00 00 00 02 20 01
				39 00 00 00 00 00 02 21 08
				39 00 00 00 00 00 02 22 01
				39 00 00 00 00 00 02 23 17
				39 00 00 00 00 00 02 24 01
				39 00 00 00 00 00 02 25 25
				39 00 00 00 00 00 02 26 01
				39 00 00 00 00 00 02 27 34
				39 00 00 00 00 00 02 28 01
				39 00 00 00 00 00 02 29 42
				39 00 00 00 00 00 02 2A 01
				39 00 00 00 00 00 02 2B 54
				39 00 00 00 00 00 02 2C 01
				39 00 00 00 00 00 02 2D 64
				39 00 00 00 00 00 02 2E 01
				39 00 00 00 00 00 02 2F 74
				39 00 00 00 00 00 02 30 01
				39 00 00 00 00 00 02 31 83
				39 01 00 00 00 00 02 32 01
				39 00 00 00 00 00 02 33 92
				39 00 00 00 00 00 02 34 01
				39 00 00 00 00 00 02 35 A2
				39 00 00 00 00 00 02 36 01
				39 00 00 00 00 00 02 37 C2
				39 00 00 00 00 00 02 38 01
				39 00 00 00 00 00 02 39 E1
				39 00 00 00 00 00 02 3A 02
				39 00 00 00 00 00 02 3B 00
				39 00 00 00 00 00 02 3C 02
				39 00 00 00 00 00 02 3D 1F
				39 00 00 00 00 00 02 3E 02
				39 00 00 00 00 00 02 3F 41
				39 00 00 00 00 00 02 40 02
				39 00 00 00 00 00 02 41 5F
				39 00 00 00 00 00 02 42 02
				39 00 00 00 00 00 02 43 7E
				39 00 00 00 00 00 02 44 02
				39 00 00 00 00 00 02 45 9F
				39 00 00 00 00 00 02 46 02
				39 00 00 00 00 00 02 47 C1
				39 00 00 00 00 00 02 48 02
				39 00 00 00 00 00 02 49 DD
				39 00 00 00 00 00 02 4A 02
				39 00 00 00 00 00 02 4B FB
				39 00 00 00 00 00 02 4C 03
				39 00 00 00 00 00 02 4D 20
				39 00 00 00 00 00 02 4E 03
				39 00 00 00 00 00 02 4F 3B
				39 00 00 00 00 00 02 50 03
				39 00 00 00 00 00 02 51 5B
				39 00 00 00 00 00 02 52 03
				39 00 00 00 00 00 02 53 7C
				39 00 00 00 00 00 02 54 03
				39 00 00 00 00 00 02 55 A0
				39 00 00 00 00 00 02 56 03
				39 00 00 00 00 00 02 57 C3
				39 00 00 00 00 00 02 58 03
				39 00 00 00 00 00 02 59 E3
				39 00 00 00 00 00 02 5A 00
				39 01 00 00 00 00 02 5B 00
				39 00 00 00 00 00 04 FF 98 81 06
				39 00 00 00 00 00 04 FF 98 81 06
				39 00 00 00 00 00 02 00 00
				39 00 00 00 00 00 02 01 00
				39 00 00 00 00 00 02 02 00
				39 00 00 00 00 00 02 03 12
				39 00 00 00 00 00 02 04 00
				39 00 00 00 00 00 02 05 21
				39 00 00 00 00 00 02 06 00
				39 00 00 00 00 00 02 07 2F
				39 00 00 00 00 00 02 08 00
				39 00 00 00 00 00 02 09 3D
				39 00 00 00 00 00 02 0A 00
				39 00 00 00 00 00 02 0B 4B
				39 00 00 00 00 00 02 0C 00
				39 00 00 00 00 00 02 0D 5A
				39 00 00 00 00 00 02 0E 00
				39 00 00 00 00 00 02 0F 69
				39 00 00 00 00 00 02 10 00
				39 00 00 00 00 00 02 11 77
				39 00 00 00 00 00 02 12 00
				39 00 00 00 00 00 02 13 85
				39 00 00 00 00 00 02 14 00
				39 00 00 00 00 00 02 15 94
				39 00 00 00 00 00 02 16 00
				39 00 00 00 00 00 02 17 A4
				39 00 00 00 00 00 02 18 00
				39 00 00 00 00 00 02 19 B3
				39 00 00 00 00 00 02 1A 00
				39 00 00 00 00 00 02 1B C3
				39 00 00 00 00 00 02 1C 00
				39 00 00 00 00 00 02 1D D1
				39 00 00 00 00 00 02 1E 00
				39 00 00 00 00 00 02 1F E1
				39 00 00 00 00 00 02 20 00
				39 00 00 00 00 00 02 21 EF
				39 00 00 00 00 00 02 22 00
				39 00 00 00 00 00 02 23 FF
				39 00 00 00 00 00 02 24 01
				39 00 00 00 00 00 02 25 11
				39 00 00 00 00 00 02 26 01
				39 00 00 00 00 00 02 27 1F
				39 00 00 00 00 00 02 28 01
				39 00 00 00 00 00 02 29 2B
				39 00 00 00 00 00 02 2A 01
				39 00 00 00 00 00 02 2B 39
				39 00 00 00 00 00 02 2C 01
				39 00 00 00 00 00 02 2D 47
				39 00 00 00 00 00 02 2E 01
				39 00 00 00 00 00 02 2F 56
				39 00 00 00 00 00 02 30 01
				39 00 00 00 00 00 02 31 66
				39 01 00 00 00 00 02 32 01
				39 00 00 00 00 00 02 33 75
				39 00 00 00 00 00 02 34 01
				39 00 00 00 00 00 02 35 85
				39 00 00 00 00 00 02 36 01
				39 00 00 00 00 00 02 37 A1
				39 00 00 00 00 00 02 38 01
				39 00 00 00 00 00 02 39 BE
				39 00 00 00 00 00 02 3A 01
				39 00 00 00 00 00 02 3B DB
				39 00 00 00 00 00 02 3C 01
				39 00 00 00 00 00 02 3D F6
				39 00 00 00 00 00 02 3E 02
				39 00 00 00 00 00 02 3F 14
				39 00 00 00 00 00 02 40 02
				39 00 00 00 00 00 02 41 33
				39 00 00 00 00 00 02 42 02
				39 00 00 00 00 00 02 43 4F
				39 00 00 00 00 00 02 44 02
				39 00 00 00 00 00 02 45 6C
				39 00 00 00 00 00 02 46 02
				39 00 00 00 00 00 02 47 8A
				39 00 00 00 00 00 02 48 02
				39 00 00 00 00 00 02 49 A9
				39 00 00 00 00 00 02 4A 02
				39 00 00 00 00 00 02 4B C5
				39 00 00 00 00 00 02 4C 02
				39 00 00 00 00 00 02 4D E3
				39 00 00 00 00 00 02 4E 03
				39 00 00 00 00 00 02 4F 00
				39 00 00 00 00 00 02 50 03
				39 00 00 00 00 00 02 51 21
				39 00 00 00 00 00 02 52 03
				39 00 00 00 00 00 02 53 3F
				39 00 00 00 00 00 02 54 03
				39 00 00 00 00 00 02 55 61
				39 00 00 00 00 00 02 56 03
				39 00 00 00 00 00 02 57 7C
				39 00 00 00 00 00 02 58 03
				39 00 00 00 00 00 02 59 9B
				39 00 00 00 00 00 02 5A 03
				39 01 00 00 00 00 02 5B B6
				39 00 00 00 00 00 04 FF 98 81 07
				39 00 00 00 00 00 04 FF 98 81 07
				39 00 00 00 00 00 02 00 00
				39 00 00 00 00 00 02 01 00
				39 00 00 00 00 00 02 02 00
				39 00 00 00 00 00 02 03 09
				39 00 00 00 00 00 02 04 00
				39 00 00 00 00 00 02 05 16
				39 00 00 00 00 00 02 06 00
				39 00 00 00 00 00 02 07 26
				39 00 00 00 00 00 02 08 00
				39 00 00 00 00 00 02 09 36
				39 00 00 00 00 00 02 0A 00
				39 00 00 00 00 00 02 0B 43
				39 00 00 00 00 00 02 0C 00
				39 00 00 00 00 00 02 0D 4F
				39 00 00 00 00 00 02 0E 00
				39 00 00 00 00 00 02 0F 5E
				39 00 00 00 00 00 02 10 00
				39 00 00 00 00 00 02 11 6D
				39 00 00 00 00 00 02 12 00
				39 00 00 00 00 00 02 13 7D
				39 00 00 00 00 00 02 14 00
				39 00 00 00 00 00 02 15 8D
				39 00 00 00 00 00 02 16 00
				39 00 00 00 00 00 02 17 9E
				39 00 00 00 00 00 02 18 00
				39 00 00 00 00 00 02 19 AD
				39 00 00 00 00 00 02 1A 00
				39 00 00 00 00 00 02 1B BE
				39 00 00 00 00 00 02 1C 00
				39 00 00 00 00 00 02 1D CC
				39 00 00 00 00 00 02 1E 00
				39 00 00 00 00 00 02 1F DC
				39 00 00 00 00 00 02 20 00
				39 00 00 00 00 00 02 21 EC
				39 00 00 00 00 00 02 22 00
				39 00 00 00 00 00 02 23 FC
				39 00 00 00 00 00 02 24 01
				39 00 00 00 00 00 02 25 0C
				39 00 00 00 00 00 02 26 01
				39 00 00 00 00 00 02 27 1A
				39 00 00 00 00 00 02 28 01
				39 00 00 00 00 00 02 29 27
				39 00 00 00 00 00 02 2A 01
				39 00 00 00 00 00 02 2B 35
				39 00 00 00 00 00 02 2C 01
				39 00 00 00 00 00 02 2D 42
				39 00 00 00 00 00 02 2E 01
				39 00 00 00 00 00 02 2F 51
				39 00 00 00 00 00 02 30 01
				39 00 00 00 00 00 02 31 60
				39 01 00 00 00 00 02 32 01
				39 00 00 00 00 00 02 33 6F
				39 00 00 00 00 00 02 34 01
				39 00 00 00 00 00 02 35 7E
				39 00 00 00 00 00 02 36 01
				39 00 00 00 00 00 02 37 9C
				39 00 00 00 00 00 02 38 01
				39 00 00 00 00 00 02 39 B9
				39 00 00 00 00 00 02 3A 01
				39 00 00 00 00 00 02 3B D5
				39 00 00 00 00 00 02 3C 01
				39 00 00 00 00 00 02 3D F1
				39 00 00 00 00 00 02 3E 02
				39 00 00 00 00 00 02 3F 0E
				39 00 00 00 00 00 02 40 02
				39 00 00 00 00 00 02 41 2C
				39 00 00 00 00 00 02 42 02
				39 00 00 00 00 00 02 43 49
				39 00 00 00 00 00 02 44 02
				39 00 00 00 00 00 02 45 65
				39 00 00 00 00 00 02 46 02
				39 00 00 00 00 00 02 47 82
				39 00 00 00 00 00 02 48 02
				39 00 00 00 00 00 02 49 A0
				39 00 00 00 00 00 02 4A 02
				39 00 00 00 00 00 02 4B BE
				39 00 00 00 00 00 02 4C 02
				39 00 00 00 00 00 02 4D DA
				39 00 00 00 00 00 02 4E 02
				39 00 00 00 00 00 02 4F F6
				39 00 00 00 00 00 02 50 03
				39 00 00 00 00 00 02 51 17
				39 00 00 00 00 00 02 52 03
				39 00 00 00 00 00 02 53 37
				39 00 00 00 00 00 02 54 03
				39 00 00 00 00 00 02 55 56
				39 00 00 00 00 00 02 56 03
				39 00 00 00 00 00 02 57 72
				39 00 00 00 00 00 02 58 03
				39 00 00 00 00 00 02 59 8F
				39 00 00 00 00 00 02 5A 03
				39 00 00 00 00 00 02 5B AB
				39 00 00 00 00 00 04 FF 98 81 00
				39 01 00 00 00 00 04 FF 98 81 00 ];
		qcom,mdss-dsi-panel-nature-command =  [
				39 00 00 00 00 00 04 FF 98 81 01
				39 00 00 00 00 00 02 A0 00
				39 00 00 00 00 00 02 A1 18
				39 00 00 00 00 00 02 A2 27
				39 00 00 00 00 00 02 A3 15
				39 00 00 00 00 00 02 A4 17
				39 00 00 00 00 00 02 A5 2B
				39 00 00 00 00 00 02 A6 20
				39 00 00 00 00 00 02 A7 22
				39 00 00 00 00 00 02 A8 95
				39 00 00 00 00 00 02 A9 1B
				39 00 00 00 00 00 02 AA 27
				39 00 00 00 00 00 02 AB 87
				39 00 00 00 00 00 02 AC 1D
				39 00 00 00 00 00 02 AD 1F
				39 00 00 00 00 00 02 AE 54
				39 00 00 00 00 00 02 AF 28
				39 00 00 00 00 00 02 B0 2C
				39 00 00 00 00 00 02 B1 5C
				39 00 00 00 00 00 02 B2 6A
				39 00 00 00 00 00 02 B3 32
				39 00 00 00 00 00 02 C0 00
				39 00 00 00 00 00 02 C1 18
				39 00 00 00 00 00 02 C2 27
				39 00 00 00 00 00 02 C3 15
				39 00 00 00 00 00 02 C4 17
				39 00 00 00 00 00 02 C5 2B
				39 00 00 00 00 00 02 C6 20
				39 00 00 00 00 00 02 C7 22
				39 00 00 00 00 00 02 C8 95
				39 00 00 00 00 00 02 C9 1B
				39 00 00 00 00 00 02 CA 27
				39 00 00 00 00 00 02 CB 87
				39 00 00 00 00 00 02 CC 1D
				39 00 00 00 00 00 02 CD 1F
				39 00 00 00 00 00 02 CE 54
				39 00 00 00 00 00 02 CF 28
				39 00 00 00 00 00 02 D0 2C
				39 00 00 00 00 00 02 D1 5C
				39 00 00 00 00 00 02 D2 6A
				39 01 00 00 00 00 02 D3 32
				39 00 00 00 00 00 04 FF 98 81 05
				39 00 00 00 00 00 02 85 48
				39 00 00 00 00 00 02 00 00
				39 00 00 00 00 00 02 01 00
				39 00 00 00 00 00 02 02 00
				39 00 00 00 00 00 02 03 17
				39 00 00 00 00 00 02 04 00
				39 00 00 00 00 00 02 05 26
				39 00 00 00 00 00 02 06 00
				39 00 00 00 00 00 02 07 36
				39 00 00 00 00 00 02 08 00
				39 00 00 00 00 00 02 09 47
				39 00 00 00 00 00 02 0A 00
				39 00 00 00 00 00 02 0B 58
				39 00 00 00 00 00 02 0C 00
				39 00 00 00 00 00 02 0D 69
				39 00 00 00 00 00 02 0E 00
				39 00 00 00 00 00 02 0F 7B
				39 00 00 00 00 00 02 10 00
				39 00 00 00 00 00 02 11 8C
				39 00 00 00 00 00 02 12 00
				39 00 00 00 00 00 02 13 9D
				39 00 00 00 00 00 02 14 00
				39 00 00 00 00 00 02 15 AF
				39 00 00 00 00 00 02 16 00
				39 00 00 00 00 00 02 17 BE
				39 00 00 00 00 00 02 18 00
				39 00 00 00 00 00 02 19 D0
				39 00 00 00 00 00 02 1A 00
				39 00 00 00 00 00 02 1B E1
				39 00 00 00 00 00 02 1C 00
				39 00 00 00 00 00 02 1D F5
				39 00 00 00 00 00 02 1E 01
				39 00 00 00 00 00 02 1F 07
				39 00 00 00 00 00 02 20 01
				39 00 00 00 00 00 02 21 19
				39 00 00 00 00 00 02 22 01
				39 00 00 00 00 00 02 23 28
				39 00 00 00 00 00 02 24 01
				39 00 00 00 00 00 02 25 34
				39 00 00 00 00 00 02 26 01
				39 00 00 00 00 00 02 27 44
				39 00 00 00 00 00 02 28 01
				39 00 00 00 00 00 02 29 55
				39 00 00 00 00 00 02 2A 01
				39 00 00 00 00 00 02 2B 66
				39 00 00 00 00 00 02 2C 01
				39 00 00 00 00 00 02 2D 76
				39 00 00 00 00 00 02 2E 01
				39 00 00 00 00 00 02 2F 86
				39 00 00 00 00 00 02 30 01
				39 00 00 00 00 00 02 31 95
				39 00 00 00 00 00 02 32 01
				39 00 00 00 00 00 02 33 A5
				39 00 00 00 00 00 02 34 01
				39 00 00 00 00 00 02 35 B4
				39 00 00 00 00 00 02 36 01
				39 00 00 00 00 00 02 37 D2
				39 00 00 00 00 00 02 38 01
				39 00 00 00 00 00 02 39 EF
				39 00 00 00 00 00 02 3A 02
				39 00 00 00 00 00 02 3B 0E
				39 00 00 00 00 00 02 3C 02
				39 00 00 00 00 00 02 3D 2D
				39 00 00 00 00 00 02 3E 02
				39 00 00 00 00 00 02 3F 4B
				39 00 00 00 00 00 02 40 02
				39 00 00 00 00 00 02 41 69
				39 00 00 00 00 00 02 42 02
				39 00 00 00 00 00 02 43 87
				39 00 00 00 00 00 02 44 02
				39 00 00 00 00 00 02 45 A9
				39 00 00 00 00 00 02 46 02
				39 00 00 00 00 00 02 47 C4
				39 00 00 00 00 00 02 48 02
				39 00 00 00 00 00 02 49 DF
				39 00 00 00 00 00 02 4A 02
				39 00 00 00 00 00 02 4B FF
				39 00 00 00 00 00 02 4C 03
				39 00 00 00 00 00 02 4D 20
				39 00 00 00 00 00 02 4E 03
				39 00 00 00 00 00 02 4F 3F
				39 00 00 00 00 00 02 50 03
				39 00 00 00 00 00 02 51 5D
				39 00 00 00 00 00 02 52 03
				39 00 00 00 00 00 02 53 7C
				39 00 00 00 00 00 02 54 03
				39 00 00 00 00 00 02 55 A2
				39 00 00 00 00 00 02 56 03
				39 00 00 00 00 00 02 57 C2
				39 00 00 00 00 00 02 58 03
				39 00 00 00 00 00 02 59 DF
				39 00 00 00 00 00 02 5A 00
				39 01 00 00 00 00 02 5B 00
				39 00 00 00 00 00 04 FF 98 81 06
				39 00 00 00 00 00 02 00 00
				39 00 00 00 00 00 02 01 00
				39 00 00 00 00 00 02 02 00
				39 00 00 00 00 00 02 03 14
				39 00 00 00 00 00 02 04 00
				39 00 00 00 00 00 02 05 22
				39 00 00 00 00 00 02 06 00
				39 00 00 00 00 00 02 07 30
				39 00 00 00 00 00 02 08 00
				39 00 00 00 00 00 02 09 40
				39 00 00 00 00 00 02 0A 00
				39 00 00 00 00 00 02 0B 4F
				39 00 00 00 00 00 02 0C 00
				39 00 00 00 00 00 02 0D 5E
				39 00 00 00 00 00 02 0E 00
				39 00 00 00 00 00 02 0F 6E
				39 00 00 00 00 00 02 10 00
				39 00 00 00 00 00 02 11 7E
				39 00 00 00 00 00 02 12 00
				39 00 00 00 00 00 02 13 8C
				39 00 00 00 00 00 02 14 00
				39 00 00 00 00 00 02 15 9C
				39 00 00 00 00 00 02 16 00
				39 00 00 00 00 00 02 17 AC
				39 00 00 00 00 00 02 18 00
				39 00 00 00 00 00 02 19 BB
				39 00 00 00 00 00 02 1A 00
				39 00 00 00 00 00 02 1B C9
				39 00 00 00 00 00 02 1C 00
				39 00 00 00 00 00 02 1D D9
				39 00 00 00 00 00 02 1E 00
				39 00 00 00 00 00 02 1F EB
				39 00 00 00 00 00 02 20 00
				39 00 00 00 00 00 02 21 FC
				39 00 00 00 00 00 02 22 01
				39 00 00 00 00 00 02 23 0C
				39 00 00 00 00 00 02 24 01
				39 00 00 00 00 00 02 25 1B
				39 00 00 00 00 00 02 26 01
				39 00 00 00 00 00 02 27 2A
				39 00 00 00 00 00 02 28 01
				39 00 00 00 00 00 02 29 37
				39 00 00 00 00 00 02 2A 01
				39 00 00 00 00 00 02 2B 46
				39 00 00 00 00 00 02 2C 01
				39 00 00 00 00 00 02 2D 56
				39 00 00 00 00 00 02 2E 01
				39 00 00 00 00 00 02 2F 66
				39 00 00 00 00 00 02 30 01
				39 00 00 00 00 00 02 31 74
				39 00 00 00 00 00 02 32 01
				39 00 00 00 00 00 02 33 83
				39 00 00 00 00 00 02 34 01
				39 00 00 00 00 00 02 35 91
				39 00 00 00 00 00 02 36 01
				39 00 00 00 00 00 02 37 AD
				39 00 00 00 00 00 02 38 01
				39 00 00 00 00 00 02 39 C8
				39 00 00 00 00 00 02 3A 01
				39 00 00 00 00 00 02 3B E4
				39 00 00 00 00 00 02 3C 01
				39 00 00 00 00 00 02 3D FF
				39 00 00 00 00 00 02 3E 02
				39 00 00 00 00 00 02 3F 1B
				39 00 00 00 00 00 02 40 02
				39 00 00 00 00 00 02 41 38
				39 00 00 00 00 00 02 42 02
				39 00 00 00 00 00 02 43 53
				39 00 00 00 00 00 02 44 02
				39 00 00 00 00 00 02 45 6D
				39 00 00 00 00 00 02 46 02
				39 00 00 00 00 00 02 47 89
				39 00 00 00 00 00 02 48 02
				39 00 00 00 00 00 02 49 A6
				39 00 00 00 00 00 02 4A 02
				39 00 00 00 00 00 02 4B C4
				39 00 00 00 00 00 02 4C 02
				39 00 00 00 00 00 02 4D E0
				39 00 00 00 00 00 02 4E 02
				39 00 00 00 00 00 02 4F FB
				39 00 00 00 00 00 02 50 03
				39 00 00 00 00 00 02 51 1B
				39 00 00 00 00 00 02 52 03
				39 00 00 00 00 00 02 53 39
				39 00 00 00 00 00 02 54 03
				39 00 00 00 00 00 02 55 54
				39 00 00 00 00 00 02 56 03
				39 00 00 00 00 00 02 57 71
				39 00 00 00 00 00 02 58 03
				39 00 00 00 00 00 02 59 8C
				39 00 00 00 00 00 02 5A 03
				39 01 00 00 00 00 02 5B A9
				39 00 00 00 00 00 04 FF 98 81 07
				39 00 00 00 00 00 02 00 00
				39 00 00 00 00 00 02 01 00
				39 00 00 00 00 00 02 02 00
				39 00 00 00 00 00 02 03 04
				39 00 00 00 00 00 02 04 00
				39 00 00 00 00 00 02 05 11
				39 00 00 00 00 00 02 06 00
				39 00 00 00 00 00 02 07 19
				39 00 00 00 00 00 02 08 00
				39 00 00 00 00 00 02 09 2F
				39 00 00 00 00 00 02 0A 00
				39 00 00 00 00 00 02 0B 3F
				39 00 00 00 00 00 02 0C 00
				39 00 00 00 00 00 02 0D 4D
				39 00 00 00 00 00 02 0E 00
				39 00 00 00 00 00 02 0F 5D
				39 00 00 00 00 00 02 10 00
				39 00 00 00 00 00 02 11 6F
				39 00 00 00 00 00 02 12 00
				39 00 00 00 00 00 02 13 80
				39 00 00 00 00 00 02 14 00
				39 00 00 00 00 00 02 15 8F
				39 00 00 00 00 00 02 16 00
				39 00 00 00 00 00 02 17 A0
				39 00 00 00 00 00 02 18 00
				39 00 00 00 00 00 02 19 B0
				39 00 00 00 00 00 02 1A 00
				39 00 00 00 00 00 02 1B BE
				39 00 00 00 00 00 02 1C 00
				39 00 00 00 00 00 02 1D CC
				39 00 00 00 00 00 02 1E 00
				39 00 00 00 00 00 02 1F DD
				39 00 00 00 00 00 02 20 00
				39 00 00 00 00 00 02 21 EF
				39 00 00 00 00 00 02 22 00
				39 00 00 00 00 00 02 23 FF
				39 00 00 00 00 00 02 24 01
				39 00 00 00 00 00 02 25 0E
				39 00 00 00 00 00 02 26 01
				39 00 00 00 00 00 02 27 1D
				39 00 00 00 00 00 02 28 01
				39 00 00 00 00 00 02 29 2B
				39 00 00 00 00 00 02 2A 01
				39 00 00 00 00 00 02 2B 38
				39 00 00 00 00 00 02 2C 01
				39 00 00 00 00 00 02 2D 47
				39 00 00 00 00 00 02 2E 01
				39 00 00 00 00 00 02 2F 56
				39 00 00 00 00 00 02 30 01
				39 00 00 00 00 00 02 31 65
				39 00 00 00 00 00 02 32 01
				39 00 00 00 00 00 02 33 73
				39 00 00 00 00 00 02 34 01
				39 00 00 00 00 00 02 35 81
				39 00 00 00 00 00 02 36 01
				39 00 00 00 00 00 02 37 9C
				39 00 00 00 00 00 02 38 01
				39 00 00 00 00 00 02 39 B7
				39 00 00 00 00 00 02 3A 01
				39 00 00 00 00 00 02 3B D1
				39 00 00 00 00 00 02 3C 01
				39 00 00 00 00 00 02 3D EB
				39 00 00 00 00 00 02 3E 02
				39 00 00 00 00 00 02 3F 05
				39 00 00 00 00 00 02 40 02
				39 00 00 00 00 00 02 41 20
				39 00 00 00 00 00 02 42 02
				39 00 00 00 00 00 02 43 3C
				39 00 00 00 00 00 02 44 02
				39 00 00 00 00 00 02 45 55
				39 00 00 00 00 00 02 46 02
				39 00 00 00 00 00 02 47 70
				39 00 00 00 00 00 02 48 02
				39 00 00 00 00 00 02 49 8A
				39 00 00 00 00 00 02 4A 02
				39 00 00 00 00 00 02 4B A7
				39 00 00 00 00 00 02 4C 02
				39 00 00 00 00 00 02 4D C4
				39 00 00 00 00 00 02 4E 02
				39 00 00 00 00 00 02 4F DD
				39 00 00 00 00 00 02 50 02
				39 00 00 00 00 00 02 51 F8
				39 00 00 00 00 00 02 52 03
				39 00 00 00 00 00 02 53 14
				39 00 00 00 00 00 02 54 03
				39 00 00 00 00 00 02 55 32
				39 00 00 00 00 00 02 56 03
				39 00 00 00 00 00 02 57 4B
				39 00 00 00 00 00 02 58 03
				39 00 00 00 00 00 02 59 67
				39 00 00 00 00 00 02 5A 03
				39 01 00 00 00 00 02 5B 81

				39 00 00 00 00 00 04 FF 98 81 04
				39 00 00 00 00 00 04 FF 98 81 04
				39 00 00 00 00 00 02 E5 02
				39 00 00 00 0A 00 04 FF 98 81 00
				39 00 00 00 0A 00 02 11 00
				39 00 00 00 00 00 04 FF 98 81 03
				39 00 00 00 00 00 02 2C 0C
				39 01 00 00 00 00 04 FF 98 81 00];
		qcom,mdss-dsi-panel-gamma-command-state = "dsi_hs_mode";

		qcom,mdss-dsi-init-last;

		qcom,mdss-dsi-panel-ce-std-command = [39 01 00 00 00 00 04 FF 98 81 02
				39 01 00 00 00 00 04 FF 98 81 02
				39 01 00 00 00 00 02 10 06
				39 01 00 00 00 00 04 FF 98 81 00
				39 01 00 00 00 00 04 FF 98 81 00];
		qcom,mdss-dsi-panel-ce-vivid-command = [39 00 00 00 00 00 04 FF 98 81 02
				39 00 00 00 00 00 04 FF 98 81 02
				39 00 00 00 00 00 02 10 16
				39 00 00 00 00 00 02 68 05
				39 00 00 00 00 00 02 69 05
				39 00 00 00 00 00 02 6a 06
				39 00 00 00 00 00 02 6b 06
				39 00 00 00 00 00 02 6c 06
				39 00 00 00 00 00 02 6D 06
				39 00 00 00 00 00 02 6E 06
				39 00 00 00 00 00 02 6F 06
				39 00 00 00 00 00 02 70 06
				39 00 00 00 00 00 02 71 06
				39 00 00 00 00 00 02 72 06
				39 00 00 00 00 00 02 73 06
				39 00 00 00 00 00 02 74 06
				39 00 00 00 00 00 02 75 06
				39 00 00 00 00 00 02 76 06
				39 00 00 00 00 00 02 77 06
				39 00 00 00 00 00 02 78 06
				39 00 00 00 00 00 02 79 06
				39 00 00 00 00 00 02 7A 06
				39 00 00 00 00 00 02 7B 06
				39 00 00 00 00 00 02 7C 06
				39 00 00 00 00 00 02 7D 06
				39 00 00 00 00 00 02 7E 05
				39 00 00 00 00 00 02 7F 05
				39 00 00 00 00 00 04 FF 98 81 00
				39 01 00 00 00 00 04 FF 98 81 00];
		qcom,mdss-dsi-panel-ce-command-state = "dsi_hs_mode";

		qcom,mdss-dsi-panel-eye-command01 = [
				39 00 00 00 00 00 04 FF 98 81 01
				39 00 00 00 00 00 04 FF 98 81 01
				39 00 00 00 00 00 02 A0 00
				39 00 00 00 00 00 02 A1 17
				39 00 00 00 00 00 02 A2 27
				39 00 00 00 00 00 02 A3 16
				39 00 00 00 00 00 02 A4 18
				39 00 00 00 00 00 02 A5 2A
				39 00 00 00 00 00 02 A6 1F
				39 00 00 00 00 00 02 A7 21
				39 00 00 00 00 00 02 A8 8C
				39 00 00 00 00 00 02 A9 1C
				39 00 00 00 00 00 02 AA 28
				39 00 00 00 00 00 02 AB 78
				39 00 00 00 00 00 02 AC 1C
				39 00 00 00 00 00 02 AD 1D
				39 00 00 00 00 00 02 AE 52
				39 00 00 00 00 00 02 AF 28
				39 00 00 00 00 00 02 B0 2B
				39 00 00 00 00 00 02 B1 56
				39 00 00 00 00 00 02 B2 64
				39 00 00 00 00 00 02 B3 32
				39 00 00 00 00 00 02 C0 00
				39 00 00 00 00 00 02 C1 17
				39 00 00 00 00 00 02 C2 27
				39 00 00 00 00 00 02 C3 16
				39 00 00 00 00 00 02 C4 18
				39 00 00 00 00 00 02 C5 2A
				39 00 00 00 00 00 02 C6 1F
				39 00 00 00 00 00 02 C7 21
				39 00 00 00 00 00 02 C8 8C
				39 00 00 00 00 00 02 C9 1C
				39 00 00 00 00 00 02 CA 28
				39 00 00 00 00 00 02 CB 78
				39 00 00 00 00 00 02 CC 1C
				39 00 00 00 00 00 02 CD 1D
				39 00 00 00 00 00 02 CE 52
				39 00 00 00 00 00 02 CF 28
				39 00 00 00 00 00 02 D0 2B
				39 00 00 00 00 00 02 D1 56
				39 00 00 00 00 00 02 D2 64
				39 01 00 00 00 00 02 D3 32
				39 00 00 00 00 00 04 FF 98 81 05
				39 00 00 00 00 00 04 FF 98 81 05
				39 00 00 00 00 00 02 85 48
				39 00 00 00 00 00 02 00 00
				39 00 00 00 00 00 02 01 00
				39 00 00 00 00 00 02 02 00
				39 00 00 00 00 00 02 03 17
				39 00 00 00 00 00 02 04 00
				39 00 00 00 00 00 02 05 24
				39 00 00 00 00 00 02 06 00
				39 00 00 00 00 00 02 07 33
				39 00 00 00 00 00 02 08 00
				39 00 00 00 00 00 02 09 43
				39 00 00 00 00 00 02 0A 00
				39 00 00 00 00 00 02 0B 52
				39 00 00 00 00 00 02 0C 00
				39 00 00 00 00 00 02 0D 61
				39 00 00 00 00 00 02 0E 00
				39 00 00 00 00 00 02 0F 71
				39 00 00 00 00 00 02 10 00
				39 00 00 00 00 00 02 11 7F
				39 00 00 00 00 00 02 12 00
				39 00 00 00 00 00 02 13 8E
				39 00 00 00 00 00 02 14 00
				39 00 00 00 00 00 02 15 9E
				39 00 00 00 00 00 02 16 00
				39 00 00 00 00 00 02 17 AE
				39 00 00 00 00 00 02 18 00
				39 00 00 00 00 00 02 19 BC
				39 00 00 00 00 00 02 1A 00
				39 00 00 00 00 00 02 1B CA
				39 00 00 00 00 00 02 1C 00
				39 00 00 00 00 00 02 1D DA
				39 00 00 00 00 00 02 1E 00
				39 00 00 00 00 00 02 1F EB
				39 00 00 00 00 00 02 20 00
				39 00 00 00 00 00 02 21 FB
				39 00 00 00 00 00 02 22 01
				39 00 00 00 00 00 02 23 0C
				39 00 00 00 00 00 02 24 01
				39 00 00 00 00 00 02 25 1A
				39 00 00 00 00 00 02 26 01
				39 00 00 00 00 00 02 27 26
				39 00 00 00 00 00 02 28 01
				39 00 00 00 00 00 02 29 33
				39 00 00 00 00 00 02 2A 01
				39 00 00 00 00 00 02 2B 42
				39 00 00 00 00 00 02 2C 01
				39 00 00 00 00 00 02 2D 52
				39 00 00 00 00 00 02 2E 01
				39 00 00 00 00 00 02 2F 63
				39 00 00 00 00 00 02 30 01
				39 00 00 00 00 00 02 31 74
				39 01 00 00 00 00 02 32 01
				39 00 00 00 00 00 02 33 85
				39 00 00 00 00 00 02 34 01
				39 00 00 00 00 00 02 35 95
				39 00 00 00 00 00 02 36 01
				39 00 00 00 00 00 02 37 B4
				39 00 00 00 00 00 02 38 01
				39 00 00 00 00 00 02 39 D3
				39 00 00 00 00 00 02 3A 01
				39 00 00 00 00 00 02 3B F3
				39 00 00 00 00 00 02 3C 02
				39 00 00 00 00 00 02 3D 13
				39 00 00 00 00 00 02 3E 02
				39 00 00 00 00 00 02 3F 34
				39 00 00 00 00 00 02 40 02
				39 00 00 00 00 00 02 41 50
				39 00 00 00 00 00 02 42 02
				39 00 00 00 00 00 02 43 70
				39 00 00 00 00 00 02 44 02
				39 00 00 00 00 00 02 45 93
				39 00 00 00 00 00 02 46 02
				39 00 00 00 00 00 02 47 B7
				39 00 00 00 00 00 02 48 02
				39 00 00 00 00 00 02 49 D5
				39 00 00 00 00 00 02 4A 02
				39 00 00 00 00 00 02 4B F5
				39 00 00 00 00 00 02 4C 03
				39 00 00 00 00 00 02 4D 1A
				39 00 00 00 00 00 02 4E 03
				39 00 00 00 00 00 02 4F 3A
				39 00 00 00 00 00 02 50 03
				39 00 00 00 00 00 02 51 5A
				39 00 00 00 00 00 02 52 03
				39 00 00 00 00 00 02 53 7A
				39 00 00 00 00 00 02 54 03
				39 00 00 00 00 00 02 55 9C
				39 00 00 00 00 00 02 56 03
				39 00 00 00 00 00 02 57 BE
				39 00 00 00 00 00 02 58 03
				39 00 00 00 00 00 02 59 DD
				39 00 00 00 00 00 02 5A 00
				39 01 00 00 00 00 02 5B 00
				39 00 00 00 00 00 04 FF 98 81 06
				39 00 00 00 00 00 04  FF 98 81 06
				39 00 00 00 00 00 02 00 00
				39 00 00 00 00 00 02 01 00
				39 00 00 00 00 00 02 02 00
				39 00 00 00 00 00 02 03 0F
				39 00 00 00 00 00 02 04 00
				39 00 00 00 00 00 02 05 1D
				39 00 00 00 00 00 02 06 00
				39 00 00 00 00 00 02 07 2C
				39 00 00 00 00 00 02 08 00
				39 00 00 00 00 00 02 09 3A
				39 00 00 00 00 00 02 0A 00
				39 00 00 00 00 00 02 0B 48
				39 00 00 00 00 00 02 0C 00
				39 00 00 00 00 00 02 0D 55
				39 00 00 00 00 00 02 0E 00
				39 00 00 00 00 00 02 0F 63
				39 00 00 00 00 00 02 10 00
				39 00 00 00 00 00 02 11 71
				39 00 00 00 00 00 02 12 00
				39 00 00 00 00 00 02 13 7F
				39 00 00 00 00 00 02 14 00
				39 00 00 00 00 00 02 15 8B
				39 00 00 00 00 00 02 16 00
				39 00 00 00 00 00 02 17 99
				39 00 00 00 00 00 02 18 00
				39 00 00 00 00 00 02 19 A7
				39 00 00 00 00 00 02 1A 00
				39 00 00 00 00 00 02 1B B5
				39 00 00 00 00 00 02 1C 00
				39 00 00 00 00 00 02 1D C2
				39 00 00 00 00 00 02 1E 00
				39 00 00 00 00 00 02 1F CE
				39 00 00 00 00 00 02 20 00
				39 00 00 00 00 00 02 21 DD
				39 00 00 00 00 00 02 22 00
				39 00 00 00 00 00 02 23 ED
				39 00 00 00 00 00 02 24 00
				39 00 00 00 00 00 02 25 FB
				39 00 00 00 00 00 02 26 01
				39 00 00 00 00 00 02 27 09
				39 00 00 00 00 00 02 28 01
				39 00 00 00 00 00 02 29 16
				39 00 00 00 00 00 02 2A 01
				39 00 00 00 00 00 02 2B 23
				39 00 00 00 00 00 02 2C 01
				39 00 00 00 00 00 02 2D 2F
				39 00 00 00 00 00 02 2E 01
				39 00 00 00 00 00 02 2F 3B
				39 00 00 00 00 00 02 30 01
				39 00 00 00 00 00 02 31 49
				39 01 00 00 00 00 02 32 01
				39 00 00 00 00 00 02 33 58
				39 00 00 00 00 00 02 34 01
				39 00 00 00 00 00 02 35 67
				39 00 00 00 00 00 02 36 01
				39 00 00 00 00 00 02 37 84
				39 00 00 00 00 00 02 38 01
				39 00 00 00 00 00 02 39 A0
				39 00 00 00 00 00 02 3A 01
				39 00 00 00 00 00 02 3B BC
				39 00 00 00 00 00 02 3C 01
				39 00 00 00 00 00 02 3D D8
				39 00 00 00 00 00 02 3E 01
				39 00 00 00 00 00 02 3F F4
				39 00 00 00 00 00 02 40 02
				39 00 00 00 00 00 02 41 11
				39 00 00 00 00 00 02 42 02
				39 00 00 00 00 00 02 43 2E
				39 00 00 00 00 00 02 44 02
				39 00 00 00 00 00 02 45 4C
				39 00 00 00 00 00 02 46 02
				39 00 00 00 00 00 02 47 69
				39 00 00 00 00 00 02 48 02
				39 00 00 00 00 00 02 49 87
				39 00 00 00 00 00 02 4A 02
				39 00 00 00 00 00 02 4B A7
				39 00 00 00 00 00 02 4C 02
				39 00 00 00 00 00 02 4D C6
				39 00 00 00 00 00 02 4E 02
				39 00 00 00 00 00 02 4F E1
				39 00 00 00 00 00 02 50 02
				39 00 00 00 00 00 02 51 FF
				39 00 00 00 00 00 02 52 03
				39 00 00 00 00 00 02 53 1E
				39 00 00 00 00 00 02 54 03
				39 00 00 00 00 00 02 55 3C
				39 00 00 00 00 00 02 56 03
				39 00 00 00 00 00 02 57 59
				39 00 00 00 00 00 02 58 03
				39 00 00 00 00 00 02 59 77
				39 00 00 00 00 00 02 5A 03
				39 01 00 00 00 00 02 5B 93
				39 00 00 00 00 00 04 FF 98 81 07
				39 00 00 00 00 00 04 FF 98 81 07
				39 00 00 00 00 00 02 00 00
				39 00 00 00 00 00 02 01 00
				39 00 00 00 00 00 02 02 00
				39 00 00 00 00 00 02 03 05
				39 00 00 00 00 00 02 04 00
				39 00 00 00 00 00 02 05 0D
				39 00 00 00 00 00 02 06 00
				39 00 00 00 00 00 02 07 1B
				39 00 00 00 00 00 02 08 00
				39 00 00 00 00 00 02 09 2C
				39 00 00 00 00 00 02 0A 00
				39 00 00 00 00 00 02 0B 39
				39 00 00 00 00 00 02 0C 00
				39 00 00 00 00 00 02 0D 44
				39 00 00 00 00 00 02 0E 00
				39 00 00 00 00 00 02 0F 52
				39 00 00 00 00 00 02 10 00
				39 00 00 00 00 00 02 11 60
				39 00 00 00 00 00 02 12 00
				39 00 00 00 00 00 02 13 6F
				39 00 00 00 00 00 02 14 00
				39 00 00 00 00 00 02 15 7D
				39 00 00 00 00 00 02 16 00
				39 00 00 00 00 00 02 17 8A
				39 00 00 00 00 00 02 18 00
				39 00 00 00 00 00 02 19 98
				39 00 00 00 00 00 02 1A 00
				39 00 00 00 00 00 02 1B A6
				39 00 00 00 00 00 02 1C 00
				39 00 00 00 00 00 02 1D B3
				39 00 00 00 00 00 02 1E 00
				39 00 00 00 00 00 02 1F BF
				39 00 00 00 00 00 02 20 00
				39 00 00 00 00 00 02 21 CB
				39 00 00 00 00 00 02 22 00
				39 00 00 00 00 00 02 23 D9
				39 00 00 00 00 00 02 24 00
				39 00 00 00 00 00 02 25 E8
				39 00 00 00 00 00 02 26 00
				39 00 00 00 00 00 02 27 F5
				39 00 00 00 00 00 02 28 01
				39 00 00 00 00 00 02 29 03
				39 00 00 00 00 00 02 2A 01
				39 00 00 00 00 00 02 2B 10
				39 00 00 00 00 00 02 2C 01
				39 00 00 00 00 00 02 2D 1C
				39 00 00 00 00 00 02 2E 01
				39 00 00 00 00 00 02 2F 28
				39 00 00 00 00 00 02 30 01
				39 00 00 00 00 00 02 31 33
				39 01 00 00 00 00 02 32 01
				39 00 00 00 00 00 02 33 3F
				39 00 00 00 00 00 02 34 01
				39 00 00 00 00 00 02 35 4C
				39 00 00 00 00 00 02 36 01
				39 00 00 00 00 00 02 37 69
				39 00 00 00 00 00 02 38 01
				39 00 00 00 00 00 02 39 84
				39 00 00 00 00 00 02 3A 01
				39 00 00 00 00 00 02 3B 9E
				39 00 00 00 00 00 02 3C 01
				39 00 00 00 00 00 02 3D B8
				39 00 00 00 00 00 02 3E 01
				39 00 00 00 00 00 02 3F D3
				39 00 00 00 00 00 02 40 01
				39 00 00 00 00 00 02 41 EC
				39 00 00 00 00 00 02 42 02
				39 00 00 00 00 00 02 43 07
				39 00 00 00 00 00 02 44 02
				39 00 00 00 00 00 02 45 22
				39 00 00 00 00 00 02 46 02
				39 00 00 00 00 00 02 47 3F
				39 00 00 00 00 00 02 48 02
				39 00 00 00 00 00 02 49 5A
				39 00 00 00 00 00 02 4A 02
				39 00 00 00 00 00 02 4B 75
				39 00 00 00 00 00 02 4C 02
				39 00 00 00 00 00 02 4D 92
				39 00 00 00 00 00 02 4E 02
				39 00 00 00 00 00 02 4F B0
				39 00 00 00 00 00 02 50 02
				39 00 00 00 00 00 02 51 CB
				39 00 00 00 00 00 02 52 02
				39 00 00 00 00 00 02 53 E5
				39 00 00 00 00 00 02 54 03
				39 00 00 00 00 00 02 55 01
				39 00 00 00 00 00 02 56 03
				39 00 00 00 00 00 02 57 21
				39 00 00 00 00 00 02 58 03
				39 00 00 00 00 00 02 59 3A
				39 00 00 00 00 00 02 5A 03
				39 00 00 00 00 00 02 5B 55
				39 00 00 00 00 00 04 FF 98 81 00
				39 01 00 00 00 00 04 FF 98 81 00
				];
		qcom,mdss-dsi-panel-eye-command02 = [
				39 00 00 00 00 00 04 FF 98 81 01
				39 00 00 00 00 00 04 FF 98 81 01
				39 00 00 00 00 00 02 A0 00
				39 00 00 00 00 00 02 A1 17
				39 00 00 00 00 00 02 A2 27
				39 00 00 00 00 00 02 A3 16
				39 00 00 00 00 00 02 A4 18
				39 00 00 00 00 00 02 A5 2A
				39 00 00 00 00 00 02 A6 1F
				39 00 00 00 00 00 02 A7 21
				39 00 00 00 00 00 02 A8 8C
				39 00 00 00 00 00 02 A9 1C
				39 00 00 00 00 00 02 AA 28
				39 00 00 00 00 00 02 AB 78
				39 00 00 00 00 00 02 AC 1C
				39 00 00 00 00 00 02 AD 1D
				39 00 00 00 00 00 02 AE 52
				39 00 00 00 00 00 02 AF 28
				39 00 00 00 00 00 02 B0 2B
				39 00 00 00 00 00 02 B1 56
				39 00 00 00 00 00 02 B2 64
				39 00 00 00 00 00 02 B3 32
				39 00 00 00 00 00 02 C0 00
				39 00 00 00 00 00 02 C1 17
				39 00 00 00 00 00 02 C2 27
				39 00 00 00 00 00 02 C3 16
				39 00 00 00 00 00 02 C4 18
				39 00 00 00 00 00 02 C5 2A
				39 00 00 00 00 00 02 C6 1F
				39 00 00 00 00 00 02 C7 21
				39 00 00 00 00 00 02 C8 8C
				39 00 00 00 00 00 02 C9 1C
				39 00 00 00 00 00 02 CA 28
				39 00 00 00 00 00 02 CB 78
				39 00 00 00 00 00 02 CC 1C
				39 00 00 00 00 00 02 CD 1D
				39 00 00 00 00 00 02 CE 52
				39 00 00 00 00 00 02 CF 28
				39 00 00 00 00 00 02 D0 2B
				39 00 00 00 00 00 02 D1 56
				39 00 00 00 00 00 02 D2 64
				39 01 00 00 00 00 02 D3 32
				39 00 00 00 00 00 04 FF 98 81 05
				39 00 00 00 00 00 04 FF 98 81 05
				39 00 00 00 00 00 02 85 48
				39 00 00 00 00 00 02 00 00
				39 00 00 00 00 00 02 01 00
				39 00 00 00 00 00 02 02 00
				39 00 00 00 00 00 02 03 18
				39 00 00 00 00 00 02 04 00
				39 00 00 00 00 00 02 05 24
				39 00 00 00 00 00 02 06 00
				39 00 00 00 00 00 02 07 34
				39 00 00 00 00 00 02 08 00
				39 00 00 00 00 00 02 09 43
				39 00 00 00 00 00 02 0A 00
				39 00 00 00 00 00 02 0B 53
				39 00 00 00 00 00 02 0C 00
				39 00 00 00 00 00 02 0D 62
				39 00 00 00 00 00 02 0E 00
				39 00 00 00 00 00 02 0F 71
				39 00 00 00 00 00 02 10 00
				39 00 00 00 00 00 02 11 80
				39 00 00 00 00 00 02 12 00
				39 00 00 00 00 00 02 13 8E
				39 00 00 00 00 00 02 14 00
				39 00 00 00 00 00 02 15 9E
				39 00 00 00 00 00 02 16 00
				39 00 00 00 00 00 02 17 AE
				39 00 00 00 00 00 02 18 00
				39 00 00 00 00 00 02 19 BC
				39 00 00 00 00 00 02 1A 00
				39 00 00 00 00 00 02 1B CB
				39 00 00 00 00 00 02 1C 00
				39 00 00 00 00 00 02 1D DA
				39 00 00 00 00 00 02 1E 00
				39 00 00 00 00 00 02 1F EB
				39 00 00 00 00 00 02 20 00
				39 00 00 00 00 00 02 21 FB
				39 00 00 00 00 00 02 22 01
				39 00 00 00 00 00 02 23 0C
				39 00 00 00 00 00 02 24 01
				39 00 00 00 00 00 02 25 1A
				39 00 00 00 00 00 02 26 01
				39 00 00 00 00 00 02 27 26
				39 00 00 00 00 00 02 28 01
				39 00 00 00 00 00 02 29 34
				39 00 00 00 00 00 02 2A 01
				39 00 00 00 00 00 02 2B 42
				39 00 00 00 00 00 02 2C 01
				39 00 00 00 00 00 02 2D 52
				39 00 00 00 00 00 02 2E 01
				39 00 00 00 00 00 02 2F 63
				39 00 00 00 00 00 02 30 01
				39 00 00 00 00 00 02 31 75
				39 01 00 00 00 00 02 32 01
				39 00 00 00 00 00 02 33 85
				39 00 00 00 00 00 02 34 01
				39 00 00 00 00 00 02 35 95
				39 00 00 00 00 00 02 36 01
				39 00 00 00 00 00 02 37 B4
				39 00 00 00 00 00 02 38 01
				39 00 00 00 00 00 02 39 D3
				39 00 00 00 00 00 02 3A 01
				39 00 00 00 00 00 02 3B F3
				39 00 00 00 00 00 02 3C 02
				39 00 00 00 00 00 02 3D 13
				39 00 00 00 00 00 02 3E 02
				39 00 00 00 00 00 02 3F 34
				39 00 00 00 00 00 02 40 02
				39 00 00 00 00 00 02 41 50
				39 00 00 00 00 00 02 42 02
				39 00 00 00 00 00 02 43 70
				39 00 00 00 00 00 02 44 02
				39 00 00 00 00 00 02 45 93
				39 00 00 00 00 00 02 46 02
				39 00 00 00 00 00 02 47 B7
				39 00 00 00 00 00 02 48 02
				39 00 00 00 00 00 02 49 D5
				39 00 00 00 00 00 02 4A 02
				39 00 00 00 00 00 02 4B F5
				39 00 00 00 00 00 02 4C 03
				39 00 00 00 00 00 02 4D 1A
				39 00 00 00 00 00 02 4E 03
				39 00 00 00 00 00 02 4F 3A
				39 00 00 00 00 00 02 50 03
				39 00 00 00 00 00 02 51 5A
				39 00 00 00 00 00 02 52 03
				39 00 00 00 00 00 02 53 7A
				39 00 00 00 00 00 02 54 03
				39 00 00 00 00 00 02 55 9C
				39 00 00 00 00 00 02 56 03
				39 00 00 00 00 00 02 57 BE
				39 00 00 00 00 00 02 58 03
				39 00 00 00 00 00 02 59 DD
				39 00 00 00 00 00 02 5A 00
				39 01 00 00 00 00 02 5B 00
				39 00 00 00 00 00 04 FF 98 81 06
				39 00 00 00 00 00 04 FF 98 81 06
				39 00 00 00 00 00 02 00 00
				39 00 00 00 00 00 02 01 00
				39 00 00 00 00 00 02 02 00
				39 00 00 00 00 00 02 03 0E
				39 00 00 00 00 00 02 04 00
				39 00 00 00 00 00 02 05 1D
				39 00 00 00 00 00 02 06 00
				39 00 00 00 00 00 02 07 2A
				39 00 00 00 00 00 02 08 00
				39 00 00 00 00 00 02 09 38
				39 00 00 00 00 00 02 0A 00
				39 00 00 00 00 00 02 0B 46
				39 00 00 00 00 00 02 0C 00
				39 00 00 00 00 00 02 0D 53
				39 00 00 00 00 00 02 0E 00
				39 00 00 00 00 00 02 0F 60
				39 00 00 00 00 00 02 10 00
				39 00 00 00 00 00 02 11 6D
				39 00 00 00 00 00 02 12 00
				39 00 00 00 00 00 02 13 7B
				39 00 00 00 00 00 02 14 00
				39 00 00 00 00 00 02 15 88
				39 00 00 00 00 00 02 16 00
				39 00 00 00 00 00 02 17 95
				39 00 00 00 00 00 02 18 00
				39 00 00 00 00 00 02 19 A3
				39 00 00 00 00 00 02 1A 00
				39 00 00 00 00 00 02 1B B1
				39 00 00 00 00 00 02 1C 00
				39 00 00 00 00 00 02 1D BD
				39 00 00 00 00 00 02 1E 00
				39 00 00 00 00 00 02 1F C9
				39 00 00 00 00 00 02 20 00
				39 00 00 00 00 00 02 21 D7
				39 00 00 00 00 00 02 22 00
				39 00 00 00 00 00 02 23 E6
				39 00 00 00 00 00 02 24 00
				39 00 00 00 00 00 02 25 F4
				39 00 00 00 00 00 02 26 01
				39 00 00 00 00 00 02 27 02
				39 00 00 00 00 00 02 28 01
				39 00 00 00 00 00 02 29 0F
				39 00 00 00 00 00 02 2A 01
				39 00 00 00 00 00 02 2B 1C
				39 00 00 00 00 00 02 2C 01
				39 00 00 00 00 00 02 2D 28
				39 00 00 00 00 00 02 2E 01
				39 00 00 00 00 00 02 2F 34
				39 00 00 00 00 00 02 30 01
				39 00 00 00 00 00 02 31 40
				39 01 00 00 00 00 02 32 01
				39 00 00 00 00 00 02 33 4E
				39 00 00 00 00 00 02 34 01
				39 00 00 00 00 00 02 35 5D
				39 00 00 00 00 00 02 36 01
				39 00 00 00 00 00 02 37 79
				39 00 00 00 00 00 02 38 01
				39 00 00 00 00 00 02 39 95
				39 00 00 00 00 00 02 3A 01
				39 00 00 00 00 00 02 3B B0
				39 00 00 00 00 00 02 3C 01
				39 00 00 00 00 00 02 3D CB
				39 00 00 00 00 00 02 3E 01
				39 00 00 00 00 00 02 3F E6
				39 00 00 00 00 00 02 40 02
				39 00 00 00 00 00 02 41 02
				39 00 00 00 00 00 02 42 02
				39 00 00 00 00 00 02 43 1E
				39 00 00 00 00 00 02 44 02
				39 00 00 00 00 00 02 45 3C
				39 00 00 00 00 00 02 46 02
				39 00 00 00 00 00 02 47 58
				39 00 00 00 00 00 02 48 02
				39 00 00 00 00 00 02 49 75
				39 00 00 00 00 00 02 4A 02
				39 00 00 00 00 00 02 4B 93
				39 00 00 00 00 00 02 4C 02
				39 00 00 00 00 00 02 4D B2
				39 00 00 00 00 00 02 4E 02
				39 00 00 00 00 00 02 4F CE
				39 00 00 00 00 00 02 50 02
				39 00 00 00 00 00 02 51 E9
				39 00 00 00 00 00 02 52 03
				39 00 00 00 00 00 02 53 06
				39 00 00 00 00 00 02 54 03
				39 00 00 00 00 00 02 55 26
				39 00 00 00 00 00 02 56 03
				39 00 00 00 00 00 02 57 42
				39 00 00 00 00 00 02 58 03
				39 00 00 00 00 00 02 59 5F
				39 00 00 00 00 00 02 5A 03
				39 01 00 00 00 00 02 5B 7B
				39 00 00 00 00 00 04 FF 98 81 07
				39 00 00 00 00 00 04 FF 98 81 07
				39 00 00 00 00 00 02 00 00
				39 00 00 00 00 00 02 01 00
				39 00 00 00 00 00 02 02 00
				39 00 00 00 00 00 02 03 04
				39 00 00 00 00 00 02 04 00
				39 00 00 00 00 00 02 05 0B
				39 00 00 00 00 00 02 06 00
				39 00 00 00 00 00 02 07 14
				39 00 00 00 00 00 02 08 00
				39 00 00 00 00 00 02 09 27
				39 00 00 00 00 00 02 0A 00
				39 00 00 00 00 00 02 0B 34
				39 00 00 00 00 00 02 0C 00
				39 00 00 00 00 00 02 0D 3E
				39 00 00 00 00 00 02 0E 00
				39 00 00 00 00 00 02 0F 4C
				39 00 00 00 00 00 02 10 00
				39 00 00 00 00 00 02 11 5A
				39 00 00 00 00 00 02 12 00
				39 00 00 00 00 00 02 13 69
				39 00 00 00 00 00 02 14 00
				39 00 00 00 00 00 02 15 77
				39 00 00 00 00 00 02 16 00
				39 00 00 00 00 00 02 17 83
				39 00 00 00 00 00 02 18 00
				39 00 00 00 00 00 02 19 90
				39 00 00 00 00 00 02 1A 00
				39 00 00 00 00 00 02 1B 9D
				39 00 00 00 00 00 02 1C 00
				39 00 00 00 00 00 02 1D AB
				39 00 00 00 00 00 02 1E 00
				39 00 00 00 00 00 02 1F B7
				39 00 00 00 00 00 02 20 00
				39 00 00 00 00 00 02 21 C3
				39 00 00 00 00 00 02 22 00
				39 00 00 00 00 00 02 23 CE
				39 00 00 00 00 00 02 24 00
				39 00 00 00 00 00 02 25 DC
				39 00 00 00 00 00 02 26 00
				39 00 00 00 00 00 02 27 EA
				39 00 00 00 00 00 02 28 00
				39 00 00 00 00 00 02 29 F7
				39 00 00 00 00 00 02 2A 01
				39 00 00 00 00 00 02 2B 04
				39 00 00 00 00 00 02 2C 01
				39 00 00 00 00 00 02 2D 10
				39 00 00 00 00 00 02 2E 01
				39 00 00 00 00 00 02 2F 1C
				39 00 00 00 00 00 02 30 01
				39 00 00 00 00 00 02 31 27
				39 01 00 00 00 00 02 32 01
				39 00 00 00 00 00 02 33 32
				39 00 00 00 00 00 02 34 01
				39 00 00 00 00 00 02 35 3C
				39 00 00 00 00 00 02 36 01
				39 00 00 00 00 00 02 37 57
				39 00 00 00 00 00 02 38 01
				39 00 00 00 00 00 02 39 71
				39 00 00 00 00 00 02 3A 01
				39 00 00 00 00 00 02 3B 8B
				39 00 00 00 00 00 02 3C 01
				39 00 00 00 00 00 02 3D A5
				39 00 00 00 00 00 02 3E 01
				39 00 00 00 00 00 02 3F BE
				39 00 00 00 00 00 02 40 01
				39 00 00 00 00 00 02 41 D7
				39 00 00 00 00 00 02 42 01
				39 00 00 00 00 00 02 43 F0
				39 00 00 00 00 00 02 44 02
				39 00 00 00 00 00 02 45 09
				39 00 00 00 00 00 02 46 02
				39 00 00 00 00 00 02 47 23
				39 00 00 00 00 00 02 48 02
				39 00 00 00 00 00 02 49 3E
				39 00 00 00 00 00 02 4A 02
				39 00 00 00 00 00 02 4B 58
				39 00 00 00 00 00 02 4C 02
				39 00 00 00 00 00 02 4D 72
				39 00 00 00 00 00 02 4E 02
				39 00 00 00 00 00 02 4F 8E
				39 00 00 00 00 00 02 50 02
				39 00 00 00 00 00 02 51 AA
				39 00 00 00 00 00 02 52 02
				39 00 00 00 00 00 02 53 C5
				39 00 00 00 00 00 02 54 02
				39 00 00 00 00 00 02 55 DE
				39 00 00 00 00 00 02 56 02
				39 00 00 00 00 00 02 57 F7
				39 00 00 00 00 00 02 58 03
				39 00 00 00 00 00 02 59 15
				39 00 00 00 00 00 02 5A 03
				39 00 00 00 00 00 02 5B 31
				39 00 00 00 00 00 04 FF 98 81 00
				39 01 00 00 00 00 04 FF 98 81 00 ];
		qcom,mdss-dsi-panel-eye-command03 = [
				39 00 00 00 00 00 04 FF 98 81 01
				39 00 00 00 00 00 04 FF 98 81 01
				39 00 00 00 00 00 02 A0 00
				39 00 00 00 00 00 02 A1 17
				39 00 00 00 00 00 02 A2 27
				39 00 00 00 00 00 02 A3 16
				39 00 00 00 00 00 02 A4 18
				39 00 00 00 00 00 02 A5 2A
				39 00 00 00 00 00 02 A6 1F
				39 00 00 00 00 00 02 A7 21
				39 00 00 00 00 00 02 A8 8C
				39 00 00 00 00 00 02 A9 1C
				39 00 00 00 00 00 02 AA 28
				39 00 00 00 00 00 02 AB 78
				39 00 00 00 00 00 02 AC 1C
				39 00 00 00 00 00 02 AD 1D
				39 00 00 00 00 00 02 AE 52
				39 00 00 00 00 00 02 AF 28
				39 00 00 00 00 00 02 B0 2B
				39 00 00 00 00 00 02 B1 56
				39 00 00 00 00 00 02 B2 64
				39 00 00 00 00 00 02 B3 32
				39 00 00 00 00 00 02 C0 00
				39 00 00 00 00 00 02 C1 17
				39 00 00 00 00 00 02 C2 27
				39 00 00 00 00 00 02 C3 16
				39 00 00 00 00 00 02 C4 18
				39 00 00 00 00 00 02 C5 2A
				39 00 00 00 00 00 02 C6 1F
				39 00 00 00 00 00 02 C7 21
				39 00 00 00 00 00 02 C8 8C
				39 00 00 00 00 00 02 C9 1C
				39 00 00 00 00 00 02 CA 28
				39 00 00 00 00 00 02 CB 78
				39 00 00 00 00 00 02 CC 1C
				39 00 00 00 00 00 02 CD 1D
				39 00 00 00 00 00 02 CE 52
				39 00 00 00 00 00 02 CF 28
				39 00 00 00 00 00 02 D0 2B
				39 00 00 00 00 00 02 D1 56
				39 00 00 00 00 00 02 D2 64
				39 01 00 00 00 00 02 D3 32
				39 00 00 00 00 00 04 FF 98 81 05
				39 00 00 00 00 00 04 FF 98 81 05
				39 00 00 00 00 00 02 85 48
				39 00 00 00 00 00 02 00 00
				39 00 00 00 00 00 02 01 00
				39 00 00 00 00 00 02 02 00
				39 00 00 00 00 00 02 03 19
				39 00 00 00 00 00 02 04 00
				39 00 00 00 00 00 02 05 25
				39 00 00 00 00 00 02 06 00
				39 00 00 00 00 00 02 07 35
				39 00 00 00 00 00 02 08 00
				39 00 00 00 00 00 02 09 44
				39 00 00 00 00 00 02 0A 00
				39 00 00 00 00 00 02 0B 53
				39 00 00 00 00 00 02 0C 00
				39 00 00 00 00 00 02 0D 62
				39 00 00 00 00 00 02 0E 00
				39 00 00 00 00 00 02 0F 72
				39 00 00 00 00 00 02 10 00
				39 00 00 00 00 00 02 11 80
				39 00 00 00 00 00 02 12 00
				39 00 00 00 00 00 02 13 8E
				39 00 00 00 00 00 02 14 00
				39 00 00 00 00 00 02 15 9E
				39 00 00 00 00 00 02 16 00
				39 00 00 00 00 00 02 17 AE
				39 00 00 00 00 00 02 18 00
				39 00 00 00 00 00 02 19 BC
				39 00 00 00 00 00 02 1A 00
				39 00 00 00 00 00 02 1B CB
				39 00 00 00 00 00 02 1C 00
				39 00 00 00 00 00 02 1D DA
				39 00 00 00 00 00 02 1E 00
				39 00 00 00 00 00 02 1F EB
				39 00 00 00 00 00 02 20 00
				39 00 00 00 00 00 02 21 FC
				39 00 00 00 00 00 02 22 01
				39 00 00 00 00 00 02 23 0C
				39 00 00 00 00 00 02 24 01
				39 00 00 00 00 00 02 25 1A
				39 00 00 00 00 00 02 26 01
				39 00 00 00 00 00 02 27 26
				39 00 00 00 00 00 02 28 01
				39 00 00 00 00 00 02 29 34
				39 00 00 00 00 00 02 2A 01
				39 00 00 00 00 00 02 2B 42
				39 00 00 00 00 00 02 2C 01
				39 00 00 00 00 00 02 2D 52
				39 00 00 00 00 00 02 2E 01
				39 00 00 00 00 00 02 2F 63
				39 00 00 00 00 00 02 30 01
				39 00 00 00 00 00 02 31 75
				39 01 00 00 00 00 02 32 01
				39 00 00 00 00 00 02 33 85
				39 00 00 00 00 00 02 34 01
				39 00 00 00 00 00 02 35 95
				39 00 00 00 00 00 02 36 01
				39 00 00 00 00 00 02 37 B4
				39 00 00 00 00 00 02 38 01
				39 00 00 00 00 00 02 39 D3
				39 00 00 00 00 00 02 3A 01
				39 00 00 00 00 00 02 3B F3
				39 00 00 00 00 00 02 3C 02
				39 00 00 00 00 00 02 3D 13
				39 00 00 00 00 00 02 3E 02
				39 00 00 00 00 00 02 3F 34
				39 00 00 00 00 00 02 40 02
				39 00 00 00 00 00 02 41 50
				39 00 00 00 00 00 02 42 02
				39 00 00 00 00 00 02 43 70
				39 00 00 00 00 00 02 44 02
				39 00 00 00 00 00 02 45 93
				39 00 00 00 00 00 02 46 02
				39 00 00 00 00 00 02 47 B7
				39 00 00 00 00 00 02 48 02
				39 00 00 00 00 00 02 49 D5
				39 00 00 00 00 00 02 4A 02
				39 00 00 00 00 00 02 4B F5
				39 00 00 00 00 00 02 4C 03
				39 00 00 00 00 00 02 4D 1A
				39 00 00 00 00 00 02 4E 03
				39 00 00 00 00 00 02 4F 3A
				39 00 00 00 00 00 02 50 03
				39 00 00 00 00 00 02 51 5A
				39 00 00 00 00 00 02 52 03
				39 00 00 00 00 00 02 53 7A
				39 00 00 00 00 00 02 54 03
				39 00 00 00 00 00 02 55 9C
				39 00 00 00 00 00 02 56 03
				39 00 00 00 00 00 02 57 BE
				39 00 00 00 00 00 02 58 03
				39 00 00 00 00 00 02 59 DD
				39 00 00 00 00 00 02 5A 00
				39 01 00 00 00 00 02 5B 00
				39 00 00 00 00 00 04 FF 98 81 06
				39 00 00 00 00 00 04 FF 98 81 06
				39 00 00 00 00 00 02 00 00
				39 00 00 00 00 00 02 01 00
				39 00 00 00 00 00 02 02 00
				39 00 00 00 00 00 02 03 0E
				39 00 00 00 00 00 02 04 00
				39 00 00 00 00 00 02 05 1C
				39 00 00 00 00 00 02 06 00
				39 00 00 00 00 00 02 07 2A
				39 00 00 00 00 00 02 08 00
				39 00 00 00 00 00 02 09 37
				39 00 00 00 00 00 02 0A 00
				39 00 00 00 00 00 02 0B 45
				39 00 00 00 00 00 02 0C 00
				39 00 00 00 00 00 02 0D 52
				39 00 00 00 00 00 02 0E 00
				39 00 00 00 00 00 02 0F 5E
				39 00 00 00 00 00 02 10 00
				39 00 00 00 00 00 02 11 6B
				39 00 00 00 00 00 02 12 00
				39 00 00 00 00 00 02 13 79
				39 00 00 00 00 00 02 14 00
				39 00 00 00 00 00 02 15 86
				39 00 00 00 00 00 02 16 00
				39 00 00 00 00 00 02 17 92
				39 00 00 00 00 00 02 18 00
				39 00 00 00 00 00 02 19 A0
				39 00 00 00 00 00 02 1A 00
				39 00 00 00 00 00 02 1B AD
				39 00 00 00 00 00 02 1C 00
				39 00 00 00 00 00 02 1D BA
				39 00 00 00 00 00 02 1E 00
				39 00 00 00 00 00 02 1F C6
				39 00 00 00 00 00 02 20 00
				39 00 00 00 00 00 02 21 D4
				39 00 00 00 00 00 02 22 00
				39 00 00 00 00 00 02 23 E1
				39 00 00 00 00 00 02 24 00
				39 00 00 00 00 00 02 25 F0
				39 00 00 00 00 00 02 26 00
				39 00 00 00 00 00 02 27 FE
				39 00 00 00 00 00 02 28 01
				39 00 00 00 00 00 02 29 0B
				39 00 00 00 00 00 02 2A 01
				39 00 00 00 00 00 02 2B 17
				39 00 00 00 00 00 02 2C 01
				39 00 00 00 00 00 02 2D 24
				39 00 00 00 00 00 02 2E 01
				39 00 00 00 00 00 02 2F 2F
				39 00 00 00 00 00 02 30 01
				39 00 00 00 00 00 02 31 3B
				39 01 00 00 00 00 02 32 01
				39 00 00 00 00 00 02 33 48
				39 00 00 00 00 00 02 34 01
				39 00 00 00 00 00 02 35 56
				39 00 00 00 00 00 02 36 01
				39 00 00 00 00 00 02 37 72
				39 00 00 00 00 00 02 38 01
				39 00 00 00 00 00 02 39 8D
				39 00 00 00 00 00 02 3A 01
				39 00 00 00 00 00 02 3B A9
				39 00 00 00 00 00 02 3C 01
				39 00 00 00 00 00 02 3D C3
				39 00 00 00 00 00 02 3E 01
				39 00 00 00 00 00 02 3F DE
				39 00 00 00 00 00 02 40 01
				39 00 00 00 00 00 02 41 F9
				39 00 00 00 00 00 02 42 02
				39 00 00 00 00 00 02 43 14
				39 00 00 00 00 00 02 44 02
				39 00 00 00 00 00 02 45 31
				39 00 00 00 00 00 02 46 02
				39 00 00 00 00 00 02 47 4D
				39 00 00 00 00 00 02 48 02
				39 00 00 00 00 00 02 49 69
				39 00 00 00 00 00 02 4A 02
				39 00 00 00 00 00 02 4B 85
				39 00 00 00 00 00 02 4C 02
				39 00 00 00 00 00 02 4D A4
				39 00 00 00 00 00 02 4E 02
				39 00 00 00 00 00 02 4F C2
				39 00 00 00 00 00 02 50 02
				39 00 00 00 00 00 02 51 DC
				39 00 00 00 00 00 02 52 02
				39 00 00 00 00 00 02 53 F7
				39 00 00 00 00 00 02 54 03
				39 00 00 00 00 00 02 55 14
				39 00 00 00 00 00 02 56 03
				39 00 00 00 00 00 02 57 33
				39 00 00 00 00 00 02 58 03
				39 00 00 00 00 00 02 59 4E
				39 00 00 00 00 00 02 5A 03
				39 01 00 00 00 00 02 5B 6C
				39 00 00 00 00 00 04 FF 98 81 07
				39 00 00 00 00 00 04 FF 98 81 07
				39 00 00 00 00 00 02 00 00
				39 00 00 00 00 00 02 01 00
				39 00 00 00 00 00 02 02 00
				39 00 00 00 00 00 02 03 05
				39 00 00 00 00 00 02 04 00
				39 00 00 00 00 00 02 05 0D
				39 00 00 00 00 00 02 06 00
				39 00 00 00 00 00 02 07 16
				39 00 00 00 00 00 02 08 00
				39 00 00 00 00 00 02 09 22
				39 00 00 00 00 00 02 0A 00
				39 00 00 00 00 00 02 0B 2F
				39 00 00 00 00 00 02 0C 00
				39 00 00 00 00 00 02 0D 38
				39 00 00 00 00 00 02 0E 00
				39 00 00 00 00 00 02 0F 47
				39 00 00 00 00 00 02 10 00
				39 00 00 00 00 00 02 11 55
				39 00 00 00 00 00 02 12 00
				39 00 00 00 00 00 02 13 63
				39 00 00 00 00 00 02 14 00
				39 00 00 00 00 00 02 15 70
				39 00 00 00 00 00 02 16 00
				39 00 00 00 00 00 02 17 7D
				39 00 00 00 00 00 02 18 00
				39 00 00 00 00 00 02 19 89
				39 00 00 00 00 00 02 1A 00
				39 00 00 00 00 00 02 1B 96
				39 00 00 00 00 00 02 1C 00
				39 00 00 00 00 00 02 1D A2
				39 00 00 00 00 00 02 1E 00
				39 00 00 00 00 00 02 1F AF
				39 00 00 00 00 00 02 20 00
				39 00 00 00 00 00 02 21 BA
				39 00 00 00 00 00 02 22 00
				39 00 00 00 00 00 02 23 C6
				39 00 00 00 00 00 02 24 00
				39 00 00 00 00 00 02 25 D1
				39 00 00 00 00 00 02 26 00
				39 00 00 00 00 00 02 27 DE
				39 00 00 00 00 00 02 28 00
				39 00 00 00 00 00 02 29 EB
				39 00 00 00 00 00 02 2A 00
				39 00 00 00 00 00 02 2B F8
				39 00 00 00 00 00 02 2C 01
				39 00 00 00 00 00 02 2D 04
				39 00 00 00 00 00 02 2E 01
				39 00 00 00 00 00 02 2F 10
				39 00 00 00 00 00 02 30 01
				39 00 00 00 00 00 02 31 1B
				39 01 00 00 00 00 02 32 01
				39 00 00 00 00 00 02 33 26
				39 00 00 00 00 00 02 34 01
				39 00 00 00 00 00 02 35 30
				39 00 00 00 00 00 02 36 01
				39 00 00 00 00 00 02 37 46
				39 00 00 00 00 00 02 38 01
				39 00 00 00 00 00 02 39 5F
				39 00 00 00 00 00 02 3A 01
				39 00 00 00 00 00 02 3B 79
				39 00 00 00 00 00 02 3C 01
				39 00 00 00 00 00 02 3D 92
				39 00 00 00 00 00 02 3E 01
				39 00 00 00 00 00 02 3F AA
				39 00 00 00 00 00 02 40 01
				39 00 00 00 00 00 02 41 C2
				39 00 00 00 00 00 02 42 01
				39 00 00 00 00 00 02 43 DA
				39 00 00 00 00 00 02 44 01
				39 00 00 00 00 00 02 45 F2
				39 00 00 00 00 00 02 46 02
				39 00 00 00 00 00 02 47 0A
				39 00 00 00 00 00 02 48 02
				39 00 00 00 00 00 02 49 23
				39 00 00 00 00 00 02 4A 02
				39 00 00 00 00 00 02 4B 3D
				39 00 00 00 00 00 02 4C 02
				39 00 00 00 00 00 02 4D 56
				39 00 00 00 00 00 02 4E 02
				39 00 00 00 00 00 02 4F 6E
				39 00 00 00 00 00 02 50 02
				39 00 00 00 00 00 02 51 88
				39 00 00 00 00 00 02 52 02
				39 00 00 00 00 00 02 53 A3
				39 00 00 00 00 00 02 54 02
				39 00 00 00 00 00 02 55 BF
				39 00 00 00 00 00 02 56 02
				39 00 00 00 00 00 02 57 D5
				39 00 00 00 00 00 02 58 02
				39 00 00 00 00 00 02 59 EE
				39 00 00 00 00 00 02 5A 03
				39 00 00 00 00 00 02 5B 08
				39 00 00 00 00 00 04 FF 98 81 00
				39 01 00 00 00 00 04 FF 98 81 00 ];
		qcom,mdss-dsi-panel-eye-command04 = [
				39 00 00 00 00 00 04 FF 98 81 01
				39 00 00 00 00 00 04 FF 98 81 01
				39 00 00 00 00 00 02 A0 00
				39 00 00 00 00 00 02 A1 17
				39 00 00 00 00 00 02 A2 27
				39 00 00 00 00 00 02 A3 16
				39 00 00 00 00 00 02 A4 18
				39 00 00 00 00 00 02 A5 2A
				39 00 00 00 00 00 02 A6 1F
				39 00 00 00 00 00 02 A7 21
				39 00 00 00 00 00 02 A8 8C
				39 00 00 00 00 00 02 A9 1C
				39 00 00 00 00 00 02 AA 28
				39 00 00 00 00 00 02 AB 78
				39 00 00 00 00 00 02 AC 1C
				39 00 00 00 00 00 02 AD 1D
				39 00 00 00 00 00 02 AE 52
				39 00 00 00 00 00 02 AF 28
				39 00 00 00 00 00 02 B0 2B
				39 00 00 00 00 00 02 B1 56
				39 00 00 00 00 00 02 B2 64
				39 00 00 00 00 00 02 B3 32
				39 00 00 00 00 00 02 C0 00
				39 00 00 00 00 00 02 C1 17
				39 00 00 00 00 00 02 C2 27
				39 00 00 00 00 00 02 C3 16
				39 00 00 00 00 00 02 C4 18
				39 00 00 00 00 00 02 C5 2A
				39 00 00 00 00 00 02 C6 1F
				39 00 00 00 00 00 02 C7 21
				39 00 00 00 00 00 02 C8 8C
				39 00 00 00 00 00 02 C9 1C
				39 00 00 00 00 00 02 CA 28
				39 00 00 00 00 00 02 CB 78
				39 00 00 00 00 00 02 CC 1C
				39 00 00 00 00 00 02 CD 1D
				39 00 00 00 00 00 02 CE 52
				39 00 00 00 00 00 02 CF 28
				39 00 00 00 00 00 02 D0 2B
				39 00 00 00 00 00 02 D1 56
				39 00 00 00 00 00 02 D2 64
				39 01 00 00 00 00 02 D3 32
				39 00 00 00 00 00 04 FF 98 81 05
				39 00 00 00 00 00 04 FF 98 81 05
				39 00 00 00 00 00 02 85 48
				39 00 00 00 00 00 02 00 00
				39 00 00 00 00 00 02 01 00
				39 00 00 00 00 00 02 02 00
				39 00 00 00 00 00 02 03 1A
				39 00 00 00 00 00 02 04 00
				39 00 00 00 00 00 02 05 26
				39 00 00 00 00 00 02 06 00
				39 00 00 00 00 00 02 07 35
				39 00 00 00 00 00 02 08 00
				39 00 00 00 00 00 02 09 44
				39 00 00 00 00 00 02 0A 00
				39 00 00 00 00 00 02 0B 54
				39 00 00 00 00 00 02 0C 00
				39 00 00 00 00 00 02 0D 63
				39 00 00 00 00 00 02 0E 00
				39 00 00 00 00 00 02 0F 72
				39 00 00 00 00 00 02 10 00
				39 00 00 00 00 00 02 11 80
				39 00 00 00 00 00 02 12 00
				39 00 00 00 00 00 02 13 8F
				39 00 00 00 00 00 02 14 00
				39 00 00 00 00 00 02 15 9E
				39 00 00 00 00 00 02 16 00
				39 00 00 00 00 00 02 17 AE
				39 00 00 00 00 00 02 18 00
				39 00 00 00 00 00 02 19 BD
				39 00 00 00 00 00 02 1A 00
				39 00 00 00 00 00 02 1B CB
				39 00 00 00 00 00 02 1C 00
				39 00 00 00 00 00 02 1D DA
				39 00 00 00 00 00 02 1E 00
				39 00 00 00 00 00 02 1F EB
				39 00 00 00 00 00 02 20 00
				39 00 00 00 00 00 02 21 FC
				39 00 00 00 00 00 02 22 01
				39 00 00 00 00 00 02 23 0C
				39 00 00 00 00 00 02 24 01
				39 00 00 00 00 00 02 25 1A
				39 00 00 00 00 00 02 26 01
				39 00 00 00 00 00 02 27 27
				39 00 00 00 00 00 02 28 01
				39 00 00 00 00 00 02 29 34
				39 00 00 00 00 00 02 2A 01
				39 00 00 00 00 00 02 2B 42
				39 00 00 00 00 00 02 2C 01
				39 00 00 00 00 00 02 2D 53
				39 00 00 00 00 00 02 2E 01
				39 00 00 00 00 00 02 2F 63
				39 00 00 00 00 00 02 30 01
				39 00 00 00 00 00 02 31 75
				39 01 00 00 00 00 02 32 01
				39 00 00 00 00 00 02 33 85
				39 00 00 00 00 00 02 34 01
				39 00 00 00 00 00 02 35 95
				39 00 00 00 00 00 02 36 01
				39 00 00 00 00 00 02 37 B4
				39 00 00 00 00 00 02 38 01
				39 00 00 00 00 00 02 39 D3
				39 00 00 00 00 00 02 3A 01
				39 00 00 00 00 00 02 3B F3
				39 00 00 00 00 00 02 3C 02
				39 00 00 00 00 00 02 3D 13
				39 00 00 00 00 00 02 3E 02
				39 00 00 00 00 00 02 3F 34
				39 00 00 00 00 00 02 40 02
				39 00 00 00 00 00 02 41 50
				39 00 00 00 00 00 02 42 02
				39 00 00 00 00 00 02 43 70
				39 00 00 00 00 00 02 44 02
				39 00 00 00 00 00 02 45 93
				39 00 00 00 00 00 02 46 02
				39 00 00 00 00 00 02 47 B7
				39 00 00 00 00 00 02 48 02
				39 00 00 00 00 00 02 49 D5
				39 00 00 00 00 00 02 4A 02
				39 00 00 00 00 00 02 4B F5
				39 00 00 00 00 00 02 4C 03
				39 00 00 00 00 00 02 4D 1A
				39 00 00 00 00 00 02 4E 03
				39 00 00 00 00 00 02 4F 3A
				39 00 00 00 00 00 02 50 03
				39 00 00 00 00 00 02 51 5A
				39 00 00 00 00 00 02 52 03
				39 00 00 00 00 00 02 53 7A
				39 00 00 00 00 00 02 54 03
				39 00 00 00 00 00 02 55 9C
				39 00 00 00 00 00 02 56 03
				39 00 00 00 00 00 02 57 BE
				39 00 00 00 00 00 02 58 03
				39 00 00 00 00 00 02 59 DD
				39 00 00 00 00 00 02 5A 00
				39 01 00 00 00 00 02 5B 00
				39 00 00 00 00 00 04 FF 98 81 06
				39 00 00 00 00 00 04 FF 98 81 06
				39 00 00 00 00 00 02 00 00
				39 00 00 00 00 00 02 01 00
				39 00 00 00 00 00 02 02 00
				39 00 00 00 00 00 02 03 0E
				39 00 00 00 00 00 02 04 00
				39 00 00 00 00 00 02 05 1B
				39 00 00 00 00 00 02 06 00
				39 00 00 00 00 00 02 07 29
				39 00 00 00 00 00 02 08 00
				39 00 00 00 00 00 02 09 36
				39 00 00 00 00 00 02 0A 00
				39 00 00 00 00 00 02 0B 43
				39 00 00 00 00 00 02 0C 00
				39 00 00 00 00 00 02 0D 50
				39 00 00 00 00 00 02 0E 00
				39 00 00 00 00 00 02 0F 5C
				39 00 00 00 00 00 02 10 00
				39 00 00 00 00 00 02 11 69
				39 00 00 00 00 00 02 12 00
				39 00 00 00 00 00 02 13 76
				39 00 00 00 00 00 02 14 00
				39 00 00 00 00 00 02 15 82
				39 00 00 00 00 00 02 16 00
				39 00 00 00 00 00 02 17 8E
				39 00 00 00 00 00 02 18 00
				39 00 00 00 00 00 02 19 9C
				39 00 00 00 00 00 02 1A 00
				39 00 00 00 00 00 02 1B A9
				39 00 00 00 00 00 02 1C 00
				39 00 00 00 00 00 02 1D B6
				39 00 00 00 00 00 02 1E 00
				39 00 00 00 00 00 02 1F C2
				39 00 00 00 00 00 02 20 00
				39 00 00 00 00 00 02 21 CD
				39 00 00 00 00 00 02 22 00
				39 00 00 00 00 00 02 23 DB
				39 00 00 00 00 00 02 24 00
				39 00 00 00 00 00 02 25 E9
				39 00 00 00 00 00 02 26 00
				39 00 00 00 00 00 02 27 F7
				39 00 00 00 00 00 02 28 01
				39 00 00 00 00 00 02 29 04
				39 00 00 00 00 00 02 2A 01
				39 00 00 00 00 00 02 2B 10
				39 00 00 00 00 00 02 2C 01
				39 00 00 00 00 00 02 2D 1C
				39 00 00 00 00 00 02 2E 01
				39 00 00 00 00 00 02 2F 28
				39 00 00 00 00 00 02 30 01
				39 00 00 00 00 00 02 31 33
				39 01 00 00 00 00 02 32 01
				39 00 00 00 00 00 02 33 3F
				39 00 00 00 00 00 02 34 01
				39 00 00 00 00 00 02 35 4D
				39 00 00 00 00 00 02 36 01
				39 00 00 00 00 00 02 37 68
				39 00 00 00 00 00 02 38 01
				39 00 00 00 00 00 02 39 83
				39 00 00 00 00 00 02 3A 01
				39 00 00 00 00 00 02 3B 9E
				39 00 00 00 00 00 02 3C 01
				39 00 00 00 00 00 02 3D B8
				39 00 00 00 00 00 02 3E 01
				39 00 00 00 00 00 02 3F D2
				39 00 00 00 00 00 02 40 01
				39 00 00 00 00 00 02 41 EB
				39 00 00 00 00 00 02 42 02
				39 00 00 00 00 00 02 43 06
				39 00 00 00 00 00 02 44 02
				39 00 00 00 00 00 02 45 21
				39 00 00 00 00 00 02 46 02
				39 00 00 00 00 00 02 47 3E
				39 00 00 00 00 00 02 48 02
				39 00 00 00 00 00 02 49 58
				39 00 00 00 00 00 02 4A 02
				39 00 00 00 00 00 02 4B 74
				39 00 00 00 00 00 02 4C 02
				39 00 00 00 00 00 02 4D 90
				39 00 00 00 00 00 02 4E 02
				39 00 00 00 00 00 02 4F AF
				39 00 00 00 00 00 02 50 02
				39 00 00 00 00 00 02 51 CA
				39 00 00 00 00 00 02 52 02
				39 00 00 00 00 00 02 53 E3
				39 00 00 00 00 00 02 54 02
				39 00 00 00 00 00 02 55 FF
				39 00 00 00 00 00 02 56 03
				39 00 00 00 00 00 02 57 1C
				39 00 00 00 00 00 02 58 03
				39 00 00 00 00 00 02 59 39
				39 00 00 00 00 00 02 5A 03
				39 01 00 00 00 00 02 5B 53
				39 00 00 00 00 00 04 FF 98 81 07
				39 00 00 00 00 00 04 FF 98 81 07
				39 00 00 00 00 00 02 00 00
				39 00 00 00 00 00 02 01 00
				39 00 00 00 00 00 02 02 00
				39 00 00 00 00 00 02 03 04
				39 00 00 00 00 00 02 04 00
				39 00 00 00 00 00 02 05 09
				39 00 00 00 00 00 02 06 00
				39 00 00 00 00 00 02 07 11
				39 00 00 00 00 00 02 08 00
				39 00 00 00 00 00 02 09 1B
				39 00 00 00 00 00 02 0A 00
				39 00 00 00 00 00 02 0B 29
				39 00 00 00 00 00 02 0C 00
				39 00 00 00 00 00 02 0D 31
				39 00 00 00 00 00 02 0E 00
				39 00 00 00 00 00 02 0F 41
				39 00 00 00 00 00 02 10 00
				39 00 00 00 00 00 02 11 50
				39 00 00 00 00 00 02 12 00
				39 00 00 00 00 00 02 13 5C
				39 00 00 00 00 00 02 14 00
				39 00 00 00 00 00 02 15 69
				39 00 00 00 00 00 02 16 00
				39 00 00 00 00 00 02 17 76
				39 00 00 00 00 00 02 18 00
				39 00 00 00 00 00 02 19 82
				39 00 00 00 00 00 02 1A 00
				39 00 00 00 00 00 02 1B 8D
				39 00 00 00 00 00 02 1C 00
				39 00 00 00 00 00 02 1D 99
				39 00 00 00 00 00 02 1E 00
				39 00 00 00 00 00 02 1F A6
				39 00 00 00 00 00 02 20 00
				39 00 00 00 00 00 02 21 B1
				39 00 00 00 00 00 02 22 00
				39 00 00 00 00 00 02 23 BC
				39 00 00 00 00 00 02 24 00
				39 00 00 00 00 00 02 25 C7
				39 00 00 00 00 00 02 26 00
				39 00 00 00 00 00 02 27 D2
				39 00 00 00 00 00 02 28 00
				39 00 00 00 00 00 02 29 DE
				39 00 00 00 00 00 02 2A 00
				39 00 00 00 00 00 02 2B EB
				39 00 00 00 00 00 02 2C 00
				39 00 00 00 00 00 02 2D F7
				39 00 00 00 00 00 02 2E 01
				39 00 00 00 00 00 02 2F 03
				39 00 00 00 00 00 02 30 01
				39 00 00 00 00 00 02 31 0E
				39 01 00 00 00 00 02 32 01
				39 00 00 00 00 00 02 33 19
				39 00 00 00 00 00 02 34 01
				39 00 00 00 00 00 02 35 23
				39 00 00 00 00 00 02 36 01
				39 00 00 00 00 00 02 37 37
				39 00 00 00 00 00 02 38 01
				39 00 00 00 00 00 02 39 4D
				39 00 00 00 00 00 02 3A 01
				39 00 00 00 00 00 02 3B 66
				39 00 00 00 00 00 02 3C 01
				39 00 00 00 00 00 02 3D 7E
				39 00 00 00 00 00 02 3E 01
				39 00 00 00 00 00 02 3F 95
				39 00 00 00 00 00 02 40 01
				39 00 00 00 00 00 02 41 AC
				39 00 00 00 00 00 02 42 01
				39 00 00 00 00 00 02 43 C2
				39 00 00 00 00 00 02 44 01
				39 00 00 00 00 00 02 45 D9
				39 00 00 00 00 00 02 46 01
				39 00 00 00 00 00 02 47 F0
				39 00 00 00 00 00 02 48 02
				39 00 00 00 00 00 02 49 07
				39 00 00 00 00 00 02 4A 02
				39 00 00 00 00 00 02 4B 1F
				39 00 00 00 00 00 02 4C 02
				39 00 00 00 00 00 02 4D 38
				39 00 00 00 00 00 02 4E 02
				39 00 00 00 00 00 02 4F 4F
				39 00 00 00 00 00 02 50 02
				39 00 00 00 00 00 02 51 67
				39 00 00 00 00 00 02 52 02
				39 00 00 00 00 00 02 53 7F
				39 00 00 00 00 00 02 54 02
				39 00 00 00 00 00 02 55 99
				39 00 00 00 00 00 02 56 02
				39 00 00 00 00 00 02 57 B3
				39 00 00 00 00 00 02 58 02
				39 00 00 00 00 00 02 59 CA
				39 00 00 00 00 00 02 5A 02
				39 00 00 00 00 00 02 5B E0
				39 00 00 00 00 00 04 FF 98 81 00
				39 01 00 00 00 00 04 FF 98 81 00];
		qcom,mdss-dsi-panel-eye-command05 = [
				39 00 00 00 00 00 04 FF 98 81 01
				39 00 00 00 00 00 04 FF 98 81 01
				39 00 00 00 00 00 02 A0 00
				39 00 00 00 00 00 02 A1 17
				39 00 00 00 00 00 02 A2 27
				39 00 00 00 00 00 02 A3 16
				39 00 00 00 00 00 02 A4 18
				39 00 00 00 00 00 02 A5 2A
				39 00 00 00 00 00 02 A6 1F
				39 00 00 00 00 00 02 A7 21
				39 00 00 00 00 00 02 A8 8C
				39 00 00 00 00 00 02 A9 1C
				39 00 00 00 00 00 02 AA 28
				39 00 00 00 00 00 02 AB 78
				39 00 00 00 00 00 02 AC 1C
				39 00 00 00 00 00 02 AD 1D
				39 00 00 00 00 00 02 AE 52
				39 00 00 00 00 00 02 AF 28
				39 00 00 00 00 00 02 B0 2B
				39 00 00 00 00 00 02 B1 56
				39 00 00 00 00 00 02 B2 64
				39 00 00 00 00 00 02 B3 32
				39 00 00 00 00 00 02 C0 00
				39 00 00 00 00 00 02 C1 17
				39 00 00 00 00 00 02 C2 27
				39 00 00 00 00 00 02 C3 16
				39 00 00 00 00 00 02 C4 18
				39 00 00 00 00 00 02 C5 2A
				39 00 00 00 00 00 02 C6 1F
				39 00 00 00 00 00 02 C7 21
				39 00 00 00 00 00 02 C8 8C
				39 00 00 00 00 00 02 C9 1C
				39 00 00 00 00 00 02 CA 28
				39 00 00 00 00 00 02 CB 78
				39 00 00 00 00 00 02 CC 1C
				39 00 00 00 00 00 02 CD 1D
				39 00 00 00 00 00 02 CE 52
				39 00 00 00 00 00 02 CF 28
				39 00 00 00 00 00 02 D0 2B
				39 00 00 00 00 00 02 D1 56
				39 00 00 00 00 00 02 D2 64
				39 01 00 00 00 00 02 D3 32
				39 00 00 00 00 00 04 FF 98 81 05
				39 00 00 00 00 00 04 FF 98 81 05
				39 00 00 00 00 00 02 85 48
				39 00 00 00 00 00 02 00 00
				39 00 00 00 00 00 02 01 00
				39 00 00 00 00 00 02 02 00
				39 00 00 00 00 00 02 03 1B
				39 00 00 00 00 00 02 04 00
				39 00 00 00 00 00 02 05 27
				39 00 00 00 00 00 02 06 00
				39 00 00 00 00 00 02 07 36
				39 00 00 00 00 00 02 08 00
				39 00 00 00 00 00 02 09 45
				39 00 00 00 00 00 02 0A 00
				39 00 00 00 00 00 02 0B 54
				39 00 00 00 00 00 02 0C 00
				39 00 00 00 00 00 02 0D 63
				39 00 00 00 00 00 02 0E 00
				39 00 00 00 00 00 02 0F 73
				39 00 00 00 00 00 02 10 00
				39 00 00 00 00 00 02 11 81
				39 00 00 00 00 00 02 12 00
				39 00 00 00 00 00 02 13 8F
				39 00 00 00 00 00 02 14 00
				39 00 00 00 00 00 02 15 9F
				39 00 00 00 00 00 02 16 00
				39 00 00 00 00 00 02 17 AE
				39 00 00 00 00 00 02 18 00
				39 00 00 00 00 00 02 19 BD
				39 00 00 00 00 00 02 1A 00
				39 00 00 00 00 00 02 1B CB
				39 00 00 00 00 00 02 1C 00
				39 00 00 00 00 00 02 1D DA
				39 00 00 00 00 00 02 1E 00
				39 00 00 00 00 00 02 1F EB
				39 00 00 00 00 00 02 20 00
				39 00 00 00 00 00 02 21 FC
				39 00 00 00 00 00 02 22 01
				39 00 00 00 00 00 02 23 0C
				39 00 00 00 00 00 02 24 01
				39 00 00 00 00 00 02 25 1B
				39 00 00 00 00 00 02 26 01
				39 00 00 00 00 00 02 27 27
				39 00 00 00 00 00 02 28 01
				39 00 00 00 00 00 02 29 34
				39 00 00 00 00 00 02 2A 01
				39 00 00 00 00 00 02 2B 42
				39 00 00 00 00 00 02 2C 01
				39 00 00 00 00 00 02 2D 53
				39 00 00 00 00 00 02 2E 01
				39 00 00 00 00 00 02 2F 63
				39 00 00 00 00 00 02 30 01
				39 00 00 00 00 00 02 31 75
				39 01 00 00 00 00 02 32 01
				39 00 00 00 00 00 02 33 85
				39 00 00 00 00 00 02 34 01
				39 00 00 00 00 00 02 35 95
				39 00 00 00 00 00 02 36 01
				39 00 00 00 00 00 02 37 B4
				39 00 00 00 00 00 02 38 01
				39 00 00 00 00 00 02 39 D3
				39 00 00 00 00 00 02 3A 01
				39 00 00 00 00 00 02 3B F3
				39 00 00 00 00 00 02 3C 02
				39 00 00 00 00 00 02 3D 13
				39 00 00 00 00 00 02 3E 02
				39 00 00 00 00 00 02 3F 34
				39 00 00 00 00 00 02 40 02
				39 00 00 00 00 00 02 41 50
				39 00 00 00 00 00 02 42 02
				39 00 00 00 00 00 02 43 70
				39 00 00 00 00 00 02 44 02
				39 00 00 00 00 00 02 45 93
				39 00 00 00 00 00 02 46 02
				39 00 00 00 00 00 02 47 B7
				39 00 00 00 00 00 02 48 02
				39 00 00 00 00 00 02 49 D5
				39 00 00 00 00 00 02 4A 02
				39 00 00 00 00 00 02 4B F5
				39 00 00 00 00 00 02 4C 03
				39 00 00 00 00 00 02 4D 1A
				39 00 00 00 00 00 02 4E 03
				39 00 00 00 00 00 02 4F 3A
				39 00 00 00 00 00 02 50 03
				39 00 00 00 00 00 02 51 5A
				39 00 00 00 00 00 02 52 03
				39 00 00 00 00 00 02 53 7A
				39 00 00 00 00 00 02 54 03
				39 00 00 00 00 00 02 55 9C
				39 00 00 00 00 00 02 56 03
				39 00 00 00 00 00 02 57 BE
				39 00 00 00 00 00 02 58 03
				39 00 00 00 00 00 02 59 DD
				39 00 00 00 00 00 02 5A 00
				39 01 00 00 00 00 02 5B 00
				39 00 00 00 00 00 04 FF 98 81 06
				39 00 00 00 00 00 04 FF 98 81 06
				39 00 00 00 00 00 02 00 00
				39 00 00 00 00 00 02 01 00
				39 00 00 00 00 00 02 02 00
				39 00 00 00 00 00 02 03 0D
				39 00 00 00 00 00 02 04 00
				39 00 00 00 00 00 02 05 1A
				39 00 00 00 00 00 02 06 00
				39 00 00 00 00 00 02 07 28
				39 00 00 00 00 00 02 08 00
				39 00 00 00 00 00 02 09 34
				39 00 00 00 00 00 02 0A 00
				39 00 00 00 00 00 02 0B 42
				39 00 00 00 00 00 02 0C 00
				39 00 00 00 00 00 02 0D 4E
				39 00 00 00 00 00 02 0E 00
				39 00 00 00 00 00 02 0F 5A
				39 00 00 00 00 00 02 10 00
				39 00 00 00 00 00 02 11 66
				39 00 00 00 00 00 02 12 00
				39 00 00 00 00 00 02 13 73
				39 00 00 00 00 00 02 14 00
				39 00 00 00 00 00 02 15 80
				39 00 00 00 00 00 02 16 00
				39 00 00 00 00 00 02 17 8B
				39 00 00 00 00 00 02 18 00
				39 00 00 00 00 00 02 19 98
				39 00 00 00 00 00 02 1A 00
				39 00 00 00 00 00 02 1B A5
				39 00 00 00 00 00 02 1C 00
				39 00 00 00 00 00 02 1D B2
				39 00 00 00 00 00 02 1E 00
				39 00 00 00 00 00 02 1F BD
				39 00 00 00 00 00 02 20 00
				39 00 00 00 00 00 02 21 C9
				39 00 00 00 00 00 02 22 00
				39 00 00 00 00 00 02 23 D6
				39 00 00 00 00 00 02 24 00
				39 00 00 00 00 00 02 25 E3
				39 00 00 00 00 00 02 26 00
				39 00 00 00 00 00 02 27 F1
				39 00 00 00 00 00 02 28 00
				39 00 00 00 00 00 02 29 FE
				39 00 00 00 00 00 02 2A 01
				39 00 00 00 00 00 02 2B 0A
				39 00 00 00 00 00 02 2C 01
				39 00 00 00 00 00 02 2D 16
				39 00 00 00 00 00 02 2E 01
				39 00 00 00 00 00 02 2F 22
				39 00 00 00 00 00 02 30 01
				39 00 00 00 00 00 02 31 2D
				39 01 00 00 00 00 02 32 01
				39 00 00 00 00 00 02 33 38
				39 00 00 00 00 00 02 34 01
				39 00 00 00 00 00 02 35 44
				39 00 00 00 00 00 02 36 01
				39 00 00 00 00 00 02 37 5F
				39 00 00 00 00 00 02 38 01
				39 00 00 00 00 00 02 39 79
				39 00 00 00 00 00 02 3A 01
				39 00 00 00 00 00 02 3B 94
				39 00 00 00 00 00 02 3C 01
				39 00 00 00 00 00 02 3D AD
				39 00 00 00 00 00 02 3E 01
				39 00 00 00 00 00 02 3F C7
				39 00 00 00 00 00 02 40 01
				39 00 00 00 00 00 02 41 E0
				39 00 00 00 00 00 02 42 01
				39 00 00 00 00 00 02 43 F9
				39 00 00 00 00 00 02 44 02
				39 00 00 00 00 00 02 45 14
				39 00 00 00 00 00 02 46 02
				39 00 00 00 00 00 02 47 2F
				39 00 00 00 00 00 02 48 02
				39 00 00 00 00 00 02 49 4A
				39 00 00 00 00 00 02 4A 02
				39 00 00 00 00 00 02 4B 64
				39 00 00 00 00 00 02 4C 02
				39 00 00 00 00 00 02 4D 7F
				39 00 00 00 00 00 02 4E 02
				39 00 00 00 00 00 02 4F 9C
				39 00 00 00 00 00 02 50 02
				39 00 00 00 00 00 02 51 BA
				39 00 00 00 00 00 02 52 02
				39 00 00 00 00 00 02 53 D2
				39 00 00 00 00 00 02 54 02
				39 00 00 00 00 00 02 55 EC
				39 00 00 00 00 00 02 56 03
				39 00 00 00 00 00 02 57 07
				39 00 00 00 00 00 02 58 03
				39 00 00 00 00 00 02 59 24
				39 00 00 00 00 00 02 5A 03
				39 01 00 00 00 00 02 5B 3F
				39 00 00 00 00 00 04 FF 98 81 07
				39 00 00 00 00 00 04 FF 98 81 07
				39 00 00 00 00 00 02 00 00
				39 00 00 00 00 00 02 01 00
				39 00 00 00 00 00 02 02 00
				39 00 00 00 00 00 02 03 03
				39 00 00 00 00 00 02 04 00
				39 00 00 00 00 00 02 05 08
				39 00 00 00 00 00 02 06 00
				39 00 00 00 00 00 02 07 0F
				39 00 00 00 00 00 02 08 00
				39 00 00 00 00 00 02 09 16
				39 00 00 00 00 00 02 0A 00
				39 00 00 00 00 00 02 0B 21
				39 00 00 00 00 00 02 0C 00
				39 00 00 00 00 00 02 0D 2A
				39 00 00 00 00 00 02 0E 00
				39 00 00 00 00 00 02 0F 3A
				39 00 00 00 00 00 02 10 00
				39 00 00 00 00 00 02 11 49
				39 00 00 00 00 00 02 12 00
				39 00 00 00 00 00 02 13 56
				39 00 00 00 00 00 02 14 00
				39 00 00 00 00 00 02 15 63
				39 00 00 00 00 00 02 16 00
				39 00 00 00 00 00 02 17 6F
				39 00 00 00 00 00 02 18 00
				39 00 00 00 00 00 02 19 7B
				39 00 00 00 00 00 02 1A 00
				39 00 00 00 00 00 02 1B 86
				39 00 00 00 00 00 02 1C 00
				39 00 00 00 00 00 02 1D 91
				39 00 00 00 00 00 02 1E 00
				39 00 00 00 00 00 02 1F 9D
				39 00 00 00 00 00 02 20 00
				39 00 00 00 00 00 02 21 A8
				39 00 00 00 00 00 02 22 00
				39 00 00 00 00 00 02 23 B3
				39 00 00 00 00 00 02 24 00
				39 00 00 00 00 00 02 25 BD
				39 00 00 00 00 00 02 26 00
				39 00 00 00 00 00 02 27 C8
				39 00 00 00 00 00 02 28 00
				39 00 00 00 00 00 02 29 D2
				39 00 00 00 00 00 02 2A 00
				39 00 00 00 00 00 02 2B DE
				39 00 00 00 00 00 02 2C 00
				39 00 00 00 00 00 02 2D EA
				39 00 00 00 00 00 02 2E 00
				39 00 00 00 00 00 02 2F F5
				39 00 00 00 00 00 02 30 01
				39 00 00 00 00 00 02 31 01
				39 01 00 00 00 00 02 32 01
				39 00 00 00 00 00 02 33 0C
				39 00 00 00 00 00 02 34 01
				39 00 00 00 00 00 02 35 16
				39 00 00 00 00 00 02 36 01
				39 00 00 00 00 00 02 37 2A
				39 00 00 00 00 00 02 38 01
				39 00 00 00 00 00 02 39 3C
				39 00 00 00 00 00 02 3A 01
				39 00 00 00 00 00 02 3B 53
				39 00 00 00 00 00 02 3C 01
				39 00 00 00 00 00 02 3D 6B
				39 00 00 00 00 00 02 3E 01
				39 00 00 00 00 00 02 3F 81
				39 00 00 00 00 00 02 40 01
				39 00 00 00 00 00 02 41 97
				39 00 00 00 00 00 02 42 01
				39 00 00 00 00 00 02 43 AD
				39 00 00 00 00 00 02 44 01
				39 00 00 00 00 00 02 45 C2
				39 00 00 00 00 00 02 46 01
				39 00 00 00 00 00 02 47 D8
				39 00 00 00 00 00 02 48 01
				39 00 00 00 00 00 02 49 ED
				39 00 00 00 00 00 02 4A 02
				39 00 00 00 00 00 02 4B 03
				39 00 00 00 00 00 02 4C 02
				39 00 00 00 00 00 02 4D 1A
				39 00 00 00 00 00 02 4E 02
				39 00 00 00 00 00 02 4F 31
				39 00 00 00 00 00 02 50 02
				39 00 00 00 00 00 02 51 48
				39 00 00 00 00 00 02 52 02
				39 00 00 00 00 00 02 53 5F
				39 00 00 00 00 00 02 54 02
				39 00 00 00 00 00 02 55 75
				39 00 00 00 00 00 02 56 02
				39 00 00 00 00 00 02 57 8D
				39 00 00 00 00 00 02 58 02
				39 00 00 00 00 00 02 59 A5
				39 00 00 00 00 00 02 5A 02
				39 00 00 00 00 00 02 5B BF
				39 00 00 00 00 00 04 FF 98 81 00
				39 01 00 00 00 00 04 FF 98 81 00];
		qcom,mdss-dsi-panel-eye-command06 = [
				39 00 00 00 00 00 04 FF 98 81 01
				39 00 00 00 00 00 04 FF 98 81 01
				39 00 00 00 00 00 02 A0 00
				39 00 00 00 00 00 02 A1 17
				39 00 00 00 00 00 02 A2 27
				39 00 00 00 00 00 02 A3 16
				39 00 00 00 00 00 02 A4 18
				39 00 00 00 00 00 02 A5 2A
				39 00 00 00 00 00 02 A6 1F
				39 00 00 00 00 00 02 A7 21
				39 00 00 00 00 00 02 A8 8C
				39 00 00 00 00 00 02 A9 1C
				39 00 00 00 00 00 02 AA 28
				39 00 00 00 00 00 02 AB 78
				39 00 00 00 00 00 02 AC 1C
				39 00 00 00 00 00 02 AD 1D
				39 00 00 00 00 00 02 AE 52
				39 00 00 00 00 00 02 AF 28
				39 00 00 00 00 00 02 B0 2B
				39 00 00 00 00 00 02 B1 56
				39 00 00 00 00 00 02 B2 64
				39 00 00 00 00 00 02 B3 32
				39 00 00 00 00 00 02 C0 00
				39 00 00 00 00 00 02 C1 17
				39 00 00 00 00 00 02 C2 27
				39 00 00 00 00 00 02 C3 16
				39 00 00 00 00 00 02 C4 18
				39 00 00 00 00 00 02 C5 2A
				39 00 00 00 00 00 02 C6 1F
				39 00 00 00 00 00 02 C7 21
				39 00 00 00 00 00 02 C8 8C
				39 00 00 00 00 00 02 C9 1C
				39 00 00 00 00 00 02 CA 28
				39 00 00 00 00 00 02 CB 78
				39 00 00 00 00 00 02 CC 1C
				39 00 00 00 00 00 02 CD 1D
				39 00 00 00 00 00 02 CE 52
				39 00 00 00 00 00 02 CF 28
				39 00 00 00 00 00 02 D0 2B
				39 00 00 00 00 00 02 D1 56
				39 00 00 00 00 00 02 D2 64
				39 01 00 00 00 00 02 D3 32
				39 00 00 00 00 00 04 FF 98 81 05
				39 00 00 00 00 00 04 FF 98 81 05
				39 00 00 00 00 00 02 85 48
				39 00 00 00 00 00 02 00 00
				39 00 00 00 00 00 02 01 00
				39 00 00 00 00 00 02 02 00
				39 00 00 00 00 00 02 03 1B
				39 00 00 00 00 00 02 04 00
				39 00 00 00 00 00 02 05 28
				39 00 00 00 00 00 02 06 00
				39 00 00 00 00 00 02 07 37
				39 00 00 00 00 00 02 08 00
				39 00 00 00 00 00 02 09 45
				39 00 00 00 00 00 02 0A 00
				39 00 00 00 00 00 02 0B 55
				39 00 00 00 00 00 02 0C 00
				39 00 00 00 00 00 02 0D 64
				39 00 00 00 00 00 02 0E 00
				39 00 00 00 00 00 02 0F 73
				39 00 00 00 00 00 02 10 00
				39 00 00 00 00 00 02 11 81
				39 00 00 00 00 00 02 12 00
				39 00 00 00 00 00 02 13 90
				39 00 00 00 00 00 02 14 00
				39 00 00 00 00 00 02 15 9F
				39 00 00 00 00 00 02 16 00
				39 00 00 00 00 00 02 17 AE
				39 00 00 00 00 00 02 18 00
				39 00 00 00 00 00 02 19 BD
				39 00 00 00 00 00 02 1A 00
				39 00 00 00 00 00 02 1B CB
				39 00 00 00 00 00 02 1C 00
				39 00 00 00 00 00 02 1D DA
				39 00 00 00 00 00 02 1E 00
				39 00 00 00 00 00 02 1F EC
				39 00 00 00 00 00 02 20 00
				39 00 00 00 00 00 02 21 FC
				39 00 00 00 00 00 02 22 01
				39 00 00 00 00 00 02 23 0C
				39 00 00 00 00 00 02 24 01
				39 00 00 00 00 00 02 25 1B
				39 00 00 00 00 00 02 26 01
				39 00 00 00 00 00 02 27 27
				39 00 00 00 00 00 02 28 01
				39 00 00 00 00 00 02 29 34
				39 00 00 00 00 00 02 2A 01
				39 00 00 00 00 00 02 2B 42
				39 00 00 00 00 00 02 2C 01
				39 00 00 00 00 00 02 2D 53
				39 00 00 00 00 00 02 2E 01
				39 00 00 00 00 00 02 2F 63
				39 00 00 00 00 00 02 30 01
				39 00 00 00 00 00 02 31 75
				39 01 00 00 00 00 02 32 01
				39 00 00 00 00 00 02 33 85
				39 00 00 00 00 00 02 34 01
				39 00 00 00 00 00 02 35 95
				39 00 00 00 00 00 02 36 01
				39 00 00 00 00 00 02 37 B4
				39 00 00 00 00 00 02 38 01
				39 00 00 00 00 00 02 39 D4
				39 00 00 00 00 00 02 3A 01
				39 00 00 00 00 00 02 3B F3
				39 00 00 00 00 00 02 3C 02
				39 00 00 00 00 00 02 3D 13
				39 00 00 00 00 00 02 3E 02
				39 00 00 00 00 00 02 3F 34
				39 00 00 00 00 00 02 40 02
				39 00 00 00 00 00 02 41 50
				39 00 00 00 00 00 02 42 02
				39 00 00 00 00 00 02 43 70
				39 00 00 00 00 00 02 44 02
				39 00 00 00 00 00 02 45 93
				39 00 00 00 00 00 02 46 02
				39 00 00 00 00 00 02 47 B7
				39 00 00 00 00 00 02 48 02
				39 00 00 00 00 00 02 49 D5
				39 00 00 00 00 00 02 4A 02
				39 00 00 00 00 00 02 4B F5
				39 00 00 00 00 00 02 4C 03
				39 00 00 00 00 00 02 4D 1A
				39 00 00 00 00 00 02 4E 03
				39 00 00 00 00 00 02 4F 3A
				39 00 00 00 00 00 02 50 03
				39 00 00 00 00 00 02 51 5A
				39 00 00 00 00 00 02 52 03
				39 00 00 00 00 00 02 53 7A
				39 00 00 00 00 00 02 54 03
				39 00 00 00 00 00 02 55 9C
				39 00 00 00 00 00 02 56 03
				39 00 00 00 00 00 02 57 BE
				39 00 00 00 00 00 02 58 03
				39 00 00 00 00 00 02 59 DD
				39 00 00 00 00 00 02 5A 00
				39 01 00 00 00 00 02 5B 00
				39 00 00 00 00 00 04 FF 98 81 06
				39 00 00 00 00 00 04 FF 98 81 06
				39 00 00 00 00 00 02 00 00
				39 00 00 00 00 00 02 01 00
				39 00 00 00 00 00 02 02 00
				39 00 00 00 00 00 02 03 0D
				39 00 00 00 00 00 02 04 00
				39 00 00 00 00 00 02 05 1A
				39 00 00 00 00 00 02 06 00
				39 00 00 00 00 00 02 07 27
				39 00 00 00 00 00 02 08 00
				39 00 00 00 00 00 02 09 33
				39 00 00 00 00 00 02 0A 00
				39 00 00 00 00 00 02 0B 40
				39 00 00 00 00 00 02 0C 00
				39 00 00 00 00 00 02 0D 4C
				39 00 00 00 00 00 02 0E 00
				39 00 00 00 00 00 02 0F 58
				39 00 00 00 00 00 02 10 00
				39 00 00 00 00 00 02 11 64
				39 00 00 00 00 00 02 12 00
				39 00 00 00 00 00 02 13 71
				39 00 00 00 00 00 02 14 00
				39 00 00 00 00 00 02 15 7D
				39 00 00 00 00 00 02 16 00
				39 00 00 00 00 00 02 17 88
				39 00 00 00 00 00 02 18 00
				39 00 00 00 00 00 02 19 94
				39 00 00 00 00 00 02 1A 00
				39 00 00 00 00 00 02 1B A1
				39 00 00 00 00 00 02 1C 00
				39 00 00 00 00 00 02 1D AE
				39 00 00 00 00 00 02 1E 00
				39 00 00 00 00 00 02 1F B9
				39 00 00 00 00 00 02 20 00
				39 00 00 00 00 00 02 21 C5
				39 00 00 00 00 00 02 22 00
				39 00 00 00 00 00 02 23 D0
				39 00 00 00 00 00 02 24 00
				39 00 00 00 00 00 02 25 DD
				39 00 00 00 00 00 02 26 00
				39 00 00 00 00 00 02 27 EB
				39 00 00 00 00 00 02 28 00
				39 00 00 00 00 00 02 29 F8
				39 00 00 00 00 00 02 2A 01
				39 00 00 00 00 00 02 2B 05
				39 00 00 00 00 00 02 2C 01
				39 00 00 00 00 00 02 2D 10
				39 00 00 00 00 00 02 2E 01
				39 00 00 00 00 00 02 2F 1C
				39 00 00 00 00 00 02 30 01
				39 00 00 00 00 00 02 31 27
				39 01 00 00 00 00 02 32 01
				39 00 00 00 00 00 02 33 32
				39 00 00 00 00 00 02 34 01
				39 00 00 00 00 00 02 35 3D
				39 00 00 00 00 00 02 36 01
				39 00 00 00 00 00 02 37 57
				39 00 00 00 00 00 02 38 01
				39 00 00 00 00 00 02 39 71
				39 00 00 00 00 00 02 3A 01
				39 00 00 00 00 00 02 3B 8A
				39 00 00 00 00 00 02 3C 01
				39 00 00 00 00 00 02 3D A4
				39 00 00 00 00 00 02 3E 01
				39 00 00 00 00 00 02 3F BD
				39 00 00 00 00 00 02 40 01
				39 00 00 00 00 00 02 41 D5
				39 00 00 00 00 00 02 42 01
				39 00 00 00 00 00 02 43 EE
				39 00 00 00 00 00 02 44 02
				39 00 00 00 00 00 02 45 07
				39 00 00 00 00 00 02 46 02
				39 00 00 00 00 00 02 47 21
				39 00 00 00 00 00 02 48 02
				39 00 00 00 00 00 02 49 3D
				39 00 00 00 00 00 02 4A 02
				39 00 00 00 00 00 02 4B 56
				39 00 00 00 00 00 02 4C 02
				39 00 00 00 00 00 02 4D 70
				39 00 00 00 00 00 02 4E 02
				39 00 00 00 00 00 02 4F 8C
				39 00 00 00 00 00 02 50 02
				39 00 00 00 00 00 02 51 A7
				39 00 00 00 00 00 02 52 02
				39 00 00 00 00 00 02 53 C3
				39 00 00 00 00 00 02 54 02
				39 00 00 00 00 00 02 55 DB
				39 00 00 00 00 00 02 56 02
				39 00 00 00 00 00 02 57 F4
				39 00 00 00 00 00 02 58 03
				39 00 00 00 00 00 02 59 11
				39 00 00 00 00 00 02 5A 03
				39 01 00 00 00 00 02 5B 2E
				39 00 00 00 00 00 04 FF 98 81 07
				39 00 00 00 00 00 04 FF 98 81 07
				39 00 00 00 00 00 02 00 00
				39 00 00 00 00 00 02 01 00
				39 00 00 00 00 00 02 02 00
				39 00 00 00 00 00 02 03 02
				39 00 00 00 00 00 02 04 00
				39 00 00 00 00 00 02 05 06
				39 00 00 00 00 00 02 06 00
				39 00 00 00 00 00 02 07 0B
				39 00 00 00 00 00 02 08 00
				39 00 00 00 00 00 02 09 11
				39 00 00 00 00 00 02 0A 00
				39 00 00 00 00 00 02 0B 19
				39 00 00 00 00 00 02 0C 00
				39 00 00 00 00 00 02 0D 22
				39 00 00 00 00 00 02 0E 00
				39 00 00 00 00 00 02 0F 33
				39 00 00 00 00 00 02 10 00
				39 00 00 00 00 00 02 11 43
				39 00 00 00 00 00 02 12 00
				39 00 00 00 00 00 02 13 51
				39 00 00 00 00 00 02 14 00
				39 00 00 00 00 00 02 15 5C
				39 00 00 00 00 00 02 16 00
				39 00 00 00 00 00 02 17 68
				39 00 00 00 00 00 02 18 00
				39 00 00 00 00 00 02 19 74
				39 00 00 00 00 00 02 1A 00
				39 00 00 00 00 00 02 1B 7F
				39 00 00 00 00 00 02 1C 00
				39 00 00 00 00 00 02 1D 89
				39 00 00 00 00 00 02 1E 00
				39 00 00 00 00 00 02 1F 94
				39 00 00 00 00 00 02 20 00
				39 00 00 00 00 00 02 21 9F
				39 00 00 00 00 00 02 22 00
				39 00 00 00 00 00 02 23 AA
				39 00 00 00 00 00 02 24 00
				39 00 00 00 00 00 02 25 B5
				39 00 00 00 00 00 02 26 00
				39 00 00 00 00 00 02 27 BE
				39 00 00 00 00 00 02 28 00
				39 00 00 00 00 00 02 29 C8
				39 00 00 00 00 00 02 2A 00
				39 00 00 00 00 00 02 2B D2
				39 00 00 00 00 00 02 2C 00
				39 00 00 00 00 00 02 2D DD
				39 00 00 00 00 00 02 2E 00
				39 00 00 00 00 00 02 2F E9
				39 00 00 00 00 00 02 30 00
				39 00 00 00 00 00 02 31 F4
				39 01 00 00 00 00 02 32 00
				39 00 00 00 00 00 02 33 FE
				39 00 00 00 00 00 02 34 01
				39 00 00 00 00 00 02 35 09
				39 00 00 00 00 00 02 36 01
				39 00 00 00 00 00 02 37 1C
				39 00 00 00 00 00 02 38 01
				39 00 00 00 00 00 02 39 2F
				39 00 00 00 00 00 02 3A 01
				39 00 00 00 00 00 02 3B 41
				39 00 00 00 00 00 02 3C 01
				39 00 00 00 00 00 02 3D 57
				39 00 00 00 00 00 02 3E 01
				39 00 00 00 00 00 02 3F 6D
				39 00 00 00 00 00 02 40 01
				39 00 00 00 00 00 02 41 83
				39 00 00 00 00 00 02 42 01
				39 00 00 00 00 00 02 43 98
				39 00 00 00 00 00 02 44 01
				39 00 00 00 00 00 02 45 AD
				39 00 00 00 00 00 02 46 01
				39 00 00 00 00 00 02 47 C1
				39 00 00 00 00 00 02 48 01
				39 00 00 00 00 00 02 49 D6
				39 00 00 00 00 00 02 4A 01
				39 00 00 00 00 00 02 4B EA
				39 00 00 00 00 00 02 4C 01
				39 00 00 00 00 00 02 4D FF
				39 00 00 00 00 00 02 4E 02
				39 00 00 00 00 00 02 4F 14
				39 00 00 00 00 00 02 50 02
				39 00 00 00 00 00 02 51 2A
				39 00 00 00 00 00 02 52 02
				39 00 00 00 00 00 02 53 40
				39 00 00 00 00 00 02 54 02
				39 00 00 00 00 00 02 55 56
				39 00 00 00 00 00 02 56 02
				39 00 00 00 00 00 02 57 6B
				39 00 00 00 00 00 02 58 02
				39 00 00 00 00 00 02 59 81
				39 00 00 00 00 00 02 5A 02
				39 00 00 00 00 00 02 5B 99
				39 00 00 00 00 00 04 FF 98 81 00
				39 01 00 00 00 00 04 FF 98 81 00];
		qcom,mdss-dsi-panel-eye-command07 = [
				39 00 00 00 00 00 04 FF 98 81 01
				39 00 00 00 00 00 04 FF 98 81 01
				39 00 00 00 00 00 02 A0 00
				39 00 00 00 00 00 02 A1 17
				39 00 00 00 00 00 02 A2 27
				39 00 00 00 00 00 02 A3 16
				39 00 00 00 00 00 02 A4 18
				39 00 00 00 00 00 02 A5 2A
				39 00 00 00 00 00 02 A6 1F
				39 00 00 00 00 00 02 A7 21
				39 00 00 00 00 00 02 A8 8C
				39 00 00 00 00 00 02 A9 1C
				39 00 00 00 00 00 02 AA 28
				39 00 00 00 00 00 02 AB 78
				39 00 00 00 00 00 02 AC 1C
				39 00 00 00 00 00 02 AD 1D
				39 00 00 00 00 00 02 AE 52
				39 00 00 00 00 00 02 AF 28
				39 00 00 00 00 00 02 B0 2B
				39 00 00 00 00 00 02 B1 56
				39 00 00 00 00 00 02 B2 64
				39 00 00 00 00 00 02 B3 32
				39 00 00 00 00 00 02 C0 00
				39 00 00 00 00 00 02 C1 17
				39 00 00 00 00 00 02 C2 27
				39 00 00 00 00 00 02 C3 16
				39 00 00 00 00 00 02 C4 18
				39 00 00 00 00 00 02 C5 2A
				39 00 00 00 00 00 02 C6 1F
				39 00 00 00 00 00 02 C7 21
				39 00 00 00 00 00 02 C8 8C
				39 00 00 00 00 00 02 C9 1C
				39 00 00 00 00 00 02 CA 28
				39 00 00 00 00 00 02 CB 78
				39 00 00 00 00 00 02 CC 1C
				39 00 00 00 00 00 02 CD 1D
				39 00 00 00 00 00 02 CE 52
				39 00 00 00 00 00 02 CF 28
				39 00 00 00 00 00 02 D0 2B
				39 00 00 00 00 00 02 D1 56
				39 00 00 00 00 00 02 D2 64
				39 01 00 00 00 00 02 D3 32
				39 00 00 00 00 00 04 FF 98 81 05
				39 00 00 00 00 00 04 FF 98 81 05
				39 00 00 00 00 00 02 85 48
				39 00 00 00 00 00 02 00 00
				39 00 00 00 00 00 02 01 00
				39 00 00 00 00 00 02 02 00
				39 00 00 00 00 00 02 03 1C
				39 00 00 00 00 00 02 04 00
				39 00 00 00 00 00 02 05 29
				39 00 00 00 00 00 02 06 00
				39 00 00 00 00 00 02 07 37
				39 00 00 00 00 00 02 08 00
				39 00 00 00 00 00 02 09 46
				39 00 00 00 00 00 02 0A 00
				39 00 00 00 00 00 02 0B 55
				39 00 00 00 00 00 02 0C 00
				39 00 00 00 00 00 02 0D 64
				39 00 00 00 00 00 02 0E 00
				39 00 00 00 00 00 02 0F 74
				39 00 00 00 00 00 02 10 00
				39 00 00 00 00 00 02 11 82
				39 00 00 00 00 00 02 12 00
				39 00 00 00 00 00 02 13 90
				39 00 00 00 00 00 02 14 00
				39 00 00 00 00 00 02 15 9F
				39 00 00 00 00 00 02 16 00
				39 00 00 00 00 00 02 17 AF
				39 00 00 00 00 00 02 18 00
				39 00 00 00 00 00 02 19 BD
				39 00 00 00 00 00 02 1A 00
				39 00 00 00 00 00 02 1B CB
				39 00 00 00 00 00 02 1C 00
				39 00 00 00 00 00 02 1D DA
				39 00 00 00 00 00 02 1E 00
				39 00 00 00 00 00 02 1F EC
				39 00 00 00 00 00 02 20 00
				39 00 00 00 00 00 02 21 FC
				39 00 00 00 00 00 02 22 01
				39 00 00 00 00 00 02 23 0C
				39 00 00 00 00 00 02 24 01
				39 00 00 00 00 00 02 25 1B
				39 00 00 00 00 00 02 26 01
				39 00 00 00 00 00 02 27 27
				39 00 00 00 00 00 02 28 01
				39 00 00 00 00 00 02 29 34
				39 00 00 00 00 00 02 2A 01
				39 00 00 00 00 00 02 2B 42
				39 00 00 00 00 00 02 2C 01
				39 00 00 00 00 00 02 2D 53
				39 00 00 00 00 00 02 2E 01
				39 00 00 00 00 00 02 2F 63
				39 00 00 00 00 00 02 30 01
				39 00 00 00 00 00 02 31 75
				39 01 00 00 00 00 02 32 01
				39 00 00 00 00 00 02 33 85
				39 00 00 00 00 00 02 34 01
				39 00 00 00 00 00 02 35 95
				39 00 00 00 00 00 02 36 01
				39 00 00 00 00 00 02 37 B4
				39 00 00 00 00 00 02 38 01
				39 00 00 00 00 00 02 39 D4
				39 00 00 00 00 00 02 3A 01
				39 00 00 00 00 00 02 3B F3
				39 00 00 00 00 00 02 3C 02
				39 00 00 00 00 00 02 3D 13
				39 00 00 00 00 00 02 3E 02
				39 00 00 00 00 00 02 3F 34
				39 00 00 00 00 00 02 40 02
				39 00 00 00 00 00 02 41 50
				39 00 00 00 00 00 02 42 02
				39 00 00 00 00 00 02 43 70
				39 00 00 00 00 00 02 44 02
				39 00 00 00 00 00 02 45 93
				39 00 00 00 00 00 02 46 02
				39 00 00 00 00 00 02 47 B7
				39 00 00 00 00 00 02 48 02
				39 00 00 00 00 00 02 49 D5
				39 00 00 00 00 00 02 4A 02
				39 00 00 00 00 00 02 4B F5
				39 00 00 00 00 00 02 4C 03
				39 00 00 00 00 00 02 4D 1A
				39 00 00 00 00 00 02 4E 03
				39 00 00 00 00 00 02 4F 3A
				39 00 00 00 00 00 02 50 03
				39 00 00 00 00 00 02 51 5A
				39 00 00 00 00 00 02 52 03
				39 00 00 00 00 00 02 53 7A
				39 00 00 00 00 00 02 54 03
				39 00 00 00 00 00 02 55 9C
				39 00 00 00 00 00 02 56 03
				39 00 00 00 00 00 02 57 BE
				39 00 00 00 00 00 02 58 03
				39 00 00 00 00 00 02 59 DD
				39 00 00 00 00 00 02 5A 00
				39 01 00 00 00 00 02 5B 00
				39 00 00 00 00 00 04 FF 98 81 06
				39 00 00 00 00 00 04 FF 98 81 06
				39 00 00 00 00 00 02 00 00
				39 00 00 00 00 00 02 01 00
				39 00 00 00 00 00 02 02 00
				39 00 00 00 00 00 02 03 0C
				39 00 00 00 00 00 02 04 00
				39 00 00 00 00 00 02 05 19
				39 00 00 00 00 00 02 06 00
				39 00 00 00 00 00 02 07 26
				39 00 00 00 00 00 02 08 00
				39 00 00 00 00 00 02 09 32
				39 00 00 00 00 00 02 0A 00
				39 00 00 00 00 00 02 0B 3E
				39 00 00 00 00 00 02 0C 00
				39 00 00 00 00 00 02 0D 4B
				39 00 00 00 00 00 02 0E 00
				39 00 00 00 00 00 02 0F 56
				39 00 00 00 00 00 02 10 00
				39 00 00 00 00 00 02 11 62
				39 00 00 00 00 00 02 12 00
				39 00 00 00 00 00 02 13 6E
				39 00 00 00 00 00 02 14 00
				39 00 00 00 00 00 02 15 7A
				39 00 00 00 00 00 02 16 00
				39 00 00 00 00 00 02 17 85
				39 00 00 00 00 00 02 18 00
				39 00 00 00 00 00 02 19 91
				39 00 00 00 00 00 02 1A 00
				39 00 00 00 00 00 02 1B 9D
				39 00 00 00 00 00 02 1C 00
				39 00 00 00 00 00 02 1D AA
				39 00 00 00 00 00 02 1E 00
				39 00 00 00 00 00 02 1F B6
				39 00 00 00 00 00 02 20 00
				39 00 00 00 00 00 02 21 C1
				39 00 00 00 00 00 02 22 00
				39 00 00 00 00 00 02 23 CB
				39 00 00 00 00 00 02 24 00
				39 00 00 00 00 00 02 25 D8
				39 00 00 00 00 00 02 26 00
				39 00 00 00 00 00 02 27 E5
				39 00 00 00 00 00 02 28 00
				39 00 00 00 00 00 02 29 F2
				39 00 00 00 00 00 02 2A 00
				39 00 00 00 00 00 02 2B FF
				39 00 00 00 00 00 02 2C 01
				39 00 00 00 00 00 02 2D 0B
				39 00 00 00 00 00 02 2E 01
				39 00 00 00 00 00 02 2F 16
				39 00 00 00 00 00 02 30 01
				39 00 00 00 00 00 02 31 21
				39 01 00 00 00 00 02 32 01
				39 00 00 00 00 00 02 33 2C
				39 00 00 00 00 00 02 34 01
				39 00 00 00 00 00 02 35 36
				39 00 00 00 00 00 02 36 01
				39 00 00 00 00 00 02 37 4E
				39 00 00 00 00 00 02 38 01
				39 00 00 00 00 00 02 39 68
				39 00 00 00 00 00 02 3A 01
				39 00 00 00 00 00 02 3B 81
				39 00 00 00 00 00 02 3C 01
				39 00 00 00 00 00 02 3D 9A
				39 00 00 00 00 00 02 3E 01
				39 00 00 00 00 00 02 3F B2
				39 00 00 00 00 00 02 40 01
				39 00 00 00 00 00 02 41 CA
				39 00 00 00 00 00 02 42 01
				39 00 00 00 00 00 02 43 E2
				39 00 00 00 00 00 02 44 01
				39 00 00 00 00 00 02 45 FB
				39 00 00 00 00 00 02 46 02
				39 00 00 00 00 00 02 47 14
				39 00 00 00 00 00 02 48 02
				39 00 00 00 00 00 02 49 2E
				39 00 00 00 00 00 02 4A 02
				39 00 00 00 00 00 02 4B 48
				39 00 00 00 00 00 02 4C 02
				39 00 00 00 00 00 02 4D 62
				39 00 00 00 00 00 02 4E 02
				39 00 00 00 00 00 02 4F 7B
				39 00 00 00 00 00 02 50 02
				39 00 00 00 00 00 02 51 97
				39 00 00 00 00 00 02 52 02
				39 00 00 00 00 00 02 53 B3
				39 00 00 00 00 00 02 54 02
				39 00 00 00 00 00 02 55 CC
				39 00 00 00 00 00 02 56 02
				39 00 00 00 00 00 02 57 E3
				39 00 00 00 00 00 02 58 02
				39 00 00 00 00 00 02 59 FD
				39 00 00 00 00 00 02 5A 03
				39 01 00 00 00 00 02 5B 17
				39 00 00 00 00 00 04 FF 98 81 07
				39 00 00 00 00 00 04 FF 98 81 07
				39 00 00 00 00 00 02 00 00
				39 00 00 00 00 00 02 01 00
				39 00 00 00 00 00 02 02 00
				39 00 00 00 00 00 02 03 01
				39 00 00 00 00 00 02 04 00
				39 00 00 00 00 00 02 05 03
				39 00 00 00 00 00 02 06 00
				39 00 00 00 00 00 02 07 05
				39 00 00 00 00 00 02 08 00
				39 00 00 00 00 00 02 09 07
				39 00 00 00 00 00 02 0A 00
				39 00 00 00 00 00 02 0B 0A
				39 00 00 00 00 00 02 0C 00
				39 00 00 00 00 00 02 0D 14
				39 00 00 00 00 00 02 0E 00
				39 00 00 00 00 00 02 0F 2A
				39 00 00 00 00 00 02 10 00
				39 00 00 00 00 00 02 11 3C
				39 00 00 00 00 00 02 12 00
				39 00 00 00 00 00 02 13 4A
				39 00 00 00 00 00 02 14 00
				39 00 00 00 00 00 02 15 56
				39 00 00 00 00 00 02 16 00
				39 00 00 00 00 00 02 17 61
				39 00 00 00 00 00 02 18 00
				39 00 00 00 00 00 02 19 6C
				39 00 00 00 00 00 02 1A 00
				39 00 00 00 00 00 02 1B 77
				39 00 00 00 00 00 02 1C 00
				39 00 00 00 00 00 02 1D 81
				39 00 00 00 00 00 02 1E 00
				39 00 00 00 00 00 02 1F 8B
				39 00 00 00 00 00 02 20 00
				39 00 00 00 00 00 02 21 95
				39 00 00 00 00 00 02 22 00
				39 00 00 00 00 00 02 23 A0
				39 00 00 00 00 00 02 24 00
				39 00 00 00 00 00 02 25 AA
				39 00 00 00 00 00 02 26 00
				39 00 00 00 00 00 02 27 B4
				39 00 00 00 00 00 02 28 00
				39 00 00 00 00 00 02 29 BD
				39 00 00 00 00 00 02 2A 00
				39 00 00 00 00 00 02 2B C7
				39 00 00 00 00 00 02 2C 00
				39 00 00 00 00 00 02 2D D0
				39 00 00 00 00 00 02 2E 00
				39 00 00 00 00 00 02 2F DA
				39 00 00 00 00 00 02 30 00
				39 00 00 00 00 00 02 31 E5
				39 01 00 00 00 00 02 32 00
				39 00 00 00 00 00 02 33 F0
				39 00 00 00 00 00 02 34 00
				39 00 00 00 00 00 02 35 FA
				39 00 00 00 00 00 02 36 01
				39 00 00 00 00 00 02 37 0E
				39 00 00 00 00 00 02 38 01
				39 00 00 00 00 00 02 39 20
				39 00 00 00 00 00 02 3A 01
				39 00 00 00 00 00 02 3B 31
				39 00 00 00 00 00 02 3C 01
				39 00 00 00 00 00 02 3D 43
				39 00 00 00 00 00 02 3E 01
				39 00 00 00 00 00 02 3F 58
				39 00 00 00 00 00 02 40 01
				39 00 00 00 00 00 02 41 6D
				39 00 00 00 00 00 02 42 01
				39 00 00 00 00 00 02 43 81
				39 00 00 00 00 00 02 44 01
				39 00 00 00 00 00 02 45 95
				39 00 00 00 00 00 02 46 01
				39 00 00 00 00 00 02 47 A9
				39 00 00 00 00 00 02 48 01
				39 00 00 00 00 00 02 49 BD
				39 00 00 00 00 00 02 4A 01
				39 00 00 00 00 00 02 4B D0
				39 00 00 00 00 00 02 4C 01
				39 00 00 00 00 00 02 4D E3
				39 00 00 00 00 00 02 4E 01
				39 00 00 00 00 00 02 4F F7
				39 00 00 00 00 00 02 50 02
				39 00 00 00 00 00 02 51 0B
				39 00 00 00 00 00 02 52 02
				39 00 00 00 00 00 02 53 1F
				39 00 00 00 00 00 02 54 02
				39 00 00 00 00 00 02 55 34
				39 00 00 00 00 00 02 56 02
				39 00 00 00 00 00 02 57 49
				39 00 00 00 00 00 02 58 02
				39 00 00 00 00 00 02 59 5D
				39 00 00 00 00 00 02 5A 02
				39 00 00 00 00 00 02 5B 71
				39 00 00 00 00 00 04 FF 98 81 00
				39 01 00 00 00 00 04 FF 98 81 00 ];
		qcom,mdss-dsi-panel-eye-command08 = [
				39 00 00 00 00 00 04 FF 98 81 01
				39 00 00 00 00 00 04 FF 98 81 01
				39 00 00 00 00 00 02 A0 00
				39 00 00 00 00 00 02 A1 17
				39 00 00 00 00 00 02 A2 27
				39 00 00 00 00 00 02 A3 16
				39 00 00 00 00 00 02 A4 18
				39 00 00 00 00 00 02 A5 2A
				39 00 00 00 00 00 02 A6 1F
				39 00 00 00 00 00 02 A7 21
				39 00 00 00 00 00 02 A8 8C
				39 00 00 00 00 00 02 A9 1C
				39 00 00 00 00 00 02 AA 28
				39 00 00 00 00 00 02 AB 78
				39 00 00 00 00 00 02 AC 1C
				39 00 00 00 00 00 02 AD 1D
				39 00 00 00 00 00 02 AE 52
				39 00 00 00 00 00 02 AF 28
				39 00 00 00 00 00 02 B0 2B
				39 00 00 00 00 00 02 B1 56
				39 00 00 00 00 00 02 B2 64
				39 00 00 00 00 00 02 B3 32
				39 00 00 00 00 00 02 C0 00
				39 00 00 00 00 00 02 C1 17
				39 00 00 00 00 00 02 C2 27
				39 00 00 00 00 00 02 C3 16
				39 00 00 00 00 00 02 C4 18
				39 00 00 00 00 00 02 C5 2A
				39 00 00 00 00 00 02 C6 1F
				39 00 00 00 00 00 02 C7 21
				39 00 00 00 00 00 02 C8 8C
				39 00 00 00 00 00 02 C9 1C
				39 00 00 00 00 00 02 CA 28
				39 00 00 00 00 00 02 CB 78
				39 00 00 00 00 00 02 CC 1C
				39 00 00 00 00 00 02 CD 1D
				39 00 00 00 00 00 02 CE 52
				39 00 00 00 00 00 02 CF 28
				39 00 00 00 00 00 02 D0 2B
				39 00 00 00 00 00 02 D1 56
				39 00 00 00 00 00 02 D2 64
				39 01 00 00 00 00 02 D3 32
				39 00 00 00 00 00 04 FF 98 81 05
				39 00 00 00 00 00 04 FF 98 81 05
				39 00 00 00 00 00 02 85 48
				39 00 00 00 00 00 02 00 00
				39 00 00 00 00 00 02 01 00
				39 00 00 00 00 00 02 02 00
				39 00 00 00 00 00 02 03 1D
				39 00 00 00 00 00 02 04 00
				39 00 00 00 00 00 02 05 1F
				39 00 00 00 00 00 02 06 00
				39 00 00 00 00 00 02 07 38
				39 00 00 00 00 00 02 08 00
				39 00 00 00 00 00 02 09 47
				39 00 00 00 00 00 02 0A 00
				39 00 00 00 00 00 02 0B 56
				39 00 00 00 00 00 02 0C 00
				39 00 00 00 00 00 02 0D 65
				39 00 00 00 00 00 02 0E 00
				39 00 00 00 00 00 02 0F 74
				39 00 00 00 00 00 02 10 00
				39 00 00 00 00 00 02 11 82
				39 00 00 00 00 00 02 12 00
				39 00 00 00 00 00 02 13 91
				39 00 00 00 00 00 02 14 00
				39 00 00 00 00 00 02 15 A0
				39 00 00 00 00 00 02 16 00
				39 00 00 00 00 00 02 17 AF
				39 00 00 00 00 00 02 18 00
				39 00 00 00 00 00 02 19 BD
				39 00 00 00 00 00 02 1A 00
				39 00 00 00 00 00 02 1B CC
				39 00 00 00 00 00 02 1C 00
				39 00 00 00 00 00 02 1D DB
				39 00 00 00 00 00 02 1E 00
				39 00 00 00 00 00 02 1F EC
				39 00 00 00 00 00 02 20 00
				39 00 00 00 00 00 02 21 FC
				39 00 00 00 00 00 02 22 01
				39 00 00 00 00 00 02 23 0D
				39 00 00 00 00 00 02 24 01
				39 00 00 00 00 00 02 25 1B
				39 00 00 00 00 00 02 26 01
				39 00 00 00 00 00 02 27 27
				39 00 00 00 00 00 02 28 01
				39 00 00 00 00 00 02 29 34
				39 00 00 00 00 00 02 2A 01
				39 00 00 00 00 00 02 2B 42
				39 00 00 00 00 00 02 2C 01
				39 00 00 00 00 00 02 2D 53
				39 00 00 00 00 00 02 2E 01
				39 00 00 00 00 00 02 2F 64
				39 00 00 00 00 00 02 30 01
				39 00 00 00 00 00 02 31 75
				39 01 00 00 00 00 02 32 01
				39 00 00 00 00 00 02 33 85
				39 00 00 00 00 00 02 34 01
				39 00 00 00 00 00 02 35 95
				39 00 00 00 00 00 02 36 01
				39 00 00 00 00 00 02 37 B4
				39 00 00 00 00 00 02 38 01
				39 00 00 00 00 00 02 39 D4
				39 00 00 00 00 00 02 3A 01
				39 00 00 00 00 00 02 3B F3
				39 00 00 00 00 00 02 3C 02
				39 00 00 00 00 00 02 3D 13
				39 00 00 00 00 00 02 3E 02
				39 00 00 00 00 00 02 3F 34
				39 00 00 00 00 00 02 40 02
				39 00 00 00 00 00 02 41 50
				39 00 00 00 00 00 02 42 02
				39 00 00 00 00 00 02 43 70
				39 00 00 00 00 00 02 44 02
				39 00 00 00 00 00 02 45 93
				39 00 00 00 00 00 02 46 02
				39 00 00 00 00 00 02 47 B7
				39 00 00 00 00 00 02 48 02
				39 00 00 00 00 00 02 49 D5
				39 00 00 00 00 00 02 4A 02
				39 00 00 00 00 00 02 4B F5
				39 00 00 00 00 00 02 4C 03
				39 00 00 00 00 00 02 4D 1A
				39 00 00 00 00 00 02 4E 03
				39 00 00 00 00 00 02 4F 3A
				39 00 00 00 00 00 02 50 03
				39 00 00 00 00 00 02 51 5A
				39 00 00 00 00 00 02 52 03
				39 00 00 00 00 00 02 53 7A
				39 00 00 00 00 00 02 54 03
				39 00 00 00 00 00 02 55 9C
				39 00 00 00 00 00 02 56 03
				39 00 00 00 00 00 02 57 BE
				39 00 00 00 00 00 02 58 03
				39 00 00 00 00 00 02 59 DD
				39 00 00 00 00 00 02 5A 00
				39 01 00 00 00 00 02 5B 00
				39 00 00 00 00 00 04 FF 98 81 06
				39 00 00 00 00 00 04 FF 98 81 06
				39 00 00 00 00 00 02 00 00
				39 00 00 00 00 00 02 01 00
				39 00 00 00 00 00 02 02 00
				39 00 00 00 00 00 02 03 0B
				39 00 00 00 00 00 02 04 00
				39 00 00 00 00 00 02 05 0C
				39 00 00 00 00 00 02 06 00
				39 00 00 00 00 00 02 07 24
				39 00 00 00 00 00 02 08 00
				39 00 00 00 00 00 02 09 30
				39 00 00 00 00 00 02 0A 00
				39 00 00 00 00 00 02 0B 3C
				39 00 00 00 00 00 02 0C 00
				39 00 00 00 00 00 02 0D 49
				39 00 00 00 00 00 02 0E 00
				39 00 00 00 00 00 02 0F 54
				39 00 00 00 00 00 02 10 00
				39 00 00 00 00 00 02 11 5F
				39 00 00 00 00 00 02 12 00
				39 00 00 00 00 00 02 13 6A
				39 00 00 00 00 00 02 14 00
				39 00 00 00 00 00 02 15 77
				39 00 00 00 00 00 02 16 00
				39 00 00 00 00 00 02 17 82
				39 00 00 00 00 00 02 18 00
				39 00 00 00 00 00 02 19 8C
				39 00 00 00 00 00 02 1A 00
				39 00 00 00 00 00 02 1B 99
				39 00 00 00 00 00 02 1C 00
				39 00 00 00 00 00 02 1D A5
				39 00 00 00 00 00 02 1E 00
				39 00 00 00 00 00 02 1F B1
				39 00 00 00 00 00 02 20 00
				39 00 00 00 00 00 02 21 BC
				39 00 00 00 00 00 02 22 00
				39 00 00 00 00 00 02 23 C6
				39 00 00 00 00 00 02 24 00
				39 00 00 00 00 00 02 25 D2
				39 00 00 00 00 00 02 26 00
				39 00 00 00 00 00 02 27 DE
				39 00 00 00 00 00 02 28 00
				39 00 00 00 00 00 02 29 EB
				39 00 00 00 00 00 02 2A 00
				39 00 00 00 00 00 02 2B F7
				39 00 00 00 00 00 02 2C 01
				39 00 00 00 00 00 02 2D 04
				39 00 00 00 00 00 02 2E 01
				39 00 00 00 00 00 02 2F 0F
				39 00 00 00 00 00 02 30 01
				39 00 00 00 00 00 02 31 1A
				39 01 00 00 00 00 02 32 01
				39 00 00 00 00 00 02 33 25
				39 00 00 00 00 00 02 34 01
				39 00 00 00 00 00 02 35 2F
				39 00 00 00 00 00 02 36 01
				39 00 00 00 00 00 02 37 44
				39 00 00 00 00 00 02 38 01
				39 00 00 00 00 00 02 39 5E
				39 00 00 00 00 00 02 3A 01
				39 00 00 00 00 00 02 3B 76
				39 00 00 00 00 00 02 3C 01
				39 00 00 00 00 00 02 3D 8E
				39 00 00 00 00 00 02 3E 01
				39 00 00 00 00 00 02 3F A6
				39 00 00 00 00 00 02 40 01
				39 00 00 00 00 00 02 41 BE
				39 00 00 00 00 00 02 42 01
				39 00 00 00 00 00 02 43 D5
				39 00 00 00 00 00 02 44 01
				39 00 00 00 00 00 02 45 EC
				39 00 00 00 00 00 02 46 02
				39 00 00 00 00 00 02 47 04
				39 00 00 00 00 00 02 48 02
				39 00 00 00 00 00 02 49 1D
				39 00 00 00 00 00 02 4A 02
				39 00 00 00 00 00 02 4B 37
				39 00 00 00 00 00 02 4C 02
				39 00 00 00 00 00 02 4D 50
				39 00 00 00 00 00 02 4E 02
				39 00 00 00 00 00 02 4F 68
				39 00 00 00 00 00 02 50 02
				39 00 00 00 00 00 02 51 81
				39 00 00 00 00 00 02 52 02
				39 00 00 00 00 00 02 53 9C
				39 00 00 00 00 00 02 54 02
				39 00 00 00 00 00 02 55 B8
				39 00 00 00 00 00 02 56 02
				39 00 00 00 00 00 02 57 CF
				39 00 00 00 00 00 02 58 02
				39 00 00 00 00 00 02 59 E6
				39 00 00 00 00 00 02 5A 02
				39 01 00 00 00 00 02 5B FF
				39 00 00 00 00 00 04 FF 98 81 07
				39 00 00 00 00 00 04 FF 98 81 07
				39 00 00 00 00 00 02 00 00
				39 00 00 00 00 00 02 01 00
				39 00 00 00 00 00 02 02 00
				39 00 00 00 00 00 02 03 02
				39 00 00 00 00 00 02 04 00
				39 00 00 00 00 00 02 05 03
				39 00 00 00 00 00 02 06 00
				39 00 00 00 00 00 02 07 0C
				39 00 00 00 00 00 02 08 00
				39 00 00 00 00 00 02 09 11
				39 00 00 00 00 00 02 0A 00
				39 00 00 00 00 00 02 0B 17
				39 00 00 00 00 00 02 0C 00
				39 00 00 00 00 00 02 0D 1B
				39 00 00 00 00 00 02 0E 00
				39 00 00 00 00 00 02 0F 1F
				39 00 00 00 00 00 02 10 00
				39 00 00 00 00 00 02 11 33
				39 00 00 00 00 00 02 12 00
				39 00 00 00 00 00 02 13 42
				39 00 00 00 00 00 02 14 00
				39 00 00 00 00 00 02 15 4F
				39 00 00 00 00 00 02 16 00
				39 00 00 00 00 00 02 17 59
				39 00 00 00 00 00 02 18 00
				39 00 00 00 00 00 02 19 64
				39 00 00 00 00 00 02 1A 00
				39 00 00 00 00 00 02 1B 6E
				39 00 00 00 00 00 02 1C 00
				39 00 00 00 00 00 02 1D 79
				39 00 00 00 00 00 02 1E 00
				39 00 00 00 00 00 02 1F 82
				39 00 00 00 00 00 02 20 00
				39 00 00 00 00 00 02 21 8B
				39 00 00 00 00 00 02 22 00
				39 00 00 00 00 00 02 23 95
				39 00 00 00 00 00 02 24 00
				39 00 00 00 00 00 02 25 9F
				39 00 00 00 00 00 02 26 00
				39 00 00 00 00 00 02 27 A9
				39 00 00 00 00 00 02 28 00
				39 00 00 00 00 00 02 29 B3
				39 00 00 00 00 00 02 2A 00
				39 00 00 00 00 00 02 2B BB
				39 00 00 00 00 00 02 2C 00
				39 00 00 00 00 00 02 2D C4
				39 00 00 00 00 00 02 2E 00
				39 00 00 00 00 00 02 2F CC
				39 00 00 00 00 00 02 30 00
				39 00 00 00 00 00 02 31 D7
				39 01 00 00 00 00 02 32 00
				39 00 00 00 00 00 02 33 E0
				39 00 00 00 00 00 02 34 00
				39 00 00 00 00 00 02 35 EB
				39 00 00 00 00 00 02 36 00
				39 00 00 00 00 00 02 37 FE
				39 00 00 00 00 00 02 38 01
				39 00 00 00 00 00 02 39 10
				39 00 00 00 00 00 02 3A 01
				39 00 00 00 00 00 02 3B 21
				39 00 00 00 00 00 02 3C 01
				39 00 00 00 00 00 02 3D 31
				39 00 00 00 00 00 02 3E 01
				39 00 00 00 00 00 02 3F 42
				39 00 00 00 00 00 02 40 01
				39 00 00 00 00 00 02 41 55
				39 00 00 00 00 00 02 42 01
				39 00 00 00 00 00 02 43 6A
				39 00 00 00 00 00 02 44 01
				39 00 00 00 00 00 02 45 7D
				39 00 00 00 00 00 02 46 01
				39 00 00 00 00 00 02 47 90
				39 00 00 00 00 00 02 48 01
				39 00 00 00 00 00 02 49 A2
				39 00 00 00 00 00 02 4A 01
				39 00 00 00 00 00 02 4B B4
				39 00 00 00 00 00 02 4C 01
				39 00 00 00 00 00 02 4D C7
				39 00 00 00 00 00 02 4E 01
				39 00 00 00 00 00 02 4F D9
				39 00 00 00 00 00 02 50 01
				39 00 00 00 00 00 02 51 EB
				39 00 00 00 00 00 02 52 01
				39 00 00 00 00 00 02 53 FE
				39 00 00 00 00 00 02 54 02
				39 00 00 00 00 00 02 55 11
				39 00 00 00 00 00 02 56 02
				39 00 00 00 00 00 02 57 24
				39 00 00 00 00 00 02 58 02
				39 00 00 00 00 00 02 59 39
				39 00 00 00 00 00 02 5A 02
				39 00 00 00 00 00 02 5B 4B
				39 00 00 00 00 00 04 FF 98 81 00
				39 01 00 00 00 00 04 FF 98 81 00];
		qcom,mdss-dsi-panel-eye-command-num = <8>;

		qcom,mdss-dsi-h-sync-pulse = <1>;
		qcom,mdss-dsi-traffic-mode = "burst_mode";
		qcom,mdss-dsi-bllp-eof-power-mode;
		qcom,mdss-dsi-bllp-power-mode;
		qcom,mdss-dsi-lane-0-state;
		qcom,mdss-dsi-lane-1-state;
		qcom,mdss-dsi-lane-2-state;
		qcom,mdss-dsi-lane-3-state;

		qcom,mdss-dsi-panel-timings = [8B 1E 14 00 44 46 18 20 19 03 04 00];
		qcom,mdss-dsi-t-clk-post = <0x04>;
		qcom,mdss-dsi-t-clk-pre = <0x1c>;
		qcom,mdss-dsi-bl-min-level = <4>;
		qcom,mdss-dsi-bl-max-level = <255>;
		qcom,mdss-dsi-bl-pmic-pwm-frequency = <100>;
		qcom,mdss-dsi-bl-pmic-bank-select = <0>;
		qcom,mdss-dsi-dma-trigger = "trigger_sw";
		qcom,mdss-dsi-mdp-trigger = "none";
		qcom,mdss-dsi-bl-pmic-control-type = "bl_ctrl_pwm";
		qcom,mdss-dsi-pwm-gpio = <&pm8937_mpps 4 0>;

		qcom,esd-check-enabled;
		qcom,mdss-dsi-panel-status-command = [06 01 00 01 05 00 02 0A 08];
		qcom,mdss-dsi-panel-status-command-state = "dsi_hs_mode";
		qcom,mdss-dsi-panel-status-check-mode = "reg_read";
		qcom,mdss-dsi-panel-status-valid-params = <1>;
		qcom,mdss-dsi-panel-status-value = <0x9c>;
		qcom,mdss-dsi-panel-status-read-length = <1>;

		qcom,mdss-dsi-lp11-init;
		qcom,mdss-dsi-init-delay-us = <50000>;
		qcom,mdss-dsi-reset-sequence = <1 5>, <0 10>, <1 80>;

	};
};
