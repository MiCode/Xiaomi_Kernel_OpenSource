/* Copyright (c) 2015, The Linux Foundation. All rights reserved.
 *
 * This program is free software; you can redistribute it and/or modify
 * it under the terms of the GNU General Public License version 2 and
 * only version 2 as published by the Free Software Foundation.
 *
 * This program is distributed in the hope that it will be useful,
 * but WITHOUT ANY WARRANTY; without even the implied warranty of
 * MERCHANTABILITY or FITNESS FOR A PARTICULAR PURPOSE.  See the
 * GNU General Public License for more details.
 */

&mdss_mdp {
	dsi_fl10802_fwvga_video: qcom,mdss_dsi_fl10802_fwvga_video {
		qcom,mdss-dsi-panel-name = "fl10802 fwvga video mode dsi panel";
		qcom,mdss-dsi-panel-controller = <&mdss_dsi0>;
		qcom,mdss-dsi-panel-type = "dsi_video_mode";
		qcom,mdss-dsi-panel-destination = "display_1";
		qcom,mdss-dsi-panel-framerate = <60>;
		qcom,mdss-dsi-virtual-channel-id = <0>;
		qcom,mdss-dsi-stream = <0>;
		qcom,mdss-dsi-panel-width = <480>;
		qcom,mdss-dsi-panel-height = <854>;
		qcom,mdss-dsi-h-front-porch = <79>;
		qcom,mdss-dsi-h-back-porch = <69>;
		qcom,mdss-dsi-h-pulse-width = <59>;
		qcom,mdss-dsi-h-sync-skew = <0>;
		qcom,mdss-dsi-v-back-porch = <12>;
		qcom,mdss-dsi-v-front-porch = <18>;
		qcom,mdss-dsi-v-pulse-width = <4>;
		qcom,mdss-dsi-h-left-border = <0>;
		qcom,mdss-dsi-h-right-border = <0>;
		qcom,mdss-dsi-v-top-border = <0>;
		qcom,mdss-dsi-v-bottom-border = <0>;
		qcom,mdss-dsi-bpp = <24>;
		qcom,mdss-dsi-color-order = "rgb_swap_rgb";
		qcom,mdss-dsi-underflow-color = <0xff>;
		qcom,mdss-dsi-border-color = <0>;
		qcom,mdss-dsi-on-command = [39 01 00 00 00 00 04 B9 F1 08 01
				39 01 00 00 00 00 05 B1 22 1A 1A 87
				39 01 00 00 00 00 02 B2 22
				39 01 00 00 00 00 09 B3 01 00 06 06 18 13 39 35
				39 01 00 00 00 00 12 BA 31 00 44 25 91 0A 00 00 C1 00 00 00 0D 02 4F B9 EE
				39 01 00 00 00 00 06 E3 09 09 03 03 00
				39 01 00 00 00 00 03 B5 07 07
				39 01 00 00 00 00 03 B6 3F 3F
				39 01 00 00 00 00 03 B8 64 28
				39 01 00 00 00 00 02 B4 02
				39 01 00 00 00 00 02 CC 00
				39 01 00 00 00 00 02 BC 47
				39 01 00 00 00 00 34 E9 00 00 09 03 65 0A 8A 10 01 00 37 0D 0A 8A 37 00 00 18 00 00 00 25 09 80 40 00 42 60 00 00 00 09 81 50 01 53 70 00 00 00 00 00 00 00 00 00 00 00 00 00 00
				39 01 00 00 00 00 17 EA 94 00 00 00 08 95 10 07 35 10 00 00 00 08 94 00 06 24 00 00 00 00
				39 01 00 00 00 00 23 E0 00 00 11 0F 10 2A 26 34 0C 0F 10 14 17 14 16 13 17 00 00 11 0F 10 2A 26 34 0C 0F 10 14 17 14 16 13 17
				39 01 00 00 00 00 80
				   C1 01 00 0C 17 20
				   29 31 39 42 4B 53
				   5B 63 6B 74 7C 85
				   8E 97 A0 A8 AF B7
				   BE C6 CD D4 DB E2
				   E9 EF F6 FB FF 3C
				   4B 1C 27 26 2F 1D
				   08 03 00 0A 13 1B
				   24 2B 32 3A 42 4A
				   51 59 61 69 71 79
				   81 8A 93 9C A4 AC
				   B4 BC C4 CB D3 DB
				   E2 EA F2 F9 FF 2C
				   34 4F 49 3F 23 14
				   3F 03 00 10 18 1E
				   25 2C 32 37 3E 45
				   4C 52 59 60 65 6D
				   74 7B 82 89 92 9A
				   A2 AA B2 B9 C1 CA
				   D2 DB E6 F1 FF 20
				   26 1F 19 4E 45 24
				   42 03
				39 01 00 00 00 00 02 C7 A0
				39 01 00 00 00 00 02 53 24
				39 01 00 00 00 00 03 C8 10 00
				05 01 00 00 78 00 02 11 00
				05 01 00 00 78 00 02 29 00];
		qcom,mdss-dsi-off-command = [05 01 00 00 32 00 02 28 00
					05 01 00 00 78 00 02 10 00];
		qcom,mdss-dsi-on-command-state = "dsi_lp_mode";
		qcom,mdss-dsi-off-command-state = "dsi_hs_mode";
		qcom,mdss-dsi-h-sync-pulse = <1>;
		qcom,mdss-dsi-traffic-mode = "burst_mode";
		qcom,mdss-dsi-lane-map = "lane_map_0123";
		qcom,mdss-dsi-bllp-eof-power-mode;
		qcom,mdss-dsi-bllp-power-mode;
		qcom,mdss-dsi-lane-0-state;
		qcom,mdss-dsi-lane-1-state;
		qcom,mdss-dsi-panel-timings = [af 23 1c 00 36 33 1d 25 2d 03 04 00];
		qcom,mdss-dsi-t-clk-post = <0x1f>;
		qcom,mdss-dsi-t-clk-pre = <0x30>;
		qcom,mdss-dsi-bl-min-level = <1>;
		qcom,mdss-dsi-bl-max-level = <255>;
		qcom,mdss-dsi-dma-trigger = "trigger_sw";
		qcom,mdss-dsi-mdp-trigger = "none";
		qcom,mdss-dsi-bl-pmic-control-type = "bl_ctrl_dcs";
		qcom,mdss-dsi-reset-sequence = <1 20>, <0 2>, <1 20>;
		qcom,mdss-dsi-lp11-init;
		qcom,mdss-dsi-init-delay-us = <7000>;
	};
};
