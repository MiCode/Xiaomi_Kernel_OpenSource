/* Copyright (c) 2016, The Linux Foundation. All rights reserved.
*
* This program is free software; you can redistribute it and/or modify
* it under the terms of the GNU General Public License version 2 and
* only version 2 as published by the Free Software Foundation.
*
* This program is distributed in the hope that it will be useful,
* but WITHOUT ANY WARRANTY; without even the implied warranty of
* MERCHANTABILITY or FITNESS FOR A PARTICULAR PURPOSE.  See the
* GNU General Public License for more details.
*/

#include "msm-arm-smmu-660.dtsi"
#include "msm-arm-smmu-impl-defs-660.dtsi"

&soc {
	/delete-node/ arm,smmu-turing_q6@5180000;
};

&mmss_bimc_smmu {
	attach-impl-defs = <0x6000 0x2378>,
			<0x6060	0x1055>,
			<0x678c	0x28>,
			<0x6794	0xe0>,
			<0x6800	0x6>,
			<0x6900	0x3ff>,
			<0x6924	0x204>,
			<0x6928	0x11002>,
			<0x6930	0x800>,
			<0x6960	0xffffffff>,
			<0x6964	0xffffffff>,
			<0x6968	0xffffffff>,
			<0x696c	0xffffffff>,
			<0x6b48	0x330330>,
			<0x6b4c	0x81>,
			<0x6b50	0x3333>,
			<0x6b54	0x3333>,
			<0x6b64	0x1a5555>,
			<0x6b68	0xbaaa892a>,
			<0x6b70	0x0c0c0202>,
			<0x6b74	0x0e0e0202>,
			<0x6b78	0x0e0e0000>,
			<0x6b80	0x20042004>,
			<0x6b84	0x20042004>;
};
