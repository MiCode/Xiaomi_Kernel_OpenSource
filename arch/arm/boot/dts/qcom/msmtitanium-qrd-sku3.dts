/*
 * Copyright (c) 2015, The Linux Foundation. All rights reserved.
 *
 * This program is free software; you can redistribute it and/or modify
 * it under the terms of the GNU General Public License version 2 and
 * only version 2 as published by the Free Software Foundation.
 *
 * This program is distributed in the hope that it will be useful,
 * but WITHOUT ANY WARRANTY; without even the implied warranty of
 * MERCHANTABILITY or FITNESS FOR A PARTICULAR PURPOSE.  See the
 * GNU General Public License for more details.
 */

/dts-v1/;

#include "msmtitanium.dtsi"
#include "msmtitanium-qrd-sku3.dtsi"

/ {
	model = "Qualcomm Technologies, Inc. MSMTITANIUM QRD SKU3";
	compatible = "qcom,msmtitanium-qrd-sku3",
		   "qcom,msmtitanium-qrd", "qcom,msmtitanium", "qcom,qrd";
	qcom,board-id= <0x2000b 0>;
};

