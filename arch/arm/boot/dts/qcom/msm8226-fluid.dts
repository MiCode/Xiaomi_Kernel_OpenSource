/* Copyright (c) 2013-2014 The Linux Foundation. All rights reserved.
 *
 * This program is free software; you can redistribute it and/or modify
 * it under the terms of the GNU General Public License version 2 and
 * only version 2 as published by the Free Software Foundation.
 *
 * This program is distributed in the hope that it will be useful,
 * but WITHOUT ANY WARRANTY; without even the implied warranty of
 * MERCHANTABILITY or FITNESS FOR A PARTICULAR PURPOSE.  See the
 * GNU General Public License for more details.
 */

/dts-v1/;
#include "msm8226.dtsi"
#include "msm8226-memory.dtsi"

/ {
	model = "Qualcomm Technologies, Inc. MSM 8226 FLUID";
	compatible = "qcom,msm8226-fluid", "qcom,msm8226", "qcom,fluid";
	qcom,msm-id = <145 3 0>,
		      <158 3 0>,
		      <159 3 0>,
		      <198 3 0>;
};

&soc {
	serial@f991f000 {
		status = "disabled";
	};
};

&pm8226_bms {
	status = "ok";
};
