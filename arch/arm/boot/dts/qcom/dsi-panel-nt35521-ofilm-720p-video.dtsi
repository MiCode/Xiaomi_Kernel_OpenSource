/* Copyright (c) 2013, The Linux Foundation. All rights reserved.
 * Copyright (C) 2016 XiaoMi, Inc.
 *
 * This program is free software; you can redistribute it and/or modify
 * it under the terms of the GNU General Public License version 2 and
 * only version 2 as published by the Free Software Foundation.
 *
 * This program is distributed in the hope that it will be useful,
 * but WITHOUT ANY WARRANTY; without even the implied warranty of
 * MERCHANTABILITY or FITNESS FOR A PARTICULAR PURPOSE.  See the
 * GNU General Public License for more details.
 */

/*---------------------------------------------------------------------------
 * This file is autogenerated file using gcdb parser. Please do not edit it.
 * Update input XML file to add a new entry or update variable in this file
 * VERSION = "1.0"
 *---------------------------------------------------------------------------*/
&mdss_mdp {
	dsi_nt35521_ofilm_720_video: qcom,mdss_dsi_nt35521_ofilm_720p_video {
		qcom,mdss-dsi-panel-name = "nt35521_HD720p_video_OFILM";
		qcom,mdss-dsi-panel-controller = <&mdss_dsi0>;
		qcom,mdss-dsi-panel-type = "dsi_video_mode";
		qcom,mdss-dsi-panel-destination = "display_1";
		qcom,mdss-dsi-panel-framerate = <60>;
		qcom,mdss-dsi-virtual-channel-id = <0>;
		qcom,mdss-dsi-stream = <0>;
		qcom,mdss-dsi-panel-width = <720>;
		qcom,mdss-dsi-panel-height = <1280>;
		qcom,mdss-pan-physical-width-dimension = <58>;
		qcom,mdss-pan-physical-height-dimension = <103>;
		qcom,mdss-dsi-h-front-porch = <160>;
		qcom,mdss-dsi-h-back-porch = <160>;
		qcom,mdss-dsi-h-pulse-width = <20>;
		qcom,mdss-dsi-h-sync-skew = <0>;
		qcom,mdss-dsi-v-back-porch = <16>;
		qcom,mdss-dsi-v-front-porch = <16>;
		qcom,mdss-dsi-v-pulse-width = <2>;
		qcom,mdss-dsi-h-left-border = <0>;
		qcom,mdss-dsi-h-right-border = <0>;
		qcom,mdss-dsi-v-top-border = <0>;
		qcom,mdss-dsi-v-bottom-border = <20>;
		qcom,mdss-dsi-bpp = <24>;
		qcom,mdss-dsi-underflow-color = <0xff>;
		qcom,mdss-dsi-border-color = <0>;
		qcom,mdss-dsi-pixel-packing = "tight";
		qcom,mdss-dsi-on-command = [39 01 00 00 00 00 06 F0 55 AA 52 08 00
				39 01 00 00 00 00 02 C8 00
				39 01 00 00 00 00 06 F0 55 AA 52 08 01
				39 01 00 00 00 00 03 B5 04 04
				39 01 00 00 00 00 03 B9 35 35
				39 01 00 00 00 00 03 BA 25 25
				05 01 00 00 78 00 02 11 00
				05 01 00 00 00 00 02 29 00];
		qcom,mdss-dsi-off-command = [05 01 00 00 00 00 02 28 00
				05 01 00 00 00 00 02 10 00];
		qcom,mdss-dsi-on-command-state = "dsi_lp_mode";
		qcom,mdss-dsi-off-command-state = "dsi_hs_mode";
		qcom,mdss-dsi-panel-warm-command = [29 00 00 00 00 00 06 F0 55 AA 52 08 02
				29 00 00 00 00 00 05 EF 11 08 16 19
				29 00 00 00 00 00 02 EE 03
				29 00 00 00 00 00 11 B0 00 1D 00 48 00 5D 00 6C 00 78 00 89 00 A4 00 DC
				29 00 00 00 00 00 11 B1 01 09 01 50 01 86 01 DE 02 24 02 26 02 67 02 AD
				29 00 00 00 00 00 11 B2 02 DA 03 14 03 3D 03 72 03 95 03 A9 03 B7 03 C7
				29 00 00 00 00 00 05 B3 03 FD 03 FF
				29 00 00 00 00 00 11 B4 00 A6 00 AD 00 BA 00 C7 00 D5 00 EB 00 FF 01 26
				29 00 00 00 00 00 11 B5 01 47 01 79 01 A9 01 F5 02 33 02 35 02 73 02 B8
				29 00 00 00 00 00 11 B6 02 E5 03 1E 03 43 03 77 03 96 03 AA 03 B7 03 C6
				29 00 00 00 00 00 05 B7 03 DA 03 FF
				29 00 00 00 00 00 11 B8 01 2E 01 32 01 39 01 40 01 47 01 53 01 5F 01 76
				29 00 00 00 00 00 11 B9 01 8B 01 B1 01 D7 02 14 02 4A 02 4B 02 86 02 C9
				29 00 00 00 00 00 11 BA 02 F7 03 33 03 65 03 8F 03 98 03 A5 03 B2 03 C1
				29 00 00 00 00 00 05 BB 03 DD 03 FF
				29 00 00 00 00 00 11 BC 00 1D 00 48 00 5D 00 6C 00 78 00 89 00 A4 00 DC
				29 00 00 00 00 00 11 BD 01 09 01 50 01 86 01 DE 02 24 02 26 02 67 02 AD
				29 00 00 00 00 00 11 BE 02 DA 03 14 03 3D 03 72 03 95 03 A9 03 B7 03 C7
				29 00 00 00 00 00 05 BF 03 FD 03 FF
				29 00 00 00 00 00 11 C0 00 A6 00 AD 00 BA 00 C7 00 D5 00 EB 00 FF 01 26
				29 00 00 00 00 00 11 C1 01 47 01 79 01 A9 01 F5 02 33 02 35 02 73 02 B8
				29 00 00 00 00 00 11 C2 02 E5 03 1E 03 43 03 77 03 96 03 AA 03 B7 03 C6
				29 00 00 00 00 00 05 C3 03 DA 03 FF
				29 00 00 00 00 00 11 C4 01 2E 01 32 01 39 01 40 01 47 01 53 01 5F 01 76
				29 00 00 00 00 00 11 C5 01 8B 01 B1 01 D7 02 14 02 4A 02 4B 02 86 02 C9
				29 00 00 00 00 00 11 C6 02 F7 03 33 03 65 03 8F 03 98 03 A5 03 B2 03 C1
				29 01 00 00 00 00 05 C7 03 DD 03 FF];
		qcom,mdss-dsi-panel-cool-command = [29 00 00 00 00 00 06 F0 55 AA 52 08 02
				29 00 00 00 00 00 05 EF 11 08 16 19
				29 00 00 00 00 00 02 EE 03
				29 00 00 00 00 00 11 B0 00 1D 00 49 00 61 00 70 00 7A 00 8D 00 AF 00 E8
				29 00 00 00 00 00 11 B1 01 16 01 5E 01 95 01 EE 02 34 02 36 02 78 02 C4
				29 00 00 00 00 00 11 B2 02 F3 03 2D 03 59 03 91 03 A1 03 B5 03 C1 03 CE
				29 00 00 00 00 00 05 B3 03 FA 03 FF
				29 00 00 00 00 00 11 B4 00 1D 00 45 00 5B 00 6B 00 78 00 8B 00 AE 00 E3
				29 00 00 00 00 00 11 B5 01 13 01 59 01 91 01 EC 02 32 02 36 02 77 02 C3
				29 00 00 00 00 00 11 B6 02 F3 03 2E 03 57 03 8F 03 A0 03 B4 03 BF 03 CE
				29 00 00 00 00 00 05 B7 03 F8 03 FF
				29 00 00 00 00 00 11 B8 00 78 00 7C 00 86 00 8C 00 9A 00 B9 00 D6 01 00
				29 00 00 00 00 00 11 B9 01 29 01 67 01 9B 01 F2 02 36 02 39 02 7A 02 C7
				29 00 00 00 00 00 11 BA 02 F8 03 38 03 6C 03 98 03 A4 03 B2 03 BB 03 CC
				29 00 00 00 00 00 05 BB 03 F3 03 FF
				29 00 00 00 00 00 11 BC 00 1D 00 49 00 61 00 70 00 7A 00 8D 00 AF 00 E8
				29 00 00 00 00 00 11 BD 01 16 01 5E 01 95 01 EE 02 34 02 36 02 78 02 C4
				29 00 00 00 00 00 11 BE 02 F3 03 2D 03 59 03 91 03 A1 03 B5 03 C1 03 CE
				29 00 00 00 00 00 05 BF 03 FA 03 FF
				29 00 00 00 00 00 11 C0 00 1D 00 45 00 5B 00 6B 00 78 00 8B 00 AE 00 E3
				29 00 00 00 00 00 11 C1 01 13 01 59 01 91 01 EC 02 32 02 36 02 77 02 C3
				29 00 00 00 00 00 11 C2 02 F3 03 2E 03 57 03 8F 03 A0 03 B4 03 BF 03 CE
				29 00 00 00 00 00 05 C3 03 F8 03 FF
				29 00 00 00 00 00 11 C4 00 78 00 7C 00 86 00 8C 00 9A 00 B9 00 D6 01 00
				29 00 00 00 00 00 11 C5 01 29 01 67 01 9B 01 F2 02 36 02 39 02 7A 02 C7
				29 00 00 00 00 00 11 C6 02 F8 03 38 03 6C 03 98 03 A4 03 B2 03 BB 03 CC
				29 01 00 00 00 00 05 C7 03 F3 03 FF];
		qcom,mdss-dsi-panel-nature-command = [29 00 00 00 00 00 06 F0 55 AA 52 08 02
				29 00 00 00 00 00 05 EF 11 08 16 19
				29 00 00 00 00 00 02 EE 03
				29 00 00 00 00 00 11 B0 00 1D 00 49 00 61 00 70 00 7A 00 8D 00 AF 00 E8
				29 00 00 00 00 00 11 B1 01 16 01 5E 01 95 01 EE 02 34 02 36 02 78 02 C2
				29 00 00 00 00 00 11 B2 02 F2 03 2C 03 58 03 91 03 A1 03 B5 03 C0 03 CE
				29 00 00 00 00 00 05 B3 03 FA 03 FF
				29 00 00 00 00 00 11 B4 00 7D 00 84 00 8A 00 98 00 A9 00 C5 00 E1 01 12
				29 00 00 00 00 00 11 B5 01 35 01 74 01 A7 01 F9 02 3C 02 3E 02 7E 02 C7
				29 00 00 00 00 00 11 B6 02 F8 03 32 03 5B 03 92 03 A2 03 B6 03 C0 03 CE
				29 00 00 00 00 00 05 B7 03 F8 03 FF
				29 00 00 00 00 00 11 B8 00 E2 00 E8 00 F3 00 FD 01 07 01 19 01 2B 01 4D
				29 00 00 00 00 00 11 B9 01 66 01 98 01 C4 02 0C 02 49 02 4B 02 89 02 D2
				29 00 00 00 00 00 11 BA 03 04 03 45 03 7D 03 A2 03 A9 03 B7 03 BB 03 CC
				29 00 00 00 00 00 05 BB 03 F3 03 FF
				29 00 00 00 00 00 11 BC 00 1D 00 49 00 61 00 70 00 7A 00 8D 00 AF 00 E8
				29 00 00 00 00 00 11 BD 01 16 01 5E 01 95 01 EE 02 34 02 36 02 78 02 C2
				29 00 00 00 00 00 11 BE 02 F2 03 2C 03 58 03 91 03 A1 03 B5 03 C0 03 CE
				29 00 00 00 00 00 05 BF 03 FA 03 FF
				29 00 00 00 00 00 11 C0 00 7D 00 84 00 8A 00 98 00 A9 00 C5 00 E1 01 12
				29 00 00 00 00 00 11 C1 01 35 01 74 01 A7 01 F9 02 3C 02 3E 02 7E 02 C7
				29 00 00 00 00 00 11 C2 02 F8 03 32 03 5B 03 92 03 A2 03 B6 03 C0 03 CE
				29 00 00 00 00 00 05 C3 03 F8 03 FF
				29 00 00 00 00 00 11 C4 00 E2 00 E8 00 F3 00 FD 01 07 01 19 01 2B 01 4D
				29 00 00 00 00 00 11 C5 01 66 01 98 01 C4 02 0C 02 49 02 4B 02 89 02 D2
				29 00 00 00 00 00 11 C6 03 04 03 45 03 7D 03 A2 03 A9 03 B7 03 BB 03 CC
				29 01 00 00 00 00 05 C7 03 F3 03 FF];
		qcom,mdss-dsi-panel-ce-std-command = [29 00 00 00 00 00 06 F0 55 AA 52 08 00
				29 01 00 00 00 00 02 55 01];
	 	qcom,mdss-dsi-panel-ce-vivid-command = [29 00 00 00 00 00 06 F0 55 AA 52 08 00
				29 00 00 00 00 00 02 55 80
				29 00 00 00 00 00 11 CC 40 36 87 00 00 00 00 00 00 00 00 00 40 08 A5 05
				29 00 00 00 00 00 11 D1 00 02 0A 0E 12 16 18 18 18 18 16 14 12 0E 08 00
				29 00 00 00 00 00 0D D7 28 30 27 23 23 00 00 00 00 00 00 00
				29 01 00 00 00 00 0E D8 00 00 00 00 00 00 00 00 00 00 23 25 00];
		qcom,mdss-dsi-panel-gamma-command-state = "dsi_lp_mode";
		qcom,mdss-dsi-panel-ce-command-state = "dsi_lp_mode";
		qcom,mdss-dsi-h-sync-pulse = <1>;
		qcom,mdss-dsi-traffic-mode = "burst_mode";
		qcom,mdss-dsi-bllp-eof-power-mode;
		qcom,mdss-dsi-bllp-power-mode;
		qcom,mdss-dsi-lane-0-state;
		qcom,mdss-dsi-lane-1-state;
		qcom,mdss-dsi-lane-2-state;
		qcom,mdss-dsi-panel-timings = [B4 2A 1C 00 54 58 20 2E 20 03 04 00];
		qcom,mdss-dsi-t-clk-post = <0x03>;
		qcom,mdss-dsi-t-clk-pre = <0x23>;
		qcom,mdss-dsi-bl-min-level = <1>;
		qcom,mdss-dsi-bl-max-level = <255>;
		qcom,mdss-dsi-bl-pmic-pwm-frequency = <100>;
		qcom,mdss-dsi-bl-pmic-bank-select = <0>;
		qcom,mdss-dsi-dma-trigger = "trigger_sw";
		qcom,mdss-dsi-mdp-trigger = "none";
		qcom,mdss-dsi-lp11-init;
		qcom,mdss-dsi-init-delay-us = <50000>;
		qcom,mdss-dsi-bl-pmic-control-type = "bl_ctrl_pwm";
		qcom,mdss-dsi-reset-sequence = <1 5>, <0 10>, <1 30>;
	};
};
