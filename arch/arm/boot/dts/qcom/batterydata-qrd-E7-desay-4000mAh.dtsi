
qcom,3199087_huaqin_e7desay_4000mah_averaged_masterslave_dec4th2017 {
	qcom,max-voltage-uv = <4400000>;
	qcom,nom-batt-capacity-mah = <4000>;
	qcom,batt-id-kohm = <24>;
	qcom,battery-beta = <3380>;
	qcom,battery-type = "qrd_msm8953_E7_desay_4000mah";
	qcom,chg-rslow-comp-c1 = <4132413>;
	qcom,chg-rslow-comp-c2 = <7193808>;
	qcom,chg-rs-to-rslow = <1059831>;
	qcom,chg-rslow-comp-thr = <0xB7>;
	qcom,checksum = <0x4B4D>;
	qcom,gui-version = "PMI8950GUI - 2.0.0.16";
	qcom,fg-profile-data = [
		A5 83 51 74
		6F 79 3B 6C
		37 83 D1 73
		70 84 1A 81
		EA 81 49 A0
		75 C4 52 D2
		6C 0F D0 83
		B9 76 4E 7B
		10 74 2F 83
		61 7A 78 8C
		EC 88 20 82
		47 A0 3F C5
		75 D8 63 0C
		DC 0F C6 59
		14 70 EE FC
		0E 20 34 45
		77 39 00 00
		46 47 EA 3B
		FD 2E 00 00
		00 00 00 00
		00 00 00 00
		60 71 DC 6A
		29 7C 0B 83
		51 7D DF 72
		3B 67 A7 78
		D6 75 DE 6A
		04 74 5A A3
		2D 6E 60 A6
		5D A0 71 0C
		28 00 FF 36
		F0 11 30 03
		00 00 00 0C
	];
};
