qcom,b7_lg_3840mah {
	qcom,max-voltage-uv = <4400000>;
	qcom,nom-batt-capacity-mah = <3800>;
	qcom,batt-id-kohm = <50>;
	qcom,battery-beta = <3380>;
	qcom,battery-type = "b7_lg";
	qcom,chg-rslow-comp-c1 = <3925013>;
	qcom,chg-rslow-comp-c2 = <6341655>;
	qcom,chg-rs-to-rslow = <1721524>;
	qcom,chg-rslow-comp-thr = <0xB1>;
	qcom,checksum = <0xBA78>;
	qcom,gui-version = "PMI8996GUI - 1.1.0.0";
	qcom,fg-profile-data = [
		 D2 83 18 7C
		 50 80 67 75
		 5C 83 BA 6C
		 4B 88 74 8F
		 30 82 52 99
		 14 BC 3E C8
		 56 0F 22 83
		 2D 70 DB 48
		 74 68 36 83
		 62 79 3D 86
		 6E 81 A6 82
		 FB 90 23 AD
		 0F B2 70 11
		 DD 0E 01 58
		 14 70 15 FD
		 EA 3E AE 45
		 FA 43 00 00
		 AF 3F E3 42
		 C1 47 00 00
		 00 00 00 00
		 00 00 00 00
		 1B 72 66 70
		 29 71 83 88
		 0A 75 6A 62
		 F1 59 A0 79
		 08 6F F2 51
		 CB 5E 09 AA
		 26 7D 6A 12
		 6C A0 71 0C
		 28 00 FF 36
		 F0 11 30 03
		 00 00 00 0C
	];
};
