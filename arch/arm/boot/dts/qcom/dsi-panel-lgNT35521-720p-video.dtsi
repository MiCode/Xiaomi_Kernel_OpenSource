/* Copyright (c) 2013, The Linux Foundation. All rights reserved.
 * Copyright (C) 2016 XiaoMi, Inc.
 *
 * This program is free software; you can redistribute it and/or modify
 * it under the terms of the GNU General Public License version 2 and
 * only version 2 as published by the Free Software Foundation.
 *
 * This program is distributed in the hope that it will be useful,
 * but WITHOUT ANY WARRANTY; without even the implied warranty of
 * MERCHANTABILITY or FITNESS FOR A PARTICULAR PURPOSE.  See the
 * GNU General Public License for more details.
 */

/*---------------------------------------------------------------------------
 * This file is autogenerated file using gcdb parser. Please do not edit it.
 * Update input XML file to add a new entry or update variable in this file
 * VERSION = "1.0"
 *---------------------------------------------------------------------------*/
&mdss_mdp {
	dsi_lgnt35521_720p_vid: qcom,mdss_dsi_lgnt35521_720p_video {
		qcom,mdss-dsi-panel-name = "lg nt35521 720p video mode dsi panel";
		qcom,mdss-dsi-panel-controller = <&mdss_dsi0>;
		qcom,mdss-dsi-panel-type = "dsi_video_mode";
		qcom,mdss-dsi-panel-destination = "display_1";
		qcom,cont-splash-enabled;
		qcom,mdss-dsi-panel-framerate = <60>;
		qcom,mdss-dsi-virtual-channel-id = <0>;
		qcom,mdss-dsi-stream = <0>;
		qcom,mdss-dsi-panel-width = <720>;
		qcom,mdss-dsi-panel-height = <1280>;
		qcom,mdss-dsi-h-front-porch = <42>;
		qcom,mdss-dsi-h-back-porch = <48>;
		qcom,mdss-dsi-h-pulse-width = <4>;
		qcom,mdss-dsi-h-sync-skew = <0>;
		qcom,mdss-dsi-v-back-porch = <32>;
		qcom,mdss-dsi-v-front-porch = <64>;
		qcom,mdss-dsi-v-pulse-width = <4>;
		qcom,mdss-dsi-h-left-border = <0>;
		qcom,mdss-dsi-h-right-border = <0>;
		qcom,mdss-dsi-v-top-border = <0>;
		qcom,mdss-dsi-v-bottom-border = <0>;
		qcom,mdss-dsi-bpp = <24>;
		qcom,mdss-dsi-underflow-color = <0xff>;
		qcom,mdss-dsi-border-color = <0>;
		qcom,mdss-dsi-pixel-packing = "tight";
		qcom,mdss-dsi-on-command = [
				15 01 00 00 00 00 02 51 ff
				15 01 00 00 10 00 02 53 2c
				15 01 00 00 10 00 02 55 01
				05 01 00 00 78 00 02 11 00
				05 01 00 00 23 00 02 29 00
				];
		qcom,mdss-dsi-off-command = [05 01 00 00 64 00 02 28 00
				05 01 00 00 00 00 02 10 00];
		ceon-command = [
				29 00 00 00 00 00 06 F0 55 AA 52 08 00
				29 00 00 00 00 00 11 CC 40 36 87 00 00 00 00 00 00 00 00 00 40 08 A5 05
				29 00 00 00 00 00 11 D1 00 02 0A 0E 12 16 18 18 18 18 16 14 12 0E 08 00
				29 00 00 00 00 00 0D D7 28 30 27 23 23 00 00 00 00 00 00 00
				29 00 00 00 00 00 0E D8 00 00 00 00 00 00 00 00 00 00 23 25 00
				15 01 00 00 10 00 02 55 81
				];
		ceoff-command = [
				15 01 00 00 10 00 02 55 01
				];

		warm-command = [
				29 01 00 00 00 00 06 F0 55 AA 52 08 02
				29 01 00 00 00 00 02 EE 00
				29 01 00 00 00 00 11 B0 00 2D 00 3C 00 5B 00 70 00 84 00 A7 00 C0 00 EB
				29 01 00 00 00 00 11 B1 01 15 01 50 01 7F 01 CC 02 0B 02 0C 02 4A 02 8E
				29 01 00 00 00 00 11 B2 02 BB 02 F3 03 1C 03 45 03 5B 03 77 03 90 03 A8
				29 01 00 00 00 00 05 B3 03 CF 03 FF
				29 01 00 00 00 00 11 B4 00 2D 00 3C 00 5B 00 70 00 84 00 A7 00 C4 00 F1
				29 01 00 00 00 00 11 B5 01 18 01 52 01 81 01 CB 02 0A 02 0C 02 4A 02 8E
				29 01 00 00 00 00 11 B6 02 BA 02 F3 03 1C 03 45 03 5B 03 77 03 90 03 A8
				29 01 00 00 00 00 05 B7 03 CF 03 FF
				29 01 00 00 00 00 11 B8 00 AD 00 B4 00 BF 00 CA 00 D0 00 E7 00 F9 01 17
				29 01 00 00 00 00 11 B9 01 37 01 68 01 90 01 D6 02 15 02 17 02 4F 02 94
				29 01 00 00 00 00 11 BA 02 BA 02 F3 03 1C 03 45 03 5B 03 77 03 90 03 A8
				29 01 00 00 00 00 05 BB 03 CF 03 FF
				29 01 00 00 00 00 11 BC 00 00 00 15 00 3E 00 55 00 6C 00 93 00 AD 00 DB
				29 01 00 00 00 00 11 BD 01 0A 01 46 01 77 01 C7 02 0B 02 0C 02 4A 02 8E
				29 01 00 00 00 00 11 BE 02 BB 02 F3 03 1C 03 45 03 5B 03 77 03 90 03 A8
				29 01 00 00 00 00 05 BF 03 CF 03 FF
				29 01 00 00 00 00 11 C0 00 00 00 19 00 3D 00 59 00 6B 00 93 00 B2 00 E1
				29 01 00 00 00 00 11 C1 01 0C 01 48 01 79 01 C6 02 0A 02 0C 02 4A 02 8E
				29 01 00 00 00 00 11 C2 02 BA 02 F3 03 1C 03 45 03 5B 03 77 03 90 03 A8
				29 01 00 00 00 00 05 C3 03 CF 03 FF
				29 01 00 00 00 00 11 C4 00 80 00 8A 00 98 00 A9 00 B0 00 C7 00 DD 01 00
				29 01 00 00 00 00 11 C5 01 22 01 54 01 81 01 CB 02 0A 02 0C 02 4F 02 94
				29 01 00 00 00 00 11 C6 02 BA 02 F3 03 1C 03 45 03 5B 03 77 03 90 03 A8
				29 01 00 00 00 00 05 C7 03 CF 03 FF
				];
		default-command = [
				29 01 00 00 00 00 06 F0 55 AA 52 08 02
				29 01 00 00 00 00 02 EE 00
				29 01 00 00 00 00 11 B0 00 2D 00 3C 00 5B 00 70 00 84 00 A7 00 C0 00 EB
				29 01 00 00 00 00 11 B1 01 15 01 50 01 7F 01 CC 02 0B 02 0C 02 4A 02 8E
				29 01 00 00 00 00 11 B2 02 BB 02 F3 03 1C 03 45 03 5B 03 77 03 90 03 A8
				29 01 00 00 00 00 05 B3 03 CF 03 FF
				29 01 00 00 00 00 11 B4 00 2D 00 3C 00 5B 00 70 00 84 00 A7 00 C4 00 F1
				29 01 00 00 00 00 11 B5 01 18 01 52 01 81 01 CB 02 0A 02 0C 02 4A 02 8E
				29 01 00 00 00 00 11 B6 02 BA 02 F3 03 1C 03 45 03 5B 03 77 03 90 03 A8
				29 01 00 00 00 00 05 B7 03 CF 03 FF
				29 01 00 00 00 00 11 B8 00 2D 00 3C 00 55 00 6A 00 7B 00 9B 00 B6 00 E2
				29 01 00 00 00 00 11 B9 01 0C 01 48 01 76 01 C5 02 04 02 06 02 46 02 8A
				29 01 00 00 00 00 11 BA 02 B9 02 F5 03 1C 03 45 03 5B 03 77 03 90 03 A8
				29 01 00 00 00 00 05 BB 03 CF 03 FF
				29 01 00 00 00 00 11 BC 00 00 00 15 00 3E 00 55 00 6C 00 93 00 AD 00 DB
				29 01 00 00 00 00 11 BD 01 0A 01 46 01 77 01 C7 02 0B 02 0C 02 4A 02 8E
				29 01 00 00 00 00 11 BE 02 BB 02 F3 03 1C 03 45 03 5B 03 77 03 90 03 A8
				29 01 00 00 00 00 05 BF 03 CF 03 FF
				29 01 00 00 00 00 11 C0 00 00 00 19 00 3D 00 59 00 6B 00 93 00 B2 00 E1
				29 01 00 00 00 00 11 C1 01 0C 01 48 01 79 01 C6 02 0A 02 0C 02 4A 02 8E
				29 01 00 00 00 00 11 C2 02 BA 02 F3 03 1C 03 45 03 5B 03 77 03 90 03 A8
				29 01 00 00 00 00 05 C3 03 CF 03 FF
				29 01 00 00 00 00 11 C4 00 00 00 12 00 2A 00 42 00 56 00 76 00 A3 00 D2
				29 01 00 00 00 00 11 C5 01 01 01 3B 01 6E 01 C0 02 04 02 06 02 46 02 8A
				29 01 00 00 00 00 11 C6 02 B9 02 F5 03 1C 03 45 03 5B 03 77 03 90 03 A8
				29 01 00 00 00 00 05 C7 03 CF 03 FF
				];

		cold-command = [
				29 01 00 00 00 00 06 F0 55 AA 52 08 02
				29 01 00 00 00 00 02 EE 00
				29 01 00 00 00 00 11 B0 00 A4 00 AA 00 BA 00 CA 00 D4 00 EA 00 FB 01 18
				29 01 00 00 00 00 11 B1 01 32 01 5C 01 86 01 C6 02 0C 02 0E 02 4E 02 92
				29 01 00 00 00 00 11 B2 02 BA 02 F3 03 1C 03 45 03 5B 03 77 03 90 03 A8
				29 01 00 00 00 00 05 B3 03 CF 03 FF
				29 01 00 00 00 00 11 B4 00 A4 00 AA 00 BA 00 CA 00 D4 00 EA 00 FB 01 18
				29 01 00 00 00 00 11 B5 01 32 01 5C 01 86 01 C6 02 0C 02 0E 02 4E 02 92
				29 01 00 00 00 00 11 B6 02 BA 02 F3 03 1C 03 45 03 5B 03 77 03 90 03 A8
				29 01 00 00 00 00 05 B7 03 CF 03 FF
				29 01 00 00 00 00 11 B8 00 2D 00 3C 00 55 00 6F 00 81 00 A9 00 BA 00 E6
				29 01 00 00 00 00 11 B9 01 0A 01 43 01 72 01 BC 01 FE 02 00 02 43 02 89
				29 01 00 00 00 00 11 BA 02 B9 02 F5 03 1C 03 45 03 5B 03 77 03 90 03 A8
				29 01 00 00 00 00 05 BB 03 CF 03 FF
				29 01 00 00 00 00 11 BC 00 77 00 80 00 90 00 A0 00 B0 00 CB 00 E4 01 0A
				29 01 00 00 00 00 11 BD 01 2D 01 63 01 8E 01 D5 02 0F 02 11 02 4E 02 92
				29 01 00 00 00 00 11 BE 02 BA 02 F3 03 1C 03 45 03 5B 03 77 03 90 03 A8
				29 01 00 00 00 00 05 BF 03 CF 03 FF
				29 01 00 00 00 00 11 C0 00 77 00 80 00 90 00 A0 00 B0 00 CF 00 E4 01 0A
				29 01 00 00 00 00 11 C1 01 2D 01 63 01 8E 01 D5 02 0F 02 11 02 4E 02 92
				29 01 00 00 00 00 11 C2 02 BA 02 F3 03 1C 03 45 03 5B 03 77 03 90 03 A8
				29 01 00 00 00 00 05 C3 03 CF 03 FF
				29 01 00 00 00 00 11 C4 00 00 00 12 00 2A 00 46 00 5C 00 80 00 A7 00 D6
				29 01 00 00 00 00 11 C5 00 FF 01 36 01 6A 01 B7 01 FE 02 00 02 43 02 89
				29 01 00 00 00 00 11 C6 02 B9 02 F5 03 1C 03 45 03 5B 03 77 03 90 03 A8
				29 01 00 00 00 00 05 C7 03 CF 03 FF
				];
		qcom,mdss-dsi-on-command-state = "dsi_lp_mode";
		qcom,mdss-dsi-off-command-state = "dsi_lp_mode";
		qcom,mdss-extra-command-state = "dsi_lp_mode";
		qcom,mdss-dsi-panel-status-command = [06 01 00 01 05 00 02 0A 08];
		qcom,mdss-dsi-panel-status-command-state = "dsi_lp_mode";
		qcom,mdss-dsi-panel-status-check-mode = "reg_read";
		qcom,mdss-dsi-panel-status-value = <0x9c>;
		qcom,esd-check-enabled;
		qcom,mdss-dsi-h-sync-pulse = <1>;
		qcom,mdss-dsi-traffic-mode = "burst_mode";
		qcom,mdss-dsi-bllp-eof-power-mode;
		qcom,mdss-dsi-bllp-power-mode;
		qcom,mdss-dsi-lane-0-state;
		qcom,mdss-dsi-lane-1-state;
		qcom,mdss-dsi-lane-2-state;
		qcom,mdss-dsi-lane-3-state;
		qcom,mdss-dsi-panel-timings = [ 7B 1A 10 00 3C 40 14 1C 15 03 04 00];
		qcom,mdss-dsi-t-clk-post = <0x20>;
		qcom,mdss-dsi-t-clk-pre = <0x2D>;
		qcom,mdss-dsi-bl-min-level = <1>;
		qcom,mdss-dsi-bl-max-level = <64>;
		qcom,mdss-dsi-dma-trigger = "trigger_sw";
		qcom,mdss-dsi-mdp-trigger = "none";
		qcom,mdss-dsi-bl-pmic-control-type = "bl_ctrl_gpio";
		qcom,mdss-dsi-pulse-gpio = <&msm_gpio 98 0>;
		qcom,mdss-dsi-reset-sequence = <1 20>, <0 20>, <1 120>;
		qcom,mdss-pan-physical-width-dimension = <68>;
		qcom,mdss-pan-physical-height-dimension = <121>;

	};
};

