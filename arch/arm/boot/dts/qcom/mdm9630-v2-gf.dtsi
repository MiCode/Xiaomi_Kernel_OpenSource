/* Copyright (c) 2014, The Linux Foundation. All rights reserved.
 *
 * This program is free software; you can redistribute it and/or modify
 * it under the terms of the GNU General Public License version 2 and
 * only version 2 as published by the Free Software Foundation.
 *
 * This program is distributed in the hope that it will be useful,
 * but WITHOUT ANY WARRANTY; without even the implied warranty of
 * MERCHANTABILITY or FITNESS FOR A PARTICULAR PURPOSE.  See the
 * GNU General Public License for more details.
 */

#include "mdm9630-v2.dtsi"

/ {
	qcom,msm-id = <0x200bb 0x20000>, <0x200e3 0x20000>, <0x200e4 0x20000>,
		      <0x200e5 0x20000>, <0x200e6 0x20000>, <0x200e7 0x20000>;
};

&ssphy0 {
	qcom,qmp-misc-config;
};
