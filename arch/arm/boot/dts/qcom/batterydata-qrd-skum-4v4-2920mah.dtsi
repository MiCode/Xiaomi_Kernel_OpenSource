/* Copyright (c) 2015, The Linux Foundation. All rights reserved.
 *
 * This program is free software; you can redistribute it and/or modify
 * it under the terms of the GNU General Public License version 2 and
 * only version 2 as published by the Free Software Foundation.
 *
 * This program is distributed in the hope that it will be useful,
 * but WITHOUT ANY WARRANTY; without even the implied warranty of
 * MERCHANTABILITY or FITNESS FOR A PARTICULAR PURPOSE.  See the
 * GNU General Public License for more details.
 */

qcom,qrd_msm8952_skum_2920mah {
	qcom,max-voltage-uv = <4400000>;
	qcom,nom-batt-capacity-mah = <2920>;
	qcom,batt-id-kohm = <90>;
	qcom,battery-beta = <3435>;
	qcom,battery-type = "qrd_msm8952_skum_2920mah";
	qcom,fastchg-current-ma = <3000>;
	qcom,fg-cc-cv-threshold-mv = <4390>;
	qcom,chg-rslow-comp-c1 = <3030186>;
	qcom,chg-rslow-comp-c2 = <3746792>;
	qcom,chg-rs-to-rslow = <892752>;
	qcom,chg-rslow-comp-thr = <0x99>;
	qcom,checksum = <0x7DBF>;
	qcom,gui-version = "PMI8950GUI - 2.0.0.0";
	qcom,fg-profile-data = [
		B5 83 CF 75
		89 7A 3F 6E
		76 83 73 7D
		29 91 6E 9C
		24 82 38 99
		76 B7 1E C3
		4C 15 52 83
		CD 61 DE 6A
		B4 5A 38 83
		19 79 90 85
		B2 80 68 82
		BE 98 D9 B7
		6D C8 70 13
		CE 0B 28 61
		14 70 71 FD
		F5 37 9A 46
		0B 48 00 00
		B4 47 C7 32
		5F 30 00 00
		00 00 00 00
		00 00 00 00
		08 70 C3 69
		03 75 74 88
		97 7C DF 70
		A2 6D D0 79
		36 76 BC 68
		C9 68 C0 B0
		21 C7 62 62
		64 A0 71 0C
		28 00 FF 36
		F0 11 30 03
		00 00 00 0C
	];
};
