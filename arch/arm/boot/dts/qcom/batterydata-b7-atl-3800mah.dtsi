qcom,b7_atl_3840mah {
	qcom,max-voltage-uv = <4400000>;
	qcom,nom-batt-capacity-mah = <3800>;
	qcom,batt-id-kohm = <68>;
	qcom,battery-beta = <3435>;
	qcom,battery-type = "b7_atl";
	qcom,chg-rslow-comp-c1 = <3242434>;
	qcom,chg-rslow-comp-c2 = <4155869>;
	qcom,chg-rs-to-rslow = <1143884>;
	qcom,chg-rslow-comp-thr = <0x9C>;
	qcom,fg-cc-cv-threshold-mv = <4390>;
	qcom,checksum = <0x90D0>;
	qcom,gui-version = "PMI8996GUI - 1.1.0.4";
	qcom,fg-profile-data = [
			F4 83 30 7D
			24 81 F8 76
			3D 83 62 72
			19 7E 2F 7B
			E6 81 C5 9B
			25 BF 7A D0
			82 11 F9 83
			43 7D 65 81
			DD 77 2D 83
			5F 7A 64 8C
			C8 88 1F 82
			A5 9B 2C C4
			52 D2 69 0E
			B7 0E F9 59
			14 70 15 FD
			00 36 FB 3F
			E9 39 00 00
			82 4D EF 38
			35 48 00 00
			00 00 00 00
			00 00 00 00
			09 71 1B 6B
			A0 85 2B 73
			B6 77 46 71
			F6 58 44 7B
			E8 6E F9 63
			64 6D E6 A0
			2D 45 63 53
			65 A0 71 0C
			28 00 FF 36
			F0 11 30 03
			00 00 00 0C
	];
};
