/* Copyright (c) 2015, 2017 The Linux Foundation. All rights reserved.
 *
 * This program is free software; you can redistribute it and/or modify
 * it under the terms of the GNU General Public License version 2 and
 * only version 2 as published by the Free Software Foundation.
 *
 * This program is distributed in the hope that it will be useful,
 * but WITHOUT ANY WARRANTY; without even the implied warranty of
 * MERCHANTABILITY or FITNESS FOR A PARTICULAR PURPOSE.  See the
 * GNU General Public License for more details.
 */

/dts-v1/;

#include "mdm9650.dtsi"
#include "mdm9650-pinctrl.dtsi"

/ {
	model = "Qualcomm Technologies, Inc. MDM 9650 SIM";
	compatible = "qcom,mdm9650-sim",
		   "qcom,mdm9650", "qcom,sim";
	qcom,board-id = <16 0>;
};

&blsp1_uart1 {
	status = "ok";
};

&qnand_1 {
	status = "ok";
};
