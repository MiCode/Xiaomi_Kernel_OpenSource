/*
 * Copyright (c) 2015, The Linux Foundation. All rights reserved.
 * Copyright (C) 2018 XiaoMi, Inc.
 *
 * This program is free software; you can redistribute it and/or modify
 * it under the terms of the GNU General Public License version 2 and
 * only version 2 as published by the Free Software Foundation.
 *
 * This program is distributed in the hope that it will be useful,
 * but WITHOUT ANY WARRANTY; without even the implied warranty of
 * MERCHANTABILITY or FITNESS FOR A PARTICULAR PURPOSE.  See the
 * GNU General Public License for more details.
 */

/*---------------------------------------------------------------------------
 * This file is autogenerated file using gcdb parser. Please do not edit it.
 * Update input XML file to add a new entry or update variable in this file
 * VERSION = "1.0"
 *---------------------------------------------------------------------------*/
&mdss_mdp {
	dsi_tm_otm1901a_720p_video: qcom,mdss_dsi_tm_otm1901a_720p_video {
		qcom,mdss-dsi-panel-name = "tm otm1901a 720p video mode dsi panel";
		qcom,mdss-dsi-panel-controller = <&mdss_dsi0>;
		qcom,mdss-dsi-panel-type = "dsi_video_mode";
		qcom,mdss-dsi-panel-destination = "display_1";
		qcom,mdss-dsi-panel-framerate = <60>;
		qcom,mdss-dsi-virtual-channel-id = <0>;
		qcom,mdss-dsi-stream = <0>;
		qcom,mdss-dsi-panel-width = <720>;
		qcom,mdss-dsi-panel-height = <1280>;
		qcom,mdss-dsi-h-front-porch = <96>;
		qcom,mdss-dsi-h-back-porch = <96>;
		qcom,mdss-dsi-h-pulse-width = <4>;
		qcom,mdss-dsi-h-sync-skew = <0>;
		qcom,mdss-dsi-v-back-porch = <9>;
		qcom,mdss-dsi-v-front-porch = <14>;
		qcom,mdss-dsi-v-pulse-width = <1>;
		qcom,mdss-dsi-h-left-border = <0>;
		qcom,mdss-dsi-h-right-border = <0>;
		qcom,mdss-dsi-v-top-border = <0>;
		qcom,mdss-dsi-v-bottom-border = <0>;
		qcom,mdss-dsi-bpp = <24>;
		qcom,mdss-dsi-underflow-color = <0xff>;
		qcom,mdss-dsi-border-color = <0>;
		qcom,mdss-dsi-on-command = [
			39 01 00 00 00 00 02 00 00
			39 01 00 00 00 00 04 FF 19 01 01
			39 01 00 00 00 00 02 00 80
			39 01 00 00 00 00 03 FF 19 01
			39 01 00 00 00 00 02 00 00
			39 01 00 00 00 00 02 1C 33
			39 01 00 00 00 00 02 00 00
			39 01 00 00 00 00 02 1C 05
			39 01 00 00 00 00 05 2A 00 00 02 CF
			39 01 00 00 00 00 05 2B 00 00 04 FF
			39 01 00 00 00 00 02 00 90
			39 01 00 00 00 00 02 D7 00
			39 01 00 00 00 00 02 00 91
			39 01 00 00 00 00 02 D7 C8
			39 01 00 00 00 00 02 00 BA
			39 01 00 00 00 00 03 C0 C2 01
			39 01 00 00 00 00 02 00 B0
			39 01 00 00 00 00 02 CA 02
			39 01 00 00 00 00 02 00 80
			39 01 00 00 00 00 02 CA 80
			39 01 00 00 00 00 02 35 00
			39 01 00 00 00 00 02 00 C1
			39 01 00 00 00 00 02 C5 77
			39 01 00 00 00 00 02 00 86
			39 01 00 00 00 00 02 F3 E0
			39 01 00 00 1E 00 02 11 00
			39 01 00 00 0a 00 02 29 00
			39 01 00 00 00 00 02 53 24
			39 01 00 00 00 00 02 55 00];

		qcom,mdss-dsi-off-command = [05 01 00 00 35 00 02 28 00
					05 01 00 00 78 00 02 10 00];

		qcom,mdss-dsi-cabc-on-command = [
			23 01 00 00 00 00 02 55 01
		];

		qcom,mdss-dsi-cabc-off-command = [
			23 01 00 00 00 00 02 55 00
		];

		qcom,mdss-dsi-warm-command = [
			23 00 00 00 00 00 02 00 00
			23 00 00 00 00 00 02 E1 33
			23 00 00 00 00 00 02 E1 38
			23 00 00 00 00 00 02 E1 3a
			23 00 00 00 00 00 02 E1 43
			23 00 00 00 00 00 02 E1 49
			23 00 00 00 00 00 02 E1 50
			23 00 00 00 00 00 02 E1 59
			23 00 00 00 00 00 02 E1 69
			23 00 00 00 00 00 02 E1 70
			23 00 00 00 00 00 02 E1 80
			23 00 00 00 00 00 02 E1 89
			23 00 00 00 00 00 02 E1 8d
			23 00 00 00 00 00 02 E1 6f
			23 00 00 00 00 00 02 E1 6b
			23 00 00 00 00 00 02 E1 66
			23 00 00 00 00 00 02 E1 57
			23 00 00 00 00 00 02 E1 42
			23 00 00 00 00 00 02 E1 31
			23 00 00 00 00 00 02 E1 27
			23 00 00 00 00 00 02 E1 21
			23 00 00 00 00 00 02 E1 18
			23 00 00 00 00 00 02 E1 0f
			23 00 00 00 00 00 02 E1 07
			23 00 00 00 00 00 02 E1 03
			23 00 00 00 00 00 02 00 00
			23 00 00 00 00 00 02 E2 33
			23 00 00 00 00 00 02 E2 38
			23 00 00 00 00 00 02 E2 3a
			23 00 00 00 00 00 02 E2 43
			23 00 00 00 00 00 02 E2 49
			23 00 00 00 00 00 02 E2 50
			23 00 00 00 00 00 02 E2 59
			23 00 00 00 00 00 02 E2 69
			23 00 00 00 00 00 02 E2 70
			23 00 00 00 00 00 02 E2 80
			23 00 00 00 00 00 02 E2 89
			23 00 00 00 00 00 02 E2 8d
			23 00 00 00 00 00 02 E2 6f
			23 00 00 00 00 00 02 E2 6b
			23 00 00 00 00 00 02 E2 66
			23 00 00 00 00 00 02 E2 57
			23 00 00 00 00 00 02 E2 42
			23 00 00 00 00 00 02 E2 31
			23 00 00 00 00 00 02 E2 27
			23 00 00 00 00 00 02 E2 21
			23 00 00 00 00 00 02 E2 18
			23 00 00 00 00 00 02 E2 0f
			23 00 00 00 00 00 02 E2 07
			23 00 00 00 00 00 02 E2 03
			23 00 00 00 00 00 02 00 00
			23 00 00 00 00 00 02 E3 39
			23 00 00 00 00 00 02 E3 3d
			23 00 00 00 00 00 02 E3 41
			23 00 00 00 00 00 02 E3 48
			23 00 00 00 00 00 02 E3 4e
			23 00 00 00 00 00 02 E3 53
			23 00 00 00 00 00 02 E3 5c
			23 00 00 00 00 00 02 E3 6c
			23 00 00 00 00 00 02 E3 72
			23 00 00 00 00 00 02 E3 82
			23 00 00 00 00 00 02 E3 8a
			23 00 00 00 00 00 02 E3 8e
			23 00 00 00 00 00 02 E3 6e
			23 00 00 00 00 00 02 E3 6a
			23 00 00 00 00 00 02 E3 64
			23 00 00 00 00 00 02 E3 55
			23 00 00 00 00 00 02 E3 42
			23 00 00 00 00 00 02 E3 31
			23 00 00 00 00 00 02 E3 27
			23 00 00 00 00 00 02 E3 20
			23 00 00 00 00 00 02 E3 17
			23 00 00 00 00 00 02 E3 0f
			23 00 00 00 00 00 02 E3 07
			23 00 00 00 00 00 02 E3 03
			23 00 00 00 00 00 02 00 00
			23 00 00 00 00 00 02 E4 39
			23 00 00 00 00 00 02 E4 3d
			23 00 00 00 00 00 02 E4 41
			23 00 00 00 00 00 02 E4 48
			23 00 00 00 00 00 02 E4 4e
			23 00 00 00 00 00 02 E4 53
			23 00 00 00 00 00 02 E4 5c
			23 00 00 00 00 00 02 E4 6c
			23 00 00 00 00 00 02 E4 72
			23 00 00 00 00 00 02 E4 82
			23 00 00 00 00 00 02 E4 8a
			23 00 00 00 00 00 02 E4 8e
			23 00 00 00 00 00 02 E4 6e
			23 00 00 00 00 00 02 E4 6a
			23 00 00 00 00 00 02 E4 64
			23 00 00 00 00 00 02 E4 55
			23 00 00 00 00 00 02 E4 42
			23 00 00 00 00 00 02 E4 31
			23 00 00 00 00 00 02 E4 27
			23 00 00 00 00 00 02 E4 20
			23 00 00 00 00 00 02 E4 17
			23 00 00 00 00 00 02 E4 0f
			23 00 00 00 00 00 02 E4 07
			23 00 00 00 00 00 02 E4 03
			23 00 00 00 00 00 02 00 00
			23 00 00 00 00 00 02 E5 70
			23 00 00 00 00 00 02 E5 72
			23 00 00 00 00 00 02 E5 73
			23 00 00 00 00 00 02 E5 75
			23 00 00 00 00 00 02 E5 79
			23 00 00 00 00 00 02 E5 7c
			23 00 00 00 00 00 02 E5 82
			23 00 00 00 00 00 02 E5 88
			23 00 00 00 00 00 02 E5 88
			23 00 00 00 00 00 02 E5 90
			23 00 00 00 00 00 02 E5 94
			23 00 00 00 00 00 02 E5 95
			23 00 00 00 00 00 02 E5 69
			23 00 00 00 00 00 02 E5 66
			23 00 00 00 00 00 02 E5 61
			23 00 00 00 00 00 02 E5 51
			23 00 00 00 00 00 02 E5 3f
			23 00 00 00 00 00 02 E5 2e
			23 00 00 00 00 00 02 E5 24
			23 00 00 00 00 00 02 E5 1e
			23 00 00 00 00 00 02 E5 16
			23 00 00 00 00 00 02 E5 0d
			23 00 00 00 00 00 02 E5 07
			23 00 00 00 00 00 02 E5 03
			23 00 00 00 00 00 02 00 00
			23 00 00 00 00 00 02 E6 70
			23 00 00 00 00 00 02 E6 72
			23 00 00 00 00 00 02 E6 73
			23 00 00 00 00 00 02 E6 75
			23 00 00 00 00 00 02 E6 79
			23 00 00 00 00 00 02 E6 7c
			23 00 00 00 00 00 02 E6 82
			23 00 00 00 00 00 02 E6 88
			23 00 00 00 00 00 02 E6 88
			23 00 00 00 00 00 02 E6 90
			23 00 00 00 00 00 02 E6 94
			23 00 00 00 00 00 02 E6 95
			23 00 00 00 00 00 02 E6 69
			23 00 00 00 00 00 02 E6 66
			23 00 00 00 00 00 02 E6 61
			23 00 00 00 00 00 02 E6 51
			23 00 00 00 00 00 02 E6 3f
			23 00 00 00 00 00 02 E6 2e
			23 00 00 00 00 00 02 E6 24
			23 00 00 00 00 00 02 E6 1e
			23 00 00 00 00 00 02 E6 16
			23 00 00 00 00 00 02 E6 0d
			23 00 00 00 00 00 02 E6 07
			23 01 00 00 00 00 02 E6 03
		];

		qcom,mdss-dsi-cold-command = [
			23 00 00 00 00 00 02 00 00
			23 00 00 00 00 00 02 E1 61
			23 00 00 00 00 00 02 E1 63
			23 00 00 00 00 00 02 E1 65
			23 00 00 00 00 00 02 E1 68
			23 00 00 00 00 00 02 E1 6c
			23 00 00 00 00 00 02 E1 6f
			23 00 00 00 00 00 02 E1 74
			23 00 00 00 00 00 02 E1 7e
			23 00 00 00 00 00 02 E1 7f
			23 00 00 00 00 00 02 E1 8a
			23 00 00 00 00 00 02 E1 8f
			23 00 00 00 00 00 02 E1 91
			23 00 00 00 00 00 02 E1 6c
			23 00 00 00 00 00 02 E1 68
			23 00 00 00 00 00 02 E1 63
			23 00 00 00 00 00 02 E1 55
			23 00 00 00 00 00 02 E1 41
			23 00 00 00 00 00 02 E1 2f
			23 00 00 00 00 00 02 E1 25
			23 00 00 00 00 00 02 E1 1f
			23 00 00 00 00 00 02 E1 16
			23 00 00 00 00 00 02 E1 0e
			23 00 00 00 00 00 02 E1 07
			23 00 00 00 00 00 02 E1 03
			23 00 00 00 00 00 02 00 00
			23 00 00 00 00 00 02 E2 61
			23 00 00 00 00 00 02 E2 63
			23 00 00 00 00 00 02 E2 65
			23 00 00 00 00 00 02 E2 68
			23 00 00 00 00 00 02 E2 6c
			23 00 00 00 00 00 02 E2 6f
			23 00 00 00 00 00 02 E2 74
			23 00 00 00 00 00 02 E2 7e
			23 00 00 00 00 00 02 E2 7f
			23 00 00 00 00 00 02 E2 8a
			23 00 00 00 00 00 02 E2 8f
			23 00 00 00 00 00 02 E2 91
			23 00 00 00 00 00 02 E2 6c
			23 00 00 00 00 00 02 E2 68
			23 00 00 00 00 00 02 E2 63
			23 00 00 00 00 00 02 E2 55
			23 00 00 00 00 00 02 E2 41
			23 00 00 00 00 00 02 E2 2f
			23 00 00 00 00 00 02 E2 25
			23 00 00 00 00 00 02 E2 1f
			23 00 00 00 00 00 02 E2 16
			23 00 00 00 00 00 02 E2 0e
			23 00 00 00 00 00 02 E2 07
			23 00 00 00 00 00 02 E2 03
			23 00 00 00 00 00 02 00 00
			23 00 00 00 00 00 02 E3 39
			23 00 00 00 00 00 02 E3 3d
			23 00 00 00 00 00 02 E3 40
			23 00 00 00 00 00 02 E3 47
			23 00 00 00 00 00 02 E3 4d
			23 00 00 00 00 00 02 E3 53
			23 00 00 00 00 00 02 E3 5c
			23 00 00 00 00 00 02 E3 6c
			23 00 00 00 00 00 02 E3 72
			23 00 00 00 00 00 02 E3 81
			23 00 00 00 00 00 02 E3 89
			23 00 00 00 00 00 02 E3 8d
			23 00 00 00 00 00 02 E3 6e
			23 00 00 00 00 00 02 E3 6a
			23 00 00 00 00 00 02 E3 65
			23 00 00 00 00 00 02 E3 55
			23 00 00 00 00 00 02 E3 42
			23 00 00 00 00 00 02 E3 31
			23 00 00 00 00 00 02 E3 27
			23 00 00 00 00 00 02 E3 20
			23 00 00 00 00 00 02 E3 17
			23 00 00 00 00 00 02 E3 0f
			23 00 00 00 00 00 02 E3 07
			23 00 00 00 00 00 02 E3 03
			23 00 00 00 00 00 02 00 00
			23 00 00 00 00 00 02 E4 39
			23 00 00 00 00 00 02 E4 3d
			23 00 00 00 00 00 02 E4 40
			23 00 00 00 00 00 02 E4 47
			23 00 00 00 00 00 02 E4 4d
			23 00 00 00 00 00 02 E4 53
			23 00 00 00 00 00 02 E4 5c
			23 00 00 00 00 00 02 E4 6c
			23 00 00 00 00 00 02 E4 72
			23 00 00 00 00 00 02 E4 81
			23 00 00 00 00 00 02 E4 89
			23 00 00 00 00 00 02 E4 8d
			23 00 00 00 00 00 02 E4 6e
			23 00 00 00 00 00 02 E4 6a
			23 00 00 00 00 00 02 E4 65
			23 00 00 00 00 00 02 E4 55
			23 00 00 00 00 00 02 E4 42
			23 00 00 00 00 00 02 E4 31
			23 00 00 00 00 00 02 E4 27
			23 00 00 00 00 00 02 E4 20
			23 00 00 00 00 00 02 E4 17
			23 00 00 00 00 00 02 E4 0f
			23 00 00 00 00 00 02 E4 07
			23 00 00 00 00 00 02 E4 03
			23 00 00 00 00 00 02 00 00
			23 00 00 00 00 00 02 E5 49
			23 00 00 00 00 00 02 E5 4b
			23 00 00 00 00 00 02 E5 4e
			23 00 00 00 00 00 02 E5 51
			23 00 00 00 00 00 02 E5 55
			23 00 00 00 00 00 02 E5 5c
			23 00 00 00 00 00 02 E5 67
			23 00 00 00 00 00 02 E5 72
			23 00 00 00 00 00 02 E5 79
			23 00 00 00 00 00 02 E5 85
			23 00 00 00 00 00 02 E5 8c
			23 00 00 00 00 00 02 E5 8f
			23 00 00 00 00 00 02 E5 6d
			23 00 00 00 00 00 02 E5 6a
			23 00 00 00 00 00 02 E5 64
			23 00 00 00 00 00 02 E5 55
			23 00 00 00 00 00 02 E5 41
			23 00 00 00 00 00 02 E5 31
			23 00 00 00 00 00 02 E5 26
			23 00 00 00 00 00 02 E5 20
			23 00 00 00 00 00 02 E5 17
			23 00 00 00 00 00 02 E5 0e
			23 00 00 00 00 00 02 E5 07
			23 00 00 00 00 00 02 E5 03
			23 00 00 00 00 00 02 00 00
			23 00 00 00 00 00 02 E6 49
			23 00 00 00 00 00 02 E6 4b
			23 00 00 00 00 00 02 E6 4e
			23 00 00 00 00 00 02 E6 51
			23 00 00 00 00 00 02 E6 55
			23 00 00 00 00 00 02 E6 5c
			23 00 00 00 00 00 02 E6 67
			23 00 00 00 00 00 02 E6 72
			23 00 00 00 00 00 02 E6 79
			23 00 00 00 00 00 02 E6 85
			23 00 00 00 00 00 02 E6 8c
			23 00 00 00 00 00 02 E6 8f
			23 00 00 00 00 00 02 E6 6d
			23 00 00 00 00 00 02 E6 6a
			23 00 00 00 00 00 02 E6 64
			23 00 00 00 00 00 02 E6 55
			23 00 00 00 00 00 02 E6 41
			23 00 00 00 00 00 02 E6 31
			23 00 00 00 00 00 02 E6 26
			23 00 00 00 00 00 02 E6 20
			23 00 00 00 00 00 02 E6 17
			23 00 00 00 00 00 02 E6 0e
			23 00 00 00 00 00 02 E6 07
			23 01 00 00 00 00 02 E6 03
		];

		qcom,mdss-dsi-default-command = [
			23 00 00 00 00 00 02 00 00
			23 00 00 00 00 00 02 E1 30
			23 00 00 00 00 00 02 E1 34
			23 00 00 00 00 00 02 E1 3c
			23 00 00 00 00 00 02 E1 42
			23 00 00 00 00 00 02 E1 48
			23 00 00 00 00 00 02 E1 4d
			23 00 00 00 00 00 02 E1 58
			23 00 00 00 00 00 02 E1 68
			23 00 00 00 00 00 02 E1 70
			23 00 00 00 00 00 02 E1 7f
			23 00 00 00 00 00 02 E1 89
			23 00 00 00 00 00 02 E1 8d
			23 00 00 00 00 00 02 E1 70
			23 00 00 00 00 00 02 E1 6b
			23 00 00 00 00 00 02 E1 67
			23 00 00 00 00 00 02 E1 57
			23 00 00 00 00 00 02 E1 42
			23 00 00 00 00 00 02 E1 32
			23 00 00 00 00 00 02 E1 27
			23 00 00 00 00 00 02 E1 21
			23 00 00 00 00 00 02 E1 18
			23 00 00 00 00 00 02 E1 0f
			23 00 00 00 00 00 02 E1 07
			23 00 00 00 00 00 02 E1 03
			23 00 00 00 00 00 02 00 00
			23 00 00 00 00 00 02 E2 30
			23 00 00 00 00 00 02 E2 34
			23 00 00 00 00 00 02 E2 3c
			23 00 00 00 00 00 02 E2 42
			23 00 00 00 00 00 02 E2 48
			23 00 00 00 00 00 02 E2 4d
			23 00 00 00 00 00 02 E2 58
			23 00 00 00 00 00 02 E2 68
			23 00 00 00 00 00 02 E2 70
			23 00 00 00 00 00 02 E2 7f
			23 00 00 00 00 00 02 E2 89
			23 00 00 00 00 00 02 E2 8d
			23 00 00 00 00 00 02 E2 70
			23 00 00 00 00 00 02 E2 6b
			23 00 00 00 00 00 02 E2 67
			23 00 00 00 00 00 02 E2 57
			23 00 00 00 00 00 02 E2 42
			23 00 00 00 00 00 02 E2 32
			23 00 00 00 00 00 02 E2 27
			23 00 00 00 00 00 02 E2 21
			23 00 00 00 00 00 02 E2 18
			23 00 00 00 00 00 02 E2 0f
			23 00 00 00 00 00 02 E2 07
			23 00 00 00 00 00 02 E2 03
			23 00 00 00 00 00 02 00 00
			23 00 00 00 00 00 02 E3 0c
			23 00 00 00 00 00 02 E3 16
			23 00 00 00 00 00 02 E3 1d
			23 00 00 00 00 00 02 E3 2a
			23 00 00 00 00 00 02 E3 35
			23 00 00 00 00 00 02 E3 3e
			23 00 00 00 00 00 02 E3 4c
			23 00 00 00 00 00 02 E3 60
			23 00 00 00 00 00 02 E3 6a
			23 00 00 00 00 00 02 E3 7d
			23 00 00 00 00 00 02 E3 87
			23 00 00 00 00 00 02 E3 8c
			23 00 00 00 00 00 02 E3 70
			23 00 00 00 00 00 02 E3 6b
			23 00 00 00 00 00 02 E3 66
			23 00 00 00 00 00 02 E3 56
			23 00 00 00 00 00 02 E3 43
			23 00 00 00 00 00 02 E3 32
			23 00 00 00 00 00 02 E3 27
			23 00 00 00 00 00 02 E3 21
			23 00 00 00 00 00 02 E3 18
			23 00 00 00 00 00 02 E3 0f
			23 00 00 00 00 00 02 E3 07
			23 00 00 00 00 00 02 E3 03
			23 00 00 00 00 00 02 00 00
			23 00 00 00 00 00 02 E4 0c
			23 00 00 00 00 00 02 E4 16
			23 00 00 00 00 00 02 E4 1d
			23 00 00 00 00 00 02 E4 2a
			23 00 00 00 00 00 02 E4 35
			23 00 00 00 00 00 02 E4 3e
			23 00 00 00 00 00 02 E4 4c
			23 00 00 00 00 00 02 E4 60
			23 00 00 00 00 00 02 E4 6a
			23 00 00 00 00 00 02 E4 7d
			23 00 00 00 00 00 02 E4 87
			23 00 00 00 00 00 02 E4 8c
			23 00 00 00 00 00 02 E4 70
			23 00 00 00 00 00 02 E4 6b
			23 00 00 00 00 00 02 E4 66
			23 00 00 00 00 00 02 E4 56
			23 00 00 00 00 00 02 E4 43
			23 00 00 00 00 00 02 E4 32
			23 00 00 00 00 00 02 E4 27
			23 00 00 00 00 00 02 E4 21
			23 00 00 00 00 00 02 E4 18
			23 00 00 00 00 00 02 E4 0f
			23 00 00 00 00 00 02 E4 07
			23 00 00 00 00 00 02 E4 03
			23 00 00 00 00 00 02 00 00
			23 00 00 00 00 00 02 E5 46
			23 00 00 00 00 00 02 E5 4c
			23 00 00 00 00 00 02 E5 4f
			23 00 00 00 00 00 02 E5 57
			23 00 00 00 00 00 02 E5 5d
			23 00 00 00 00 00 02 E5 61
			23 00 00 00 00 00 02 E5 68
			23 00 00 00 00 00 02 E5 73
			23 00 00 00 00 00 02 E5 7a
			23 00 00 00 00 00 02 E5 87
			23 00 00 00 00 00 02 E5 8d
			23 00 00 00 00 00 02 E5 90
			23 00 00 00 00 00 02 E5 6d
			23 00 00 00 00 00 02 E5 69
			23 00 00 00 00 00 02 E5 64
			23 00 00 00 00 00 02 E5 54
			23 00 00 00 00 00 02 E5 41
			23 00 00 00 00 00 02 E5 31
			23 00 00 00 00 00 02 E5 26
			23 00 00 00 00 00 02 E5 20
			23 00 00 00 00 00 02 E5 17
			23 00 00 00 00 00 02 E5 0e
			23 00 00 00 00 00 02 E5 07
			23 00 00 00 00 00 02 E5 03
			23 00 00 00 00 00 02 00 00
			23 00 00 00 00 00 02 E6 46
			23 00 00 00 00 00 02 E6 4c
			23 00 00 00 00 00 02 E6 4f
			23 00 00 00 00 00 02 E6 57
			23 00 00 00 00 00 02 E6 5d
			23 00 00 00 00 00 02 E6 61
			23 00 00 00 00 00 02 E6 68
			23 00 00 00 00 00 02 E6 73
			23 00 00 00 00 00 02 E6 7a
			23 00 00 00 00 00 02 E6 87
			23 00 00 00 00 00 02 E6 8d
			23 00 00 00 00 00 02 E6 90
			23 00 00 00 00 00 02 E6 6d
			23 00 00 00 00 00 02 E6 69
			23 00 00 00 00 00 02 E6 64
			23 00 00 00 00 00 02 E6 54
			23 00 00 00 00 00 02 E6 41
			23 00 00 00 00 00 02 E6 31
			23 00 00 00 00 00 02 E6 26
			23 00 00 00 00 00 02 E6 20
			23 00 00 00 00 00 02 E6 17
			23 00 00 00 00 00 02 E6 0e
			23 00 00 00 00 00 02 E6 07
			23 01 00 00 00 00 02 E6 03
		];

		qcom,mdss-dsi-level1-command = [
			23 00 00 00 00 00 02 00 00
			23 00 00 00 00 00 02 E1 32
			23 00 00 00 00 00 02 E1 36
			23 00 00 00 00 00 02 E1 3a
			23 00 00 00 00 00 02 E1 43
			23 00 00 00 00 00 02 E1 48
			23 00 00 00 00 00 02 E1 4c
			23 00 00 00 00 00 02 E1 57
			23 00 00 00 00 00 02 E1 69
			23 00 00 00 00 00 02 E1 6f
			23 00 00 00 00 00 02 E1 7f
			23 00 00 00 00 00 02 E1 87
			23 00 00 00 00 00 02 E1 8c
			23 00 00 00 00 00 02 E1 6f
			23 00 00 00 00 00 02 E1 6b
			23 00 00 00 00 00 02 E1 67
			23 00 00 00 00 00 02 E1 56
			23 00 00 00 00 00 02 E1 42
			23 00 00 00 00 00 02 E1 33
			23 00 00 00 00 00 02 E1 27
			23 00 00 00 00 00 02 E1 22
			23 00 00 00 00 00 02 E1 19
			23 00 00 00 00 00 02 E1 0f
			23 00 00 00 00 00 02 E1 09
			23 00 00 00 00 00 02 E1 03
			23 00 00 00 00 00 02 00 00
			23 00 00 00 00 00 02 E2 32
			23 00 00 00 00 00 02 E2 36
			23 00 00 00 00 00 02 E2 3a
			23 00 00 00 00 00 02 E2 43
			23 00 00 00 00 00 02 E2 48
			23 00 00 00 00 00 02 E2 4c
			23 00 00 00 00 00 02 E2 57
			23 00 00 00 00 00 02 E2 69
			23 00 00 00 00 00 02 E2 6f
			23 00 00 00 00 00 02 E2 7f
			23 00 00 00 00 00 02 E2 87
			23 00 00 00 00 00 02 E2 8c
			23 00 00 00 00 00 02 E2 6f
			23 00 00 00 00 00 02 E2 6b
			23 00 00 00 00 00 02 E2 67
			23 00 00 00 00 00 02 E2 56
			23 00 00 00 00 00 02 E2 42
			23 00 00 00 00 00 02 E2 33
			23 00 00 00 00 00 02 E2 27
			23 00 00 00 00 00 02 E2 22
			23 00 00 00 00 00 02 E2 19
			23 00 00 00 00 00 02 E2 0f
			23 00 00 00 00 00 02 E2 09
			23 00 00 00 00 00 02 E2 03
			23 00 00 00 00 00 02 00 00
			23 00 00 00 00 00 02 E3 2f
			23 00 00 00 00 00 02 E3 34
			23 00 00 00 00 00 02 E3 39
			23 00 00 00 00 00 02 E3 40
			23 00 00 00 00 00 02 E3 48
			23 00 00 00 00 00 02 E3 4f
			23 00 00 00 00 00 02 E3 59
			23 00 00 00 00 00 02 E3 68
			23 00 00 00 00 00 02 E3 70
			23 00 00 00 00 00 02 E3 80
			23 00 00 00 00 00 02 E3 87
			23 00 00 00 00 00 02 E3 8c
			23 00 00 00 00 00 02 E3 6f
			23 00 00 00 00 00 02 E3 6a
			23 00 00 00 00 00 02 E3 65
			23 00 00 00 00 00 02 E3 55
			23 00 00 00 00 00 02 E3 42
			23 00 00 00 00 00 02 E3 32
			23 00 00 00 00 00 02 E3 27
			23 00 00 00 00 00 02 E3 21
			23 00 00 00 00 00 02 E3 19
			23 00 00 00 00 00 02 E3 0f
			23 00 00 00 00 00 02 E3 09
			23 00 00 00 00 00 02 E3 03
			23 00 00 00 00 00 02 00 00
			23 00 00 00 00 00 02 E4 2f
			23 00 00 00 00 00 02 E4 34
			23 00 00 00 00 00 02 E4 39
			23 00 00 00 00 00 02 E4 40
			23 00 00 00 00 00 02 E4 48
			23 00 00 00 00 00 02 E4 4f
			23 00 00 00 00 00 02 E4 59
			23 00 00 00 00 00 02 E4 68
			23 00 00 00 00 00 02 E4 70
			23 00 00 00 00 00 02 E4 80
			23 00 00 00 00 00 02 E4 87
			23 00 00 00 00 00 02 E4 8c
			23 00 00 00 00 00 02 E4 6f
			23 00 00 00 00 00 02 E4 6a
			23 00 00 00 00 00 02 E4 65
			23 00 00 00 00 00 02 E4 55
			23 00 00 00 00 00 02 E4 42
			23 00 00 00 00 00 02 E4 32
			23 00 00 00 00 00 02 E4 27
			23 00 00 00 00 00 02 E4 21
			23 00 00 00 00 00 02 E4 19
			23 00 00 00 00 00 02 E4 0f
			23 00 00 00 00 00 02 E4 09
			23 00 00 00 00 00 02 E4 03
			23 00 00 00 00 00 02 00 00
			23 00 00 00 00 00 02 E5 6a
			23 00 00 00 00 00 02 E5 6b
			23 00 00 00 00 00 02 E5 6d
			23 00 00 00 00 00 02 E5 6e
			23 00 00 00 00 00 02 E5 6e
			23 00 00 00 00 00 02 E5 6f
			23 00 00 00 00 00 02 E5 75
			23 00 00 00 00 00 02 E5 81
			23 00 00 00 00 00 02 E5 83
			23 00 00 00 00 00 02 E5 8b
			23 00 00 00 00 00 02 E5 8e
			23 00 00 00 00 00 02 E5 92
			23 00 00 00 00 00 02 E5 6b
			23 00 00 00 00 00 02 E5 67
			23 00 00 00 00 00 02 E5 63
			23 00 00 00 00 00 02 E5 52
			23 00 00 00 00 00 02 E5 40
			23 00 00 00 00 00 02 E5 30
			23 00 00 00 00 00 02 E5 25
			23 00 00 00 00 00 02 E5 20
			23 00 00 00 00 00 02 E5 17
			23 00 00 00 00 00 02 E5 0d
			23 00 00 00 00 00 02 E5 09
			23 00 00 00 00 00 02 E5 03
			23 00 00 00 00 00 02 00 00
			23 00 00 00 00 00 02 E6 6a
			23 00 00 00 00 00 02 E6 6b
			23 00 00 00 00 00 02 E6 6d
			23 00 00 00 00 00 02 E6 6e
			23 00 00 00 00 00 02 E6 6e
			23 00 00 00 00 00 02 E6 6f
			23 00 00 00 00 00 02 E6 75
			23 00 00 00 00 00 02 E6 81
			23 00 00 00 00 00 02 E6 83
			23 00 00 00 00 00 02 E6 8b
			23 00 00 00 00 00 02 E6 8e
			23 00 00 00 00 00 02 E6 92
			23 00 00 00 00 00 02 E6 6b
			23 00 00 00 00 00 02 E6 67
			23 00 00 00 00 00 02 E6 63
			23 00 00 00 00 00 02 E6 52
			23 00 00 00 00 00 02 E6 40
			23 00 00 00 00 00 02 E6 30
			23 00 00 00 00 00 02 E6 25
			23 00 00 00 00 00 02 E6 20
			23 00 00 00 00 00 02 E6 17
			23 00 00 00 00 00 02 E6 0d
			23 00 00 00 00 00 02 E6 09
			23 01 00 00 00 00 02 E6 03
		];

		qcom,mdss-dsi-level2-command = [
			23 00 00 00 00 00 02 00 00
			23 00 00 00 00 00 02 E1 35
			23 00 00 00 00 00 02 E1 3b
			23 00 00 00 00 00 02 E1 3d
			23 00 00 00 00 00 02 E1 43
			23 00 00 00 00 00 02 E1 4a
			23 00 00 00 00 00 02 E1 52
			23 00 00 00 00 00 02 E1 5b
			23 00 00 00 00 00 02 E1 69
			23 00 00 00 00 00 02 E1 70
			23 00 00 00 00 00 02 E1 7f
			23 00 00 00 00 00 02 E1 88
			23 00 00 00 00 00 02 E1 8d
			23 00 00 00 00 00 02 E1 70
			23 00 00 00 00 00 02 E1 6b
			23 00 00 00 00 00 02 E1 67
			23 00 00 00 00 00 02 E1 56
			23 00 00 00 00 00 02 E1 42
			23 00 00 00 00 00 02 E1 32
			23 00 00 00 00 00 02 E1 27
			23 00 00 00 00 00 02 E1 21
			23 00 00 00 00 00 02 E1 19
			23 00 00 00 00 00 02 E1 0f
			23 00 00 00 00 00 02 E1 08
			23 00 00 00 00 00 02 E1 03
			23 00 00 00 00 00 02 00 00
			23 00 00 00 00 00 02 E2 35
			23 00 00 00 00 00 02 E2 3b
			23 00 00 00 00 00 02 E2 3d
			23 00 00 00 00 00 02 E2 43
			23 00 00 00 00 00 02 E2 4a
			23 00 00 00 00 00 02 E2 52
			23 00 00 00 00 00 02 E2 5b
			23 00 00 00 00 00 02 E2 69
			23 00 00 00 00 00 02 E2 70
			23 00 00 00 00 00 02 E2 7f
			23 00 00 00 00 00 02 E2 88
			23 00 00 00 00 00 02 E2 8d
			23 00 00 00 00 00 02 E2 70
			23 00 00 00 00 00 02 E2 6b
			23 00 00 00 00 00 02 E2 67
			23 00 00 00 00 00 02 E2 56
			23 00 00 00 00 00 02 E2 42
			23 00 00 00 00 00 02 E2 32
			23 00 00 00 00 00 02 E2 27
			23 00 00 00 00 00 02 E2 21
			23 00 00 00 00 00 02 E2 19
			23 00 00 00 00 00 02 E2 0f
			23 00 00 00 00 00 02 E2 08
			23 00 00 00 00 00 02 E2 03
			23 00 00 00 00 00 02 00 00
			23 00 00 00 00 00 02 E3 4a
			23 00 00 00 00 00 02 E3 4d
			23 00 00 00 00 00 02 E3 50
			23 00 00 00 00 00 02 E3 55
			23 00 00 00 00 00 02 E3 59
			23 00 00 00 00 00 02 E3 5e
			23 00 00 00 00 00 02 E3 65
			23 00 00 00 00 00 02 E3 72
			23 00 00 00 00 00 02 E3 77
			23 00 00 00 00 00 02 E3 84
			23 00 00 00 00 00 02 E3 8a
			23 00 00 00 00 00 02 E3 8f
			23 00 00 00 00 00 02 E3 6e
			23 00 00 00 00 00 02 E3 69
			23 00 00 00 00 00 02 E3 64
			23 00 00 00 00 00 02 E3 54
			23 00 00 00 00 00 02 E3 41
			23 00 00 00 00 00 02 E3 31
			23 00 00 00 00 00 02 E3 26
			23 00 00 00 00 00 02 E3 20
			23 00 00 00 00 00 02 E3 18
			23 00 00 00 00 00 02 E3 0e
			23 00 00 00 00 00 02 E3 07
			23 00 00 00 00 00 02 E3 03
			23 00 00 00 00 00 02 00 00
			23 00 00 00 00 00 02 E4 4a
			23 00 00 00 00 00 02 E4 4d
			23 00 00 00 00 00 02 E4 50
			23 00 00 00 00 00 02 E4 55
			23 00 00 00 00 00 02 E4 59
			23 00 00 00 00 00 02 E4 5e
			23 00 00 00 00 00 02 E4 65
			23 00 00 00 00 00 02 E4 72
			23 00 00 00 00 00 02 E4 77
			23 00 00 00 00 00 02 E4 84
			23 00 00 00 00 00 02 E4 8a
			23 00 00 00 00 00 02 E4 8f
			23 00 00 00 00 00 02 E4 6e
			23 00 00 00 00 00 02 E4 69
			23 00 00 00 00 00 02 E4 64
			23 00 00 00 00 00 02 E4 54
			23 00 00 00 00 00 02 E4 41
			23 00 00 00 00 00 02 E4 31
			23 00 00 00 00 00 02 E4 26
			23 00 00 00 00 00 02 E4 20
			23 00 00 00 00 00 02 E4 18
			23 00 00 00 00 00 02 E4 0e
			23 00 00 00 00 00 02 E4 07
			23 00 00 00 00 00 02 E4 03
			23 00 00 00 00 00 02 00 00
			23 00 00 00 00 00 02 E5 79
			23 00 00 00 00 00 02 E5 7a
			23 00 00 00 00 00 02 E5 7b
			23 00 00 00 00 00 02 E5 7c
			23 00 00 00 00 00 02 E5 7e
			23 00 00 00 00 00 02 E5 80
			23 00 00 00 00 00 02 E5 86
			23 00 00 00 00 00 02 E5 8d
			23 00 00 00 00 00 02 E5 8b
			23 00 00 00 00 00 02 E5 91
			23 00 00 00 00 00 02 E5 93
			23 00 00 00 00 00 02 E5 95
			23 00 00 00 00 00 02 E5 69
			23 00 00 00 00 00 02 E5 65
			23 00 00 00 00 00 02 E5 61
			23 00 00 00 00 00 02 E5 51
			23 00 00 00 00 00 02 E5 3e
			23 00 00 00 00 00 02 E5 2e
			23 00 00 00 00 00 02 E5 24
			23 00 00 00 00 00 02 E5 1f
			23 00 00 00 00 00 02 E5 17
			23 00 00 00 00 00 02 E5 0d
			23 00 00 00 00 00 02 E5 07
			23 00 00 00 00 00 02 E5 03
			23 00 00 00 00 00 02 00 00
			23 00 00 00 00 00 02 E6 79
			23 00 00 00 00 00 02 E6 7a
			23 00 00 00 00 00 02 E6 7b
			23 00 00 00 00 00 02 E6 7c
			23 00 00 00 00 00 02 E6 7e
			23 00 00 00 00 00 02 E6 80
			23 00 00 00 00 00 02 E6 86
			23 00 00 00 00 00 02 E6 8d
			23 00 00 00 00 00 02 E6 8b
			23 00 00 00 00 00 02 E6 91
			23 00 00 00 00 00 02 E6 93
			23 00 00 00 00 00 02 E6 95
			23 00 00 00 00 00 02 E6 69
			23 00 00 00 00 00 02 E6 65
			23 00 00 00 00 00 02 E6 61
			23 00 00 00 00 00 02 E6 51
			23 00 00 00 00 00 02 E6 3e
			23 00 00 00 00 00 02 E6 2e
			23 00 00 00 00 00 02 E6 24
			23 00 00 00 00 00 02 E6 1f
			23 00 00 00 00 00 02 E6 17
			23 00 00 00 00 00 02 E6 0d
			23 00 00 00 00 00 02 E6 07
			23 01 00 00 00 00 02 E6 03
		];

		qcom,mdss-dsi-level3-command = [
			23 00 00 00 00 00 02 00 00
			23 00 00 00 00 00 02 E1 3f
			23 00 00 00 00 00 02 E1 41
			23 00 00 00 00 00 02 E1 42
			23 00 00 00 00 00 02 E1 49
			23 00 00 00 00 00 02 E1 50
			23 00 00 00 00 00 02 E1 56
			23 00 00 00 00 00 02 E1 5d
			23 00 00 00 00 00 02 E1 6b
			23 00 00 00 00 00 02 E1 71
			23 00 00 00 00 00 02 E1 80
			23 00 00 00 00 00 02 E1 89
			23 00 00 00 00 00 02 E1 8d
			23 00 00 00 00 00 02 E1 6f
			23 00 00 00 00 00 02 E1 6b
			23 00 00 00 00 00 02 E1 66
			23 00 00 00 00 00 02 E1 56
			23 00 00 00 00 00 02 E1 42
			23 00 00 00 00 00 02 E1 33
			23 00 00 00 00 00 02 E1 27
			23 00 00 00 00 00 02 E1 21
			23 00 00 00 00 00 02 E1 19
			23 00 00 00 00 00 02 E1 0f
			23 00 00 00 00 00 02 E1 08
			23 00 00 00 00 00 02 E1 03
			23 00 00 00 00 00 02 00 00
			23 00 00 00 00 00 02 E2 3f
			23 00 00 00 00 00 02 E2 41
			23 00 00 00 00 00 02 E2 42
			23 00 00 00 00 00 02 E2 49
			23 00 00 00 00 00 02 E2 50
			23 00 00 00 00 00 02 E2 56
			23 00 00 00 00 00 02 E2 5d
			23 00 00 00 00 00 02 E2 6b
			23 00 00 00 00 00 02 E2 71
			23 00 00 00 00 00 02 E2 80
			23 00 00 00 00 00 02 E2 89
			23 00 00 00 00 00 02 E2 8d
			23 00 00 00 00 00 02 E2 6f
			23 00 00 00 00 00 02 E2 6b
			23 00 00 00 00 00 02 E2 66
			23 00 00 00 00 00 02 E2 56
			23 00 00 00 00 00 02 E2 42
			23 00 00 00 00 00 02 E2 33
			23 00 00 00 00 00 02 E2 27
			23 00 00 00 00 00 02 E2 21
			23 00 00 00 00 00 02 E2 19
			23 00 00 00 00 00 02 E2 0f
			23 00 00 00 00 00 02 E2 08
			23 00 00 00 00 00 02 E2 03
			23 00 00 00 00 00 02 00 00
			23 00 00 00 00 00 02 E3 5c
			23 00 00 00 00 00 02 E3 5e
			23 00 00 00 00 00 02 E3 61
			23 00 00 00 00 00 02 E3 64
			23 00 00 00 00 00 02 E3 67
			23 00 00 00 00 00 02 E3 6b
			23 00 00 00 00 00 02 E3 71
			23 00 00 00 00 00 02 E3 7c
			23 00 00 00 00 00 02 E3 7d
			23 00 00 00 00 00 02 E3 89
			23 00 00 00 00 00 02 E3 8f
			23 00 00 00 00 00 02 E3 91
			23 00 00 00 00 00 02 E3 6c
			23 00 00 00 00 00 02 E3 68
			23 00 00 00 00 00 02 E3 62
			23 00 00 00 00 00 02 E3 52
			23 00 00 00 00 00 02 E3 40
			23 00 00 00 00 00 02 E3 31
			23 00 00 00 00 00 02 E3 26
			23 00 00 00 00 00 02 E3 20
			23 00 00 00 00 00 02 E3 18
			23 00 00 00 00 00 02 E3 0e
			23 00 00 00 00 00 02 E3 08
			23 00 00 00 00 00 02 E3 03
			23 00 00 00 00 00 02 00 00
			23 00 00 00 00 00 02 E4 5c
			23 00 00 00 00 00 02 E4 5e
			23 00 00 00 00 00 02 E4 61
			23 00 00 00 00 00 02 E4 64
			23 00 00 00 00 00 02 E4 67
			23 00 00 00 00 00 02 E4 6b
			23 00 00 00 00 00 02 E4 71
			23 00 00 00 00 00 02 E4 7c
			23 00 00 00 00 00 02 E4 7d
			23 00 00 00 00 00 02 E4 89
			23 00 00 00 00 00 02 E4 8f
			23 00 00 00 00 00 02 E4 91
			23 00 00 00 00 00 02 E4 6c
			23 00 00 00 00 00 02 E4 68
			23 00 00 00 00 00 02 E4 62
			23 00 00 00 00 00 02 E4 52
			23 00 00 00 00 00 02 E4 40
			23 00 00 00 00 00 02 E4 31
			23 00 00 00 00 00 02 E4 26
			23 00 00 00 00 00 02 E4 20
			23 00 00 00 00 00 02 E4 18
			23 00 00 00 00 00 02 E4 0e
			23 00 00 00 00 00 02 E4 08
			23 00 00 00 00 00 02 E4 03
			23 00 00 00 00 00 02 00 00
			23 00 00 00 00 00 02 E5 89
			23 00 00 00 00 00 02 E5 8a
			23 00 00 00 00 00 02 E5 8b
			23 00 00 00 00 00 02 E5 8c
			23 00 00 00 00 00 02 E5 8c
			23 00 00 00 00 00 02 E5 8e
			23 00 00 00 00 00 02 E5 90
			23 00 00 00 00 00 02 E5 96
			23 00 00 00 00 00 02 E5 94
			23 00 00 00 00 00 02 E5 98
			23 00 00 00 00 00 02 E5 98
			23 00 00 00 00 00 02 E5 99
			23 00 00 00 00 00 02 E5 66
			23 00 00 00 00 00 02 E5 63
			23 00 00 00 00 00 02 E5 5e
			23 00 00 00 00 00 02 E5 4e
			23 00 00 00 00 00 02 E5 3c
			23 00 00 00 00 00 02 E5 2d
			23 00 00 00 00 00 02 E5 23
			23 00 00 00 00 00 02 E5 1e
			23 00 00 00 00 00 02 E5 16
			23 00 00 00 00 00 02 E5 0c
			23 00 00 00 00 00 02 E5 08
			23 00 00 00 00 00 02 E5 03
			23 00 00 00 00 00 02 00 00
			23 00 00 00 00 00 02 E6 89
			23 00 00 00 00 00 02 E6 8a
			23 00 00 00 00 00 02 E6 8b
			23 00 00 00 00 00 02 E6 8c
			23 00 00 00 00 00 02 E6 8c
			23 00 00 00 00 00 02 E6 8e
			23 00 00 00 00 00 02 E6 90
			23 00 00 00 00 00 02 E6 96
			23 00 00 00 00 00 02 E6 94
			23 00 00 00 00 00 02 E6 98
			23 00 00 00 00 00 02 E6 98
			23 00 00 00 00 00 02 E6 99
			23 00 00 00 00 00 02 E6 66
			23 00 00 00 00 00 02 E6 63
			23 00 00 00 00 00 02 E6 5e
			23 00 00 00 00 00 02 E6 4e
			23 00 00 00 00 00 02 E6 3c
			23 00 00 00 00 00 02 E6 2d
			23 00 00 00 00 00 02 E6 23
			23 00 00 00 00 00 02 E6 1e
			23 00 00 00 00 00 02 E6 16
			23 00 00 00 00 00 02 E6 0c
			23 00 00 00 00 00 02 E6 08
			23 01 00 00 00 00 02 E6 03
		];

		qcom,mdss-dsi-level4-command = [
			23 00 00 00 00 00 02 00 00
			23 00 00 00 00 00 02 E1 3d
			23 00 00 00 00 00 02 E1 43
			23 00 00 00 00 00 02 E1 45
			23 00 00 00 00 00 02 E1 4c
			23 00 00 00 00 00 02 E1 53
			23 00 00 00 00 00 02 E1 57
			23 00 00 00 00 00 02 E1 5f
			23 00 00 00 00 00 02 E1 6e
			23 00 00 00 00 00 02 E1 72
			23 00 00 00 00 00 02 E1 84
			23 00 00 00 00 00 02 E1 89
			23 00 00 00 00 00 02 E1 8d
			23 00 00 00 00 00 02 E1 6f
			23 00 00 00 00 00 02 E1 6a
			23 00 00 00 00 00 02 E1 66
			23 00 00 00 00 00 02 E1 55
			23 00 00 00 00 00 02 E1 42
			23 00 00 00 00 00 02 E1 32
			23 00 00 00 00 00 02 E1 26
			23 00 00 00 00 00 02 E1 21
			23 00 00 00 00 00 02 E1 19
			23 00 00 00 00 00 02 E1 0f
			23 00 00 00 00 00 02 E1 08
			23 00 00 00 00 00 02 E1 03
			23 00 00 00 00 00 02 00 00
			23 00 00 00 00 00 02 E2 3d
			23 00 00 00 00 00 02 E2 43
			23 00 00 00 00 00 02 E2 45
			23 00 00 00 00 00 02 E2 4c
			23 00 00 00 00 00 02 E2 53
			23 00 00 00 00 00 02 E2 57
			23 00 00 00 00 00 02 E2 5f
			23 00 00 00 00 00 02 E2 6e
			23 00 00 00 00 00 02 E2 72
			23 00 00 00 00 00 02 E2 84
			23 00 00 00 00 00 02 E2 89
			23 00 00 00 00 00 02 E2 8d
			23 00 00 00 00 00 02 E2 6f
			23 00 00 00 00 00 02 E2 6a
			23 00 00 00 00 00 02 E2 66
			23 00 00 00 00 00 02 E2 55
			23 00 00 00 00 00 02 E2 42
			23 00 00 00 00 00 02 E2 32
			23 00 00 00 00 00 02 E2 26
			23 00 00 00 00 00 02 E2 21
			23 00 00 00 00 00 02 E2 19
			23 00 00 00 00 00 02 E2 0f
			23 00 00 00 00 00 02 E2 08
			23 00 00 00 00 00 02 E2 03
			23 00 00 00 00 00 02 00 00
			23 00 00 00 00 00 02 E3 6d
			23 00 00 00 00 00 02 E3 6e
			23 00 00 00 00 00 02 E3 70
			23 00 00 00 00 00 02 E3 72
			23 00 00 00 00 00 02 E3 75
			23 00 00 00 00 00 02 E3 77
			23 00 00 00 00 00 02 E3 7c
			23 00 00 00 00 00 02 E3 84
			23 00 00 00 00 00 02 E3 84
			23 00 00 00 00 00 02 E3 8e
			23 00 00 00 00 00 02 E3 91
			23 00 00 00 00 00 02 E3 93
			23 00 00 00 00 00 02 E3 6a
			23 00 00 00 00 00 02 E3 66
			23 00 00 00 00 00 02 E3 61
			23 00 00 00 00 00 02 E3 51
			23 00 00 00 00 00 02 E3 40
			23 00 00 00 00 00 02 E3 2f
			23 00 00 00 00 00 02 E3 25
			23 00 00 00 00 00 02 E3 1f
			23 00 00 00 00 00 02 E3 17
			23 00 00 00 00 00 02 E3 0e
			23 00 00 00 00 00 02 E3 08
			23 00 00 00 00 00 02 E3 03
			23 00 00 00 00 00 02 00 00
			23 00 00 00 00 00 02 E4 6d
			23 00 00 00 00 00 02 E4 6e
			23 00 00 00 00 00 02 E4 70
			23 00 00 00 00 00 02 E4 72
			23 00 00 00 00 00 02 E4 75
			23 00 00 00 00 00 02 E4 77
			23 00 00 00 00 00 02 E4 7c
			23 00 00 00 00 00 02 E4 84
			23 00 00 00 00 00 02 E4 84
			23 00 00 00 00 00 02 E4 8e
			23 00 00 00 00 00 02 E4 91
			23 00 00 00 00 00 02 E4 93
			23 00 00 00 00 00 02 E4 6a
			23 00 00 00 00 00 02 E4 66
			23 00 00 00 00 00 02 E4 61
			23 00 00 00 00 00 02 E4 51
			23 00 00 00 00 00 02 E4 40
			23 00 00 00 00 00 02 E4 2f
			23 00 00 00 00 00 02 E4 25
			23 00 00 00 00 00 02 E4 1f
			23 00 00 00 00 00 02 E4 17
			23 00 00 00 00 00 02 E4 0e
			23 00 00 00 00 00 02 E4 08
			23 00 00 00 00 00 02 E4 03
			23 00 00 00 00 00 02 00 00
			23 00 00 00 00 00 02 E5 90
			23 00 00 00 00 00 02 E5 91
			23 00 00 00 00 00 02 E5 91
			23 00 00 00 00 00 02 E5 93
			23 00 00 00 00 00 02 E5 94
			23 00 00 00 00 00 02 E5 96
			23 00 00 00 00 00 02 E5 98
			23 00 00 00 00 00 02 E5 9c
			23 00 00 00 00 00 02 E5 99
			23 00 00 00 00 00 02 E5 9d
			23 00 00 00 00 00 02 E5 9c
			23 00 00 00 00 00 02 E5 9b
			23 00 00 00 00 00 02 E5 64
			23 00 00 00 00 00 02 E5 60
			23 00 00 00 00 00 02 E5 5c
			23 00 00 00 00 00 02 E5 4c
			23 00 00 00 00 00 02 E5 3c
			23 00 00 00 00 00 02 E5 2c
			23 00 00 00 00 00 02 E5 21
			23 00 00 00 00 00 02 E5 1d
			23 00 00 00 00 00 02 E5 15
			23 00 00 00 00 00 02 E5 0c
			23 00 00 00 00 00 02 E5 06
			23 00 00 00 00 00 02 E5 03
			23 00 00 00 00 00 02 00 00
			23 00 00 00 00 00 02 E6 90
			23 00 00 00 00 00 02 E6 91
			23 00 00 00 00 00 02 E6 91
			23 00 00 00 00 00 02 E6 93
			23 00 00 00 00 00 02 E6 94
			23 00 00 00 00 00 02 E6 96
			23 00 00 00 00 00 02 E6 98
			23 00 00 00 00 00 02 E6 9c
			23 00 00 00 00 00 02 E6 99
			23 00 00 00 00 00 02 E6 9d
			23 00 00 00 00 00 02 E6 9c
			23 00 00 00 00 00 02 E6 9b
			23 00 00 00 00 00 02 E6 64
			23 00 00 00 00 00 02 E6 60
			23 00 00 00 00 00 02 E6 5c
			23 00 00 00 00 00 02 E6 4c
			23 00 00 00 00 00 02 E6 3c
			23 00 00 00 00 00 02 E6 2c
			23 00 00 00 00 00 02 E6 21
			23 00 00 00 00 00 02 E6 1d
			23 00 00 00 00 00 02 E6 15
			23 00 00 00 00 00 02 E6 0c
			23 00 00 00 00 00 02 E6 06
			23 01 00 00 00 00 02 E6 03
		];

		qcom,mdss-dsi-level5-command = [
			23 00 00 00 00 00 02 00 00
			23 00 00 00 00 00 02 E1 30
			23 00 00 00 00 00 02 E1 39
			23 00 00 00 00 00 02 E1 3a
			23 00 00 00 00 00 02 E1 45
			23 00 00 00 00 00 02 E1 4b
			23 00 00 00 00 00 02 E1 50
			23 00 00 00 00 00 02 E1 59
			23 00 00 00 00 00 02 E1 69
			23 00 00 00 00 00 02 E1 6c
			23 00 00 00 00 00 02 E1 7c
			23 00 00 00 00 00 02 E1 85
			23 00 00 00 00 00 02 E1 8c
			23 00 00 00 00 00 02 E1 6f
			23 00 00 00 00 00 02 E1 6b
			23 00 00 00 00 00 02 E1 67
			23 00 00 00 00 00 02 E1 56
			23 00 00 00 00 00 02 E1 42
			23 00 00 00 00 00 02 E1 33
			23 00 00 00 00 00 02 E1 27
			23 00 00 00 00 00 02 E1 21
			23 00 00 00 00 00 02 E1 19
			23 00 00 00 00 00 02 E1 10
			23 00 00 00 00 00 02 E1 07
			23 00 00 00 00 00 02 E1 03
			23 00 00 00 00 00 02 00 00
			23 00 00 00 00 00 02 E2 30
			23 00 00 00 00 00 02 E2 39
			23 00 00 00 00 00 02 E2 3a
			23 00 00 00 00 00 02 E2 45
			23 00 00 00 00 00 02 E2 4b
			23 00 00 00 00 00 02 E2 50
			23 00 00 00 00 00 02 E2 59
			23 00 00 00 00 00 02 E2 69
			23 00 00 00 00 00 02 E2 6c
			23 00 00 00 00 00 02 E2 7c
			23 00 00 00 00 00 02 E2 85
			23 00 00 00 00 00 02 E2 8c
			23 00 00 00 00 00 02 E2 6f
			23 00 00 00 00 00 02 E2 6b
			23 00 00 00 00 00 02 E2 67
			23 00 00 00 00 00 02 E2 56
			23 00 00 00 00 00 02 E2 42
			23 00 00 00 00 00 02 E2 33
			23 00 00 00 00 00 02 E2 27
			23 00 00 00 00 00 02 E2 21
			23 00 00 00 00 00 02 E2 19
			23 00 00 00 00 00 02 E2 10
			23 00 00 00 00 00 02 E2 07
			23 00 00 00 00 00 02 E2 03
			23 00 00 00 00 00 02 00 00
			23 00 00 00 00 00 02 E3 6c
			23 00 00 00 00 00 02 E3 6d
			23 00 00 00 00 00 02 E3 6f
			23 00 00 00 00 00 02 E3 71
			23 00 00 00 00 00 02 E3 73
			23 00 00 00 00 00 02 E3 76
			23 00 00 00 00 00 02 E3 7b
			23 00 00 00 00 00 02 E3 83
			23 00 00 00 00 00 02 E3 84
			23 00 00 00 00 00 02 E3 8e
			23 00 00 00 00 00 02 E3 91
			23 00 00 00 00 00 02 E3 93
			23 00 00 00 00 00 02 E3 6a
			23 00 00 00 00 00 02 E3 66
			23 00 00 00 00 00 02 E3 62
			23 00 00 00 00 00 02 E3 51
			23 00 00 00 00 00 02 E3 40
			23 00 00 00 00 00 02 E3 30
			23 00 00 00 00 00 02 E3 25
			23 00 00 00 00 00 02 E3 1f
			23 00 00 00 00 00 02 E3 17
			23 00 00 00 00 00 02 E3 0e
			23 00 00 00 00 00 02 E3 07
			23 00 00 00 00 00 02 E3 03
			23 00 00 00 00 00 02 00 00
			23 00 00 00 00 00 02 E4 6c
			23 00 00 00 00 00 02 E4 6d
			23 00 00 00 00 00 02 E4 6f
			23 00 00 00 00 00 02 E4 71
			23 00 00 00 00 00 02 E4 73
			23 00 00 00 00 00 02 E4 76
			23 00 00 00 00 00 02 E4 7b
			23 00 00 00 00 00 02 E4 83
			23 00 00 00 00 00 02 E4 84
			23 00 00 00 00 00 02 E4 8e
			23 00 00 00 00 00 02 E4 91
			23 00 00 00 00 00 02 E4 93
			23 00 00 00 00 00 02 E4 6a
			23 00 00 00 00 00 02 E4 66
			23 00 00 00 00 00 02 E4 62
			23 00 00 00 00 00 02 E4 51
			23 00 00 00 00 00 02 E4 40
			23 00 00 00 00 00 02 E4 30
			23 00 00 00 00 00 02 E4 25
			23 00 00 00 00 00 02 E4 1f
			23 00 00 00 00 00 02 E4 17
			23 00 00 00 00 00 02 E4 0e
			23 00 00 00 00 00 02 E4 07
			23 00 00 00 00 00 02 E4 03
			23 00 00 00 00 00 02 00 00
			23 00 00 00 00 00 02 E5 97
			23 00 00 00 00 00 02 E5 98
			23 00 00 00 00 00 02 E5 99
			23 00 00 00 00 00 02 E5 9b
			23 00 00 00 00 00 02 E5 9d
			23 00 00 00 00 00 02 E5 9f
			23 00 00 00 00 00 02 E5 a1
			23 00 00 00 00 00 02 E5 a6
			23 00 00 00 00 00 02 E5 a2
			23 00 00 00 00 00 02 E5 a3
			23 00 00 00 00 00 02 E5 9f
			23 00 00 00 00 00 02 E5 9d
			23 00 00 00 00 00 02 E5 62
			23 00 00 00 00 00 02 E5 5f
			23 00 00 00 00 00 02 E5 5a
			23 00 00 00 00 00 02 E5 4b
			23 00 00 00 00 00 02 E5 3a
			23 00 00 00 00 00 02 E5 2b
			23 00 00 00 00 00 02 E5 21
			23 00 00 00 00 00 02 E5 1b
			23 00 00 00 00 00 02 E5 14
			23 00 00 00 00 00 02 E5 0c
			23 00 00 00 00 00 02 E5 06
			23 00 00 00 00 00 02 E5 03
			23 00 00 00 00 00 02 00 00
			23 00 00 00 00 00 02 E6 97
			23 00 00 00 00 00 02 E6 98
			23 00 00 00 00 00 02 E6 99
			23 00 00 00 00 00 02 E6 9b
			23 00 00 00 00 00 02 E6 9d
			23 00 00 00 00 00 02 E6 9f
			23 00 00 00 00 00 02 E6 a1
			23 00 00 00 00 00 02 E6 a6
			23 00 00 00 00 00 02 E6 a2
			23 00 00 00 00 00 02 E6 a3
			23 00 00 00 00 00 02 E6 9f
			23 00 00 00 00 00 02 E6 9d
			23 00 00 00 00 00 02 E6 62
			23 00 00 00 00 00 02 E6 5f
			23 00 00 00 00 00 02 E6 5a
			23 00 00 00 00 00 02 E6 4b
			23 00 00 00 00 00 02 E6 3a
			23 00 00 00 00 00 02 E6 2b
			23 00 00 00 00 00 02 E6 21
			23 00 00 00 00 00 02 E6 1b
			23 00 00 00 00 00 02 E6 14
			23 00 00 00 00 00 02 E6 0c
			23 00 00 00 00 00 02 E6 06
			23 01 00 00 00 00 02 E6 03
		];

		qcom,mdss-dsi-level6-command = [
			23 00 00 00 00 00 02 00 00
			23 00 00 00 00 00 02 E1 41
			23 00 00 00 00 00 02 E1 45
			23 00 00 00 00 00 02 E1 4a
			23 00 00 00 00 00 02 E1 48
			23 00 00 00 00 00 02 E1 52
			23 00 00 00 00 00 02 E1 56
			23 00 00 00 00 00 02 E1 5e
			23 00 00 00 00 00 02 E1 6c
			23 00 00 00 00 00 02 E1 71
			23 00 00 00 00 00 02 E1 82
			23 00 00 00 00 00 02 E1 89
			23 00 00 00 00 00 02 E1 8d
			23 00 00 00 00 00 02 E1 70
			23 00 00 00 00 00 02 E1 6b
			23 00 00 00 00 00 02 E1 66
			23 00 00 00 00 00 02 E1 54
			23 00 00 00 00 00 02 E1 41
			23 00 00 00 00 00 02 E1 32
			23 00 00 00 00 00 02 E1 27
			23 00 00 00 00 00 02 E1 21
			23 00 00 00 00 00 02 E1 19
			23 00 00 00 00 00 02 E1 0f
			23 00 00 00 00 00 02 E1 07
			23 00 00 00 00 00 02 E1 03
			23 00 00 00 00 00 02 00 00
			23 00 00 00 00 00 02 E2 41
			23 00 00 00 00 00 02 E2 45
			23 00 00 00 00 00 02 E2 4a
			23 00 00 00 00 00 02 E2 48
			23 00 00 00 00 00 02 E2 52
			23 00 00 00 00 00 02 E2 56
			23 00 00 00 00 00 02 E2 5e
			23 00 00 00 00 00 02 E2 6c
			23 00 00 00 00 00 02 E2 71
			23 00 00 00 00 00 02 E2 82
			23 00 00 00 00 00 02 E2 89
			23 00 00 00 00 00 02 E2 8d
			23 00 00 00 00 00 02 E2 70
			23 00 00 00 00 00 02 E2 6b
			23 00 00 00 00 00 02 E2 66
			23 00 00 00 00 00 02 E2 54
			23 00 00 00 00 00 02 E2 41
			23 00 00 00 00 00 02 E2 32
			23 00 00 00 00 00 02 E2 27
			23 00 00 00 00 00 02 E2 21
			23 00 00 00 00 00 02 E2 19
			23 00 00 00 00 00 02 E2 0f
			23 00 00 00 00 00 02 E2 07
			23 00 00 00 00 00 02 E2 03
			23 00 00 00 00 00 02 00 00
			23 00 00 00 00 00 02 E3 79
			23 00 00 00 00 00 02 E3 7a
			23 00 00 00 00 00 02 E3 7b
			23 00 00 00 00 00 02 E3 7e
			23 00 00 00 00 00 02 E3 80
			23 00 00 00 00 00 02 E3 82
			23 00 00 00 00 00 02 E3 85
			23 00 00 00 00 00 02 E3 8c
			23 00 00 00 00 00 02 E3 8b
			23 00 00 00 00 00 02 E3 93
			23 00 00 00 00 00 02 E3 94
			23 00 00 00 00 00 02 E3 95
			23 00 00 00 00 00 02 E3 68
			23 00 00 00 00 00 02 E3 64
			23 00 00 00 00 00 02 E3 60
			23 00 00 00 00 00 02 E3 4f
			23 00 00 00 00 00 02 E3 3e
			23 00 00 00 00 00 02 E3 2e
			23 00 00 00 00 00 02 E3 24
			23 00 00 00 00 00 02 E3 1e
			23 00 00 00 00 00 02 E3 17
			23 00 00 00 00 00 02 E3 0d
			23 00 00 00 00 00 02 E3 06
			23 00 00 00 00 00 02 E3 03
			23 00 00 00 00 00 02 00 00
			23 00 00 00 00 00 02 E4 79
			23 00 00 00 00 00 02 E4 7a
			23 00 00 00 00 00 02 E4 7b
			23 00 00 00 00 00 02 E4 7e
			23 00 00 00 00 00 02 E4 80
			23 00 00 00 00 00 02 E4 82
			23 00 00 00 00 00 02 E4 85
			23 00 00 00 00 00 02 E4 8c
			23 00 00 00 00 00 02 E4 8b
			23 00 00 00 00 00 02 E4 93
			23 00 00 00 00 00 02 E4 94
			23 00 00 00 00 00 02 E4 95
			23 00 00 00 00 00 02 E4 68
			23 00 00 00 00 00 02 E4 64
			23 00 00 00 00 00 02 E4 60
			23 00 00 00 00 00 02 E4 4f
			23 00 00 00 00 00 02 E4 3e
			23 00 00 00 00 00 02 E4 2e
			23 00 00 00 00 00 02 E4 24
			23 00 00 00 00 00 02 E4 1e
			23 00 00 00 00 00 02 E4 17
			23 00 00 00 00 00 02 E4 0d
			23 00 00 00 00 00 02 E4 06
			23 00 00 00 00 00 02 E4 03
			23 00 00 00 00 00 02 00 00
			23 00 00 00 00 00 02 E5 a1
			23 00 00 00 00 00 02 E5 a1
			23 00 00 00 00 00 02 E5 a2
			23 00 00 00 00 00 02 E5 a2
			23 00 00 00 00 00 02 E5 a3
			23 00 00 00 00 00 02 E5 a4
			23 00 00 00 00 00 02 E5 a6
			23 00 00 00 00 00 02 E5 a9
			23 00 00 00 00 00 02 E5 a5
			23 00 00 00 00 00 02 E5 a6
			23 00 00 00 00 00 02 E5 a4
			23 00 00 00 00 00 02 E5 a1
			23 00 00 00 00 00 02 E5 5e
			23 00 00 00 00 00 02 E5 5a
			23 00 00 00 00 00 02 E5 57
			23 00 00 00 00 00 02 E5 46
			23 00 00 00 00 00 02 E5 38
			23 00 00 00 00 00 02 E5 28
			23 00 00 00 00 00 02 E5 20
			23 00 00 00 00 00 02 E5 1a
			23 00 00 00 00 00 02 E5 13
			23 00 00 00 00 00 02 E5 0b
			23 00 00 00 00 00 02 E5 05
			23 00 00 00 00 00 02 E5 03
			23 00 00 00 00 00 02 00 00
			23 00 00 00 00 00 02 E6 a1
			23 00 00 00 00 00 02 E6 a1
			23 00 00 00 00 00 02 E6 a2
			23 00 00 00 00 00 02 E6 a2
			23 00 00 00 00 00 02 E6 a3
			23 00 00 00 00 00 02 E6 a4
			23 00 00 00 00 00 02 E6 a6
			23 00 00 00 00 00 02 E6 a9
			23 00 00 00 00 00 02 E6 a5
			23 00 00 00 00 00 02 E6 a6
			23 00 00 00 00 00 02 E6 a4
			23 00 00 00 00 00 02 E6 a1
			23 00 00 00 00 00 02 E6 5e
			23 00 00 00 00 00 02 E6 5a
			23 00 00 00 00 00 02 E6 57
			23 00 00 00 00 00 02 E6 46
			23 00 00 00 00 00 02 E6 38
			23 00 00 00 00 00 02 E6 28
			23 00 00 00 00 00 02 E6 20
			23 00 00 00 00 00 02 E6 1a
			23 00 00 00 00 00 02 E6 13
			23 00 00 00 00 00 02 E6 0b
			23 00 00 00 00 00 02 E6 05
			23 01 00 00 00 00 02 E6 03
		];

		qcom,mdss-dsi-level7-command = [
			23 00 00 00 00 00 02 00 00
			23 00 00 00 00 00 02 E1 45
			23 00 00 00 00 00 02 E1 46
			23 00 00 00 00 00 02 E1 4b
			23 00 00 00 00 00 02 E1 52
			23 00 00 00 00 00 02 E1 55
			23 00 00 00 00 00 02 E1 57
			23 00 00 00 00 00 02 E1 5e
			23 00 00 00 00 00 02 E1 70
			23 00 00 00 00 00 02 E1 71
			23 00 00 00 00 00 02 E1 81
			23 00 00 00 00 00 02 E1 88
			23 00 00 00 00 00 02 E1 8d
			23 00 00 00 00 00 02 E1 6f
			23 00 00 00 00 00 02 E1 6b
			23 00 00 00 00 00 02 E1 66
			23 00 00 00 00 00 02 E1 56
			23 00 00 00 00 00 02 E1 41
			23 00 00 00 00 00 02 E1 32
			23 00 00 00 00 00 02 E1 27
			23 00 00 00 00 00 02 E1 21
			23 00 00 00 00 00 02 E1 19
			23 00 00 00 00 00 02 E1 0f
			23 00 00 00 00 00 02 E1 08
			23 00 00 00 00 00 02 E1 03
			23 00 00 00 00 00 02 00 00
			23 00 00 00 00 00 02 E2 45
			23 00 00 00 00 00 02 E2 46
			23 00 00 00 00 00 02 E2 4b
			23 00 00 00 00 00 02 E2 52
			23 00 00 00 00 00 02 E2 55
			23 00 00 00 00 00 02 E2 57
			23 00 00 00 00 00 02 E2 5e
			23 00 00 00 00 00 02 E2 70
			23 00 00 00 00 00 02 E2 71
			23 00 00 00 00 00 02 E2 81
			23 00 00 00 00 00 02 E2 88
			23 00 00 00 00 00 02 E2 8d
			23 00 00 00 00 00 02 E2 6f
			23 00 00 00 00 00 02 E2 6b
			23 00 00 00 00 00 02 E2 66
			23 00 00 00 00 00 02 E2 56
			23 00 00 00 00 00 02 E2 41
			23 00 00 00 00 00 02 E2 32
			23 00 00 00 00 00 02 E2 27
			23 00 00 00 00 00 02 E2 21
			23 00 00 00 00 00 02 E2 19
			23 00 00 00 00 00 02 E2 0f
			23 00 00 00 00 00 02 E2 08
			23 00 00 00 00 00 02 E2 03
			23 00 00 00 00 00 02 00 00
			23 00 00 00 00 00 02 E3 81
			23 00 00 00 00 00 02 E3 82
			23 00 00 00 00 00 02 E3 83
			23 00 00 00 00 00 02 E3 84
			23 00 00 00 00 00 02 E3 87
			23 00 00 00 00 00 02 E3 89
			23 00 00 00 00 00 02 E3 8c
			23 00 00 00 00 00 02 E3 91
			23 00 00 00 00 00 02 E3 8f
			23 00 00 00 00 00 02 E3 96
			23 00 00 00 00 00 02 E3 96
			23 00 00 00 00 00 02 E3 97
			23 00 00 00 00 00 02 E3 67
			23 00 00 00 00 00 02 E3 63
			23 00 00 00 00 00 02 E3 5e
			23 00 00 00 00 00 02 E3 4e
			23 00 00 00 00 00 02 E3 3d
			23 00 00 00 00 00 02 E3 2e
			23 00 00 00 00 00 02 E3 23
			23 00 00 00 00 00 02 E3 1e
			23 00 00 00 00 00 02 E3 16
			23 00 00 00 00 00 02 E3 0d
			23 00 00 00 00 00 02 E3 07
			23 00 00 00 00 00 02 E3 03
			23 00 00 00 00 00 02 00 00
			23 00 00 00 00 00 02 E4 81
			23 00 00 00 00 00 02 E4 82
			23 00 00 00 00 00 02 E4 83
			23 00 00 00 00 00 02 E4 84
			23 00 00 00 00 00 02 E4 87
			23 00 00 00 00 00 02 E4 89
			23 00 00 00 00 00 02 E4 8c
			23 00 00 00 00 00 02 E4 91
			23 00 00 00 00 00 02 E4 8f
			23 00 00 00 00 00 02 E4 96
			23 00 00 00 00 00 02 E4 96
			23 00 00 00 00 00 02 E4 97
			23 00 00 00 00 00 02 E4 67
			23 00 00 00 00 00 02 E4 63
			23 00 00 00 00 00 02 E4 5e
			23 00 00 00 00 00 02 E4 4e
			23 00 00 00 00 00 02 E4 3d
			23 00 00 00 00 00 02 E4 2e
			23 00 00 00 00 00 02 E4 23
			23 00 00 00 00 00 02 E4 1e
			23 00 00 00 00 00 02 E4 16
			23 00 00 00 00 00 02 E4 0d
			23 00 00 00 00 00 02 E4 07
			23 00 00 00 00 00 02 E4 03
			23 00 00 00 00 00 02 00 00
			23 00 00 00 00 00 02 E5 aa
			23 00 00 00 00 00 02 E5 ac
			23 00 00 00 00 00 02 E5 ab
			23 00 00 00 00 00 02 E5 ac
			23 00 00 00 00 00 02 E5 ac
			23 00 00 00 00 00 02 E5 ac
			23 00 00 00 00 00 02 E5 ae
			23 00 00 00 00 00 02 E5 b1
			23 00 00 00 00 00 02 E5 ac
			23 00 00 00 00 00 02 E5 ad
			23 00 00 00 00 00 02 E5 a8
			23 00 00 00 00 00 02 E5 a6
			23 00 00 00 00 00 02 E5 5a
			23 00 00 00 00 00 02 E5 56
			23 00 00 00 00 00 02 E5 52
			23 00 00 00 00 00 02 E5 42
			23 00 00 00 00 00 02 E5 34
			23 00 00 00 00 00 02 E5 27
			23 00 00 00 00 00 02 E5 1d
			23 00 00 00 00 00 02 E5 18
			23 00 00 00 00 00 02 E5 12
			23 00 00 00 00 00 02 E5 09
			23 00 00 00 00 00 02 E5 05
			23 00 00 00 00 00 02 E5 03
			23 00 00 00 00 00 02 00 00
			23 00 00 00 00 00 02 E6 aa
			23 00 00 00 00 00 02 E6 ac
			23 00 00 00 00 00 02 E6 ab
			23 00 00 00 00 00 02 E6 ac
			23 00 00 00 00 00 02 E6 ac
			23 00 00 00 00 00 02 E6 ac
			23 00 00 00 00 00 02 E6 ae
			23 00 00 00 00 00 02 E6 b1
			23 00 00 00 00 00 02 E6 ac
			23 00 00 00 00 00 02 E6 ad
			23 00 00 00 00 00 02 E6 a8
			23 00 00 00 00 00 02 E6 a6
			23 00 00 00 00 00 02 E6 5a
			23 00 00 00 00 00 02 E6 56
			23 00 00 00 00 00 02 E6 52
			23 00 00 00 00 00 02 E6 42
			23 00 00 00 00 00 02 E6 34
			23 00 00 00 00 00 02 E6 27
			23 00 00 00 00 00 02 E6 1d
			23 00 00 00 00 00 02 E6 18
			23 00 00 00 00 00 02 E6 12
			23 00 00 00 00 00 02 E6 09
			23 00 00 00 00 00 02 E6 05
			23 01 00 00 00 00 02 E6 03
			];

		qcom,mdss-dsi-level8-command = [
			23 00 00 00 00 00 02 00 00
			23 00 00 00 00 00 02 E1 30
			23 00 00 00 00 00 02 E1 34
			23 00 00 00 00 00 02 E1 43
			23 00 00 00 00 00 02 E1 45
			23 00 00 00 00 00 02 E1 49
			23 00 00 00 00 00 02 E1 4e
			23 00 00 00 00 00 02 E1 58
			23 00 00 00 00 00 02 E1 69
			23 00 00 00 00 00 02 E1 6b
			23 00 00 00 00 00 02 E1 7d
			23 00 00 00 00 00 02 E1 8a
			23 00 00 00 00 00 02 E1 8f
			23 00 00 00 00 00 02 E1 6f
			23 00 00 00 00 00 02 E1 6a
			23 00 00 00 00 00 02 E1 66
			23 00 00 00 00 00 02 E1 55
			23 00 00 00 00 00 02 E1 41
			23 00 00 00 00 00 02 E1 32
			23 00 00 00 00 00 02 E1 27
			23 00 00 00 00 00 02 E1 21
			23 00 00 00 00 00 02 E1 19
			23 00 00 00 00 00 02 E1 10
			23 00 00 00 00 00 02 E1 09
			23 00 00 00 00 00 02 E1 03
			23 00 00 00 00 00 02 00 00
			23 00 00 00 00 00 02 E2 30
			23 00 00 00 00 00 02 E2 34
			23 00 00 00 00 00 02 E2 43
			23 00 00 00 00 00 02 E2 45
			23 00 00 00 00 00 02 E2 49
			23 00 00 00 00 00 02 E2 4e
			23 00 00 00 00 00 02 E2 58
			23 00 00 00 00 00 02 E2 69
			23 00 00 00 00 00 02 E2 6b
			23 00 00 00 00 00 02 E2 7d
			23 00 00 00 00 00 02 E2 8a
			23 00 00 00 00 00 02 E2 8f
			23 00 00 00 00 00 02 E2 6f
			23 00 00 00 00 00 02 E2 6a
			23 00 00 00 00 00 02 E2 66
			23 00 00 00 00 00 02 E2 55
			23 00 00 00 00 00 02 E2 41
			23 00 00 00 00 00 02 E2 32
			23 00 00 00 00 00 02 E2 27
			23 00 00 00 00 00 02 E2 21
			23 00 00 00 00 00 02 E2 19
			23 00 00 00 00 00 02 E2 10
			23 00 00 00 00 00 02 E2 09
			23 00 00 00 00 00 02 E2 03
			23 00 00 00 00 00 02 00 00
			23 00 00 00 00 00 02 E3 83
			23 00 00 00 00 00 02 E3 84
			23 00 00 00 00 00 02 E3 84
			23 00 00 00 00 00 02 E3 86
			23 00 00 00 00 00 02 E3 88
			23 00 00 00 00 00 02 E3 8a
			23 00 00 00 00 00 02 E3 8d
			23 00 00 00 00 00 02 E3 93
			23 00 00 00 00 00 02 E3 91
			23 00 00 00 00 00 02 E3 98
			23 00 00 00 00 00 02 E3 99
			23 00 00 00 00 00 02 E3 98
			23 00 00 00 00 00 02 E3 66
			23 00 00 00 00 00 02 E3 62
			23 00 00 00 00 00 02 E3 5d
			23 00 00 00 00 00 02 E3 4d
			23 00 00 00 00 00 02 E3 3d
			23 00 00 00 00 00 02 E3 2d
			23 00 00 00 00 00 02 E3 23
			23 00 00 00 00 00 02 E3 1d
			23 00 00 00 00 00 02 E3 16
			23 00 00 00 00 00 02 E3 0d
			23 00 00 00 00 00 02 E3 07
			23 00 00 00 00 00 02 E3 03
			23 00 00 00 00 00 02 00 00
			23 00 00 00 00 00 02 E4 83
			23 00 00 00 00 00 02 E4 84
			23 00 00 00 00 00 02 E4 84
			23 00 00 00 00 00 02 E4 86
			23 00 00 00 00 00 02 E4 88
			23 00 00 00 00 00 02 E4 8a
			23 00 00 00 00 00 02 E4 8d
			23 00 00 00 00 00 02 E4 93
			23 00 00 00 00 00 02 E4 91
			23 00 00 00 00 00 02 E4 98
			23 00 00 00 00 00 02 E4 99
			23 00 00 00 00 00 02 E4 98
			23 00 00 00 00 00 02 E4 66
			23 00 00 00 00 00 02 E4 62
			23 00 00 00 00 00 02 E4 5d
			23 00 00 00 00 00 02 E4 4d
			23 00 00 00 00 00 02 E4 3d
			23 00 00 00 00 00 02 E4 2d
			23 00 00 00 00 00 02 E4 23
			23 00 00 00 00 00 02 E4 1d
			23 00 00 00 00 00 02 E4 16
			23 00 00 00 00 00 02 E4 0d
			23 00 00 00 00 00 02 E4 07
			23 00 00 00 00 00 02 E4 03
			23 00 00 00 00 00 02 00 00
			23 00 00 00 00 00 02 E5 af
			23 00 00 00 00 00 02 E5 b0
			23 00 00 00 00 00 02 E5 b0
			23 00 00 00 00 00 02 E5 b1
			23 00 00 00 00 00 02 E5 b2
			23 00 00 00 00 00 02 E5 b3
			23 00 00 00 00 00 02 E5 b4
			23 00 00 00 00 00 02 E5 b6
			23 00 00 00 00 00 02 E5 b1
			23 00 00 00 00 00 02 E5 b0
			23 00 00 00 00 00 02 E5 ab
			23 00 00 00 00 00 02 E5 a7
			23 00 00 00 00 00 02 E5 58
			23 00 00 00 00 00 02 E5 55
			23 00 00 00 00 00 02 E5 4e
			23 00 00 00 00 00 02 E5 42
			23 00 00 00 00 00 02 E5 32
			23 00 00 00 00 00 02 E5 25
			23 00 00 00 00 00 02 E5 1d
			23 00 00 00 00 00 02 E5 18
			23 00 00 00 00 00 02 E5 11
			23 00 00 00 00 00 02 E5 0a
			23 00 00 00 00 00 02 E5 06
			23 00 00 00 00 00 02 E5 03
			23 00 00 00 00 00 02 00 00
			23 00 00 00 00 00 02 E6 af
			23 00 00 00 00 00 02 E6 b0
			23 00 00 00 00 00 02 E6 b0
			23 00 00 00 00 00 02 E6 b1
			23 00 00 00 00 00 02 E6 b2
			23 00 00 00 00 00 02 E6 b3
			23 00 00 00 00 00 02 E6 b4
			23 00 00 00 00 00 02 E6 b6
			23 00 00 00 00 00 02 E6 b1
			23 00 00 00 00 00 02 E6 b0
			23 00 00 00 00 00 02 E6 ab
			23 00 00 00 00 00 02 E6 a7
			23 00 00 00 00 00 02 E6 58
			23 00 00 00 00 00 02 E6 55
			23 00 00 00 00 00 02 E6 4e
			23 00 00 00 00 00 02 E6 42
			23 00 00 00 00 00 02 E6 32
			23 00 00 00 00 00 02 E6 25
			23 00 00 00 00 00 02 E6 1d
			23 00 00 00 00 00 02 E6 18
			23 00 00 00 00 00 02 E6 11
			23 00 00 00 00 00 02 E6 0a
			23 00 00 00 00 00 02 E6 06
			23 01 00 00 00 00 02 E6 03
		];
		qcom,mdss-dsi-china-ce-on-command = [
			39 00 00 00 00 00 02 00 00
			39 01 00 00 00 00 91 D4 00 40 00 40 00 40 00 40 00 40 00 40 00 40 00 40 00 40 00 40 00 40 00 40 00 40 00 40 00 40 00 40 00 40 00 40 00 40 00 40 00 40 00 40 00 40 00 40 00 40 00 40 00 40 00 40 00 40 00 40 00 40 00 40 00 40 00 40 00 40 00 40 00 40 ff 40 ff 40 ff 40 ff 40 ff 40 ff 40 ff 40 ff 40 ff 40 ff 40 ff 40 ff 40 ff 40 ff 40 ff 40 fe 40 fe 40 fe 40 fe 40 fe 40 fe 40 fe 40 fe 40 fe 40 fe 40 fe 40 fe 40 ff 40 ff 40 ff 40 ff 40 ff 40 ff 40 ff 40 ff 40
			39 01 00 00 00 00 91 D4 00 40 00 40 00 40 00 40 00 40 00 40 00 40 00 40 00 40 00 40 00 40 00 40 00 40 00 40 00 40 00 40 00 40 00 40 00 40 00 40 00 40 00 3f 00 3f 00 3f 00 3f 00 3e 00 3e 00 3e 00 3e 00 3e 00 3d 00 3d 00 3d 00 3d 00 3d 00 3d 00 3d 00 3e 00 3e 00 3e 00 3e 01 3f 01 3f 01 3f 01 3f 01 3f 01 40 01 40 01 40 01 40 01 40 01 40 01 40 01 40 01 40 01 40 00 40 00 40 00 40 00 40 00 40 00 40 00 40 00 40 00 40 00 40 00 40 00 40 00 40 00 40 00 40 00 40
			39 01 00 00 00 00 91 D4 00 40 00 40 00 40 00 40 00 40 00 40 00 40 00 40 00 40 00 40 00 40 00 40 00 40 00 40 00 40 00 40 00 40 00 40 00 40 00 40 00 40 00 40 00 40 00 40 00 40 00 40 00 40 00 40 00 40 00 40 00 40 00 40 00 40 00 40 00 40 00 40 ff 52 ff 52 ff 51 ff 51 ff 50 ff 50 ff 4f ff 4f 00 4e 00 4e 00 4d 00 4d 00 4c 00 4c 00 4b 00 4b 00 4a 00 49 00 49 00 48 00 47 00 46 00 46 00 45 00 44 00 43 00 43 00 42 00 41 00 41 00 40 00 41 ff 41 ff 42 ff 43 ff 43
			39 01 00 00 00 00 91 D4 ff 44 fe 45 fe 45 fe 46 fe 47 fe 47 fd 48 fc 48 fc 49 fc 4a fc 4a fc 4a fc 4a fc 4a fc 4b fc 4b fc 4b fd 4b fd 4c fd 4c fd 4c fd 4c fd 4c fd 4d fd 4d fd 4c fd 4b ff 4a ff 4a ff 49 ff 48 ff 48 ff 47 00 46 00 46 00 45 00 44 00 43 01 43 01 42 01 42 01 42 01 42 01 42 01 42 01 42 01 42 01 42 01 42 01 42 01 42 01 42 01 43 01 43 01 43 01 43 01 43 02 43 02 44 02 44 02 44 02 45 02 45 02 45 02 46 02 46 02 46 02 46 02 47 03 47 02 47 02 47
			39 01 00 00 00 00 91 D4 02 47 02 47 02 47 02 47 02 47 02 47 02 47 02 48 02 48 03 48 03 48 03 48 03 48 03 48 02 47 02 47 02 47 02 47 02 47 01 47 01 47 01 47 01 46 01 46 01 46 01 46 00 46 00 46 00 46 00 46 00 47 00 47 00 47 00 47 00 48 00 48 00 48 00 48 00 49 00 49 00 49 00 49 00 4a 00 49 00 49 00 49 00 49 00 48 ff 48 ff 48 ff 47 ff 47 ff 47 ff 47 ff 46 ff 46 ff 46 ff 46 ff 47 ff 48 ff 49 ff 49 ff 4a ff 4b ff 4c ff 4d ff 4e ff 4e ff 4f ff 50 ff 51 ff 52
			39 00 00 00 00 00 02 00 00
			39 01 00 00 00 00 91 D5 00 52 00 52 00 52 00 51 00 51 00 50 00 50 ff 4f ff 4f ff 4f ff 4e ff 4e ff 4d ff 4d ff 4c ff 4c ff 4c ff 4b ff 4b ff 4b ff 4a ff 4a ff 49 ff 49 ff 49 ff 48 ff 48 00 47 00 47 00 47 00 46 ff 46 ff 46 ff 46 ff 46 ff 46 ff 46 fe 46 fe 46 fe 46 fe 46 fe 46 fd 46 fc 46 fc 46 fc 46 fc 46 fc 46 fc 46 fc 46 fc 46 fc 46 fc 46 fe 46 fe 46 fe 46 fe 46 fe 46 fe 46 fe 46 fe 46 fe 46 fe 46 ff 46 ff 45 ff 45 ff 45 ff 45 00 45 00 44 00 44 00 44
			39 01 00 00 00 00 91 D5 00 44 01 44 01 43 01 43 01 43 01 42 01 42 01 42 01 41 01 41 01 41 01 40 01 40 01 40 01 3f 01 3f 01 3f 01 3e 01 3e 01 3f 01 40 01 40 01 41 01 42 02 43 02 43 02 44 02 45 02 45 02 46 02 47 03 48 03 48 03 49 03 48 02 47 02 47 02 46 02 45 02 44 02 44 02 43 02 42 02 41 02 41 02 40 02 3f 02 3f 02 3e 02 3e 02 3e 02 3d 02 3d 02 3d 02 3d 02 3d 02 3d 02 3c 02 3c 02 3c 02 3c 02 3c 02 3c 02 3c 02 3c 02 3c 01 3c 01 3c 01 3c 01 3c 00 3c 00 3c
			39 01 00 00 00 00 91 D5 00 3c 00 3c ff 3c ff 3c ff 3c ff 3d ff 3d fe 3d fe 3e fe 3f fe 3f fe 40 fe 41 fe 41 fe 42 fe 43 fe 43 fe 44 fe 45 fe 45 fe 46 fd 47 fe 48 fd 48 fd 49 fd 4a ff 4b ff 4c ff 4c ff 4d ff 4e ff 4f ff 50 00 50 00 51 00 52 ff 53 ff 53 ff 53 ff 53 00 53 00 53 00 53 00 53 00 53 00 53 00 53 01 53 01 53 01 53 01 53 01 52 01 52 01 51 01 50 01 4f 00 4f 00 4e 00 4d 00 4c 00 4b 00 4b 00 4a 00 49 ff 48 ff 48 ff 47 ff 48 ff 48 ff 49 ff 49 fe 4a
			39 01 00 00 00 00 91 D5 fd 4a fd 4b fd 4c fd 4c fd 4d fd 4d fc 4e fc 4e fc 4f fc 4f fc 50 fc 51 fc 51 fc 52 fc 52 fd 53 fd 54 fd 54 fd 55 fd 55 fd 56 fd 57 fd 57 fd 58 fe 58 fe 57 ff 55 ff 54 ff 53 00 51 00 50 00 4f 00 4d 01 4c 01 4b 01 49 01 48 02 47 02 45 02 45 02 46 02 46 02 47 03 48 03 49 03 4a 02 4b 01 4c 01 4c 01 4d 01 4e 01 4f 01 50 01 51 01 51 01 51 01 50 01 50 01 4f 01 4f 01 4e 03 4e 03 4d 03 4d 03 4c 03 4c 03 4b 03 4b 03 4b 03 4a 03 4b 03 4b
			39 01 00 00 00 00 91 D5 03 4c 03 4c 03 4c 03 4d 03 4d 03 4e 03 4e 03 4f 03 4f 03 4f 03 50 03 50 03 50 03 50 02 50 01 4f 01 4f 01 4f 00 4e 00 4e 00 4d ff 4d ff 4d ff 4c ff 4c fe 4c fd 4b fd 4b fd 4a fd 4a ff 4a ff 4a ff 49 ff 49 ff 49 00 48 00 48 00 48 00 48 00 47 01 47 01 47 01 47 01 47 00 47 00 48 00 48 00 49 ff 49 ff 4a ff 4a ff 4b ff 4b fd 4c fd 4c fd 4d fd 4d fd 4d fd 4e fd 4e fd 4f fd 4f fd 4f fd 50 fd 50 fd 51 fd 51 ff 51 ff 52 ff 52 ff 53 ff 53
			23 01 00 00 00 00 02 55 00
			23 01 00 00 00 00 02 81 80
		];


		qcom,mdss-dsi-india-ce-on-command = [
			39 00 00 00 00 00 02 00 00
			39 01 00 00 00 00 91 D4 00 40 00 40 00 40 00 40 00 40 00 40 00 40 00 40 00 40 00 40 00 40 00 40 00 40 00 40 00 40 00 40 00 40 00 40 00 40 00 40 00 40 00 40 00 40 00 40 00 40 00 40 00 40 00 40 00 40 00 40 00 40 00 40 00 40 00 40 00 40 00 40 00 40 ff 40 ff 40 ff 40 ff 40 ff 40 ff 40 ff 40 ff 40 ff 40 ff 40 ff 40 ff 40 ff 40 ff 40 ff 40 ff 40 00 40 00 40 00 40 00 40 00 40 00 40 00 40 00 40 00 40 00 40 00 40 ff 40 ff 40 ff 40 ff 40 ff 40 ff 40 ff 40 fe 40
			39 01 00 00 00 00 91 D4 fe 40 fe 40 fe 40 fe 40 fe 40 fe 40 fe 40 ff 40 ff 40 ff 40 ff 40 ff 40 ff 40 ff 40 ff 40 00 40 00 40 00 40 00 40 00 40 00 40 00 40 00 40 00 40 00 40 00 40 00 40 00 40 00 40 00 40 00 40 00 40 00 40 00 40 00 40 00 40 00 40 00 40 00 40 00 40 00 40 01 40 01 40 01 40 01 40 01 40 01 40 01 40 01 40 01 40 01 40 01 40 01 40 01 40 01 40 01 40 00 40 00 40 00 40 00 40 00 40 00 40 00 40 00 40 00 40 00 40 00 40 00 40 00 40 00 40 00 40 00 40
			39 01 00 00 00 00 91 D4 00 40 00 40 00 40 00 40 00 40 00 40 00 40 00 40 00 40 00 40 00 40 00 40 00 40 00 40 00 40 00 40 00 40 00 40 00 40 00 40 00 40 00 40 00 40 00 40 00 40 00 40 00 40 00 40 00 40 00 40 00 40 00 40 00 40 00 40 00 40 00 40 fe 57 fe 56 ff 55 ff 54 ff 53 ff 52 ff 51 ff 50 00 4f 00 4d 00 4c 00 4b 00 4a 00 49 00 48 00 47 00 46 00 46 00 45 00 45 00 44 00 44 00 43 00 42 00 42 00 41 00 41 00 40 00 40 00 3f 00 3f 00 40 ff 41 ff 42 ff 43 ff 44
			39 01 00 00 00 00 91 D4 ff 45 fe 46 fe 47 fd 48 fd 49 fd 4a fd 4b fc 4c fc 4d fc 4e fc 4e fc 4d fc 4d fc 4d fc 4c fc 4c fc 4c fd 4b fd 4b fd 4b fd 4a fd 4a fd 4a fd 49 fd 49 fd 48 fd 48 ff 47 ff 47 ff 47 ff 46 ff 46 ff 45 00 45 00 44 00 44 00 43 00 43 01 43 01 42 01 42 01 43 01 43 01 43 01 43 01 44 01 44 01 44 01 44 01 45 01 45 01 45 01 45 01 46 01 46 01 47 01 48 03 49 03 4a 03 4b 03 4c 03 4d 03 4e 03 4f 03 50 03 51 03 52 03 53 03 54 03 55 03 55 03 56
			39 01 00 00 00 00 91 D4 03 56 03 56 03 57 03 57 03 57 03 58 03 58 03 58 03 59 03 59 03 59 03 59 03 59 03 59 03 58 03 57 03 57 03 56 02 55 01 54 01 54 01 53 01 52 01 51 01 51 01 50 00 4f 00 4f 00 4e 00 4e 00 4e 00 4d 00 4d 00 4d 00 4c 00 4c 00 4c 00 4b 00 4b 00 4b 00 4a 00 4a 00 4a 00 49 00 49 00 49 00 49 00 48 ff 48 ff 48 ff 48 ff 48 ff 47 ff 47 ff 47 ff 47 ff 47 ff 47 ff 48 ff 49 ff 4a ff 4b ff 4c ff 4e ff 4f ff 50 ff 51 ff 52 ff 53 ff 54 ff 56 fe 57
			39 00 00 00 00 00 02 00 00
			39 01 00 00 00 00 91 D5 00 54 00 53 00 52 00 52 00 51 00 50 00 50 ff 4f ff 4f ff 4e ff 4d ff 4d ff 4c ff 4b ff 4b ff 4a ff 4a ff 4a ff 49 ff 49 ff 49 ff 49 ff 48 ff 48 ff 48 ff 48 ff 47 00 47 00 47 00 47 00 46 ff 47 ff 47 ff 47 ff 48 ff 48 ff 49 fd 49 fd 49 fd 4a fd 4a fd 4a fd 4b fc 4b fc 4b fc 4b fc 4b fc 4b fc 4a fc 4a fc 4a fc 4a fc 49 fd 49 fd 49 fd 48 fd 48 fd 48 fe 48 fe 47 fe 47 fe 47 fe 46 ff 46 ff 46 ff 46 ff 45 ff 45 00 45 00 45 00 44 00 44
			39 01 00 00 00 00 91 D5 00 44 01 44 01 43 01 43 01 43 01 42 01 42 01 42 01 41 01 41 01 41 01 40 01 40 01 40 01 3f 01 3f 01 3f 01 3e 01 3e 01 3f 01 40 01 42 01 43 01 44 02 45 02 46 02 47 03 48 03 49 03 4a 03 4b 03 4c 03 4d 03 4e 03 4f 03 4f 03 4f 03 50 03 50 03 51 03 51 03 52 03 52 03 52 03 53 03 53 03 54 03 54 03 54 03 53 03 53 03 52 03 51 03 50 03 50 03 4f 03 4e 03 4d 03 4d 03 4c 03 4b 03 4a 03 49 03 49 03 48 02 47 01 47 01 46 01 45 01 44 00 44 00 43
			39 01 00 00 00 00 91 D5 00 42 00 41 ff 41 ff 40 ff 3f ff 3e ff 3e fe 3e fe 3f fe 3f fe 40 fe 40 fe 41 fe 41 fe 42 fe 42 fe 43 fe 43 fe 44 fe 44 fe 45 fd 45 fe 46 fe 47 fd 48 fd 49 ff 4a ff 4b ff 4c ff 4d ff 4e ff 4f ff 50 00 51 00 52 00 53 fe 5f fe 5e fe 5d fe 5c 00 5b 00 5b 00 5a 00 59 00 58 00 58 00 57 01 56 01 55 01 55 01 54 01 53 01 52 01 51 01 51 01 50 00 4f 00 4e 00 4d 00 4d 00 4c 00 4b 00 4a 00 49 ff 48 ff 48 ff 47 ff 48 ff 49 ff 49 ff 4a fe 4b
			39 01 00 00 00 00 91 D5 fd 4c fd 4c fd 4d fd 4e fd 4e fd 4f fc 50 fc 51 fc 51 fc 52 fc 52 fc 53 fc 53 fc 53 fc 54 fd 54 fd 54 fd 55 fd 55 fd 55 fd 56 fd 56 fd 56 fd 57 fe 57 ff 55 ff 54 ff 53 ff 52 00 51 00 4f 00 4e 00 4d 01 4c 01 4a 01 49 01 48 02 47 02 45 02 45 02 45 02 46 02 47 03 48 03 48 03 49 02 4a 01 4b 01 4c 01 4c 01 4d 01 4e 01 4f 01 4f 01 50 01 51 01 51 01 52 01 53 01 53 01 54 03 55 03 55 03 56 03 57 03 57 03 58 03 58 03 59 03 5a 03 5b 03 5b
			39 01 00 00 00 00 91 D5 03 5c 03 5d 03 5e 03 5f 03 60 03 61 03 61 03 62 03 63 03 64 04 65 04 66 04 66 04 65 03 64 02 64 02 63 02 62 00 61 00 60 00 5f ff 5e fe 5e fe 5d fe 5c fe 5b fd 5a fd 59 fd 59 fd 58 fe 57 fe 57 fe 56 ff 55 ff 55 00 54 00 53 00 53 00 52 00 51 01 51 01 50 01 4f 01 4f 00 4f 00 4f 00 4f 00 4f ff 4f ff 4e ff 4e ff 4e ff 4e fd 4e fd 4e fd 4e fd 4d fd 4e fd 4f fd 50 fd 51 fd 52 fd 53 fd 55 fd 56 fd 57 fd 58 fe 59 fe 5a fe 5c fe 5d fe 5e
			23 01 00 00 00 00 02 55 00
			23 01 00 00 00 00 02 81 80
		];


		qcom,mdss-dsi-ce-off-command = [
			39 01 00 00 00 00 02 81 00
		];
		qcom,mdss-dsi-on-command-state = "dsi_lp_mode";
		qcom,mdss-dsi-off-command-state = "dsi_lp_mode";
		qcom,mdss-dsi-cabc-on-command-state = "dsi_hs_mode";
		qcom,mdss-dsi-cabc-off-command-state = "dsi_hs_mode";
		qcom,mdss-dsi-warm-command-state = "dsi_hs_mode";
		qcom,mdss-dsi-cold-command-state = "dsi_hs_mode";
		qcom,mdss-dsi-default-command-state = "dsi_hs_mode";
		qcom,mdss-dsi-level1-command-state = "dsi_hs_mode";
		qcom,mdss-dsi-level2-command-state = "dsi_hs_mode";
		qcom,mdss-dsi-level3-command-state = "dsi_hs_mode";
		qcom,mdss-dsi-level4-command-state = "dsi_hs_mode";
		qcom,mdss-dsi-level5-command-state = "dsi_hs_mode";
		qcom,mdss-dsi-level6-command-state = "dsi_hs_mode";
		qcom,mdss-dsi-level7-command-state = "dsi_hs_mode";
		qcom,mdss-dsi-level8-command-state = "dsi_hs_mode";
		qcom,mdss-dsi-ce-on-command-state = "dsi_lp_mode";
		qcom,mdss-dsi-ce-off-command-state = "dsi_lp_mode";
		qcom,mdss-dsi-h-sync-pulse = <1>;
		qcom,mdss-dsi-traffic-mode = "burst_mode";
		qcom,mdss-dsi-lane-map = "lane_map_0123";
		qcom,mdss-dsi-bllp-eof-power-mode;
		qcom,mdss-dsi-bllp-power-mode;
		qcom,cont-splash-enabled;
			qcom,mdss-dsi-lane-0-state;
		qcom,mdss-dsi-lane-1-state;
		qcom,mdss-dsi-lane-2-state;
		qcom,mdss-dsi-lane-3-state;
		qcom,mdss-dsi-panel-timings = [6e 18 10 00 38 3e 12 25 1a 03 04 00];
		qcom,mdss-dsi-t-clk-post = <0x05>;
		qcom,mdss-dsi-t-clk-pre = <0x25>;
		qcom,mdss-dsi-dma-trigger = "trigger_sw";
		qcom,mdss-dsi-mdp-trigger = "none";
		qcom,mdss-dsi-bl-pmic-control-type = "bl_ctrl_dcs";
		qcom,mdss-dsi-bl-min-level = <1>;
		qcom,mdss-dsi-bl-max-level = <255>;
		qcom,mdss-pan-physical-width-dimension = <68>;
		qcom,mdss-pan-physical-height-dimension = <121>;
		qcom,mdss-dsi-reset-sequence = <1 10>, <0 1>, <1 20>;
		qcom,mdss-dsi-tx-eot-append;
		qcom,esd-check-enabled;
		qcom,mdss-dsi-panel-status-command = [06 01 00 01 05 00 01 ac
				06 01 00 01 05 00 01 1d];
		qcom,mdss-dsi-panel-status-command-state = "dsi_lp_mode";
		qcom,mdss-dsi-panel-status-check-mode = "reg_read";
		qcom,mdss-dsi-panel-status-read-length = <1 1>;
		qcom,mdss-dsi-panel-max-error-count = <3>;
		qcom,mdss-dsi-panel-status-value = <0x00 0x05>;
	};
};

