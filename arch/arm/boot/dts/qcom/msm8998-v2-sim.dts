/* Copyright (c) 2016, The Linux Foundation. All rights reserved.
 *
 * This program is free software; you can redistribute it and/or modify
 * it under the terms of the GNU General Public License version 2 and
 * only version 2 as published by the Free Software Foundation.
 *
 * This program is distributed in the hope that it will be useful,
 * but WITHOUT ANY WARRANTY; without even the implied warranty of
 * MERCHANTABILITY or FITNESS FOR A PARTICULAR PURPOSE.  See the
 * GNU General Public License for more details.
 */


/dts-v1/;
/memreserve/ 0x90000000 0x00000100;

#include "msm8998-v2.dtsi"
#include "msm8998-sim.dtsi"

/ {
	model = "Qualcomm Technologies, Inc. MSM 8998 V2 SIM";
	compatible = "qcom,msm8998-sim", "qcom,msm8998", "qcom,sim";
	qcom,board-id = <16 0>;
};

&gfx_stub_vreg {
	regulator-max-microvolt = <8>;
	status = "okay";
};
