/*
 * Copyright (c) 2015, The Linux Foundation. All rights reserved.
 *
 * This program is free software; you can redistribute it and/or modify
 * it under the terms of the GNU General Public License version 2 and
 * only version 2 as published by the Free Software Foundation.
 *
 * This program is distributed in the hope that it will be useful,
 * but WITHOUT ANY WARRANTY; without even the implied warranty of
 * MERCHANTABILITY or FITNESS FOR A PARTICULAR PURPOSE.  See the
 * GNU General Public License for more details.
 */

/*---------------------------------------------------------------------------
 * This file is autogenerated file using gcdb parser. Please do not edit it.
 * Update input XML file to add a new entry or update variable in this file
 * VERSION = "1.0"
 *---------------------------------------------------------------------------*/
&mdss_mdp {
	dsi_hx8394f_720p_video: qcom,mdss_dsi_hx8394f_720p_video {
		qcom,mdss-dsi-panel-name = "hx8394f 720p video mode dsi panel";
		qcom,mdss-dsi-panel-controller = <&mdss_dsi0>;
		qcom,mdss-dsi-panel-type = "dsi_video_mode";
		qcom,mdss-dsi-panel-destination = "display_1";
		qcom,mdss-dsi-panel-framerate = <60>;
		qcom,mdss-dsi-virtual-channel-id = <0>;
		qcom,mdss-dsi-stream = <0>;
		qcom,mdss-dsi-panel-width = <720>;
		qcom,mdss-dsi-panel-height = <1280>;
		qcom,mdss-dsi-h-front-porch = <16>;
		qcom,mdss-dsi-h-back-porch = <16>;
		qcom,mdss-dsi-h-pulse-width = <10>;
		qcom,mdss-dsi-h-sync-skew = <0>;
		qcom,mdss-dsi-v-back-porch = <12>;
		qcom,mdss-dsi-v-front-porch = <15>;
		qcom,mdss-dsi-v-pulse-width = <4>;
		qcom,mdss-dsi-h-left-border = <0>;
		qcom,mdss-dsi-h-right-border = <0>;
		qcom,mdss-dsi-v-top-border = <0>;
		qcom,mdss-dsi-v-bottom-border = <0>;
		qcom,mdss-dsi-bpp = <24>;
		qcom,mdss-dsi-underflow-color = <0xff>;
		qcom,mdss-dsi-border-color = <0>;
		qcom,mdss-dsi-on-command = [29 01 00 00 00 00 04 B9 FF 83 94
				29 01 00 00 00 00 07
					BA 63 03 68 6b b2 c0
				29 01 00 00 00 00 0B
					B1 50 12 72 09 32 34 71 31 70 2f
				29 01 00 00 00 00 07
					B2 00 80 64 0E 0D 2F
				29 01 00 00 00 00 16
					B4 6C 6D 6C 6D 6C 6D 01 01 FF 75
					00 3f 6C 6D 6C 6D 6C 6D 01 01 FF
				29 01 00 00 00 00 22
					D3 00 00 07 07 40 07 10 00 08 10
					08 00 08 54 15 0E 05 0E 02 15 06
					05 06 47 44 0A 0A 4B 10 07 07 0e
					40
				29 01 00 00 00 00 2d
					D5 1A 1A 1B 1B 00 01 02 03 04 05
					06 07 08 09 0A 0B 24 25 18 18 26
					27 18 18 18 18 18 18 18 18 18 18
					18 18 18 18 18 18 20 21 18 18 18
					18
				29 01 00 00 00 00 2d
					D6 1A 1A 1B 1B 0B 0A 09 08 07 06
					05 04 03 02 01 00 21 20 18 18 27
					26 18 18 18 18 18 18 18 18 18 18
					18 18 18 18 18 18 25 24 18 18 18
					18
				29 01 00 00 00 00 3B
					E0 00 0C 19 20 23 26 29 28 51 61
					70 6F 76 86 89 8D 99 9A 95 A1 B0
					57 55 58 5C 5e 64 6b 7f 00 0C 19
					20 23 26 29 28 51 61 70 6F 76 86
					89 8D 99 9A 95 A1 B0 57 55 58 5C
					5e 64 6b 7f
				29 01 00 00 00 00 03 C0 1f 73
				29 01 00 00 00 00 02 CC 0B
				29 01 00 00 00 00 02 d4 02
				29 01 00 00 00 00 03 B6 7E 7E
				05 01 00 00 96 00 02 11 00
				05 01 00 00 0a 00 02 29 00];
		qcom,mdss-dsi-off-command = [05 01 00 00 78 00 02 28 00
				05 01 00 00 96 00 02 10 00];
		qcom,mdss-dsi-on-command-state = "dsi_lp_mode";
		qcom,mdss-dsi-off-command-state = "dsi_hs_mode";
		qcom,mdss-dsi-h-sync-pulse = <1>;
		qcom,mdss-dsi-traffic-mode = "burst_mode";
		qcom,mdss-dsi-lane-map = "lane_map_0123";
		qcom,mdss-dsi-bllp-eof-power-mode;
		qcom,mdss-dsi-bllp-power-mode;
		qcom,mdss-dsi-lane-0-state;
		qcom,mdss-dsi-lane-1-state;
		qcom,mdss-dsi-lane-2-state;
		qcom,mdss-dsi-lane-3-state;
		qcom,mdss-dsi-panel-timings
			= [72 16 0e 00 38 3c 12 1a 10 03 04 00];
		qcom,mdss-dsi-t-clk-post = <0x04>;
		qcom,mdss-dsi-t-clk-pre = <0x18>;
		qcom,mdss-dsi-bl-min-level = <1>;
		qcom,mdss-dsi-bl-max-level = <4095>;
		qcom,mdss-dsi-dma-trigger = "trigger_sw";
		qcom,mdss-dsi-mdp-trigger = "none";
		qcom,mdss-dsi-bl-pmic-control-type = "bl_ctrl_wled";
		qcom,mdss-dsi-reset-sequence = <1 20>, <0 2>, <1 20>;
	};
};
