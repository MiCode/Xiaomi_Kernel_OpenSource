/* Copyright (c) 2017, The Linux Foundation. All rights reserved.
 *
 * This program is free software; you can redistribute it and/or modify
 * it under the terms of the GNU General Public License version 2 and
 * only version 2 as published by the Free Software Foundation.
 *
 * This program is distributed in the hope that it will be useful,
 * but WITHOUT ANY WARRANTY; without even the implied warranty of
 * MERCHANTABILITY or FITNESS FOR A PARTICULAR PURPOSE.  See the
 * GNU General Public License for more details.
 */

/dts-v1/;

#include "sdxhedgehog-cdp.dtsi"

/ {
	model = "Qualcomm Technologies, Inc. SDX HEDGEHOG CDP - DWIFI";
	compatible = "qcom,sdxhedgehog-cdp", "qcom,sdxhedgehog",
		     "qcom,cdp";
	qcom,board-id = <1 0x2>, <1 0x102>;
};

&qnand_1 {
	status = "ok";
};

&smb1351_otg_supply {
	status = "disabled";
};
