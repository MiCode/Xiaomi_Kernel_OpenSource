/* Copyright (c) 2015, 2018, The Linux Foundation. All rights reserved.
 *
 * This program is free software; you can redistribute it and/or modify
 * it under the terms of the GNU General Public License version 2 and
 * only version 2 as published by the Free Software Foundation.
 *
 * This program is distributed in the hope that it will be useful,
 * but WITHOUT ANY WARRANTY; without even the implied warranty of
 * MERCHANTABILITY or FITNESS FOR A PARTICULAR PURPOSE.  See the
 * GNU General Public License for more details.
 */


/dts-v1/;

#include "apq8096-v2.dtsi"
#include "apq8096-auto-dragonboard.dtsi"

/ {
	model = "Qualcomm Technologies, Inc. APQ8096v2.1 + PMI8994 DragonBoard";
	compatible = "qcom,apq8096-dragonboard", "qcom,msm8996",
			"qcom,apq8096", "qcom,dragonboard";
	qcom,msm-id = <246 0x20001>, <291 0x20001>;
	qcom,board-id = <10 1>;
};

&spi_9 {
	status = "ok";
	can-controller@0 {
		compatible = "qcom,renesas,rh850";
		reg = <0>;
		interrupt-parent = <&tlmm>;
		interrupts = <127 2>;
		spi-max-frequency = <5000000>;
		qcom,clk-freq-mhz = <16000000>;
		qcom,max-can-channels = <4>;
		qcom,bits-per-word = <8>;
		qcom,support-can-fd;
	};
};
