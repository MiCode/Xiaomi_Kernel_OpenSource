/* Copyright (c) 2015, The Linux Foundation. All rights reserved.
 * Copyright (C) 2018 XiaoMi, Inc.
 *
 * This program is free software; you can redistribute it and/or modify
 * it under the terms of the GNU General Public License version 2 and
 * only version 2 as published by the Free Software Foundation.
 *
 * This program is distributed in the hope that it will be useful,
 * but WITHOUT ANY WARRANTY; without even the implied warranty of
 * MERCHANTABILITY or FITNESS FOR A PARTICULAR PURPOSE.  See the
 * GNU General Public License for more details.
 */

 /*---------------------------------------------------------------------------
 * This file is autogenerated file using gcdb parser. Please do not edit it.
 * Update input XML file to add a new entry or update variable in this file
 * VERSION = "1.0"
 *---------------------------------------------------------------------------*/
&mdss_mdp {
	dsi_sharp_rsp61322_1080_vid: qcom,mdss_dsi_sharp_rsp61322_1080p_video {
		qcom,mdss-dsi-panel-name = "sharp rsp61322 1080p video mode dsi panel";
		qcom,mdss-dsi-panel-id = <8>;
		qcom,mdss-dsi-panel-controller = <&mdss_dsi0>;
		qcom,mdss-dsi-panel-type = "dsi_video_mode";
		qcom,mdss-dsi-panel-destination = "display_1";
		qcom,mdss-dsi-panel-framerate = <60>;
		qcom,mdss-dsi-virtual-channel-id = <0>;
		qcom,mdss-dsi-stream = <0>;
		qcom,mdss-dsi-panel-width = <1080>;
		qcom,mdss-dsi-panel-height = <1920>;
		qcom,mdss-dsi-h-front-porch = <72>;
		qcom,mdss-dsi-h-back-porch = <50>;
		qcom,mdss-dsi-h-pulse-width = <10>;
		qcom,mdss-dsi-h-sync-skew = <0>;
		qcom,mdss-dsi-v-back-porch = <5>;
		qcom,mdss-dsi-v-front-porch = <7>;
		qcom,mdss-dsi-v-pulse-width = <2>;
		qcom,mdss-dsi-h-left-border = <0>;
		qcom,mdss-dsi-h-right-border = <0>;
		qcom,mdss-dsi-v-top-border = <0>;
		qcom,mdss-dsi-v-bottom-border = <0>;
		qcom,mdss-dsi-bpp = <24>;
		qcom,mdss-dsi-underflow-color = <0xff>;
		qcom,mdss-dsi-border-color = <0>;
		qcom,mdss-dsi-pixel-packing = "tight";
		qcom,mdss-dsi-pan-enable-dynamic-fps;
		qcom,mdss-dsi-pan-fps-update = "dfps_immediate_porch_mode_vfp";
		qcom,mdss-dsi-min-refresh-rate = <55>;
		qcom,mdss-dsi-max-refresh-rate = <60>;
		qcom,mdss-dsi-on-command = [
				23 00 00 00 00 00 02 b0 00
				23 00 00 00 00 00 02 d6 01
				29 01 00 00 00 00 19 CE 3D 40 48 56 67 78 88 98 A7 B5 C3 D1 DE E9 F2 FA FF 01 5F 04 04 00 00 00
				29 00 00 00 00 00 1F C7 0B 18 20 2B 3A 48 51 60 45 4D 58 65 71 73 74 09 16 1E 29 38 48 51 60 45 4D 58 65 71 75 76
				29 01 00 00 00 00 14 c8 01 00 09 02 FD CF 00 00 05 FE 02 FC 00 00 0C FE F4 E8 00
				29 00 00 00 00 00 04 c3 01 00 0A
				29 00 00 00 00 00 06 EC 04 10 32 00 00
				23 00 00 00 00 00 02 b0 03

				15 00 00 00 00 00 02 34 00
				39 00 00 00 00 00 02 51 FF
				15 00 00 00 00 00 02 53 24
				15 00 00 00 00 00 02 55 01
				05 01 00 00 14 00 02 29 00
				05 01 00 00 32 00 02 11 00 ];

		qcom,mdss-dsi-off-command = [
				05 01 00 00 1D 00 02 28 00
				05 01 00 00 78 00 02 10 00
				];
		qcom,mdss-dsi-on-command-state = "dsi_lp_mode";
		qcom,mdss-dsi-off-command-state = "dsi_hs_mode";
		qcom,mdss-dsi-h-sync-pulse = <0>;
		//qcom,mdss-dsi-traffic-mode = "non_burst_sync_pulse";
		qcom,mdss-dsi-traffic-mode = "burst_mode";
		qcom,mdss-dsi-bllp-eof-power-mode;
		qcom,mdss-dsi-bllp-power-mode;
		qcom,mdss-dsi-lane-0-state;
		qcom,mdss-dsi-lane-1-state;
		qcom,mdss-dsi-lane-2-state;
		qcom,mdss-dsi-lane-3-state;
		qcom,mdss-dsi-lp11-init;
		qcom,mdss-dsi-panel-timings = [E1 4B 37 00 A9 AB 2A 4F 3D 03 04 00];//843.84M
		qcom,mdss-dsi-t-clk-post = <0x19>;
		qcom,mdss-dsi-t-clk-pre = <0x2f>;
		qcom,mdss-dsi-bl-min-level = <1>;
		qcom,mdss-dsi-bl-max-level = <4095>;
		qcom,mdss-brightness-max-level = <4095>;
		qcom,mdss-dsi-dma-trigger = "trigger_sw";
		qcom,mdss-dsi-mdp-trigger = "none";
		qcom,mdss-dsi-bl-pmic-control-type = "bl_ctrl_wled";
		qcom,mdss-dsi-reset-sequence = <1 5>, <0 10>, <1 10>;
		qcom,mdss-pan-physical-width-dimension = <61>;
		qcom,mdss-pan-physical-height-dimension = <109>;
		qcom,cont-splash-enabled;
		qcom,dispparam-enabled;
		qcom,mdss-dsi-dispparam-warm-command = [
				29 01 00 00 32 00 02 b0 00
				29 00 00 00 00 00 02 b0 00
				29 00 00 00 00 00 1F C7 0C 19 21 2C 3B 48 51 60 45 4D 58 65 71 72 73 08 15 1D 28 37 48 51 60 45 4D 58 65 71 76 77
				29 00 00 00 00 00 14 c8 01 00 0B 02 FE EC 00 00 05 FD 02 FC 00 00 0D 00 F7 BB 00
				29 00 00 00 00 00 02 d6 01
				29 01 00 00 05 00 02 b0 03
				];
		qcom,mdss-dsi-dispparam-warm-command-state = "dsi_hs_mode";

		qcom,mdss-dsi-dispparam-default-command = [
				29 01 00 00 32 00 02 b0 00
				29 00 00 00 00 00 02 b0 00
				29 00 00 00 00 00 1F C7 0B 18 20 2B 3A 48 51 60 45 4D 58 65 71 73 74 09 16 1E 29 38 48 51 60 45 4D 58 65 71 75 76
				29 00 00 00 00 00 14 c8 01 00 09 02 FD CF 00 00 05 FE 02 FC 00 00 0C FE F4 E8 00
				29 00 00 00 00 00 02 d6 01
				29 01 00 00 05 00 02 b0 03
				];
		qcom,mdss-dsi-dispparam-default-command-state = "dsi_hs_mode";

		qcom,mdss-dsi-dispparam-cold-command = [
				29 01 00 00 32 00 02 b0 00
				29 00 00 00 00 00 02 b0 00
				29 00 00 00 00 00 1F C7 0C 19 22 2D 3D 49 53 63 48 50 5C 6B 72 73 74 08 15 1E 29 39 49 53 63 48 50 5C 6B 74 75 76
				29 00 00 00 00 00 14 c8 01 11 F7 05 F6 A1 00 11 F3 00 F8 E7 00 11 FA FE EC FC 00
				29 00 00 00 00 00 02 d6 01
				29 01 00 00 05 00 02 b0 03
				];
		qcom,mdss-dsi-dispparam-cold-command-state = "dsi_hs_mode";

		qcom,mdss-dsi-dispparam-cabcon-command = [
				39 01 00 00 32 00 02 55 01
				39 00 00 00 01 00 02 55 01
				15 01 00 00 01 00 02 53 2C
			];
		qcom,mdss-dsi-dispparam-cabcon-command-state = "dsi_hs_mode";
		qcom,mdss-dsi-dispparam-cabcguion-command = [
				39 01 00 00 32 00 02 55 01
				39 00 00 00 01 00 02 55 01
				15 01 00 00 01 00 02 53 2C
			];
		qcom,mdss-dsi-dispparam-cabcguion-command-state = "dsi_hs_mode";
		qcom,mdss-dsi-dispparam-cabcstillon-command = [
				39 01 00 00 32 00 02 55 02
				39 00 00 00 01 00 02 55 02
				15 01 00 00 01 00 02 53 2C
			];
		qcom,mdss-dsi-dispparam-cabcstillon-command-state = "dsi_hs_mode";
		qcom,mdss-dsi-dispparam-cabcmovieon-command = [
				15 01 00 00 32 00 02 55 03
				15 00 00 00 01 00 02 55 03
				15 01 00 00 01 00 02 53 2C
			];
		qcom,mdss-dsi-dispparam-cabcmovieon-command-state = "dsi_hs_mode";
		qcom,mdss-dsi-dispparam-cabcoff-command = [
				39 01 00 00 32 00 02 55 00
				39 00 00 00 01 00 02 55 00
				15 01 00 00 01 00 02 53 2C
			];
		qcom,mdss-dsi-dispparam-cabcoff-command-state = "dsi_hs_mode";
		qcom,mdss-dsi-dispparam-nightmode1-command = [//L216
				29 01 00 00 00 00 02 b0 00
				29 01 00 00 00 00 1F C7 3E 41 42 45 4C 54 5A 65 49 50 5B 66 6D 71 75 3E 41 42 45 4C 54 5A 65 49 50 5B 66 6D 71 75
				29 01 00 00 00 00 14 c8 01 00 06 03 01 DB 00 00 01 FF 03 FA 00 06 03 03 FD A7 0F
				29 01 00 00 00 00 02 d6 01
				29 01 00 00 05 00 02 b0 03
			];
		qcom,mdss-dsi-dispparam-nightmode1-command-state = "dsi_hs_mode";
		qcom,mdss-dsi-dispparam-nightmode2-command = [//L178
				29 01 00 00 00 00 02 b0 00
				29 01 00 00 00 00 1F C7 51 52 53 55 58 5D 61 6B 4D 54 5E 68 6E 72 74 51 52 53 55 58 5D 61 6B 4D 54 5E 68 6E 72 74
				29 01 00 00 00 00 14 c8 01 00 03 05 FD E3 00 01 FB 01 FD FC F0 00 FC 07 F8 B2 00
				29 01 00 00 00 00 02 d6 01
				29 01 00 00 05 00 02 b0 03
			];
		qcom,mdss-dsi-dispparam-nightmode2-command-state = "dsi_hs_mode";
		qcom,mdss-dsi-dispparam-nightmode3-command = [//L140
				29 01 00 00 00 00 02 b0 00
				29 01 00 00 00 00 1F C7 5C 5D 5E 5F 61 64 68 71 52 58 62 6A 6F 71 72 5C 5D 5E 5F 61 64 68 71 52 58 62 6A 6F 71 72
				29 01 00 00 00 00 14 c8 01 00 11 0D FB EC 0E 00 FD 03 09 F7 EF 00 FF 0C FA BC 02
				29 01 00 00 00 00 02 d6 01
				29 01 00 00 05 00 02 b0 03
			];
		qcom,mdss-dsi-dispparam-nightmode3-command-state = "dsi_hs_mode";
		qcom,mdss-dsi-dispparam-nightmode4-command = [//L102
				29 01 00 00 00 00 02 b0 00
				29 01 00 00 00 00 1F C7 67 68 69 6A 6B 6E 71 78 58 5E 66 6D 71 73 74 67 68 69 6A 6B 6E 71 78 58 5E 66 6D 71 73 74
				29 01 00 00 00 00 14 c8 01 00 0B 06 19 F2 0F 03 FC 00 24 F6 CF 03 F1 FD 11 D7 0B
				29 01 00 00 00 00 02 d6 01
				29 01 00 00 05 00 02 b0 03
			];
		qcom,mdss-dsi-dispparam-nightmode4-command-state = "dsi_hs_mode";
		qcom,mdss-dsi-dispparam-nightmode5-command = [//L64
				29 01 00 00 00 00 02 b0 00
				29 01 00 00 00 00 1F C7 72 73 74 75 76 78 7A 7F 5F 65 6B 71 73 74 75 72 73 74 75 76 78 7A 7F 5F 65 6B 71 73 74 75
				29 01 00 00 00 00 14 c8 01 11 0D F4 2B F8 B1 07 15 F0 34 F7 A2 26 E7 E7 1F EA 99
				29 01 00 00 00 00 02 d6 01
				29 01 00 00 05 00 02 b0 03
			];
		qcom,mdss-dsi-dispparam-nightmode5-command-state = "dsi_hs_mode";

		qcom,mdss-dsi-dispparam-papermode-command = [
				29 01 00 00 32 00 02 b0 00
				29 00 00 00 00 00 02 b0 00
				29 00 00 00 00 00 1F C7 0A 17 1F 2A 39 47 51 60 45 4D 58 63 6D 72 75 0A 17 1F 2A 39 47 51 60 45 4D 58 63 6D 72 75
				29 00 00 00 00 00 14 c8 01 00 0C 03 04 CF 00 00 05 FE 02 FC 00 00 03 05 FE 09 20
				29 00 00 00 00 00 02 d6 01
				29 01 00 00 05 00 02 b0 03
			];
		qcom,mdss-dsi-dispparam-papermode-state = "dsi_hs_mode";
		qcom,mdss-dsi-dispparam-papermode1-command = [
				29 01 00 00 32 00 02 b0 00
				29 00 00 00 00 00 02 b0 00
				29 00 00 00 00 00 1F C7 0A 17 1F 2A 38 47 51 60 45 4D 58 64 6F 73 75 0A 17 1F 2A 38 47 51 60 45 4D 58 64 6F 73 75
				29 00 00 00 00 00 14 c8 01 00 0A 02 00 D4 E1 00 05 FE 04 FC E0 00 0C 01 FE B0 E0
				29 00 00 00 00 00 02 d6 01
				29 01 00 00 05 00 02 b0 03
			];
		qcom,mdss-dsi-dispparam-papermode1-state = "dsi_hs_mode";
		qcom,mdss-dsi-dispparam-papermode2-command = [
				29 01 00 00 32 00 02 b0 00
				29 00 00 00 00 00 02 b0 00
				29 00 00 00 00 00 1F C7 0A 17 1F 2A 38 47 51 60 45 4D 58 64 6F 73 75 0A 17 1F 2A 38 47 51 60 45 4D 58 64 6F 73 75
				29 00 00 00 00 00 14 c8 01 00 0A 02 00 D4 E1 00 05 FE 04 FC E0 00 0C 01 FE B0 E0
				29 00 00 00 00 00 02 d6 01
				29 01 00 00 05 00 02 b0 03
			];
		qcom,mdss-dsi-dispparam-papermode2-state = "dsi_hs_mode";
		qcom,mdss-dsi-dispparam-papermode3-command = [
				29 01 00 00 32 00 02 b0 00
				29 00 00 00 00 00 02 b0 00
				29 00 00 00 00 00 1F C7 0A 17 1F 2A 39 48 51 60 44 4D 58 64 6F 73 75 0A 17 1F 2A 39 48 51 60 44 4D 58 64 6F 73 75
				29 00 00 00 00 00 14 c8 01 00 0C 02 05 CE F0 00 05 FE 02 FC 00 00 0C 00 FC 7B 10
				29 00 00 00 00 00 02 d6 01
				29 01 00 00 05 00 02 b0 03
			];
		qcom,mdss-dsi-dispparam-papermode3-state = "dsi_hs_mode";
		qcom,mdss-dsi-dispparam-papermode4-command = [
				29 01 00 00 32 00 02 b0 00
				29 00 00 00 00 00 02 b0 00
				29 00 00 00 00 00 1F C7 0A 17 1F 2A 39 48 51 60 44 4D 58 64 6F 73 75 0A 17 1F 2A 39 48 51 60 44 4D 58 64 6F 73 75
				29 00 00 00 00 00 14 c8 01 00 0C 02 05 CE F0 00 05 FE 02 FC 00 00 0C 00 FC 7B 10
				29 00 00 00 00 00 02 d6 01
				29 01 00 00 05 00 02 b0 03
			];
		qcom,mdss-dsi-dispparam-papermode4-state = "dsi_hs_mode";
		qcom,mdss-dsi-dispparam-papermode5-command = [
				29 01 00 00 32 00 02 b0 00
				29 00 00 00 00 00 02 b0 00
				29 00 00 00 00 00 1F C7 0A 17 1F 2A 39 47 51 60 45 4D 58 64 6F 73 75 0A 17 1F 2A 39 47 51 60 45 4D 58 64 6F 73 75
				29 00 00 00 00 00 14 c8 01 00 0C 03 04 CD 00 00 05 FE 02 FC 00 00 06 04 F8 41 20
				29 00 00 00 00 00 02 d6 01
				29 01 00 00 05 00 02 b0 03
			];
		qcom,mdss-dsi-dispparam-papermode5-state = "dsi_hs_mode";
		qcom,mdss-dsi-dispparam-papermode6-command = [
				29 01 00 00 32 00 02 b0 00
				29 00 00 00 00 00 02 b0 00
				29 00 00 00 00 00 1F C7 0A 17 1F 2A 39 47 51 60 45 4D 58 64 6F 73 75 0A 17 1F 2A 39 47 51 60 45 4D 58 64 6F 73 75
				29 00 00 00 00 00 14 c8 01 00 0C 03 04 CD 00 00 05 FE 02 FC 00 00 06 04 F8 41 20
				29 00 00 00 00 00 02 d6 01
				29 01 00 00 05 00 02 b0 03
			];
		qcom,mdss-dsi-dispparam-papermode6-state = "dsi_hs_mode";
		qcom,mdss-dsi-dispparam-papermode7-command = [
				29 01 00 00 32 00 02 b0 00
				29 00 00 00 00 00 02 b0 00
				29 00 00 00 00 00 1F C7 0A 17 1F 2A 39 47 51 60 45 4D 58 63 6D 72 75 0A 17 1F 2A 39 47 51 60 45 4D 58 63 6D 72 75
				29 00 00 00 00 00 14 c8 01 00 0C 03 04 CF 00 00 05 FE 02 FC 00 00 03 05 FE 09 20
				29 00 00 00 00 00 02 d6 01
				29 01 00 00 05 00 02 b0 03
			];
		qcom,mdss-dsi-dispparam-papermode7-state = "dsi_hs_mode";
		};
	};

