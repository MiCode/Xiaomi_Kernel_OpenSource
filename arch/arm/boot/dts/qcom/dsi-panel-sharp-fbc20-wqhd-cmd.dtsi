/* Copyright (c) 2013-2014, The Linux Foundation. All rights reserved.
 * Copyright (C) 2018 XiaoMi, Inc.
 *
 * This program is free software; you can redistribute it and/or modify
 * it under the terms of the GNU General Public License version 2 and
 * only version 2 as published by the Free Software Foundation.
 *
 * This program is distributed in the hope that it will be useful,
 * but WITHOUT ANY WARRANTY; without even the implied warranty of
 * MERCHANTABILITY or FITNESS FOR A PARTICULAR PURPOSE.  See the
 * GNU General Public License for more details.
 */

/*---------------------------------------------------------------------------
 * This file is autogenerated file using gcdb parser. Please do not edit it.
 * Update input XML file to add a new entry or update variable in this file
 * VERSION = "1.0"
 *---------------------------------------------------------------------------*/
&mdss_mdp {
	dsi_sharp_fbc20_wqhd_cmd: qcom,mdss_dsi_sharp_fbc20_wqhd_command {
		qcom,mdss-dsi-panel-name = "sharp fbc20 wqhd cmd mode dsi panel";
		qcom,mdss-dsi-panel-id = <5>;
		qcom,mdss-dsi-panel-controller = <&mdss_dsi1>;
		qcom,mdss-dsi-panel-type = "dsi_cmd_mode";
		qcom,mdss-dsi-panel-destination = "display_2";
		qcom,mdss-dsi-panel-framerate = <60>;

		qcom,mdss-dsi-virtual-channel-id = <0>;
		qcom,mdss-dsi-stream = <0>;
		qcom,mdss-dsi-panel-width = <1440>;
		qcom,mdss-dsi-panel-height = <2560>;
		qcom,mdss-dsi-h-front-porch = <186>;
		qcom,mdss-dsi-h-back-porch = <180>;
		qcom,mdss-dsi-h-pulse-width = <12>;
		qcom,mdss-dsi-h-sync-skew = <0>;
		qcom,mdss-dsi-v-back-porch = <16>;
		qcom,mdss-dsi-v-front-porch = <17>;
		qcom,mdss-dsi-v-pulse-width = <2>;
		qcom,mdss-dsi-h-left-border = <0>;
		qcom,mdss-dsi-h-right-border = <0>;
		qcom,mdss-dsi-v-top-border = <0>;
		qcom,mdss-dsi-v-bottom-border = <0>;
		qcom,mdss-dsi-bpp = <24>;
		qcom,mdss-dsi-underflow-color = <0xff>;
		qcom,mdss-dsi-border-color = <0>;
		qcom,mdss-dsi-on-command = [
			15 00 00 00 00 00 02 ff 10
			15 00 00 00 00 00 02 fb 01
			15 00 00 00 00 00 02 ba 03
			15 00 00 00 00 00 02 e5 01
			15 00 00 00 00 00 02 35 00
			15 00 00 00 00 00 02 bb 10
			15 00 00 00 00 00 02 b0 03
			39 01 00 00 00 00 06 3b 03 08 08 64 9a

			15 00 00 00 00 00 02 ff e0
			15 00 00 00 00 00 02 fb 01
			15 00 00 00 00 00 02 6b 3d
			15 00 00 00 00 00 02 6c 3d
			15 00 00 00 00 00 02 6d 3d
			15 00 00 00 00 00 02 6e 3d
			15 00 00 00 00 00 02 6f 3d
			15 00 00 00 00 00 02 35 02
			15 00 00 00 00 00 02 36 52
			15 00 00 00 00 00 02 37 10
			15 01 00 00 00 00 02 08 c0

			15 00 00 00 00 00 02 ff 24
			15 00 00 00 00 00 02 ba 83
			15 00 00 00 00 00 02 7d 10
			15 00 00 00 00 00 02 fb 01
			15 00 00 00 00 00 02 ff d0
			15 00 00 00 00 00 02 fb 01
			15 00 00 00 00 00 02 3a a0

			15 01 00 00 01 00 02 FF 20
			15 00 00 00 01 00 02 75 00
			15 00 00 00 01 00 02 76 00
			15 00 00 00 01 00 02 77 00
			15 00 00 00 01 00 02 78 41
			15 00 00 00 01 00 02 79 00
			15 00 00 00 01 00 02 7A 80
			15 00 00 00 01 00 02 7B 00
			15 00 00 00 01 00 02 7C A7
			15 00 00 00 01 00 02 7D 00
			15 00 00 00 01 00 02 7E C6
			15 00 00 00 01 00 02 7F 00
			15 00 00 00 01 00 02 80 DD
			15 00 00 00 01 00 02 81 00
			15 00 00 00 01 00 02 82 F3
			15 00 00 00 01 00 02 83 01
			15 00 00 00 01 00 02 84 06
			15 00 00 00 01 00 02 85 01
			15 00 00 00 01 00 02 86 15
			15 00 00 00 01 00 02 87 01
			15 00 00 00 01 00 02 88 4B
			15 00 00 00 01 00 02 89 01
			15 00 00 00 01 00 02 8A 74
			15 00 00 00 01 00 02 8B 01
			15 00 00 00 01 00 02 8C B1
			15 00 00 00 01 00 02 8D 01
			15 00 00 00 01 00 02 8E E2
			15 00 00 00 01 00 02 8F 02
			15 00 00 00 01 00 02 90 28
			15 00 00 00 01 00 02 91 02
			15 00 00 00 01 00 02 92 5B
			15 00 00 00 01 00 02 93 02
			15 00 00 00 01 00 02 94 5C
			15 00 00 00 01 00 02 95 02
			15 00 00 00 01 00 02 96 8E
			15 00 00 00 01 00 02 97 02
			15 00 00 00 01 00 02 98 C8
			15 00 00 00 01 00 02 99 02
			15 00 00 00 01 00 02 9A EC
			15 00 00 00 01 00 02 9B 03
			15 00 00 00 01 00 02 9C 1B
			15 00 00 00 01 00 02 9D 03
			15 00 00 00 01 00 02 9E 39
			15 00 00 00 01 00 02 9F 03
			15 00 00 00 01 00 02 A0 5F
			15 00 00 00 01 00 02 A2 03
			15 00 00 00 01 00 02 A3 6B
			15 00 00 00 01 00 02 A4 03
			15 00 00 00 01 00 02 A5 78
			15 00 00 00 01 00 02 A6 03
			15 00 00 00 01 00 02 A7 86
			15 00 00 00 01 00 02 A9 03
			15 00 00 00 01 00 02 AA 95
			15 00 00 00 01 00 02 AB 03
			15 00 00 00 01 00 02 AC A8
			15 00 00 00 01 00 02 AD 03
			15 00 00 00 01 00 02 AE BA
			15 00 00 00 01 00 02 AF 03
			15 00 00 00 01 00 02 B0 CC
			15 00 00 00 01 00 02 B1 03
			15 00 00 00 01 00 02 B2 D0
			15 00 00 00 01 00 02 B3 00
			15 00 00 00 01 00 02 B4 4C
			15 00 00 00 01 00 02 B5 00
			15 00 00 00 01 00 02 B6 8D
			15 00 00 00 01 00 02 B7 00
			15 00 00 00 01 00 02 B8 CB
			15 00 00 00 01 00 02 B9 00
			15 00 00 00 01 00 02 BA F0
			15 00 00 00 01 00 02 BB 01
			15 00 00 00 01 00 02 BC 0D
			15 00 00 00 01 00 02 BD 01
			15 00 00 00 01 00 02 BE 24
			15 00 00 00 01 00 02 BF 01
			15 00 00 00 01 00 02 C0 38
			15 00 00 00 01 00 02 C1 01
			15 00 00 00 01 00 02 C2 49
			15 00 00 00 01 00 02 C3 01
			15 00 00 00 01 00 02 C4 58
			15 00 00 00 01 00 02 C5 01
			15 00 00 00 01 00 02 C6 88
			15 00 00 00 01 00 02 C7 01
			15 00 00 00 01 00 02 C8 AB
			15 00 00 00 01 00 02 C9 01
			15 00 00 00 01 00 02 CA DE
			15 00 00 00 01 00 02 CB 02
			15 00 00 00 01 00 02 CC 03
			15 00 00 00 01 00 02 CD 02
			15 00 00 00 01 00 02 CE 3B
			15 00 00 00 01 00 02 CF 02
			15 00 00 00 01 00 02 D0 6E
			15 00 00 00 01 00 02 D1 02
			15 00 00 00 01 00 02 D2 6F
			15 00 00 00 01 00 02 D3 02
			15 00 00 00 01 00 02 D4 A1
			15 00 00 00 01 00 02 D5 02
			15 00 00 00 01 00 02 D6 D7
			15 00 00 00 01 00 02 D7 02
			15 00 00 00 01 00 02 D8 F9
			15 00 00 00 01 00 02 D9 03
			15 00 00 00 01 00 02 DA 24
			15 00 00 00 01 00 02 DB 03
			15 00 00 00 01 00 02 DC 40
			15 00 00 00 01 00 02 DD 03
			15 00 00 00 01 00 02 DE 64
			15 00 00 00 01 00 02 DF 03
			15 00 00 00 01 00 02 E0 6F
			15 00 00 00 01 00 02 E1 03
			15 00 00 00 01 00 02 E2 7B
			15 00 00 00 01 00 02 E3 03
			15 00 00 00 01 00 02 E4 89
			15 00 00 00 01 00 02 E5 03
			15 00 00 00 01 00 02 E6 97
			15 00 00 00 01 00 02 E7 03
			15 00 00 00 01 00 02 E8 A9
			15 00 00 00 01 00 02 E9 03
			15 00 00 00 01 00 02 EA BB
			15 00 00 00 01 00 02 EB 03
			15 00 00 00 01 00 02 EC CD
			15 00 00 00 01 00 02 ED 03
			15 00 00 00 01 00 02 EE D0
			15 00 00 00 01 00 02 EF 00
			15 00 00 00 01 00 02 F0 00
			15 00 00 00 01 00 02 F1 00
			15 00 00 00 01 00 02 F2 41
			15 00 00 00 01 00 02 F3 00
			15 00 00 00 01 00 02 F4 80
			15 00 00 00 01 00 02 F5 00
			15 00 00 00 01 00 02 F6 A7
			15 00 00 00 01 00 02 F7 00
			15 00 00 00 01 00 02 F8 C6
			15 00 00 00 01 00 02 F9 00
			15 01 00 00 01 00 02 FA DD
			15 00 00 00 01 00 02 FF 21
			15 00 00 00 01 00 02 00 00
			15 00 00 00 01 00 02 01 F3
			15 00 00 00 01 00 02 02 01
			15 00 00 00 01 00 02 03 06
			15 00 00 00 01 00 02 04 01
			15 00 00 00 01 00 02 05 15
			15 00 00 00 01 00 02 06 01
			15 00 00 00 01 00 02 07 4B
			15 00 00 00 01 00 02 08 01
			15 00 00 00 01 00 02 09 74
			15 00 00 00 01 00 02 0A 01
			15 00 00 00 01 00 02 0B B1
			15 00 00 00 01 00 02 0C 01
			15 00 00 00 01 00 02 0D E2
			15 00 00 00 01 00 02 0E 02
			15 00 00 00 01 00 02 0F 28
			15 00 00 00 01 00 02 10 02
			15 00 00 00 01 00 02 11 5B
			15 00 00 00 01 00 02 12 02
			15 00 00 00 01 00 02 13 5C
			15 00 00 00 01 00 02 14 02
			15 00 00 00 01 00 02 15 8E
			15 00 00 00 01 00 02 16 02
			15 00 00 00 01 00 02 17 C8
			15 00 00 00 01 00 02 18 02
			15 00 00 00 01 00 02 19 EC
			15 00 00 00 01 00 02 1A 03
			15 00 00 00 01 00 02 1B 1B
			15 00 00 00 01 00 02 1C 03
			15 00 00 00 01 00 02 1D 39
			15 00 00 00 01 00 02 1E 03
			15 00 00 00 01 00 02 1F 5F
			15 00 00 00 01 00 02 20 03
			15 00 00 00 01 00 02 21 6B
			15 00 00 00 01 00 02 22 03
			15 00 00 00 01 00 02 23 78
			15 00 00 00 01 00 02 24 03
			15 00 00 00 01 00 02 25 86
			15 00 00 00 01 00 02 26 03
			15 00 00 00 01 00 02 27 95
			15 00 00 00 01 00 02 28 03
			15 00 00 00 01 00 02 29 A8
			15 00 00 00 01 00 02 2A 03
			15 00 00 00 01 00 02 2B BA
			15 00 00 00 01 00 02 2D 03
			15 00 00 00 01 00 02 2F CC
			15 00 00 00 01 00 02 30 03
			15 00 00 00 01 00 02 31 D0
			15 00 00 00 01 00 02 32 00
			15 00 00 00 01 00 02 33 4C
			15 00 00 00 01 00 02 34 00
			15 00 00 00 01 00 02 35 8D
			15 00 00 00 01 00 02 36 00
			15 00 00 00 01 00 02 37 CB
			15 00 00 00 01 00 02 38 00
			15 00 00 00 01 00 02 39 F0
			15 00 00 00 01 00 02 3A 01
			15 00 00 00 01 00 02 3B 0D
			15 00 00 00 01 00 02 3D 01
			15 00 00 00 01 00 02 3F 24
			15 00 00 00 01 00 02 40 01
			15 00 00 00 01 00 02 41 38
			15 00 00 00 01 00 02 42 01
			15 00 00 00 01 00 02 43 49
			15 00 00 00 01 00 02 44 01
			15 00 00 00 01 00 02 45 58
			15 00 00 00 01 00 02 46 01
			15 00 00 00 01 00 02 47 88
			15 00 00 00 01 00 02 48 01
			15 00 00 00 01 00 02 49 AB
			15 00 00 00 01 00 02 4A 01
			15 00 00 00 01 00 02 4B DE
			15 00 00 00 01 00 02 4C 02
			15 00 00 00 01 00 02 4D 03
			15 00 00 00 01 00 02 4E 02
			15 00 00 00 01 00 02 4F 3B
			15 00 00 00 01 00 02 50 02
			15 00 00 00 01 00 02 51 6E
			15 00 00 00 01 00 02 52 02
			15 00 00 00 01 00 02 53 6F
			15 00 00 00 01 00 02 54 02
			15 00 00 00 01 00 02 55 A1
			15 00 00 00 01 00 02 56 02
			15 00 00 00 01 00 02 58 D7
			15 00 00 00 01 00 02 59 02
			15 00 00 00 01 00 02 5A F9
			15 00 00 00 01 00 02 5B 03
			15 00 00 00 01 00 02 5C 24
			15 00 00 00 01 00 02 5D 03
			15 00 00 00 01 00 02 5E 40
			15 00 00 00 01 00 02 5F 03
			15 00 00 00 01 00 02 60 64
			15 00 00 00 01 00 02 61 03
			15 00 00 00 01 00 02 62 6F
			15 00 00 00 01 00 02 63 03
			15 00 00 00 01 00 02 64 7B
			15 00 00 00 01 00 02 65 03
			15 00 00 00 01 00 02 66 89
			15 00 00 00 01 00 02 67 03
			15 00 00 00 01 00 02 68 97
			15 00 00 00 01 00 02 69 03
			15 00 00 00 01 00 02 6A A9
			15 00 00 00 01 00 02 6B 03
			15 00 00 00 01 00 02 6C BB
			15 00 00 00 01 00 02 6D 03
			15 00 00 00 01 00 02 6E CD
			15 00 00 00 01 00 02 6F 03
			15 00 00 00 01 00 02 70 D0
			15 00 00 00 01 00 02 71 00
			15 00 00 00 01 00 02 72 00
			15 00 00 00 01 00 02 73 00
			15 00 00 00 01 00 02 74 56
			15 00 00 00 01 00 02 75 00
			15 00 00 00 01 00 02 76 94
			15 00 00 00 01 00 02 77 00
			15 00 00 00 01 00 02 78 BB
			15 00 00 00 01 00 02 79 00
			15 00 00 00 01 00 02 7A DA
			15 00 00 00 01 00 02 7B 00
			15 00 00 00 01 00 02 7C F1
			15 00 00 00 01 00 02 7D 01
			15 00 00 00 01 00 02 7E 07
			15 00 00 00 01 00 02 7F 01
			15 00 00 00 01 00 02 80 1A
			15 00 00 00 01 00 02 81 01
			15 00 00 00 01 00 02 82 29
			15 00 00 00 01 00 02 83 01
			15 00 00 00 01 00 02 84 5F
			15 00 00 00 01 00 02 85 01
			15 00 00 00 01 00 02 86 88
			15 00 00 00 01 00 02 87 01
			15 00 00 00 01 00 02 88 BF
			15 00 00 00 01 00 02 89 01
			15 00 00 00 01 00 02 8A EB
			15 00 00 00 01 00 02 8B 02
			15 00 00 00 01 00 02 8C 2F
			15 00 00 00 01 00 02 8D 02
			15 00 00 00 01 00 02 8E 60
			15 00 00 00 01 00 02 8F 02
			15 00 00 00 01 00 02 90 61
			15 00 00 00 01 00 02 91 02
			15 00 00 00 01 00 02 92 92
			15 00 00 00 01 00 02 93 02
			15 00 00 00 01 00 02 94 CC
			15 00 00 00 01 00 02 95 02
			15 00 00 00 01 00 02 96 EF
			15 00 00 00 01 00 02 97 03
			15 00 00 00 01 00 02 98 20
			15 00 00 00 01 00 02 99 03
			15 00 00 00 01 00 02 9A 39
			15 00 00 00 01 00 02 9B 03
			15 00 00 00 01 00 02 9C 5F
			15 00 00 00 01 00 02 9D 03
			15 00 00 00 01 00 02 9E 6B
			15 00 00 00 01 00 02 9F 03
			15 00 00 00 01 00 02 A0 78
			15 00 00 00 01 00 02 A2 03
			15 00 00 00 01 00 02 A3 86
			15 00 00 00 01 00 02 A4 03
			15 00 00 00 01 00 02 A5 95
			15 00 00 00 01 00 02 A6 03
			15 00 00 00 01 00 02 A7 A8
			15 00 00 00 01 00 02 A9 03
			15 00 00 00 01 00 02 AA BA
			15 00 00 00 01 00 02 AB 03
			15 00 00 00 01 00 02 AC CC
			15 00 00 00 01 00 02 AD 03
			15 00 00 00 01 00 02 AE D0
			15 00 00 00 01 00 02 AF 00
			15 00 00 00 01 00 02 B0 4C
			15 00 00 00 01 00 02 B1 00
			15 00 00 00 01 00 02 B2 A2
			15 00 00 00 01 00 02 B3 00
			15 00 00 00 01 00 02 B4 DF
			15 00 00 00 01 00 02 B5 01
			15 00 00 00 01 00 02 B6 04
			15 00 00 00 01 00 02 B7 01
			15 00 00 00 01 00 02 B8 21
			15 00 00 00 01 00 02 B9 01
			15 00 00 00 01 00 02 BA 38
			15 00 00 00 01 00 02 BB 01
			15 00 00 00 01 00 02 BC 4C
			15 00 00 00 01 00 02 BD 01
			15 00 00 00 01 00 02 BE 5D
			15 00 00 00 01 00 02 BF 01
			15 00 00 00 01 00 02 C0 6C
			15 00 00 00 01 00 02 C1 01
			15 00 00 00 01 00 02 C2 9C
			15 00 00 00 01 00 02 C3 01
			15 00 00 00 01 00 02 C4 BF
			15 00 00 00 01 00 02 C5 01
			15 00 00 00 01 00 02 C6 EC
			15 00 00 00 01 00 02 C7 02
			15 00 00 00 01 00 02 C8 0D
			15 00 00 00 01 00 02 C9 02
			15 00 00 00 01 00 02 CA 42
			15 00 00 00 01 00 02 CB 02
			15 00 00 00 01 00 02 CC 73
			15 00 00 00 01 00 02 CD 02
			15 00 00 00 01 00 02 CE 74
			15 00 00 00 01 00 02 CF 02
			15 00 00 00 01 00 02 D0 A5
			15 00 00 00 01 00 02 D1 02
			15 00 00 00 01 00 02 D2 DB
			15 00 00 00 01 00 02 D3 02
			15 00 00 00 01 00 02 D4 FC
			15 00 00 00 01 00 02 D5 03
			15 00 00 00 01 00 02 D6 29
			15 00 00 00 01 00 02 D7 03
			15 00 00 00 01 00 02 D8 40
			15 00 00 00 01 00 02 D9 03
			15 00 00 00 01 00 02 DA 64
			15 00 00 00 01 00 02 DB 03
			15 00 00 00 01 00 02 DC 6F
			15 00 00 00 01 00 02 DD 03
			15 00 00 00 01 00 02 DE 7B
			15 00 00 00 01 00 02 DF 03
			15 00 00 00 01 00 02 E0 89
			15 00 00 00 01 00 02 E1 03
			15 00 00 00 01 00 02 E2 97
			15 00 00 00 01 00 02 E3 03
			15 00 00 00 01 00 02 E4 A9
			15 00 00 00 01 00 02 E5 03
			15 00 00 00 01 00 02 E6 BB
			15 00 00 00 01 00 02 E7 03
			15 00 00 00 01 00 02 E8 CD
			15 00 00 00 01 00 02 E9 03
			15 01 00 00 01 00 02 EA D0

			15 00 00 00 00 00 02 ff 23
			15 00 00 00 00 00 02 fb 01
			15 00 00 00 00 00 02 05 24

			15 00 00 00 00 00 02 ff 10
			15 00 00 00 00 00 02 51 ff
			15 00 00 00 00 00 02 53 2c
			15 00 00 00 00 00 02 55 00
			15 00 00 00 00 00 02 c0 01

			05 01 00 00 78 00 02 11 00
			05 01 00 00 14 00 02 29 00
			];
		qcom,mdss-dsi-off-command = [
			05 01 00 00 02 00 02 28 00
			05 01 00 00 79 00 02 10 00
			];
		qcom,mdss-dsi-on-command-state = "dsi_lp_mode";
		qcom,mdss-dsi-off-command-state = "dsi_hs_mode";
		qcom,mdss-dsi-h-sync-pulse = <0>;
		qcom,mdss-dsi-traffic-mode = "burst_mode";
		qcom,mdss-dsi-bllp-eof-power-mode;
		qcom,mdss-dsi-bllp-power-mode;
		qcom,mdss-dsi-lane-0-state;
		qcom,mdss-dsi-lane-1-state;
		qcom,mdss-dsi-lane-2-state;
		qcom,mdss-dsi-lane-3-state;
		qcom,mdss-dsi-panel-timings = [dc 49 34 00 a7 a2 36 4d 41 03 04 00];
		qcom,mdss-dsi-t-clk-post = <0x19>;
		qcom,mdss-dsi-t-clk-pre = <0x35>;
		qcom,mdss-dsi-bl-min-level = <1>;
		qcom,mdss-dsi-bl-max-level = <4095>;
		qcom,mdss-brightness-max-level = <4095>;
		qcom,mdss-dsi-dma-trigger = "trigger_sw";
		qcom,mdss-dsi-mdp-trigger = "none";
		qcom,mdss-dsi-bl-pmic-control-type = "bl_ctrl_wled";
		qcom,mdss-dsi-reset-sequence = <1 10>, <0 10>, <1 10>;
		qcom,mdss-pan-physical-width-dimension = <71>;
		qcom,mdss-pan-physical-height-dimension = <126>;

		qcom,mdss-dsi-te-pin-select = <1>;
		qcom,mdss-dsi-wr-mem-start = <0x2c>;
		qcom,mdss-dsi-wr-mem-continue = <0x3c>;
		qcom,mdss-dsi-te-dcs-command = <1>;
		qcom,mdss-dsi-te-check-enable;
		qcom,mdss-dsi-te-using-te-pin;

		qcom,mdss-dsi-fbc-enable;
		qcom,mdss-dsi-fbc-ver2-mode;
		qcom,mdss-dsi-fbc-bpp = <8>;
		qcom,mdss-dsi-fbc-packing = <1>;
		qcom,mdss-dsi-fbc-2d-pred-mode;
		qcom,mdss-dsi-fbc-slice-height = <4>;
		qcom,mdss-dsi-fbc-quant-error;
		qcom,mdss-dsi-fbc-bias = <2>;
		qcom,mdss-dsi-fbc-vlc-mode;
		qcom,mdss-dsi-fbc-bflc-mode;
		qcom,mdss-dsi-fbc-lossy-mode-idx = <3>;
		qcom,mdss-dsi-fbc-pat-mode;
		qcom,mdss-dsi-fbc-budget-ctrl = <5>;
		qcom,mdss-dsi-fbc-block-budget = <59>;
		qcom,mdss-dsi-fbc-h-line-budget = <900>;
		qcom,mdss-dsi-fbc-lossless-threshold = <0x200>;
		qcom,mdss-dsi-fbc-lossy-threshold = <192>;
		qcom,mdss-dsi-fbc-rgb-threshold = <4>;
		qcom,mdss-dsi-fbc-max-pred-err = <2>;
		qcom,mdss-dual-enable-gpio = <&msm_gpio 143 0>;

		qcom,dispparam-enabled;
		qcom,mdss-dsi-dispparam-ceon-command = [
			15 00 00 00 01 00 02 FF 10
			15 01 00 00 10 00 02 55 80
			];
		qcom,mdss-dsi-dispparam-ceoff-command = [
			15 00 00 00 01 00 02 FF 10
			15 01 00 00 10 00 02 55 00
			];
		qcom,mdss-dsi-dispparam-cabcon-command = [
			15 01 00 00 01 00 02 FF 23
			15 00 00 00 01 00 02 FB 01
			15 00 00 00 01 00 02 17 F3
			15 00 00 00 01 00 02 18 E2
			15 00 00 00 01 00 02 19 D2
			15 00 00 00 01 00 02 1A C1
			15 00 00 00 01 00 02 1B B1
			15 00 00 00 01 00 02 1C A3
			15 00 00 00 01 00 02 1D 87
			15 00 00 00 01 00 02 1E 87
			15 00 00 00 01 00 02 1F 87
			15 00 00 00 01 00 02 20 66
			15 01 00 00 01 00 02 FF 10
			15 00 00 00 01 00 02 51 FF
			15 00 00 00 01 00 02 53 2C
			15 01 00 00 01 00 02 55 02
			];
		qcom,mdss-dsi-dispparam-cabcguion-command = [
			15 00 00 00 01 00 02 FF 10
			15 01 00 00 01 00 02 55 01
			];
		qcom,mdss-dsi-dispparam-cabcstillon-command = [
			15 01 00 00 01 00 02 FF 23
			15 00 00 00 01 00 02 FB 01
			15 00 00 00 01 00 02 17 F3
			15 00 00 00 01 00 02 18 E2
			15 00 00 00 01 00 02 19 D2
			15 00 00 00 01 00 02 1A C1
			15 00 00 00 01 00 02 1B B1
			15 00 00 00 01 00 02 1C A3
			15 00 00 00 01 00 02 1D 87
			15 00 00 00 01 00 02 1E 87
			15 00 00 00 01 00 02 1F 87
			15 00 00 00 01 00 02 20 66
			15 01 00 00 01 00 02 FF 10
			15 01 00 00 01 00 02 55 02
			];
		qcom,mdss-dsi-dispparam-cabcmovieon-command = [
			15 00 00 00 01 00 02 FF 10
			15 01 00 00 01 00 02 55 03
			];
		qcom,mdss-dsi-dispparam-cabcoff-command = [
			15 00 00 00 01 00 02 FF 10
			15 01 00 00 01 00 02 55 00
			];
		qcom,mdss-dsi-dispparam-warm-command = [
			15 00 00 00 01 00 02 FF 20
			15 00 00 00 01 00 02 75 00
			15 00 00 00 01 00 02 76 00
			15 00 00 00 01 00 02 77 00
			15 00 00 00 01 00 02 78 41
			15 00 00 00 01 00 02 79 00
			15 00 00 00 01 00 02 7A 80
			15 00 00 00 01 00 02 7B 00
			15 00 00 00 01 00 02 7C A7
			15 00 00 00 01 00 02 7D 00
			15 00 00 00 01 00 02 7E C6
			15 00 00 00 01 00 02 7F 00
			15 00 00 00 01 00 02 80 DD
			15 00 00 00 01 00 02 81 00
			15 00 00 00 01 00 02 82 F3
			15 00 00 00 01 00 02 83 01
			15 00 00 00 01 00 02 84 06
			15 00 00 00 01 00 02 85 01
			15 00 00 00 01 00 02 86 15
			15 00 00 00 01 00 02 87 01
			15 00 00 00 01 00 02 88 4B
			15 00 00 00 01 00 02 89 01
			15 00 00 00 01 00 02 8A 74
			15 00 00 00 01 00 02 8B 01
			15 00 00 00 01 00 02 8C B1
			15 00 00 00 01 00 02 8D 01
			15 00 00 00 01 00 02 8E E2
			15 00 00 00 01 00 02 8F 02
			15 00 00 00 01 00 02 90 28
			15 00 00 00 01 00 02 91 02
			15 00 00 00 01 00 02 92 5B
			15 00 00 00 01 00 02 93 02
			15 00 00 00 01 00 02 94 5C
			15 00 00 00 01 00 02 95 02
			15 00 00 00 01 00 02 96 8E
			15 00 00 00 01 00 02 97 02
			15 00 00 00 01 00 02 98 C8
			15 00 00 00 01 00 02 99 02
			15 00 00 00 01 00 02 9A EC
			15 00 00 00 01 00 02 9B 03
			15 00 00 00 01 00 02 9C 1B
			15 00 00 00 01 00 02 9D 03
			15 00 00 00 01 00 02 9E 39
			15 00 00 00 01 00 02 9F 03
			15 00 00 00 01 00 02 A0 5F
			15 00 00 00 01 00 02 A2 03
			15 00 00 00 01 00 02 A3 6B
			15 00 00 00 01 00 02 A4 03
			15 00 00 00 01 00 02 A5 78
			15 00 00 00 01 00 02 A6 03
			15 00 00 00 01 00 02 A7 86
			15 00 00 00 01 00 02 A9 03
			15 00 00 00 01 00 02 AA 95
			15 00 00 00 01 00 02 AB 03
			15 00 00 00 01 00 02 AC A8
			15 00 00 00 01 00 02 AD 03
			15 00 00 00 01 00 02 AE BA
			15 00 00 00 01 00 02 AF 03
			15 00 00 00 01 00 02 B0 CC
			15 00 00 00 01 00 02 B1 03
			15 00 00 00 01 00 02 B2 D0
			15 00 00 00 01 00 02 B3 00
			15 00 00 00 01 00 02 B4 4C
			15 00 00 00 01 00 02 B5 00
			15 00 00 00 01 00 02 B6 8D
			15 00 00 00 01 00 02 B7 00
			15 00 00 00 01 00 02 B8 CB
			15 00 00 00 01 00 02 B9 00
			15 00 00 00 01 00 02 BA F0
			15 00 00 00 01 00 02 BB 01
			15 00 00 00 01 00 02 BC 0D
			15 00 00 00 01 00 02 BD 01
			15 00 00 00 01 00 02 BE 24
			15 00 00 00 01 00 02 BF 01
			15 00 00 00 01 00 02 C0 38
			15 00 00 00 01 00 02 C1 01
			15 00 00 00 01 00 02 C2 49
			15 00 00 00 01 00 02 C3 01
			15 00 00 00 01 00 02 C4 58
			15 00 00 00 01 00 02 C5 01
			15 00 00 00 01 00 02 C6 88
			15 00 00 00 01 00 02 C7 01
			15 00 00 00 01 00 02 C8 AB
			15 00 00 00 01 00 02 C9 01
			15 00 00 00 01 00 02 CA DE
			15 00 00 00 01 00 02 CB 02
			15 00 00 00 01 00 02 CC 03
			15 00 00 00 01 00 02 CD 02
			15 00 00 00 01 00 02 CE 3B
			15 00 00 00 01 00 02 CF 02
			15 00 00 00 01 00 02 D0 6E
			15 00 00 00 01 00 02 D1 02
			15 00 00 00 01 00 02 D2 6F
			15 00 00 00 01 00 02 D3 02
			15 00 00 00 01 00 02 D4 A1
			15 00 00 00 01 00 02 D5 02
			15 00 00 00 01 00 02 D6 D7
			15 00 00 00 01 00 02 D7 02
			15 00 00 00 01 00 02 D8 F9
			15 00 00 00 01 00 02 D9 03
			15 00 00 00 01 00 02 DA 24
			15 00 00 00 01 00 02 DB 03
			15 00 00 00 01 00 02 DC 40
			15 00 00 00 01 00 02 DD 03
			15 00 00 00 01 00 02 DE 64
			15 00 00 00 01 00 02 DF 03
			15 00 00 00 01 00 02 E0 6F
			15 00 00 00 01 00 02 E1 03
			15 00 00 00 01 00 02 E2 7B
			15 00 00 00 01 00 02 E3 03
			15 00 00 00 01 00 02 E4 89
			15 00 00 00 01 00 02 E5 03
			15 00 00 00 01 00 02 E6 97
			15 00 00 00 01 00 02 E7 03
			15 00 00 00 01 00 02 E8 A9
			15 00 00 00 01 00 02 E9 03
			15 00 00 00 01 00 02 EA BB
			15 00 00 00 01 00 02 EB 03
			15 00 00 00 01 00 02 EC CD
			15 00 00 00 01 00 02 ED 03
			15 00 00 00 01 00 02 EE D0
			15 00 00 00 01 00 02 EF 00
			15 00 00 00 01 00 02 F0 83
			15 00 00 00 01 00 02 F1 00
			15 00 00 00 01 00 02 F2 96
			15 00 00 00 01 00 02 F3 00
			15 00 00 00 01 00 02 F4 B9
			15 00 00 00 01 00 02 F5 00
			15 00 00 00 01 00 02 F6 D4
			15 00 00 00 01 00 02 F7 00
			15 00 00 00 01 00 02 F8 EA
			15 00 00 00 01 00 02 F9 00
			15 01 00 00 01 00 02 FA FE
			15 00 00 00 01 00 02 FF 21
			15 00 00 00 01 00 02 00 01
			15 00 00 00 01 00 02 01 0F
			15 00 00 00 01 00 02 02 01
			15 00 00 00 01 00 02 03 1F
			15 00 00 00 01 00 02 04 01
			15 00 00 00 01 00 02 05 2E
			15 00 00 00 01 00 02 06 01
			15 00 00 00 01 00 02 07 5C
			15 00 00 00 01 00 02 08 01
			15 00 00 00 01 00 02 09 80
			15 00 00 00 01 00 02 0A 01
			15 00 00 00 01 00 02 0B BB
			15 00 00 00 01 00 02 0C 01
			15 00 00 00 01 00 02 0D E7
			15 00 00 00 01 00 02 0E 02
			15 00 00 00 01 00 02 0F 2B
			15 00 00 00 01 00 02 10 02
			15 00 00 00 01 00 02 11 5D
			15 00 00 00 01 00 02 12 02
			15 00 00 00 01 00 02 13 5E
			15 00 00 00 01 00 02 14 02
			15 00 00 00 01 00 02 15 8E
			15 00 00 00 01 00 02 16 02
			15 00 00 00 01 00 02 17 C9
			15 00 00 00 01 00 02 18 02
			15 00 00 00 01 00 02 19 EE
			15 00 00 00 01 00 02 1A 03
			15 00 00 00 01 00 02 1B 1C
			15 00 00 00 01 00 02 1C 03
			15 00 00 00 01 00 02 1D 3B
			15 00 00 00 01 00 02 1E 03
			15 00 00 00 01 00 02 1F 61
			15 00 00 00 01 00 02 20 03
			15 00 00 00 01 00 02 21 6C
			15 00 00 00 01 00 02 22 03
			15 00 00 00 01 00 02 23 79
			15 00 00 00 01 00 02 24 03
			15 00 00 00 01 00 02 25 87
			15 00 00 00 01 00 02 26 03
			15 00 00 00 01 00 02 27 97
			15 00 00 00 01 00 02 28 03
			15 00 00 00 01 00 02 29 A9
			15 00 00 00 01 00 02 2A 03
			15 00 00 00 01 00 02 2B BB
			15 00 00 00 01 00 02 2D 03
			15 00 00 00 01 00 02 2F CC
			15 00 00 00 01 00 02 30 03
			15 00 00 00 01 00 02 31 D0
			15 00 00 00 01 00 02 32 00
			15 00 00 00 01 00 02 33 C8
			15 00 00 00 01 00 02 34 00
			15 00 00 00 01 00 02 35 DB
			15 00 00 00 01 00 02 36 00
			15 00 00 00 01 00 02 37 FC
			15 00 00 00 01 00 02 38 01
			15 00 00 00 01 00 02 39 16
			15 00 00 00 01 00 02 3A 01
			15 00 00 00 01 00 02 3B 2B
			15 00 00 00 01 00 02 3D 01
			15 00 00 00 01 00 02 3F 3D
			15 00 00 00 01 00 02 40 01
			15 00 00 00 01 00 02 41 4E
			15 00 00 00 01 00 02 42 01
			15 00 00 00 01 00 02 43 5C
			15 00 00 00 01 00 02 44 01
			15 00 00 00 01 00 02 45 6A
			15 00 00 00 01 00 02 46 01
			15 00 00 00 01 00 02 47 93
			15 00 00 00 01 00 02 48 01
			15 00 00 00 01 00 02 49 B3
			15 00 00 00 01 00 02 4A 01
			15 00 00 00 01 00 02 4B E4
			15 00 00 00 01 00 02 4C 02
			15 00 00 00 01 00 02 4D 06
			15 00 00 00 01 00 02 4E 02
			15 00 00 00 01 00 02 4F 3E
			15 00 00 00 01 00 02 50 02
			15 00 00 00 01 00 02 51 70
			15 00 00 00 01 00 02 52 02
			15 00 00 00 01 00 02 53 71
			15 00 00 00 01 00 02 54 02
			15 00 00 00 01 00 02 55 A1
			15 00 00 00 01 00 02 56 02
			15 00 00 00 01 00 02 58 D8
			15 00 00 00 01 00 02 59 02
			15 00 00 00 01 00 02 5A FB
			15 00 00 00 01 00 02 5B 03
			15 00 00 00 01 00 02 5C 25
			15 00 00 00 01 00 02 5D 03
			15 00 00 00 01 00 02 5E 42
			15 00 00 00 01 00 02 5F 03
			15 00 00 00 01 00 02 60 66
			15 00 00 00 01 00 02 61 03
			15 00 00 00 01 00 02 62 70
			15 00 00 00 01 00 02 63 03
			15 00 00 00 01 00 02 64 7C
			15 00 00 00 01 00 02 65 03
			15 00 00 00 01 00 02 66 8A
			15 00 00 00 01 00 02 67 03
			15 00 00 00 01 00 02 68 99
			15 00 00 00 01 00 02 69 03
			15 00 00 00 01 00 02 6A AA
			15 00 00 00 01 00 02 6B 03
			15 00 00 00 01 00 02 6C BC
			15 00 00 00 01 00 02 6D 03
			15 00 00 00 01 00 02 6E CD
			15 00 00 00 01 00 02 6F 03
			15 00 00 00 01 00 02 70 D0
			15 00 00 00 01 00 02 71 01
			15 00 00 00 01 00 02 72 60
			15 00 00 00 01 00 02 73 01
			15 00 00 00 01 00 02 74 69
			15 00 00 00 01 00 02 75 01
			15 00 00 00 01 00 02 76 71
			15 00 00 00 01 00 02 77 01
			15 00 00 00 01 00 02 78 79
			15 00 00 00 01 00 02 79 01
			15 00 00 00 01 00 02 7A 81
			15 00 00 00 01 00 02 7B 01
			15 00 00 00 01 00 02 7C 88
			15 00 00 00 01 00 02 7D 01
			15 00 00 00 01 00 02 7E 90
			15 00 00 00 01 00 02 7F 01
			15 00 00 00 01 00 02 80 97
			15 00 00 00 01 00 02 81 01
			15 00 00 00 01 00 02 82 9E
			15 00 00 00 01 00 02 83 01
			15 00 00 00 01 00 02 84 B6
			15 00 00 00 01 00 02 85 01
			15 00 00 00 01 00 02 86 CC
			15 00 00 00 01 00 02 87 01
			15 00 00 00 01 00 02 88 F1
			15 00 00 00 01 00 02 89 02
			15 00 00 00 01 00 02 8A 11
			15 00 00 00 01 00 02 8B 02
			15 00 00 00 01 00 02 8C 46
			15 00 00 00 01 00 02 8D 02
			15 00 00 00 01 00 02 8E 72
			15 00 00 00 01 00 02 8F 02
			15 00 00 00 01 00 02 90 73
			15 00 00 00 01 00 02 91 02
			15 00 00 00 01 00 02 92 A0
			15 00 00 00 01 00 02 93 02
			15 00 00 00 01 00 02 94 D7
			15 00 00 00 01 00 02 95 02
			15 00 00 00 01 00 02 96 FB
			15 00 00 00 01 00 02 97 03
			15 00 00 00 01 00 02 98 2B
			15 00 00 00 01 00 02 99 03
			15 00 00 00 01 00 02 9A 44
			15 00 00 00 01 00 02 9B 03
			15 00 00 00 01 00 02 9C 68
			15 00 00 00 01 00 02 9D 03
			15 00 00 00 01 00 02 9E 74
			15 00 00 00 01 00 02 9F 03
			15 00 00 00 01 00 02 A0 80
			15 00 00 00 01 00 02 A2 03
			15 00 00 00 01 00 02 A3 8D
			15 00 00 00 01 00 02 A4 03
			15 00 00 00 01 00 02 A5 9B
			15 00 00 00 01 00 02 A6 03
			15 00 00 00 01 00 02 A7 AC
			15 00 00 00 01 00 02 A9 03
			15 00 00 00 01 00 02 AA BE
			15 00 00 00 01 00 02 AB 03
			15 00 00 00 01 00 02 AC CC
			15 00 00 00 01 00 02 AD 03
			15 00 00 00 01 00 02 AE D0
			15 00 00 00 01 00 02 AF 01
			15 00 00 00 01 00 02 B0 92
			15 00 00 00 01 00 02 B1 01
			15 00 00 00 01 00 02 B2 9B
			15 00 00 00 01 00 02 B3 01
			15 00 00 00 01 00 02 B4 A2
			15 00 00 00 01 00 02 B5 01
			15 00 00 00 01 00 02 B6 AA
			15 00 00 00 01 00 02 B7 01
			15 00 00 00 01 00 02 B8 B0
			15 00 00 00 01 00 02 B9 01
			15 00 00 00 01 00 02 BA B7
			15 00 00 00 01 00 02 BB 01
			15 00 00 00 01 00 02 BC BF
			15 00 00 00 01 00 02 BD 01
			15 00 00 00 01 00 02 BE C4
			15 00 00 00 01 00 02 BF 01
			15 00 00 00 01 00 02 C0 CB
			15 00 00 00 01 00 02 C1 01
			15 00 00 00 01 00 02 C2 E0
			15 00 00 00 01 00 02 C3 01
			15 00 00 00 01 00 02 C4 F3
			15 00 00 00 01 00 02 C5 02
			15 00 00 00 01 00 02 C6 12
			15 00 00 00 01 00 02 C7 02
			15 00 00 00 01 00 02 C8 2C
			15 00 00 00 01 00 02 C9 02
			15 00 00 00 01 00 02 CA 59
			15 00 00 00 01 00 02 CB 02
			15 00 00 00 01 00 02 CC 85
			15 00 00 00 01 00 02 CD 02
			15 00 00 00 01 00 02 CE 86
			15 00 00 00 01 00 02 CF 02
			15 00 00 00 01 00 02 D0 B3
			15 00 00 00 01 00 02 D1 02
			15 00 00 00 01 00 02 D2 E6
			15 00 00 00 01 00 02 D3 03
			15 00 00 00 01 00 02 D4 08
			15 00 00 00 01 00 02 D5 03
			15 00 00 00 01 00 02 D6 34
			15 00 00 00 01 00 02 D7 03
			15 00 00 00 01 00 02 D8 4B
			15 00 00 00 01 00 02 D9 03
			15 00 00 00 01 00 02 DA 6D
			15 00 00 00 01 00 02 DB 03
			15 00 00 00 01 00 02 DC 78
			15 00 00 00 01 00 02 DD 03
			15 00 00 00 01 00 02 DE 83
			15 00 00 00 01 00 02 DF 03
			15 00 00 00 01 00 02 E0 90
			15 00 00 00 01 00 02 E1 03
			15 00 00 00 01 00 02 E2 9E
			15 00 00 00 01 00 02 E3 03
			15 00 00 00 01 00 02 E4 AD
			15 00 00 00 01 00 02 E5 03
			15 00 00 00 01 00 02 E6 BF
			15 00 00 00 01 00 02 E7 03
			15 00 00 00 01 00 02 E8 CD
			15 00 00 00 01 00 02 E9 03
			15 01 00 00 01 00 02 EA D0
			];
		qcom,mdss-dsi-dispparam-warm-command-state = "dsi_hs_mode";
		qcom,mdss-dsi-dispparam-default-command = [
			15 01 00 00 01 00 02 FF 20
			15 00 00 00 01 00 02 75 00
			15 00 00 00 01 00 02 76 00
			15 00 00 00 01 00 02 77 00
			15 00 00 00 01 00 02 78 41
			15 00 00 00 01 00 02 79 00
			15 00 00 00 01 00 02 7A 80
			15 00 00 00 01 00 02 7B 00
			15 00 00 00 01 00 02 7C A7
			15 00 00 00 01 00 02 7D 00
			15 00 00 00 01 00 02 7E C6
			15 00 00 00 01 00 02 7F 00
			15 00 00 00 01 00 02 80 DD
			15 00 00 00 01 00 02 81 00
			15 00 00 00 01 00 02 82 F3
			15 00 00 00 01 00 02 83 01
			15 00 00 00 01 00 02 84 06
			15 00 00 00 01 00 02 85 01
			15 00 00 00 01 00 02 86 15
			15 00 00 00 01 00 02 87 01
			15 00 00 00 01 00 02 88 4B
			15 00 00 00 01 00 02 89 01
			15 00 00 00 01 00 02 8A 74
			15 00 00 00 01 00 02 8B 01
			15 00 00 00 01 00 02 8C B1
			15 00 00 00 01 00 02 8D 01
			15 00 00 00 01 00 02 8E E2
			15 00 00 00 01 00 02 8F 02
			15 00 00 00 01 00 02 90 28
			15 00 00 00 01 00 02 91 02
			15 00 00 00 01 00 02 92 5B
			15 00 00 00 01 00 02 93 02
			15 00 00 00 01 00 02 94 5C
			15 00 00 00 01 00 02 95 02
			15 00 00 00 01 00 02 96 8E
			15 00 00 00 01 00 02 97 02
			15 00 00 00 01 00 02 98 C8
			15 00 00 00 01 00 02 99 02
			15 00 00 00 01 00 02 9A EC
			15 00 00 00 01 00 02 9B 03
			15 00 00 00 01 00 02 9C 1B
			15 00 00 00 01 00 02 9D 03
			15 00 00 00 01 00 02 9E 39
			15 00 00 00 01 00 02 9F 03
			15 00 00 00 01 00 02 A0 5F
			15 00 00 00 01 00 02 A2 03
			15 00 00 00 01 00 02 A3 6B
			15 00 00 00 01 00 02 A4 03
			15 00 00 00 01 00 02 A5 78
			15 00 00 00 01 00 02 A6 03
			15 00 00 00 01 00 02 A7 86
			15 00 00 00 01 00 02 A9 03
			15 00 00 00 01 00 02 AA 95
			15 00 00 00 01 00 02 AB 03
			15 00 00 00 01 00 02 AC A8
			15 00 00 00 01 00 02 AD 03
			15 00 00 00 01 00 02 AE BA
			15 00 00 00 01 00 02 AF 03
			15 00 00 00 01 00 02 B0 CC
			15 00 00 00 01 00 02 B1 03
			15 00 00 00 01 00 02 B2 D0
			15 00 00 00 01 00 02 B3 00
			15 00 00 00 01 00 02 B4 4C
			15 00 00 00 01 00 02 B5 00
			15 00 00 00 01 00 02 B6 8D
			15 00 00 00 01 00 02 B7 00
			15 00 00 00 01 00 02 B8 CB
			15 00 00 00 01 00 02 B9 00
			15 00 00 00 01 00 02 BA F0
			15 00 00 00 01 00 02 BB 01
			15 00 00 00 01 00 02 BC 0D
			15 00 00 00 01 00 02 BD 01
			15 00 00 00 01 00 02 BE 24
			15 00 00 00 01 00 02 BF 01
			15 00 00 00 01 00 02 C0 38
			15 00 00 00 01 00 02 C1 01
			15 00 00 00 01 00 02 C2 49
			15 00 00 00 01 00 02 C3 01
			15 00 00 00 01 00 02 C4 58
			15 00 00 00 01 00 02 C5 01
			15 00 00 00 01 00 02 C6 88
			15 00 00 00 01 00 02 C7 01
			15 00 00 00 01 00 02 C8 AB
			15 00 00 00 01 00 02 C9 01
			15 00 00 00 01 00 02 CA DE
			15 00 00 00 01 00 02 CB 02
			15 00 00 00 01 00 02 CC 03
			15 00 00 00 01 00 02 CD 02
			15 00 00 00 01 00 02 CE 3B
			15 00 00 00 01 00 02 CF 02
			15 00 00 00 01 00 02 D0 6E
			15 00 00 00 01 00 02 D1 02
			15 00 00 00 01 00 02 D2 6F
			15 00 00 00 01 00 02 D3 02
			15 00 00 00 01 00 02 D4 A1
			15 00 00 00 01 00 02 D5 02
			15 00 00 00 01 00 02 D6 D7
			15 00 00 00 01 00 02 D7 02
			15 00 00 00 01 00 02 D8 F9
			15 00 00 00 01 00 02 D9 03
			15 00 00 00 01 00 02 DA 24
			15 00 00 00 01 00 02 DB 03
			15 00 00 00 01 00 02 DC 40
			15 00 00 00 01 00 02 DD 03
			15 00 00 00 01 00 02 DE 64
			15 00 00 00 01 00 02 DF 03
			15 00 00 00 01 00 02 E0 6F
			15 00 00 00 01 00 02 E1 03
			15 00 00 00 01 00 02 E2 7B
			15 00 00 00 01 00 02 E3 03
			15 00 00 00 01 00 02 E4 89
			15 00 00 00 01 00 02 E5 03
			15 00 00 00 01 00 02 E6 97
			15 00 00 00 01 00 02 E7 03
			15 00 00 00 01 00 02 E8 A9
			15 00 00 00 01 00 02 E9 03
			15 00 00 00 01 00 02 EA BB
			15 00 00 00 01 00 02 EB 03
			15 00 00 00 01 00 02 EC CD
			15 00 00 00 01 00 02 ED 03
			15 00 00 00 01 00 02 EE D0
			15 00 00 00 01 00 02 EF 00
			15 00 00 00 01 00 02 F0 00
			15 00 00 00 01 00 02 F1 00
			15 00 00 00 01 00 02 F2 41
			15 00 00 00 01 00 02 F3 00
			15 00 00 00 01 00 02 F4 80
			15 00 00 00 01 00 02 F5 00
			15 00 00 00 01 00 02 F6 A7
			15 00 00 00 01 00 02 F7 00
			15 00 00 00 01 00 02 F8 C6
			15 00 00 00 01 00 02 F9 00
			15 01 00 00 01 00 02 FA DD
			15 00 00 00 01 00 02 FF 21
			15 00 00 00 01 00 02 00 00
			15 00 00 00 01 00 02 01 F3
			15 00 00 00 01 00 02 02 01
			15 00 00 00 01 00 02 03 06
			15 00 00 00 01 00 02 04 01
			15 00 00 00 01 00 02 05 15
			15 00 00 00 01 00 02 06 01
			15 00 00 00 01 00 02 07 4B
			15 00 00 00 01 00 02 08 01
			15 00 00 00 01 00 02 09 74
			15 00 00 00 01 00 02 0A 01
			15 00 00 00 01 00 02 0B B1
			15 00 00 00 01 00 02 0C 01
			15 00 00 00 01 00 02 0D E2
			15 00 00 00 01 00 02 0E 02
			15 00 00 00 01 00 02 0F 28
			15 00 00 00 01 00 02 10 02
			15 00 00 00 01 00 02 11 5B
			15 00 00 00 01 00 02 12 02
			15 00 00 00 01 00 02 13 5C
			15 00 00 00 01 00 02 14 02
			15 00 00 00 01 00 02 15 8E
			15 00 00 00 01 00 02 16 02
			15 00 00 00 01 00 02 17 C8
			15 00 00 00 01 00 02 18 02
			15 00 00 00 01 00 02 19 EC
			15 00 00 00 01 00 02 1A 03
			15 00 00 00 01 00 02 1B 1B
			15 00 00 00 01 00 02 1C 03
			15 00 00 00 01 00 02 1D 39
			15 00 00 00 01 00 02 1E 03
			15 00 00 00 01 00 02 1F 5F
			15 00 00 00 01 00 02 20 03
			15 00 00 00 01 00 02 21 6B
			15 00 00 00 01 00 02 22 03
			15 00 00 00 01 00 02 23 78
			15 00 00 00 01 00 02 24 03
			15 00 00 00 01 00 02 25 86
			15 00 00 00 01 00 02 26 03
			15 00 00 00 01 00 02 27 95
			15 00 00 00 01 00 02 28 03
			15 00 00 00 01 00 02 29 A8
			15 00 00 00 01 00 02 2A 03
			15 00 00 00 01 00 02 2B BA
			15 00 00 00 01 00 02 2D 03
			15 00 00 00 01 00 02 2F CC
			15 00 00 00 01 00 02 30 03
			15 00 00 00 01 00 02 31 D0
			15 00 00 00 01 00 02 32 00
			15 00 00 00 01 00 02 33 4C
			15 00 00 00 01 00 02 34 00
			15 00 00 00 01 00 02 35 8D
			15 00 00 00 01 00 02 36 00
			15 00 00 00 01 00 02 37 CB
			15 00 00 00 01 00 02 38 00
			15 00 00 00 01 00 02 39 F0
			15 00 00 00 01 00 02 3A 01
			15 00 00 00 01 00 02 3B 0D
			15 00 00 00 01 00 02 3D 01
			15 00 00 00 01 00 02 3F 24
			15 00 00 00 01 00 02 40 01
			15 00 00 00 01 00 02 41 38
			15 00 00 00 01 00 02 42 01
			15 00 00 00 01 00 02 43 49
			15 00 00 00 01 00 02 44 01
			15 00 00 00 01 00 02 45 58
			15 00 00 00 01 00 02 46 01
			15 00 00 00 01 00 02 47 88
			15 00 00 00 01 00 02 48 01
			15 00 00 00 01 00 02 49 AB
			15 00 00 00 01 00 02 4A 01
			15 00 00 00 01 00 02 4B DE
			15 00 00 00 01 00 02 4C 02
			15 00 00 00 01 00 02 4D 03
			15 00 00 00 01 00 02 4E 02
			15 00 00 00 01 00 02 4F 3B
			15 00 00 00 01 00 02 50 02
			15 00 00 00 01 00 02 51 6E
			15 00 00 00 01 00 02 52 02
			15 00 00 00 01 00 02 53 6F
			15 00 00 00 01 00 02 54 02
			15 00 00 00 01 00 02 55 A1
			15 00 00 00 01 00 02 56 02
			15 00 00 00 01 00 02 58 D7
			15 00 00 00 01 00 02 59 02
			15 00 00 00 01 00 02 5A F9
			15 00 00 00 01 00 02 5B 03
			15 00 00 00 01 00 02 5C 24
			15 00 00 00 01 00 02 5D 03
			15 00 00 00 01 00 02 5E 40
			15 00 00 00 01 00 02 5F 03
			15 00 00 00 01 00 02 60 64
			15 00 00 00 01 00 02 61 03
			15 00 00 00 01 00 02 62 6F
			15 00 00 00 01 00 02 63 03
			15 00 00 00 01 00 02 64 7B
			15 00 00 00 01 00 02 65 03
			15 00 00 00 01 00 02 66 89
			15 00 00 00 01 00 02 67 03
			15 00 00 00 01 00 02 68 97
			15 00 00 00 01 00 02 69 03
			15 00 00 00 01 00 02 6A A9
			15 00 00 00 01 00 02 6B 03
			15 00 00 00 01 00 02 6C BB
			15 00 00 00 01 00 02 6D 03
			15 00 00 00 01 00 02 6E CD
			15 00 00 00 01 00 02 6F 03
			15 00 00 00 01 00 02 70 D0
			15 00 00 00 01 00 02 71 00
			15 00 00 00 01 00 02 72 00
			15 00 00 00 01 00 02 73 00
			15 00 00 00 01 00 02 74 56
			15 00 00 00 01 00 02 75 00
			15 00 00 00 01 00 02 76 94
			15 00 00 00 01 00 02 77 00
			15 00 00 00 01 00 02 78 BB
			15 00 00 00 01 00 02 79 00
			15 00 00 00 01 00 02 7A DA
			15 00 00 00 01 00 02 7B 00
			15 00 00 00 01 00 02 7C F1
			15 00 00 00 01 00 02 7D 01
			15 00 00 00 01 00 02 7E 07
			15 00 00 00 01 00 02 7F 01
			15 00 00 00 01 00 02 80 1A
			15 00 00 00 01 00 02 81 01
			15 00 00 00 01 00 02 82 29
			15 00 00 00 01 00 02 83 01
			15 00 00 00 01 00 02 84 5F
			15 00 00 00 01 00 02 85 01
			15 00 00 00 01 00 02 86 88
			15 00 00 00 01 00 02 87 01
			15 00 00 00 01 00 02 88 BF
			15 00 00 00 01 00 02 89 01
			15 00 00 00 01 00 02 8A EB
			15 00 00 00 01 00 02 8B 02
			15 00 00 00 01 00 02 8C 2F
			15 00 00 00 01 00 02 8D 02
			15 00 00 00 01 00 02 8E 60
			15 00 00 00 01 00 02 8F 02
			15 00 00 00 01 00 02 90 61
			15 00 00 00 01 00 02 91 02
			15 00 00 00 01 00 02 92 92
			15 00 00 00 01 00 02 93 02
			15 00 00 00 01 00 02 94 CC
			15 00 00 00 01 00 02 95 02
			15 00 00 00 01 00 02 96 EF
			15 00 00 00 01 00 02 97 03
			15 00 00 00 01 00 02 98 20
			15 00 00 00 01 00 02 99 03
			15 00 00 00 01 00 02 9A 39
			15 00 00 00 01 00 02 9B 03
			15 00 00 00 01 00 02 9C 5F
			15 00 00 00 01 00 02 9D 03
			15 00 00 00 01 00 02 9E 6B
			15 00 00 00 01 00 02 9F 03
			15 00 00 00 01 00 02 A0 78
			15 00 00 00 01 00 02 A2 03
			15 00 00 00 01 00 02 A3 86
			15 00 00 00 01 00 02 A4 03
			15 00 00 00 01 00 02 A5 95
			15 00 00 00 01 00 02 A6 03
			15 00 00 00 01 00 02 A7 A8
			15 00 00 00 01 00 02 A9 03
			15 00 00 00 01 00 02 AA BA
			15 00 00 00 01 00 02 AB 03
			15 00 00 00 01 00 02 AC CC
			15 00 00 00 01 00 02 AD 03
			15 00 00 00 01 00 02 AE D0
			15 00 00 00 01 00 02 AF 00
			15 00 00 00 01 00 02 B0 4C
			15 00 00 00 01 00 02 B1 00
			15 00 00 00 01 00 02 B2 A2
			15 00 00 00 01 00 02 B3 00
			15 00 00 00 01 00 02 B4 DF
			15 00 00 00 01 00 02 B5 01
			15 00 00 00 01 00 02 B6 04
			15 00 00 00 01 00 02 B7 01
			15 00 00 00 01 00 02 B8 21
			15 00 00 00 01 00 02 B9 01
			15 00 00 00 01 00 02 BA 38
			15 00 00 00 01 00 02 BB 01
			15 00 00 00 01 00 02 BC 4C
			15 00 00 00 01 00 02 BD 01
			15 00 00 00 01 00 02 BE 5D
			15 00 00 00 01 00 02 BF 01
			15 00 00 00 01 00 02 C0 6C
			15 00 00 00 01 00 02 C1 01
			15 00 00 00 01 00 02 C2 9C
			15 00 00 00 01 00 02 C3 01
			15 00 00 00 01 00 02 C4 BF
			15 00 00 00 01 00 02 C5 01
			15 00 00 00 01 00 02 C6 EC
			15 00 00 00 01 00 02 C7 02
			15 00 00 00 01 00 02 C8 0D
			15 00 00 00 01 00 02 C9 02
			15 00 00 00 01 00 02 CA 42
			15 00 00 00 01 00 02 CB 02
			15 00 00 00 01 00 02 CC 73
			15 00 00 00 01 00 02 CD 02
			15 00 00 00 01 00 02 CE 74
			15 00 00 00 01 00 02 CF 02
			15 00 00 00 01 00 02 D0 A5
			15 00 00 00 01 00 02 D1 02
			15 00 00 00 01 00 02 D2 DB
			15 00 00 00 01 00 02 D3 02
			15 00 00 00 01 00 02 D4 FC
			15 00 00 00 01 00 02 D5 03
			15 00 00 00 01 00 02 D6 29
			15 00 00 00 01 00 02 D7 03
			15 00 00 00 01 00 02 D8 40
			15 00 00 00 01 00 02 D9 03
			15 00 00 00 01 00 02 DA 64
			15 00 00 00 01 00 02 DB 03
			15 00 00 00 01 00 02 DC 6F
			15 00 00 00 01 00 02 DD 03
			15 00 00 00 01 00 02 DE 7B
			15 00 00 00 01 00 02 DF 03
			15 00 00 00 01 00 02 E0 89
			15 00 00 00 01 00 02 E1 03
			15 00 00 00 01 00 02 E2 97
			15 00 00 00 01 00 02 E3 03
			15 00 00 00 01 00 02 E4 A9
			15 00 00 00 01 00 02 E5 03
			15 00 00 00 01 00 02 E6 BB
			15 00 00 00 01 00 02 E7 03
			15 00 00 00 01 00 02 E8 CD
			15 00 00 00 01 00 02 E9 03
			15 01 00 00 01 00 02 EA D0
		];
		qcom,mdss-dsi-dispparam-default-command-state = "dsi_hs_mode";
		qcom,mdss-dsi-dispparam-cold-command = [
			15 00 00 00 00 00 02 FF 20
			15 00 00 00 00 00 02 75 00
			15 00 00 00 00 00 02 76 DA
			15 00 00 00 00 00 02 77 00
			15 00 00 00 00 00 02 78 E5
			15 00 00 00 00 00 02 79 00
			15 00 00 00 00 00 02 7A F8
			15 00 00 00 00 00 02 7B 01
			15 00 00 00 00 00 02 7C 09
			15 00 00 00 00 00 02 7D 01
			15 00 00 00 00 00 02 7E 19
			15 00 00 00 00 00 02 7F 01
			15 00 00 00 00 00 02 80 28
			15 00 00 00 00 00 02 81 01
			15 00 00 00 00 00 02 82 35
			15 00 00 00 00 00 02 83 01
			15 00 00 00 00 00 02 84 42
			15 00 00 00 00 00 02 85 01
			15 00 00 00 00 00 02 86 4D
			15 00 00 00 00 00 02 87 01
			15 00 00 00 00 00 02 88 72
			15 00 00 00 00 00 02 89 01
			15 00 00 00 00 00 02 8A 92
			15 00 00 00 00 00 02 8B 01
			15 00 00 00 00 00 02 8C C6
			15 00 00 00 00 00 02 8D 01
			15 00 00 00 00 00 02 8E EF
			15 00 00 00 00 00 02 8F 02
			15 00 00 00 00 00 02 90 2F
			15 00 00 00 00 00 02 91 02
			15 00 00 00 00 00 02 92 60
			15 00 00 00 00 00 02 93 02
			15 00 00 00 00 00 02 94 62
			15 00 00 00 00 00 02 95 02
			15 00 00 00 00 00 02 96 91
			15 00 00 00 00 00 02 97 02
			15 00 00 00 00 00 02 98 CB
			15 00 00 00 00 00 02 99 02
			15 00 00 00 00 00 02 9A F0
			15 00 00 00 00 00 02 9B 03
			15 00 00 00 00 00 02 9C 1E
			15 00 00 00 00 00 02 9D 03
			15 00 00 00 00 00 02 9E 3D
			15 00 00 00 00 00 02 9F 03
			15 00 00 00 00 00 02 A0 63
			15 00 00 00 00 00 02 A2 03
			15 00 00 00 00 00 02 A3 6E
			15 00 00 00 00 00 02 A4 03
			15 00 00 00 00 00 02 A5 7A
			15 00 00 00 00 00 02 A6 03
			15 00 00 00 00 00 02 A7 88
			15 00 00 00 00 00 02 A9 03
			15 00 00 00 00 00 02 AA 97
			15 00 00 00 00 00 02 AB 03
			15 00 00 00 00 00 02 AC A8
			15 00 00 00 00 00 02 AD 03
			15 00 00 00 00 00 02 AE BB
			15 00 00 00 00 00 02 AF 03
			15 00 00 00 00 00 02 B0 CB
			15 00 00 00 00 00 02 B1 03
			15 00 00 00 00 00 02 B2 D0
			15 00 00 00 00 00 02 B3 01
			15 00 00 00 00 00 02 B4 19
			15 00 00 00 00 00 02 B5 01
			15 00 00 00 00 00 02 B6 22
			15 00 00 00 00 00 02 B7 01
			15 00 00 00 00 00 02 B8 35
			15 00 00 00 00 00 02 B9 01
			15 00 00 00 00 00 02 BA 45
			15 00 00 00 00 00 02 BB 01
			15 00 00 00 00 00 02 BC 54
			15 00 00 00 00 00 02 BD 01
			15 00 00 00 00 00 02 BE 61
			15 00 00 00 00 00 02 BF 01
			15 00 00 00 00 00 02 C0 6E
			15 00 00 00 00 00 02 C1 01
			15 00 00 00 00 00 02 C2 79
			15 00 00 00 00 00 02 C3 01
			15 00 00 00 00 00 02 C4 84
			15 00 00 00 00 00 02 C5 01
			15 00 00 00 00 00 02 C6 A5
			15 00 00 00 00 00 02 C7 01
			15 00 00 00 00 00 02 C8 C1
			15 00 00 00 00 00 02 C9 01
			15 00 00 00 00 00 02 CA ED
			15 00 00 00 00 00 02 CB 02
			15 00 00 00 00 00 02 CC 0E
			15 00 00 00 00 00 02 CD 02
			15 00 00 00 00 00 02 CE 42
			15 00 00 00 00 00 02 CF 02
			15 00 00 00 00 00 02 D0 73
			15 00 00 00 00 00 02 D1 02
			15 00 00 00 00 00 02 D2 75
			15 00 00 00 00 00 02 D3 02
			15 00 00 00 00 00 02 D4 A4
			15 00 00 00 00 00 02 D5 02
			15 00 00 00 00 00 02 D6 DA
			15 00 00 00 00 00 02 D7 02
			15 00 00 00 00 00 02 D8 FD
			15 00 00 00 00 00 02 D9 03
			15 00 00 00 00 00 02 DA 27
			15 00 00 00 00 00 02 DB 03
			15 00 00 00 00 00 02 DC 44
			15 00 00 00 00 00 02 DD 03
			15 00 00 00 00 00 02 DE 68
			15 00 00 00 00 00 02 DF 03
			15 00 00 00 00 00 02 E0 72
			15 00 00 00 00 00 02 E1 03
			15 00 00 00 00 00 02 E2 7D
			15 00 00 00 00 00 02 E3 03
			15 00 00 00 00 00 02 E4 8B
			15 00 00 00 00 00 02 E5 03
			15 00 00 00 00 00 02 E6 9A
			15 00 00 00 00 00 02 E7 03
			15 00 00 00 00 00 02 E8 A9
			15 00 00 00 00 00 02 E9 03
			15 00 00 00 00 00 02 EA BC
			15 00 00 00 00 00 02 EB 03
			15 00 00 00 00 00 02 EC CC
			15 00 00 00 00 00 02 ED 03
			15 00 00 00 00 00 02 EE D0
			15 00 00 00 00 00 02 EF 00
			15 00 00 00 00 00 02 F0 A4
			15 00 00 00 00 00 02 F1 00
			15 00 00 00 00 00 02 F2 B4
			15 00 00 00 00 00 02 F3 00
			15 00 00 00 00 00 02 F4 CF
			15 00 00 00 00 00 02 F5 00
			15 00 00 00 00 00 02 F6 E8
			15 00 00 00 00 00 02 F7 00
			15 00 00 00 00 00 02 F8 FA
			15 00 00 00 00 00 02 F9 01
			15 01 00 00 00 00 02 FA 0C
			15 00 00 00 00 00 02 FF 21
			15 00 00 00 00 00 02 00 01
			15 00 00 00 00 00 02 01 1B
			15 00 00 00 00 00 02 02 01
			15 00 00 00 00 00 02 03 2B
			15 00 00 00 00 00 02 04 01
			15 00 00 00 00 00 02 05 37
			15 00 00 00 00 00 02 06 01
			15 00 00 00 00 00 02 07 64
			15 00 00 00 00 00 02 08 01
			15 00 00 00 00 00 02 09 86
			15 00 00 00 00 00 02 0A 01
			15 00 00 00 00 00 02 0B BE
			15 00 00 00 00 00 02 0C 01
			15 00 00 00 00 00 02 0D EA
			15 00 00 00 00 00 02 0E 02
			15 00 00 00 00 00 02 0F 2C
			15 00 00 00 00 00 02 10 02
			15 00 00 00 00 00 02 11 5E
			15 00 00 00 00 00 02 12 02
			15 00 00 00 00 00 02 13 60
			15 00 00 00 00 00 02 14 02
			15 00 00 00 00 00 02 15 8F
			15 00 00 00 00 00 02 16 02
			15 00 00 00 00 00 02 17 CA
			15 00 00 00 00 00 02 18 02
			15 00 00 00 00 00 02 19 EE
			15 00 00 00 00 00 02 1A 03
			15 00 00 00 00 00 02 1B 1D
			15 00 00 00 00 00 02 1C 03
			15 00 00 00 00 00 02 1D 3C
			15 00 00 00 00 00 02 1E 03
			15 00 00 00 00 00 02 1F 62
			15 00 00 00 00 00 02 20 03
			15 00 00 00 00 00 02 21 6E
			15 00 00 00 00 00 02 22 03
			15 00 00 00 00 00 02 23 7A
			15 00 00 00 00 00 02 24 03
			15 00 00 00 00 00 02 25 88
			15 00 00 00 00 00 02 26 03
			15 00 00 00 00 00 02 27 97
			15 00 00 00 00 00 02 28 03
			15 00 00 00 00 00 02 29 A8
			15 00 00 00 00 00 02 2A 03
			15 00 00 00 00 00 02 2B BB
			15 00 00 00 00 00 02 2D 03
			15 00 00 00 00 00 02 2F CC
			15 00 00 00 00 00 02 30 03
			15 00 00 00 00 00 02 31 D0
			15 00 00 00 00 00 02 32 00
			15 00 00 00 00 00 02 33 E7
			15 00 00 00 00 00 02 34 00
			15 00 00 00 00 00 02 35 F6
			15 00 00 00 00 00 02 36 01
			15 00 00 00 00 00 02 37 10
			15 00 00 00 00 00 02 38 01
			15 00 00 00 00 00 02 39 27
			15 00 00 00 00 00 02 3A 01
			15 00 00 00 00 00 02 3B 39
			15 00 00 00 00 00 02 3D 01
			15 00 00 00 00 00 02 3F 49
			15 00 00 00 00 00 02 40 01
			15 00 00 00 00 00 02 41 58
			15 00 00 00 00 00 02 42 01
			15 00 00 00 00 00 02 43 66
			15 00 00 00 00 00 02 44 01
			15 00 00 00 00 00 02 45 72
			15 00 00 00 00 00 02 46 01
			15 00 00 00 00 00 02 47 99
			15 00 00 00 00 00 02 48 01
			15 00 00 00 00 00 02 49 B7
			15 00 00 00 00 00 02 4A 01
			15 00 00 00 00 00 02 4B E7
			15 00 00 00 00 00 02 4C 02
			15 00 00 00 00 00 02 4D 09
			15 00 00 00 00 00 02 4E 02
			15 00 00 00 00 00 02 4F 3F
			15 00 00 00 00 00 02 50 02
			15 00 00 00 00 00 02 51 71
			15 00 00 00 00 00 02 52 02
			15 00 00 00 00 00 02 53 73
			15 00 00 00 00 00 02 54 02
			15 00 00 00 00 00 02 55 A2
			15 00 00 00 00 00 02 56 02
			15 00 00 00 00 00 02 58 D9
			15 00 00 00 00 00 02 59 02
			15 00 00 00 00 00 02 5A FB
			15 00 00 00 00 00 02 5B 03
			15 00 00 00 00 00 02 5C 26
			15 00 00 00 00 00 02 5D 03
			15 00 00 00 00 00 02 5E 43
			15 00 00 00 00 00 02 5F 03
			15 00 00 00 00 00 02 60 67
			15 00 00 00 00 00 02 61 03
			15 00 00 00 00 00 02 62 72
			15 00 00 00 00 00 02 63 03
			15 00 00 00 00 00 02 64 7D
			15 00 00 00 00 00 02 65 03
			15 00 00 00 00 00 02 66 8B
			15 00 00 00 00 00 02 67 03
			15 00 00 00 00 00 02 68 9A
			15 00 00 00 00 00 02 69 03
			15 00 00 00 00 00 02 6A A9
			15 00 00 00 00 00 02 6B 03
			15 00 00 00 00 00 02 6C BC
			15 00 00 00 00 00 02 6D 03
			15 00 00 00 00 00 02 6E CD
			15 00 00 00 00 00 02 6F 03
			15 00 00 00 00 00 02 70 D0
			15 00 00 00 00 00 02 71 00
			15 00 00 00 00 00 02 72 00
			15 00 00 00 00 00 02 73 00
			15 00 00 00 00 00 02 74 50
			15 00 00 00 00 00 02 75 00
			15 00 00 00 00 00 02 76 8E
			15 00 00 00 00 00 02 77 00
			15 00 00 00 00 00 02 78 B5
			15 00 00 00 00 00 02 79 00
			15 00 00 00 00 00 02 7A D4
			15 00 00 00 00 00 02 7B 00
			15 00 00 00 00 00 02 7C EB
			15 00 00 00 00 00 02 7D 01
			15 00 00 00 00 00 02 7E 01
			15 00 00 00 00 00 02 7F 01
			15 00 00 00 00 00 02 80 14
			15 00 00 00 00 00 02 81 01
			15 00 00 00 00 00 02 82 23
			15 00 00 00 00 00 02 83 01
			15 00 00 00 00 00 02 84 59
			15 00 00 00 00 00 02 85 01
			15 00 00 00 00 00 02 86 80
			15 00 00 00 00 00 02 87 01
			15 00 00 00 00 00 02 88 BD
			15 00 00 00 00 00 02 89 01
			15 00 00 00 00 00 02 8A E9
			15 00 00 00 00 00 02 8B 02
			15 00 00 00 00 00 02 8C 2D
			15 00 00 00 00 00 02 8D 02
			15 00 00 00 00 00 02 8E 5E
			15 00 00 00 00 00 02 8F 02
			15 00 00 00 00 00 02 90 60
			15 00 00 00 00 00 02 91 02
			15 00 00 00 00 00 02 92 90
			15 00 00 00 00 00 02 93 02
			15 00 00 00 00 00 02 94 CA
			15 00 00 00 00 00 02 95 02
			15 00 00 00 00 00 02 96 EF
			15 00 00 00 00 00 02 97 03
			15 00 00 00 00 00 02 98 1F
			15 00 00 00 00 00 02 99 03
			15 00 00 00 00 00 02 9A 39
			15 00 00 00 00 00 02 9B 03
			15 00 00 00 00 00 02 9C 5F
			15 00 00 00 00 00 02 9D 03
			15 00 00 00 00 00 02 9E 6B
			15 00 00 00 00 00 02 9F 03
			15 00 00 00 00 00 02 A0 78
			15 00 00 00 00 00 02 A2 03
			15 00 00 00 00 00 02 A3 86
			15 00 00 00 00 00 02 A4 03
			15 00 00 00 00 00 02 A5 95
			15 00 00 00 00 00 02 A6 03
			15 00 00 00 00 00 02 A7 A8
			15 00 00 00 00 00 02 A9 03
			15 00 00 00 00 00 02 AA BA
			15 00 00 00 00 00 02 AB 03
			15 00 00 00 00 00 02 AC CC
			15 00 00 00 00 00 02 AD 03
			15 00 00 00 00 00 02 AE D0
			15 00 00 00 00 00 02 AF 00
			15 00 00 00 00 00 02 B0 4C
			15 00 00 00 00 00 02 B1 00
			15 00 00 00 00 00 02 B2 9C
			15 00 00 00 00 00 02 B3 00
			15 00 00 00 00 00 02 B4 D9
			15 00 00 00 00 00 02 B5 00
			15 00 00 00 00 00 02 B6 FE
			15 00 00 00 00 00 02 B7 01
			15 00 00 00 00 00 02 B8 1B
			15 00 00 00 00 00 02 B9 01
			15 00 00 00 00 00 02 BA 32
			15 00 00 00 00 00 02 BB 01
			15 00 00 00 00 00 02 BC 46
			15 00 00 00 00 00 02 BD 01
			15 00 00 00 00 00 02 BE 57
			15 00 00 00 00 00 02 BF 01
			15 00 00 00 00 00 02 C0 66
			15 00 00 00 00 00 02 C1 01
			15 00 00 00 00 00 02 C2 96
			15 00 00 00 00 00 02 C3 01
			15 00 00 00 00 00 02 C4 B7
			15 00 00 00 00 00 02 C5 01
			15 00 00 00 00 00 02 C6 EA
			15 00 00 00 00 00 02 C7 02
			15 00 00 00 00 00 02 C8 0B
			15 00 00 00 00 00 02 C9 02
			15 00 00 00 00 00 02 CA 40
			15 00 00 00 00 00 02 CB 02
			15 00 00 00 00 00 02 CC 71
			15 00 00 00 00 00 02 CD 02
			15 00 00 00 00 00 02 CE 73
			15 00 00 00 00 00 02 CF 02
			15 00 00 00 00 00 02 D0 A3
			15 00 00 00 00 00 02 D1 02
			15 00 00 00 00 00 02 D2 D9
			15 00 00 00 00 00 02 D3 02
			15 00 00 00 00 00 02 D4 FC
			15 00 00 00 00 00 02 D5 03
			15 00 00 00 00 00 02 D6 28
			15 00 00 00 00 00 02 D7 03
			15 00 00 00 00 00 02 D8 40
			15 00 00 00 00 00 02 D9 03
			15 00 00 00 00 00 02 DA 64
			15 00 00 00 00 00 02 DB 03
			15 00 00 00 00 00 02 DC 6F
			15 00 00 00 00 00 02 DD 03
			15 00 00 00 00 00 02 DE 7B
			15 00 00 00 00 00 02 DF 03
			15 00 00 00 00 00 02 E0 89
			15 00 00 00 00 00 02 E1 03
			15 00 00 00 00 00 02 E2 97
			15 00 00 00 00 00 02 E3 03
			15 00 00 00 00 00 02 E4 A9
			15 00 00 00 00 00 02 E5 03
			15 00 00 00 00 00 02 E6 BB
			15 00 00 00 00 00 02 E7 03
			15 00 00 00 00 00 02 E8 CD
			15 00 00 00 00 00 02 E9 03
			15 01 00 00 00 00 02 EA D0
			];
		qcom,mdss-dsi-dispparam-cold-command-state = "dsi_hs_mode";
		qcom,mdss-dsi-dispparam-papermode-command = [
			15 01 00 00 01 00 02 FF 20
			15 00 00 00 01 00 02 FB 01
			15 00 00 00 01 00 02 75 00
			15 00 00 00 01 00 02 76 00
			15 00 00 00 01 00 02 77 00
			15 00 00 00 01 00 02 78 41
			15 00 00 00 01 00 02 79 00
			15 00 00 00 01 00 02 7A 80
			15 00 00 00 01 00 02 7B 00
			15 00 00 00 01 00 02 7C A7
			15 00 00 00 01 00 02 7D 00
			15 00 00 00 01 00 02 7E C6
			15 00 00 00 01 00 02 7F 00
			15 00 00 00 01 00 02 80 DD
			15 00 00 00 01 00 02 81 00
			15 00 00 00 01 00 02 82 F3
			15 00 00 00 01 00 02 83 01
			15 00 00 00 01 00 02 84 06
			15 00 00 00 01 00 02 85 01
			15 00 00 00 01 00 02 86 15
			15 00 00 00 01 00 02 87 01
			15 00 00 00 01 00 02 88 4B
			15 00 00 00 01 00 02 89 01
			15 00 00 00 01 00 02 8A 74
			15 00 00 00 01 00 02 8B 01
			15 00 00 00 01 00 02 8C B1
			15 00 00 00 01 00 02 8D 01
			15 00 00 00 01 00 02 8E E2
			15 00 00 00 01 00 02 8F 02
			15 00 00 00 01 00 02 90 28
			15 00 00 00 01 00 02 91 02
			15 00 00 00 01 00 02 92 5B
			15 00 00 00 01 00 02 93 02
			15 00 00 00 01 00 02 94 5C
			15 00 00 00 01 00 02 95 02
			15 00 00 00 01 00 02 96 8E
			15 00 00 00 01 00 02 97 02
			15 00 00 00 01 00 02 98 C8
			15 00 00 00 01 00 02 99 02
			15 00 00 00 01 00 02 9A EC
			15 00 00 00 01 00 02 9B 03
			15 00 00 00 01 00 02 9C 1B
			15 00 00 00 01 00 02 9D 03
			15 00 00 00 01 00 02 9E 39
			15 00 00 00 01 00 02 9F 03
			15 00 00 00 01 00 02 A0 5F
			15 00 00 00 01 00 02 A2 03
			15 00 00 00 01 00 02 A3 6B
			15 00 00 00 01 00 02 A4 03
			15 00 00 00 01 00 02 A5 78
			15 00 00 00 01 00 02 A6 03
			15 00 00 00 01 00 02 A7 86
			15 00 00 00 01 00 02 A9 03
			15 00 00 00 01 00 02 AA 95
			15 00 00 00 01 00 02 AB 03
			15 00 00 00 01 00 02 AC A8
			15 00 00 00 01 00 02 AD 03
			15 00 00 00 01 00 02 AE BA
			15 00 00 00 01 00 02 AF 03
			15 00 00 00 01 00 02 B0 CC
			15 00 00 00 01 00 02 B1 03
			15 00 00 00 01 00 02 B2 D0
			15 00 00 00 01 00 02 B3 00
			15 00 00 00 01 00 02 B4 4C
			15 00 00 00 01 00 02 B5 00
			15 00 00 00 01 00 02 B6 8D
			15 00 00 00 01 00 02 B7 00
			15 00 00 00 01 00 02 B8 CB
			15 00 00 00 01 00 02 B9 00
			15 00 00 00 01 00 02 BA F0
			15 00 00 00 01 00 02 BB 01
			15 00 00 00 01 00 02 BC 0D
			15 00 00 00 01 00 02 BD 01
			15 00 00 00 01 00 02 BE 24
			15 00 00 00 01 00 02 BF 01
			15 00 00 00 01 00 02 C0 38
			15 00 00 00 01 00 02 C1 01
			15 00 00 00 01 00 02 C2 49
			15 00 00 00 01 00 02 C3 01
			15 00 00 00 01 00 02 C4 58
			15 00 00 00 01 00 02 C5 01
			15 00 00 00 01 00 02 C6 88
			15 00 00 00 01 00 02 C7 01
			15 00 00 00 01 00 02 C8 AB
			15 00 00 00 01 00 02 C9 01
			15 00 00 00 01 00 02 CA DE
			15 00 00 00 01 00 02 CB 02
			15 00 00 00 01 00 02 CC 03
			15 00 00 00 01 00 02 CD 02
			15 00 00 00 01 00 02 CE 3B
			15 00 00 00 01 00 02 CF 02
			15 00 00 00 01 00 02 D0 6E
			15 00 00 00 01 00 02 D1 02
			15 00 00 00 01 00 02 D2 6F
			15 00 00 00 01 00 02 D3 02
			15 00 00 00 01 00 02 D4 A1
			15 00 00 00 01 00 02 D5 02
			15 00 00 00 01 00 02 D6 D7
			15 00 00 00 01 00 02 D7 02
			15 00 00 00 01 00 02 D8 F9
			15 00 00 00 01 00 02 D9 03
			15 00 00 00 01 00 02 DA 24
			15 00 00 00 01 00 02 DB 03
			15 00 00 00 01 00 02 DC 40
			15 00 00 00 01 00 02 DD 03
			15 00 00 00 01 00 02 DE 64
			15 00 00 00 01 00 02 DF 03
			15 00 00 00 01 00 02 E0 6F
			15 00 00 00 01 00 02 E1 03
			15 00 00 00 01 00 02 E2 7B
			15 00 00 00 01 00 02 E3 03
			15 00 00 00 01 00 02 E4 89
			15 00 00 00 01 00 02 E5 03
			15 00 00 00 01 00 02 E6 97
			15 00 00 00 01 00 02 E7 03
			15 00 00 00 01 00 02 E8 A9
			15 00 00 00 01 00 02 E9 03
			15 00 00 00 01 00 02 EA BB
			15 00 00 00 01 00 02 EB 03
			15 00 00 00 01 00 02 EC CD
			15 00 00 00 01 00 02 ED 03
			15 00 00 00 01 00 02 EE D0
			15 00 00 00 01 00 02 EF 00
			15 00 00 00 01 00 02 F0 00
			15 00 00 00 01 00 02 F1 00
			15 00 00 00 01 00 02 F2 41
			15 00 00 00 01 00 02 F3 00
			15 00 00 00 01 00 02 F4 80
			15 00 00 00 01 00 02 F5 00
			15 00 00 00 01 00 02 F6 A7
			15 00 00 00 01 00 02 F7 00
			15 00 00 00 01 00 02 F8 C6
			15 00 00 00 01 00 02 F9 00
			15 01 00 00 01 00 02 FA DD

			15 00 00 00 01 00 02 FF 21
			15 00 00 00 01 00 02 FB 01
			15 00 00 00 01 00 02 00 00
			15 00 00 00 01 00 02 01 F3
			15 00 00 00 01 00 02 02 01
			15 00 00 00 01 00 02 03 06
			15 00 00 00 01 00 02 04 01
			15 00 00 00 01 00 02 05 15
			15 00 00 00 01 00 02 06 01
			15 00 00 00 01 00 02 07 4B
			15 00 00 00 01 00 02 08 01
			15 00 00 00 01 00 02 09 74
			15 00 00 00 01 00 02 0A 01
			15 00 00 00 01 00 02 0B B1
			15 00 00 00 01 00 02 0C 01
			15 00 00 00 01 00 02 0D E2
			15 00 00 00 01 00 02 0E 02
			15 00 00 00 01 00 02 0F 28
			15 00 00 00 01 00 02 10 02
			15 00 00 00 01 00 02 11 5B
			15 00 00 00 01 00 02 12 02
			15 00 00 00 01 00 02 13 5C
			15 00 00 00 01 00 02 14 02
			15 00 00 00 01 00 02 15 8E
			15 00 00 00 01 00 02 16 02
			15 00 00 00 01 00 02 17 C8
			15 00 00 00 01 00 02 18 02
			15 00 00 00 01 00 02 19 EC
			15 00 00 00 01 00 02 1A 03
			15 00 00 00 01 00 02 1B 1B
			15 00 00 00 01 00 02 1C 03
			15 00 00 00 01 00 02 1D 39
			15 00 00 00 01 00 02 1E 03
			15 00 00 00 01 00 02 1F 5F
			15 00 00 00 01 00 02 20 03
			15 00 00 00 01 00 02 21 6B
			15 00 00 00 01 00 02 22 03
			15 00 00 00 01 00 02 23 78
			15 00 00 00 01 00 02 24 03
			15 00 00 00 01 00 02 25 86
			15 00 00 00 01 00 02 26 03
			15 00 00 00 01 00 02 27 95
			15 00 00 00 01 00 02 28 03
			15 00 00 00 01 00 02 29 A8
			15 00 00 00 01 00 02 2A 03
			15 00 00 00 01 00 02 2B BA
			15 00 00 00 01 00 02 2D 03
			15 00 00 00 01 00 02 2F CC
			15 00 00 00 01 00 02 30 03
			15 00 00 00 01 00 02 31 D0
			15 00 00 00 01 00 02 32 00
			15 00 00 00 01 00 02 33 4C
			15 00 00 00 01 00 02 34 00
			15 00 00 00 01 00 02 35 8D
			15 00 00 00 01 00 02 36 00
			15 00 00 00 01 00 02 37 CB
			15 00 00 00 01 00 02 38 00
			15 00 00 00 01 00 02 39 F0
			15 00 00 00 01 00 02 3A 01
			15 00 00 00 01 00 02 3B 0D
			15 00 00 00 01 00 02 3D 01
			15 00 00 00 01 00 02 3F 24
			15 00 00 00 01 00 02 40 01
			15 00 00 00 01 00 02 41 38
			15 00 00 00 01 00 02 42 01
			15 00 00 00 01 00 02 43 49
			15 00 00 00 01 00 02 44 01
			15 00 00 00 01 00 02 45 58
			15 00 00 00 01 00 02 46 01
			15 00 00 00 01 00 02 47 88
			15 00 00 00 01 00 02 48 01
			15 00 00 00 01 00 02 49 AB
			15 00 00 00 01 00 02 4A 01
			15 00 00 00 01 00 02 4B DE
			15 00 00 00 01 00 02 4C 02
			15 00 00 00 01 00 02 4D 03
			15 00 00 00 01 00 02 4E 02
			15 00 00 00 01 00 02 4F 3B
			15 00 00 00 01 00 02 50 02
			15 00 00 00 01 00 02 51 6E
			15 00 00 00 01 00 02 52 02
			15 00 00 00 01 00 02 53 6F
			15 00 00 00 01 00 02 54 02
			15 00 00 00 01 00 02 55 A1
			15 00 00 00 01 00 02 56 02
			15 00 00 00 01 00 02 58 D7
			15 00 00 00 01 00 02 59 02
			15 00 00 00 01 00 02 5A F9
			15 00 00 00 01 00 02 5B 03
			15 00 00 00 01 00 02 5C 24
			15 00 00 00 01 00 02 5D 03
			15 00 00 00 01 00 02 5E 40
			15 00 00 00 01 00 02 5F 03
			15 00 00 00 01 00 02 60 64
			15 00 00 00 01 00 02 61 03
			15 00 00 00 01 00 02 62 6F
			15 00 00 00 01 00 02 63 03
			15 00 00 00 01 00 02 64 7B
			15 00 00 00 01 00 02 65 03
			15 00 00 00 01 00 02 66 89
			15 00 00 00 01 00 02 67 03
			15 00 00 00 01 00 02 68 97
			15 00 00 00 01 00 02 69 03
			15 00 00 00 01 00 02 6A A9
			15 00 00 00 01 00 02 6B 03
			15 00 00 00 01 00 02 6C BB
			15 00 00 00 01 00 02 6D 03
			15 00 00 00 01 00 02 6E CD
			15 00 00 00 01 00 02 6F 03
			15 00 00 00 01 00 02 70 D0
			15 00 00 00 01 00 02 71 02
			15 00 00 00 01 00 02 72 18
			15 00 00 00 01 00 02 73 02
			15 00 00 00 01 00 02 74 19
			15 00 00 00 01 00 02 75 02
			15 00 00 00 01 00 02 76 1C
			15 00 00 00 01 00 02 77 02
			15 00 00 00 01 00 02 78 1E
			15 00 00 00 01 00 02 79 02
			15 00 00 00 01 00 02 7A 21
			15 00 00 00 01 00 02 7B 02
			15 00 00 00 01 00 02 7C 23
			15 00 00 00 01 00 02 7D 02
			15 00 00 00 01 00 02 7E 26
			15 00 00 00 01 00 02 7F 02
			15 00 00 00 01 00 02 80 28
			15 00 00 00 01 00 02 81 02
			15 00 00 00 01 00 02 82 2A
			15 00 00 00 01 00 02 83 02
			15 00 00 00 01 00 02 84 34
			15 00 00 00 01 00 02 85 02
			15 00 00 00 01 00 02 86 3D
			15 00 00 00 01 00 02 87 02
			15 00 00 00 01 00 02 88 4E
			15 00 00 00 01 00 02 89 02
			15 00 00 00 01 00 02 8A 60
			15 00 00 00 01 00 02 8B 02
			15 00 00 00 01 00 02 8C 81
			15 00 00 00 01 00 02 8D 02
			15 00 00 00 01 00 02 8E A3
			15 00 00 00 01 00 02 8F 02
			15 00 00 00 01 00 02 90 A4
			15 00 00 00 01 00 02 91 02
			15 00 00 00 01 00 02 92 C9
			15 00 00 00 01 00 02 93 02
			15 00 00 00 01 00 02 94 F4
			15 00 00 00 01 00 02 95 03
			15 00 00 00 01 00 02 96 12
			15 00 00 00 01 00 02 97 03
			15 00 00 00 01 00 02 98 45
			15 00 00 00 01 00 02 99 03
			15 00 00 00 01 00 02 9A 5E
			15 00 00 00 01 00 02 9B 03
			15 00 00 00 01 00 02 9C 7F
			15 00 00 00 01 00 02 9D 03
			15 00 00 00 01 00 02 9E 89
			15 00 00 00 01 00 02 9F 03
			15 00 00 00 01 00 02 A0 94
			15 00 00 00 01 00 02 A2 03
			15 00 00 00 01 00 02 A3 A1
			15 00 00 00 01 00 02 A4 03
			15 00 00 00 01 00 02 A5 AF
			15 00 00 00 01 00 02 A6 03
			15 00 00 00 01 00 02 A7 BD
			15 00 00 00 01 00 02 A9 03
			15 00 00 00 01 00 02 AA C9
			15 00 00 00 01 00 02 AB 03
			15 00 00 00 01 00 02 AC CF
			15 00 00 00 01 00 02 AD 03
			15 00 00 00 01 00 02 AE D0
			15 00 00 00 01 00 02 AF 02
			15 00 00 00 01 00 02 B0 64
			15 00 00 00 01 00 02 B1 02
			15 00 00 00 01 00 02 B2 65
			15 00 00 00 01 00 02 B3 02
			15 00 00 00 01 00 02 B4 66
			15 00 00 00 01 00 02 B5 02
			15 00 00 00 01 00 02 B6 68
			15 00 00 00 01 00 02 B7 02
			15 00 00 00 01 00 02 B8 69
			15 00 00 00 01 00 02 B9 02
			15 00 00 00 01 00 02 BA 6B
			15 00 00 00 01 00 02 BB 02
			15 00 00 00 01 00 02 BC 6D
			15 00 00 00 01 00 02 BD 02
			15 00 00 00 01 00 02 BE 6E
			15 00 00 00 01 00 02 BF 02
			15 00 00 00 01 00 02 C0 70
			15 00 00 00 01 00 02 C1 02
			15 00 00 00 01 00 02 C2 76
			15 00 00 00 01 00 02 C3 02
			15 00 00 00 01 00 02 C4 7C
			15 00 00 00 01 00 02 C5 02
			15 00 00 00 01 00 02 C6 89
			15 00 00 00 01 00 02 C7 02
			15 00 00 00 01 00 02 C8 95
			15 00 00 00 01 00 02 C9 02
			15 00 00 00 01 00 02 CA AF
			15 00 00 00 01 00 02 CB 02
			15 00 00 00 01 00 02 CC CA
			15 00 00 00 01 00 02 CD 02
			15 00 00 00 01 00 02 CE CB
			15 00 00 00 01 00 02 CF 02
			15 00 00 00 01 00 02 D0 EA
			15 00 00 00 01 00 02 D1 03
			15 00 00 00 01 00 02 D2 14
			15 00 00 00 01 00 02 D3 03
			15 00 00 00 01 00 02 D4 3A
			15 00 00 00 01 00 02 D5 03
			15 00 00 00 01 00 02 D6 60
			15 00 00 00 01 00 02 D7 03
			15 00 00 00 01 00 02 D8 79
			15 00 00 00 01 00 02 D9 03
			15 00 00 00 01 00 02 DA 9A
			15 00 00 00 01 00 02 DB 03
			15 00 00 00 01 00 02 DC A3
			15 00 00 00 01 00 02 DD 03
			15 00 00 00 01 00 02 DE AD
			15 00 00 00 01 00 02 DF 03
			15 00 00 00 01 00 02 E0 B7
			15 00 00 00 01 00 02 E1 03
			15 00 00 00 01 00 02 E2 C0
			15 00 00 00 01 00 02 E3 03
			15 00 00 00 01 00 02 E4 C8
			15 00 00 00 01 00 02 E5 03
			15 00 00 00 01 00 02 E6 CD
			15 00 00 00 01 00 02 E7 03
			15 00 00 00 01 00 02 E8 D0
			15 00 00 00 01 00 02 E9 03
			15 00 00 00 01 00 02 EA F7
			15 00 00 00 01 00 02 FB 01
			15 01 00 00 01 00 02 FF 10
			];
		qcom,mdss-dsi-dispparam-papermode-state = "dsi_hs_mode";
		qcom,mdss-dsi-dispparam-papermode1-command = [
			15 00 00 00 01 00 02 FF 20
			15 00 00 00 01 00 02 FB 01
			15 00 00 00 01 00 02 75 00
			15 00 00 00 01 00 02 76 00
			15 00 00 00 01 00 02 77 00
			15 00 00 00 01 00 02 78 41
			15 00 00 00 01 00 02 79 00
			15 00 00 00 01 00 02 7A 80
			15 00 00 00 01 00 02 7B 00
			15 00 00 00 01 00 02 7C A7
			15 00 00 00 01 00 02 7D 00
			15 00 00 00 01 00 02 7E C6
			15 00 00 00 01 00 02 7F 00
			15 00 00 00 01 00 02 80 DD
			15 00 00 00 01 00 02 81 00
			15 00 00 00 01 00 02 82 F3
			15 00 00 00 01 00 02 83 01
			15 00 00 00 01 00 02 84 06
			15 00 00 00 01 00 02 85 01
			15 00 00 00 01 00 02 86 15
			15 00 00 00 01 00 02 87 01
			15 00 00 00 01 00 02 88 4B
			15 00 00 00 01 00 02 89 01
			15 00 00 00 01 00 02 8A 74
			15 00 00 00 01 00 02 8B 01
			15 00 00 00 01 00 02 8C B1
			15 00 00 00 01 00 02 8D 01
			15 00 00 00 01 00 02 8E E2
			15 00 00 00 01 00 02 8F 02
			15 00 00 00 01 00 02 90 28
			15 00 00 00 01 00 02 91 02
			15 00 00 00 01 00 02 92 5B
			15 00 00 00 01 00 02 93 02
			15 00 00 00 01 00 02 94 5C
			15 00 00 00 01 00 02 95 02
			15 00 00 00 01 00 02 96 8E
			15 00 00 00 01 00 02 97 02
			15 00 00 00 01 00 02 98 C8
			15 00 00 00 01 00 02 99 02
			15 00 00 00 01 00 02 9A EC
			15 00 00 00 01 00 02 9B 03
			15 00 00 00 01 00 02 9C 1B
			15 00 00 00 01 00 02 9D 03
			15 00 00 00 01 00 02 9E 39
			15 00 00 00 01 00 02 9F 03
			15 00 00 00 01 00 02 A0 5F
			15 00 00 00 01 00 02 A2 03
			15 00 00 00 01 00 02 A3 6B
			15 00 00 00 01 00 02 A4 03
			15 00 00 00 01 00 02 A5 78
			15 00 00 00 01 00 02 A6 03
			15 00 00 00 01 00 02 A7 86
			15 00 00 00 01 00 02 A9 03
			15 00 00 00 01 00 02 AA 95
			15 00 00 00 01 00 02 AB 03
			15 00 00 00 01 00 02 AC A8
			15 00 00 00 01 00 02 AD 03
			15 00 00 00 01 00 02 AE BA
			15 00 00 00 01 00 02 AF 03
			15 00 00 00 01 00 02 B0 CC
			15 00 00 00 01 00 02 B1 03
			15 00 00 00 01 00 02 B2 D0
			15 00 00 00 01 00 02 B3 00
			15 00 00 00 01 00 02 B4 4C
			15 00 00 00 01 00 02 B5 00
			15 00 00 00 01 00 02 B6 8D
			15 00 00 00 01 00 02 B7 00
			15 00 00 00 01 00 02 B8 CB
			15 00 00 00 01 00 02 B9 00
			15 00 00 00 01 00 02 BA F0
			15 00 00 00 01 00 02 BB 01
			15 00 00 00 01 00 02 BC 0D
			15 00 00 00 01 00 02 BD 01
			15 00 00 00 01 00 02 BE 24
			15 00 00 00 01 00 02 BF 01
			15 00 00 00 01 00 02 C0 38
			15 00 00 00 01 00 02 C1 01
			15 00 00 00 01 00 02 C2 49
			15 00 00 00 01 00 02 C3 01
			15 00 00 00 01 00 02 C4 58
			15 00 00 00 01 00 02 C5 01
			15 00 00 00 01 00 02 C6 88
			15 00 00 00 01 00 02 C7 01
			15 00 00 00 01 00 02 C8 AB
			15 00 00 00 01 00 02 C9 01
			15 00 00 00 01 00 02 CA DE
			15 00 00 00 01 00 02 CB 02
			15 00 00 00 01 00 02 CC 03
			15 00 00 00 01 00 02 CD 02
			15 00 00 00 01 00 02 CE 3B
			15 00 00 00 01 00 02 CF 02
			15 00 00 00 01 00 02 D0 6E
			15 00 00 00 01 00 02 D1 02
			15 00 00 00 01 00 02 D2 6F
			15 00 00 00 01 00 02 D3 02
			15 00 00 00 01 00 02 D4 A1
			15 00 00 00 01 00 02 D5 02
			15 00 00 00 01 00 02 D6 D7
			15 00 00 00 01 00 02 D7 02
			15 00 00 00 01 00 02 D8 F9
			15 00 00 00 01 00 02 D9 03
			15 00 00 00 01 00 02 DA 24
			15 00 00 00 01 00 02 DB 03
			15 00 00 00 01 00 02 DC 40
			15 00 00 00 01 00 02 DD 03
			15 00 00 00 01 00 02 DE 64
			15 00 00 00 01 00 02 DF 03
			15 00 00 00 01 00 02 E0 6F
			15 00 00 00 01 00 02 E1 03
			15 00 00 00 01 00 02 E2 7B
			15 00 00 00 01 00 02 E3 03
			15 00 00 00 01 00 02 E4 89
			15 00 00 00 01 00 02 E5 03
			15 00 00 00 01 00 02 E6 97
			15 00 00 00 01 00 02 E7 03
			15 00 00 00 01 00 02 E8 A9
			15 00 00 00 01 00 02 E9 03
			15 00 00 00 01 00 02 EA BB
			15 00 00 00 01 00 02 EB 03
			15 00 00 00 01 00 02 EC CD
			15 00 00 00 01 00 02 ED 03
			15 00 00 00 01 00 02 EE D0
			15 00 00 00 01 00 02 EF 00
			15 00 00 00 01 00 02 F0 00
			15 00 00 00 01 00 02 F1 00
			15 00 00 00 01 00 02 F2 41
			15 00 00 00 01 00 02 F3 00
			15 00 00 00 01 00 02 F4 80
			15 00 00 00 01 00 02 F5 00
			15 00 00 00 01 00 02 F6 A7
			15 00 00 00 01 00 02 F7 00
			15 00 00 00 01 00 02 F8 C6
			15 00 00 00 01 00 02 F9 00
			15 01 00 00 01 00 02 FA DD

			15 00 00 00 01 00 02 FF 21
			15 00 00 00 01 00 02 FB 01
			15 00 00 00 01 00 02 00 00
			15 00 00 00 01 00 02 01 F3
			15 00 00 00 01 00 02 02 01
			15 00 00 00 01 00 02 03 06
			15 00 00 00 01 00 02 04 01
			15 00 00 00 01 00 02 05 15
			15 00 00 00 01 00 02 06 01
			15 00 00 00 01 00 02 07 4B
			15 00 00 00 01 00 02 08 01
			15 00 00 00 01 00 02 09 74
			15 00 00 00 01 00 02 0A 01
			15 00 00 00 01 00 02 0B B1
			15 00 00 00 01 00 02 0C 01
			15 00 00 00 01 00 02 0D E2
			15 00 00 00 01 00 02 0E 02
			15 00 00 00 01 00 02 0F 28
			15 00 00 00 01 00 02 10 02
			15 00 00 00 01 00 02 11 5B
			15 00 00 00 01 00 02 12 02
			15 00 00 00 01 00 02 13 5C
			15 00 00 00 01 00 02 14 02
			15 00 00 00 01 00 02 15 8E
			15 00 00 00 01 00 02 16 02
			15 00 00 00 01 00 02 17 C8
			15 00 00 00 01 00 02 18 02
			15 00 00 00 01 00 02 19 EC
			15 00 00 00 01 00 02 1A 03
			15 00 00 00 01 00 02 1B 1B
			15 00 00 00 01 00 02 1C 03
			15 00 00 00 01 00 02 1D 39
			15 00 00 00 01 00 02 1E 03
			15 00 00 00 01 00 02 1F 5F
			15 00 00 00 01 00 02 20 03
			15 00 00 00 01 00 02 21 6B
			15 00 00 00 01 00 02 22 03
			15 00 00 00 01 00 02 23 78
			15 00 00 00 01 00 02 24 03
			15 00 00 00 01 00 02 25 86
			15 00 00 00 01 00 02 26 03
			15 00 00 00 01 00 02 27 95
			15 00 00 00 01 00 02 28 03
			15 00 00 00 01 00 02 29 A8
			15 00 00 00 01 00 02 2A 03
			15 00 00 00 01 00 02 2B BA
			15 00 00 00 01 00 02 2D 03
			15 00 00 00 01 00 02 2F CC
			15 00 00 00 01 00 02 30 03
			15 00 00 00 01 00 02 31 D0
			15 00 00 00 01 00 02 32 00
			15 00 00 00 01 00 02 33 4C
			15 00 00 00 01 00 02 34 00
			15 00 00 00 01 00 02 35 8D
			15 00 00 00 01 00 02 36 00
			15 00 00 00 01 00 02 37 CB
			15 00 00 00 01 00 02 38 00
			15 00 00 00 01 00 02 39 F0
			15 00 00 00 01 00 02 3A 01
			15 00 00 00 01 00 02 3B 0D
			15 00 00 00 01 00 02 3D 01
			15 00 00 00 01 00 02 3F 24
			15 00 00 00 01 00 02 40 01
			15 00 00 00 01 00 02 41 38
			15 00 00 00 01 00 02 42 01
			15 00 00 00 01 00 02 43 49
			15 00 00 00 01 00 02 44 01
			15 00 00 00 01 00 02 45 58
			15 00 00 00 01 00 02 46 01
			15 00 00 00 01 00 02 47 88
			15 00 00 00 01 00 02 48 01
			15 00 00 00 01 00 02 49 AB
			15 00 00 00 01 00 02 4A 01
			15 00 00 00 01 00 02 4B DE
			15 00 00 00 01 00 02 4C 02
			15 00 00 00 01 00 02 4D 03
			15 00 00 00 01 00 02 4E 02
			15 00 00 00 01 00 02 4F 3B
			15 00 00 00 01 00 02 50 02
			15 00 00 00 01 00 02 51 6E
			15 00 00 00 01 00 02 52 02
			15 00 00 00 01 00 02 53 6F
			15 00 00 00 01 00 02 54 02
			15 00 00 00 01 00 02 55 A1
			15 00 00 00 01 00 02 56 02
			15 00 00 00 01 00 02 58 D7
			15 00 00 00 01 00 02 59 02
			15 00 00 00 01 00 02 5A F9
			15 00 00 00 01 00 02 5B 03
			15 00 00 00 01 00 02 5C 24
			15 00 00 00 01 00 02 5D 03
			15 00 00 00 01 00 02 5E 40
			15 00 00 00 01 00 02 5F 03
			15 00 00 00 01 00 02 60 64
			15 00 00 00 01 00 02 61 03
			15 00 00 00 01 00 02 62 6F
			15 00 00 00 01 00 02 63 03
			15 00 00 00 01 00 02 64 7B
			15 00 00 00 01 00 02 65 03
			15 00 00 00 01 00 02 66 89
			15 00 00 00 01 00 02 67 03
			15 00 00 00 01 00 02 68 97
			15 00 00 00 01 00 02 69 03
			15 00 00 00 01 00 02 6A A9
			15 00 00 00 01 00 02 6B 03
			15 00 00 00 01 00 02 6C BB
			15 00 00 00 01 00 02 6D 03
			15 00 00 00 01 00 02 6E CD
			15 00 00 00 01 00 02 6F 03
			15 00 00 00 01 00 02 70 D0
			15 00 00 00 01 00 02 71 01
			15 00 00 00 01 00 02 72 00
			15 00 00 00 01 00 02 73 01
			15 00 00 00 01 00 02 74 0A
			15 00 00 00 01 00 02 75 01
			15 00 00 00 01 00 02 76 1D
			15 00 00 00 01 00 02 77 01
			15 00 00 00 01 00 02 78 2E
			15 00 00 00 01 00 02 79 01
			15 00 00 00 01 00 02 7A 3D
			15 00 00 00 01 00 02 7B 01
			15 00 00 00 01 00 02 7C 4A
			15 00 00 00 01 00 02 7D 01
			15 00 00 00 01 00 02 7E 57
			15 00 00 00 01 00 02 7F 01
			15 00 00 00 01 00 02 80 62
			15 00 00 00 01 00 02 81 01
			15 00 00 00 01 00 02 82 6D
			15 00 00 00 01 00 02 83 01
			15 00 00 00 01 00 02 84 92
			15 00 00 00 01 00 02 85 01
			15 00 00 00 01 00 02 86 B0
			15 00 00 00 01 00 02 87 01
			15 00 00 00 01 00 02 88 DE
			15 00 00 00 01 00 02 89 02
			15 00 00 00 01 00 02 8A 02
			15 00 00 00 01 00 02 8B 02
			15 00 00 00 01 00 02 8C 3B
			15 00 00 00 01 00 02 8D 02
			15 00 00 00 01 00 02 8E 6C
			15 00 00 00 01 00 02 8F 02
			15 00 00 00 01 00 02 90 6D
			15 00 00 00 01 00 02 91 02
			15 00 00 00 01 00 02 92 9D
			15 00 00 00 01 00 02 93 02
			15 00 00 00 01 00 02 94 D1
			15 00 00 00 01 00 02 95 02
			15 00 00 00 01 00 02 96 EF
			15 00 00 00 01 00 02 97 03
			15 00 00 00 01 00 02 98 23
			15 00 00 00 01 00 02 99 03
			15 00 00 00 01 00 02 9A 41
			15 00 00 00 01 00 02 9B 03
			15 00 00 00 01 00 02 9C 65
			15 00 00 00 01 00 02 9D 03
			15 00 00 00 01 00 02 9E 70
			15 00 00 00 01 00 02 9F 03
			15 00 00 00 01 00 02 A0 7D
			15 00 00 00 01 00 02 A2 03
			15 00 00 00 01 00 02 A3 8B
			15 00 00 00 01 00 02 A4 03
			15 00 00 00 01 00 02 A5 9B
			15 00 00 00 01 00 02 A6 03
			15 00 00 00 01 00 02 A7 AF
			15 00 00 00 01 00 02 A9 03
			15 00 00 00 01 00 02 AA C2
			15 00 00 00 01 00 02 AB 03
			15 00 00 00 01 00 02 AC CF
			15 00 00 00 01 00 02 AD 03
			15 00 00 00 01 00 02 AE D0
			15 00 00 00 01 00 02 AF 01
			15 00 00 00 01 00 02 B0 4C
			15 00 00 00 01 00 02 B1 01
			15 00 00 00 01 00 02 B2 52
			15 00 00 00 01 00 02 B3 01
			15 00 00 00 01 00 02 B4 5E
			15 00 00 00 01 00 02 B5 01
			15 00 00 00 01 00 02 B6 69
			15 00 00 00 01 00 02 B7 01
			15 00 00 00 01 00 02 B8 74
			15 00 00 00 01 00 02 B9 01
			15 00 00 00 01 00 02 BA 7D
			15 00 00 00 01 00 02 BB 01
			15 00 00 00 01 00 02 BC 86
			15 00 00 00 01 00 02 BD 01
			15 00 00 00 01 00 02 BE 8F
			15 00 00 00 01 00 02 BF 01
			15 00 00 00 01 00 02 C0 97
			15 00 00 00 01 00 02 C1 01
			15 00 00 00 01 00 02 C2 B4
			15 00 00 00 01 00 02 C3 01
			15 00 00 00 01 00 02 C4 CC
			15 00 00 00 01 00 02 C5 01
			15 00 00 00 01 00 02 C6 F2
			15 00 00 00 01 00 02 C7 02
			15 00 00 00 01 00 02 C8 12
			15 00 00 00 01 00 02 C9 02
			15 00 00 00 01 00 02 CA 46
			15 00 00 00 01 00 02 CB 02
			15 00 00 00 01 00 02 CC 74
			15 00 00 00 01 00 02 CD 02
			15 00 00 00 01 00 02 CE 76
			15 00 00 00 01 00 02 CF 02
			15 00 00 00 01 00 02 D0 A4
			15 00 00 00 01 00 02 D1 02
			15 00 00 00 01 00 02 D2 D6
			15 00 00 00 01 00 02 D3 02
			15 00 00 00 01 00 02 D4 F4
			15 00 00 00 01 00 02 D5 03
			15 00 00 00 01 00 02 D6 28
			15 00 00 00 01 00 02 D7 03
			15 00 00 00 01 00 02 D8 45
			15 00 00 00 01 00 02 D9 03
			15 00 00 00 01 00 02 DA 6B
			15 00 00 00 01 00 02 DB 03
			15 00 00 00 01 00 02 DC 76
			15 00 00 00 01 00 02 DD 03
			15 00 00 00 01 00 02 DE 84
			15 00 00 00 01 00 02 DF 03
			15 00 00 00 01 00 02 E0 93
			15 00 00 00 01 00 02 E1 03
			15 00 00 00 01 00 02 E2 A4
			15 00 00 00 01 00 02 E3 03
			15 00 00 00 01 00 02 E4 B6
			15 00 00 00 01 00 02 E5 03
			15 00 00 00 01 00 02 E6 C6
			15 00 00 00 01 00 02 E7 03
			15 00 00 00 01 00 02 E8 CF
			15 00 00 00 01 00 02 E9 03
			15 00 00 00 01 00 02 EA D0
			15 00 00 00 01 00 02 FB 01
			15 01 00 00 01 00 02 FF 10
			];
		qcom,mdss-dsi-dispparam-papermode1-state = "dsi_hs_mode";
		qcom,mdss-dsi-dispparam-papermode2-command = [
			15 00 00 00 01 00 02 FF 20
			15 00 00 00 01 00 02 FB 01
			15 00 00 00 01 00 02 75 00
			15 00 00 00 01 00 02 76 00
			15 00 00 00 01 00 02 77 00
			15 00 00 00 01 00 02 78 41
			15 00 00 00 01 00 02 79 00
			15 00 00 00 01 00 02 7A 80
			15 00 00 00 01 00 02 7B 00
			15 00 00 00 01 00 02 7C A7
			15 00 00 00 01 00 02 7D 00
			15 00 00 00 01 00 02 7E C6
			15 00 00 00 01 00 02 7F 00
			15 00 00 00 01 00 02 80 DD
			15 00 00 00 01 00 02 81 00
			15 00 00 00 01 00 02 82 F3
			15 00 00 00 01 00 02 83 01
			15 00 00 00 01 00 02 84 06
			15 00 00 00 01 00 02 85 01
			15 00 00 00 01 00 02 86 15
			15 00 00 00 01 00 02 87 01
			15 00 00 00 01 00 02 88 4B
			15 00 00 00 01 00 02 89 01
			15 00 00 00 01 00 02 8A 74
			15 00 00 00 01 00 02 8B 01
			15 00 00 00 01 00 02 8C B1
			15 00 00 00 01 00 02 8D 01
			15 00 00 00 01 00 02 8E E2
			15 00 00 00 01 00 02 8F 02
			15 00 00 00 01 00 02 90 28
			15 00 00 00 01 00 02 91 02
			15 00 00 00 01 00 02 92 5B
			15 00 00 00 01 00 02 93 02
			15 00 00 00 01 00 02 94 5C
			15 00 00 00 01 00 02 95 02
			15 00 00 00 01 00 02 96 8E
			15 00 00 00 01 00 02 97 02
			15 00 00 00 01 00 02 98 C8
			15 00 00 00 01 00 02 99 02
			15 00 00 00 01 00 02 9A EC
			15 00 00 00 01 00 02 9B 03
			15 00 00 00 01 00 02 9C 1B
			15 00 00 00 01 00 02 9D 03
			15 00 00 00 01 00 02 9E 39
			15 00 00 00 01 00 02 9F 03
			15 00 00 00 01 00 02 A0 5F
			15 00 00 00 01 00 02 A2 03
			15 00 00 00 01 00 02 A3 6B
			15 00 00 00 01 00 02 A4 03
			15 00 00 00 01 00 02 A5 78
			15 00 00 00 01 00 02 A6 03
			15 00 00 00 01 00 02 A7 86
			15 00 00 00 01 00 02 A9 03
			15 00 00 00 01 00 02 AA 95
			15 00 00 00 01 00 02 AB 03
			15 00 00 00 01 00 02 AC A8
			15 00 00 00 01 00 02 AD 03
			15 00 00 00 01 00 02 AE BA
			15 00 00 00 01 00 02 AF 03
			15 00 00 00 01 00 02 B0 CC
			15 00 00 00 01 00 02 B1 03
			15 00 00 00 01 00 02 B2 D0
			15 00 00 00 01 00 02 B3 00
			15 00 00 00 01 00 02 B4 4C
			15 00 00 00 01 00 02 B5 00
			15 00 00 00 01 00 02 B6 8D
			15 00 00 00 01 00 02 B7 00
			15 00 00 00 01 00 02 B8 CB
			15 00 00 00 01 00 02 B9 00
			15 00 00 00 01 00 02 BA F0
			15 00 00 00 01 00 02 BB 01
			15 00 00 00 01 00 02 BC 0D
			15 00 00 00 01 00 02 BD 01
			15 00 00 00 01 00 02 BE 24
			15 00 00 00 01 00 02 BF 01
			15 00 00 00 01 00 02 C0 38
			15 00 00 00 01 00 02 C1 01
			15 00 00 00 01 00 02 C2 49
			15 00 00 00 01 00 02 C3 01
			15 00 00 00 01 00 02 C4 58
			15 00 00 00 01 00 02 C5 01
			15 00 00 00 01 00 02 C6 88
			15 00 00 00 01 00 02 C7 01
			15 00 00 00 01 00 02 C8 AB
			15 00 00 00 01 00 02 C9 01
			15 00 00 00 01 00 02 CA DE
			15 00 00 00 01 00 02 CB 02
			15 00 00 00 01 00 02 CC 03
			15 00 00 00 01 00 02 CD 02
			15 00 00 00 01 00 02 CE 3B
			15 00 00 00 01 00 02 CF 02
			15 00 00 00 01 00 02 D0 6E
			15 00 00 00 01 00 02 D1 02
			15 00 00 00 01 00 02 D2 6F
			15 00 00 00 01 00 02 D3 02
			15 00 00 00 01 00 02 D4 A1
			15 00 00 00 01 00 02 D5 02
			15 00 00 00 01 00 02 D6 D7
			15 00 00 00 01 00 02 D7 02
			15 00 00 00 01 00 02 D8 F9
			15 00 00 00 01 00 02 D9 03
			15 00 00 00 01 00 02 DA 24
			15 00 00 00 01 00 02 DB 03
			15 00 00 00 01 00 02 DC 40
			15 00 00 00 01 00 02 DD 03
			15 00 00 00 01 00 02 DE 64
			15 00 00 00 01 00 02 DF 03
			15 00 00 00 01 00 02 E0 6F
			15 00 00 00 01 00 02 E1 03
			15 00 00 00 01 00 02 E2 7B
			15 00 00 00 01 00 02 E3 03
			15 00 00 00 01 00 02 E4 89
			15 00 00 00 01 00 02 E5 03
			15 00 00 00 01 00 02 E6 97
			15 00 00 00 01 00 02 E7 03
			15 00 00 00 01 00 02 E8 A9
			15 00 00 00 01 00 02 E9 03
			15 00 00 00 01 00 02 EA BB
			15 00 00 00 01 00 02 EB 03
			15 00 00 00 01 00 02 EC CD
			15 00 00 00 01 00 02 ED 03
			15 00 00 00 01 00 02 EE D0
			15 00 00 00 01 00 02 EF 00
			15 00 00 00 01 00 02 F0 00
			15 00 00 00 01 00 02 F1 00
			15 00 00 00 01 00 02 F2 41
			15 00 00 00 01 00 02 F3 00
			15 00 00 00 01 00 02 F4 80
			15 00 00 00 01 00 02 F5 00
			15 00 00 00 01 00 02 F6 A7
			15 00 00 00 01 00 02 F7 00
			15 00 00 00 01 00 02 F8 C6
			15 00 00 00 01 00 02 F9 00
			15 01 00 00 01 00 02 FA DD

			15 00 00 00 01 00 02 FF 21
			15 00 00 00 01 00 02 FB 01
			15 00 00 00 01 00 02 00 00
			15 00 00 00 01 00 02 01 F3
			15 00 00 00 01 00 02 02 01
			15 00 00 00 01 00 02 03 06
			15 00 00 00 01 00 02 04 01
			15 00 00 00 01 00 02 05 15
			15 00 00 00 01 00 02 06 01
			15 00 00 00 01 00 02 07 4B
			15 00 00 00 01 00 02 08 01
			15 00 00 00 01 00 02 09 74
			15 00 00 00 01 00 02 0A 01
			15 00 00 00 01 00 02 0B B1
			15 00 00 00 01 00 02 0C 01
			15 00 00 00 01 00 02 0D E2
			15 00 00 00 01 00 02 0E 02
			15 00 00 00 01 00 02 0F 28
			15 00 00 00 01 00 02 10 02
			15 00 00 00 01 00 02 11 5B
			15 00 00 00 01 00 02 12 02
			15 00 00 00 01 00 02 13 5C
			15 00 00 00 01 00 02 14 02
			15 00 00 00 01 00 02 15 8E
			15 00 00 00 01 00 02 16 02
			15 00 00 00 01 00 02 17 C8
			15 00 00 00 01 00 02 18 02
			15 00 00 00 01 00 02 19 EC
			15 00 00 00 01 00 02 1A 03
			15 00 00 00 01 00 02 1B 1B
			15 00 00 00 01 00 02 1C 03
			15 00 00 00 01 00 02 1D 39
			15 00 00 00 01 00 02 1E 03
			15 00 00 00 01 00 02 1F 5F
			15 00 00 00 01 00 02 20 03
			15 00 00 00 01 00 02 21 6B
			15 00 00 00 01 00 02 22 03
			15 00 00 00 01 00 02 23 78
			15 00 00 00 01 00 02 24 03
			15 00 00 00 01 00 02 25 86
			15 00 00 00 01 00 02 26 03
			15 00 00 00 01 00 02 27 95
			15 00 00 00 01 00 02 28 03
			15 00 00 00 01 00 02 29 A8
			15 00 00 00 01 00 02 2A 03
			15 00 00 00 01 00 02 2B BA
			15 00 00 00 01 00 02 2D 03
			15 00 00 00 01 00 02 2F CC
			15 00 00 00 01 00 02 30 03
			15 00 00 00 01 00 02 31 D0
			15 00 00 00 01 00 02 32 00
			15 00 00 00 01 00 02 33 4C
			15 00 00 00 01 00 02 34 00
			15 00 00 00 01 00 02 35 8D
			15 00 00 00 01 00 02 36 00
			15 00 00 00 01 00 02 37 CB
			15 00 00 00 01 00 02 38 00
			15 00 00 00 01 00 02 39 F0
			15 00 00 00 01 00 02 3A 01
			15 00 00 00 01 00 02 3B 0D
			15 00 00 00 01 00 02 3D 01
			15 00 00 00 01 00 02 3F 24
			15 00 00 00 01 00 02 40 01
			15 00 00 00 01 00 02 41 38
			15 00 00 00 01 00 02 42 01
			15 00 00 00 01 00 02 43 49
			15 00 00 00 01 00 02 44 01
			15 00 00 00 01 00 02 45 58
			15 00 00 00 01 00 02 46 01
			15 00 00 00 01 00 02 47 88
			15 00 00 00 01 00 02 48 01
			15 00 00 00 01 00 02 49 AB
			15 00 00 00 01 00 02 4A 01
			15 00 00 00 01 00 02 4B DE
			15 00 00 00 01 00 02 4C 02
			15 00 00 00 01 00 02 4D 03
			15 00 00 00 01 00 02 4E 02
			15 00 00 00 01 00 02 4F 3B
			15 00 00 00 01 00 02 50 02
			15 00 00 00 01 00 02 51 6E
			15 00 00 00 01 00 02 52 02
			15 00 00 00 01 00 02 53 6F
			15 00 00 00 01 00 02 54 02
			15 00 00 00 01 00 02 55 A1
			15 00 00 00 01 00 02 56 02
			15 00 00 00 01 00 02 58 D7
			15 00 00 00 01 00 02 59 02
			15 00 00 00 01 00 02 5A F9
			15 00 00 00 01 00 02 5B 03
			15 00 00 00 01 00 02 5C 24
			15 00 00 00 01 00 02 5D 03
			15 00 00 00 01 00 02 5E 40
			15 00 00 00 01 00 02 5F 03
			15 00 00 00 01 00 02 60 64
			15 00 00 00 01 00 02 61 03
			15 00 00 00 01 00 02 62 6F
			15 00 00 00 01 00 02 63 03
			15 00 00 00 01 00 02 64 7B
			15 00 00 00 01 00 02 65 03
			15 00 00 00 01 00 02 66 89
			15 00 00 00 01 00 02 67 03
			15 00 00 00 01 00 02 68 97
			15 00 00 00 01 00 02 69 03
			15 00 00 00 01 00 02 6A A9
			15 00 00 00 01 00 02 6B 03
			15 00 00 00 01 00 02 6C BB
			15 00 00 00 01 00 02 6D 03
			15 00 00 00 01 00 02 6E CD
			15 00 00 00 01 00 02 6F 03
			15 00 00 00 01 00 02 70 D0
			15 00 00 00 01 00 02 71 01
			15 00 00 00 01 00 02 72 54
			15 00 00 00 01 00 02 73 01
			15 00 00 00 01 00 02 74 5A
			15 00 00 00 01 00 02 75 01
			15 00 00 00 01 00 02 76 65
			15 00 00 00 01 00 02 77 01
			15 00 00 00 01 00 02 78 6F
			15 00 00 00 01 00 02 79 01
			15 00 00 00 01 00 02 7A 78
			15 00 00 00 01 00 02 7B 01
			15 00 00 00 01 00 02 7C 81
			15 00 00 00 01 00 02 7D 01
			15 00 00 00 01 00 02 7E 8A
			15 00 00 00 01 00 02 7F 01
			15 00 00 00 01 00 02 80 92
			15 00 00 00 01 00 02 81 01
			15 00 00 00 01 00 02 82 9A
			15 00 00 00 01 00 02 83 01
			15 00 00 00 01 00 02 84 B5
			15 00 00 00 01 00 02 85 01
			15 00 00 00 01 00 02 86 CC
			15 00 00 00 01 00 02 87 01
			15 00 00 00 01 00 02 88 F2
			15 00 00 00 01 00 02 89 02
			15 00 00 00 01 00 02 8A 12
			15 00 00 00 01 00 02 8B 02
			15 00 00 00 01 00 02 8C 45
			15 00 00 00 01 00 02 8D 02
			15 00 00 00 01 00 02 8E 73
			15 00 00 00 01 00 02 8F 02
			15 00 00 00 01 00 02 90 75
			15 00 00 00 01 00 02 91 02
			15 00 00 00 01 00 02 92 A3
			15 00 00 00 01 00 02 93 02
			15 00 00 00 01 00 02 94 D5
			15 00 00 00 01 00 02 95 02
			15 00 00 00 01 00 02 96 F3
			15 00 00 00 01 00 02 97 03
			15 00 00 00 01 00 02 98 1F
			15 00 00 00 01 00 02 99 03
			15 00 00 00 01 00 02 9A 44
			15 00 00 00 01 00 02 9B 03
			15 00 00 00 01 00 02 9C 68
			15 00 00 00 01 00 02 9D 03
			15 00 00 00 01 00 02 9E 73
			15 00 00 00 01 00 02 9F 03
			15 00 00 00 01 00 02 A0 80
			15 00 00 00 01 00 02 A2 03
			15 00 00 00 01 00 02 A3 8E
			15 00 00 00 01 00 02 A4 03
			15 00 00 00 01 00 02 A5 9E
			15 00 00 00 01 00 02 A6 03
			15 00 00 00 01 00 02 A7 B1
			15 00 00 00 01 00 02 A9 03
			15 00 00 00 01 00 02 AA C3
			15 00 00 00 01 00 02 AB 03
			15 00 00 00 01 00 02 AC CF
			15 00 00 00 01 00 02 AD 03
			15 00 00 00 01 00 02 AE D0
			15 00 00 00 01 00 02 AF 01
			15 00 00 00 01 00 02 B0 A0
			15 00 00 00 01 00 02 B1 01
			15 00 00 00 01 00 02 B2 A3
			15 00 00 00 01 00 02 B3 01
			15 00 00 00 01 00 02 B4 AA
			15 00 00 00 01 00 02 B5 01
			15 00 00 00 01 00 02 B6 B0
			15 00 00 00 01 00 02 B7 01
			15 00 00 00 01 00 02 B8 B6
			15 00 00 00 01 00 02 B9 01
			15 00 00 00 01 00 02 BA BC
			15 00 00 00 01 00 02 BB 01
			15 00 00 00 01 00 02 BC C2
			15 00 00 00 01 00 02 BD 01
			15 00 00 00 01 00 02 BE C7
			15 00 00 00 01 00 02 BF 01
			15 00 00 00 01 00 02 C0 CD
			15 00 00 00 01 00 02 C1 01
			15 00 00 00 01 00 02 C2 E0
			15 00 00 00 01 00 02 C3 01
			15 00 00 00 01 00 02 C4 F0
			15 00 00 00 01 00 02 C5 02
			15 00 00 00 01 00 02 C6 0F
			15 00 00 00 01 00 02 C7 02
			15 00 00 00 01 00 02 C8 29
			15 00 00 00 01 00 02 C9 02
			15 00 00 00 01 00 02 CA 56
			15 00 00 00 01 00 02 CB 02
			15 00 00 00 01 00 02 CC 81
			15 00 00 00 01 00 02 CD 02
			15 00 00 00 01 00 02 CE 82
			15 00 00 00 01 00 02 CF 02
			15 00 00 00 01 00 02 D0 AD
			15 00 00 00 01 00 02 D1 02
			15 00 00 00 01 00 02 D2 DE
			15 00 00 00 01 00 02 D3 02
			15 00 00 00 01 00 02 D4 FB
			15 00 00 00 01 00 02 D5 03
			15 00 00 00 01 00 02 D6 2F
			15 00 00 00 01 00 02 D7 03
			15 00 00 00 01 00 02 D8 4B
			15 00 00 00 01 00 02 D9 03
			15 00 00 00 01 00 02 DA 70
			15 00 00 00 01 00 02 DB 03
			15 00 00 00 01 00 02 DC 7C
			15 00 00 00 01 00 02 DD 03
			15 00 00 00 01 00 02 DE 89
			15 00 00 00 01 00 02 DF 03
			15 00 00 00 01 00 02 E0 98
			15 00 00 00 01 00 02 E1 03
			15 00 00 00 01 00 02 E2 A9
			15 00 00 00 01 00 02 E3 03
			15 00 00 00 01 00 02 E4 B9
			15 00 00 00 01 00 02 E5 03
			15 00 00 00 01 00 02 E6 C7
			15 00 00 00 01 00 02 E7 03
			15 00 00 00 01 00 02 E8 CF
			15 00 00 00 01 00 02 E9 03
			15 00 00 00 01 00 02 EA D0
			15 00 00 00 01 00 02 FB 01
			15 01 00 00 01 00 02 FF 10
			];
		qcom,mdss-dsi-dispparam-papermode2-state = "dsi_hs_mode";
		qcom,mdss-dsi-dispparam-papermode3-command = [
			15 00 00 00 01 00 02 FF 20
			15 00 00 00 01 00 02 FB 01
			15 00 00 00 01 00 02 75 00
			15 00 00 00 01 00 02 76 00
			15 00 00 00 01 00 02 77 00
			15 00 00 00 01 00 02 78 41
			15 00 00 00 01 00 02 79 00
			15 00 00 00 01 00 02 7A 80
			15 00 00 00 01 00 02 7B 00
			15 00 00 00 01 00 02 7C A7
			15 00 00 00 01 00 02 7D 00
			15 00 00 00 01 00 02 7E C6
			15 00 00 00 01 00 02 7F 00
			15 00 00 00 01 00 02 80 DD
			15 00 00 00 01 00 02 81 00
			15 00 00 00 01 00 02 82 F3
			15 00 00 00 01 00 02 83 01
			15 00 00 00 01 00 02 84 06
			15 00 00 00 01 00 02 85 01
			15 00 00 00 01 00 02 86 15
			15 00 00 00 01 00 02 87 01
			15 00 00 00 01 00 02 88 4B
			15 00 00 00 01 00 02 89 01
			15 00 00 00 01 00 02 8A 74
			15 00 00 00 01 00 02 8B 01
			15 00 00 00 01 00 02 8C B1
			15 00 00 00 01 00 02 8D 01
			15 00 00 00 01 00 02 8E E2
			15 00 00 00 01 00 02 8F 02
			15 00 00 00 01 00 02 90 28
			15 00 00 00 01 00 02 91 02
			15 00 00 00 01 00 02 92 5B
			15 00 00 00 01 00 02 93 02
			15 00 00 00 01 00 02 94 5C
			15 00 00 00 01 00 02 95 02
			15 00 00 00 01 00 02 96 8E
			15 00 00 00 01 00 02 97 02
			15 00 00 00 01 00 02 98 C8
			15 00 00 00 01 00 02 99 02
			15 00 00 00 01 00 02 9A EC
			15 00 00 00 01 00 02 9B 03
			15 00 00 00 01 00 02 9C 1B
			15 00 00 00 01 00 02 9D 03
			15 00 00 00 01 00 02 9E 39
			15 00 00 00 01 00 02 9F 03
			15 00 00 00 01 00 02 A0 5F
			15 00 00 00 01 00 02 A2 03
			15 00 00 00 01 00 02 A3 6B
			15 00 00 00 01 00 02 A4 03
			15 00 00 00 01 00 02 A5 78
			15 00 00 00 01 00 02 A6 03
			15 00 00 00 01 00 02 A7 86
			15 00 00 00 01 00 02 A9 03
			15 00 00 00 01 00 02 AA 95
			15 00 00 00 01 00 02 AB 03
			15 00 00 00 01 00 02 AC A8
			15 00 00 00 01 00 02 AD 03
			15 00 00 00 01 00 02 AE BA
			15 00 00 00 01 00 02 AF 03
			15 00 00 00 01 00 02 B0 CC
			15 00 00 00 01 00 02 B1 03
			15 00 00 00 01 00 02 B2 D0
			15 00 00 00 01 00 02 B3 00
			15 00 00 00 01 00 02 B4 4C
			15 00 00 00 01 00 02 B5 00
			15 00 00 00 01 00 02 B6 8D
			15 00 00 00 01 00 02 B7 00
			15 00 00 00 01 00 02 B8 CB
			15 00 00 00 01 00 02 B9 00
			15 00 00 00 01 00 02 BA F0
			15 00 00 00 01 00 02 BB 01
			15 00 00 00 01 00 02 BC 0D
			15 00 00 00 01 00 02 BD 01
			15 00 00 00 01 00 02 BE 24
			15 00 00 00 01 00 02 BF 01
			15 00 00 00 01 00 02 C0 38
			15 00 00 00 01 00 02 C1 01
			15 00 00 00 01 00 02 C2 49
			15 00 00 00 01 00 02 C3 01
			15 00 00 00 01 00 02 C4 58
			15 00 00 00 01 00 02 C5 01
			15 00 00 00 01 00 02 C6 88
			15 00 00 00 01 00 02 C7 01
			15 00 00 00 01 00 02 C8 AB
			15 00 00 00 01 00 02 C9 01
			15 00 00 00 01 00 02 CA DE
			15 00 00 00 01 00 02 CB 02
			15 00 00 00 01 00 02 CC 03
			15 00 00 00 01 00 02 CD 02
			15 00 00 00 01 00 02 CE 3B
			15 00 00 00 01 00 02 CF 02
			15 00 00 00 01 00 02 D0 6E
			15 00 00 00 01 00 02 D1 02
			15 00 00 00 01 00 02 D2 6F
			15 00 00 00 01 00 02 D3 02
			15 00 00 00 01 00 02 D4 A1
			15 00 00 00 01 00 02 D5 02
			15 00 00 00 01 00 02 D6 D7
			15 00 00 00 01 00 02 D7 02
			15 00 00 00 01 00 02 D8 F9
			15 00 00 00 01 00 02 D9 03
			15 00 00 00 01 00 02 DA 24
			15 00 00 00 01 00 02 DB 03
			15 00 00 00 01 00 02 DC 40
			15 00 00 00 01 00 02 DD 03
			15 00 00 00 01 00 02 DE 64
			15 00 00 00 01 00 02 DF 03
			15 00 00 00 01 00 02 E0 6F
			15 00 00 00 01 00 02 E1 03
			15 00 00 00 01 00 02 E2 7B
			15 00 00 00 01 00 02 E3 03
			15 00 00 00 01 00 02 E4 89
			15 00 00 00 01 00 02 E5 03
			15 00 00 00 01 00 02 E6 97
			15 00 00 00 01 00 02 E7 03
			15 00 00 00 01 00 02 E8 A9
			15 00 00 00 01 00 02 E9 03
			15 00 00 00 01 00 02 EA BB
			15 00 00 00 01 00 02 EB 03
			15 00 00 00 01 00 02 EC CD
			15 00 00 00 01 00 02 ED 03
			15 00 00 00 01 00 02 EE D0
			15 00 00 00 01 00 02 EF 00
			15 00 00 00 01 00 02 F0 00
			15 00 00 00 01 00 02 F1 00
			15 00 00 00 01 00 02 F2 41
			15 00 00 00 01 00 02 F3 00
			15 00 00 00 01 00 02 F4 80
			15 00 00 00 01 00 02 F5 00
			15 00 00 00 01 00 02 F6 A7
			15 00 00 00 01 00 02 F7 00
			15 00 00 00 01 00 02 F8 C6
			15 00 00 00 01 00 02 F9 00
			15 01 00 00 01 00 02 FA DD

			15 00 00 00 01 00 02 FF 21
			15 00 00 00 01 00 02 FB 01
			15 00 00 00 01 00 02 00 00
			15 00 00 00 01 00 02 01 F3
			15 00 00 00 01 00 02 02 01
			15 00 00 00 01 00 02 03 06
			15 00 00 00 01 00 02 04 01
			15 00 00 00 01 00 02 05 15
			15 00 00 00 01 00 02 06 01
			15 00 00 00 01 00 02 07 4B
			15 00 00 00 01 00 02 08 01
			15 00 00 00 01 00 02 09 74
			15 00 00 00 01 00 02 0A 01
			15 00 00 00 01 00 02 0B B1
			15 00 00 00 01 00 02 0C 01
			15 00 00 00 01 00 02 0D E2
			15 00 00 00 01 00 02 0E 02
			15 00 00 00 01 00 02 0F 28
			15 00 00 00 01 00 02 10 02
			15 00 00 00 01 00 02 11 5B
			15 00 00 00 01 00 02 12 02
			15 00 00 00 01 00 02 13 5C
			15 00 00 00 01 00 02 14 02
			15 00 00 00 01 00 02 15 8E
			15 00 00 00 01 00 02 16 02
			15 00 00 00 01 00 02 17 C8
			15 00 00 00 01 00 02 18 02
			15 00 00 00 01 00 02 19 EC
			15 00 00 00 01 00 02 1A 03
			15 00 00 00 01 00 02 1B 1B
			15 00 00 00 01 00 02 1C 03
			15 00 00 00 01 00 02 1D 39
			15 00 00 00 01 00 02 1E 03
			15 00 00 00 01 00 02 1F 5F
			15 00 00 00 01 00 02 20 03
			15 00 00 00 01 00 02 21 6B
			15 00 00 00 01 00 02 22 03
			15 00 00 00 01 00 02 23 78
			15 00 00 00 01 00 02 24 03
			15 00 00 00 01 00 02 25 86
			15 00 00 00 01 00 02 26 03
			15 00 00 00 01 00 02 27 95
			15 00 00 00 01 00 02 28 03
			15 00 00 00 01 00 02 29 A8
			15 00 00 00 01 00 02 2A 03
			15 00 00 00 01 00 02 2B BA
			15 00 00 00 01 00 02 2D 03
			15 00 00 00 01 00 02 2F CC
			15 00 00 00 01 00 02 30 03
			15 00 00 00 01 00 02 31 D0
			15 00 00 00 01 00 02 32 00
			15 00 00 00 01 00 02 33 4C
			15 00 00 00 01 00 02 34 00
			15 00 00 00 01 00 02 35 8D
			15 00 00 00 01 00 02 36 00
			15 00 00 00 01 00 02 37 CB
			15 00 00 00 01 00 02 38 00
			15 00 00 00 01 00 02 39 F0
			15 00 00 00 01 00 02 3A 01
			15 00 00 00 01 00 02 3B 0D
			15 00 00 00 01 00 02 3D 01
			15 00 00 00 01 00 02 3F 24
			15 00 00 00 01 00 02 40 01
			15 00 00 00 01 00 02 41 38
			15 00 00 00 01 00 02 42 01
			15 00 00 00 01 00 02 43 49
			15 00 00 00 01 00 02 44 01
			15 00 00 00 01 00 02 45 58
			15 00 00 00 01 00 02 46 01
			15 00 00 00 01 00 02 47 88
			15 00 00 00 01 00 02 48 01
			15 00 00 00 01 00 02 49 AB
			15 00 00 00 01 00 02 4A 01
			15 00 00 00 01 00 02 4B DE
			15 00 00 00 01 00 02 4C 02
			15 00 00 00 01 00 02 4D 03
			15 00 00 00 01 00 02 4E 02
			15 00 00 00 01 00 02 4F 3B
			15 00 00 00 01 00 02 50 02
			15 00 00 00 01 00 02 51 6E
			15 00 00 00 01 00 02 52 02
			15 00 00 00 01 00 02 53 6F
			15 00 00 00 01 00 02 54 02
			15 00 00 00 01 00 02 55 A1
			15 00 00 00 01 00 02 56 02
			15 00 00 00 01 00 02 58 D7
			15 00 00 00 01 00 02 59 02
			15 00 00 00 01 00 02 5A F9
			15 00 00 00 01 00 02 5B 03
			15 00 00 00 01 00 02 5C 24
			15 00 00 00 01 00 02 5D 03
			15 00 00 00 01 00 02 5E 40
			15 00 00 00 01 00 02 5F 03
			15 00 00 00 01 00 02 60 64
			15 00 00 00 01 00 02 61 03
			15 00 00 00 01 00 02 62 6F
			15 00 00 00 01 00 02 63 03
			15 00 00 00 01 00 02 64 7B
			15 00 00 00 01 00 02 65 03
			15 00 00 00 01 00 02 66 89
			15 00 00 00 01 00 02 67 03
			15 00 00 00 01 00 02 68 97
			15 00 00 00 01 00 02 69 03
			15 00 00 00 01 00 02 6A A9
			15 00 00 00 01 00 02 6B 03
			15 00 00 00 01 00 02 6C BB
			15 00 00 00 01 00 02 6D 03
			15 00 00 00 01 00 02 6E CD
			15 00 00 00 01 00 02 6F 03
			15 00 00 00 01 00 02 70 D0
			15 00 00 00 01 00 02 71 01
			15 00 00 00 01 00 02 72 86
			15 00 00 00 01 00 02 73 01
			15 00 00 00 01 00 02 74 8A
			15 00 00 00 01 00 02 75 01
			15 00 00 00 01 00 02 76 92
			15 00 00 00 01 00 02 77 01
			15 00 00 00 01 00 02 78 99
			15 00 00 00 01 00 02 79 01
			15 00 00 00 01 00 02 7A A0
			15 00 00 00 01 00 02 7B 01
			15 00 00 00 01 00 02 7C A7
			15 00 00 00 01 00 02 7D 01
			15 00 00 00 01 00 02 7E AD
			15 00 00 00 01 00 02 7F 01
			15 00 00 00 01 00 02 80 B4
			15 00 00 00 01 00 02 81 01
			15 00 00 00 01 00 02 82 BA
			15 00 00 00 01 00 02 83 01
			15 00 00 00 01 00 02 84 CF
			15 00 00 00 01 00 02 85 01
			15 00 00 00 01 00 02 86 E2
			15 00 00 00 01 00 02 87 02
			15 00 00 00 01 00 02 88 03
			15 00 00 00 01 00 02 89 02
			15 00 00 00 01 00 02 8A 1F
			15 00 00 00 01 00 02 8B 02
			15 00 00 00 01 00 02 8C 4F
			15 00 00 00 01 00 02 8D 02
			15 00 00 00 01 00 02 8E 7B
			15 00 00 00 01 00 02 8F 02
			15 00 00 00 01 00 02 90 7C
			15 00 00 00 01 00 02 91 02
			15 00 00 00 01 00 02 92 A8
			15 00 00 00 01 00 02 93 02
			15 00 00 00 01 00 02 94 D9
			15 00 00 00 01 00 02 95 02
			15 00 00 00 01 00 02 96 F7
			15 00 00 00 01 00 02 97 03
			15 00 00 00 01 00 02 98 2C
			15 00 00 00 01 00 02 99 03
			15 00 00 00 01 00 02 9A 48
			15 00 00 00 01 00 02 9B 03
			15 00 00 00 01 00 02 9C 6C
			15 00 00 00 01 00 02 9D 03
			15 00 00 00 01 00 02 9E 76
			15 00 00 00 01 00 02 9F 03
			15 00 00 00 01 00 02 A0 82
			15 00 00 00 01 00 02 A2 03
			15 00 00 00 01 00 02 A3 90
			15 00 00 00 01 00 02 A4 03
			15 00 00 00 01 00 02 A5 A0
			15 00 00 00 01 00 02 A6 03
			15 00 00 00 01 00 02 A7 B3
			15 00 00 00 01 00 02 A9 03
			15 00 00 00 01 00 02 AA C4
			15 00 00 00 01 00 02 AB 03
			15 00 00 00 01 00 02 AC CF
			15 00 00 00 01 00 02 AD 03
			15 00 00 00 01 00 02 AE D0
			15 00 00 00 01 00 02 AF 01
			15 00 00 00 01 00 02 B0 D2
			15 00 00 00 01 00 02 B1 01
			15 00 00 00 01 00 02 B2 D4
			15 00 00 00 01 00 02 B3 01
			15 00 00 00 01 00 02 B4 D9
			15 00 00 00 01 00 02 B5 01
			15 00 00 00 01 00 02 B6 DD
			15 00 00 00 01 00 02 B7 01
			15 00 00 00 01 00 02 B8 E1
			15 00 00 00 01 00 02 B9 01
			15 00 00 00 01 00 02 BA E5
			15 00 00 00 01 00 02 BB 01
			15 00 00 00 01 00 02 BC E9
			15 00 00 00 01 00 02 BD 01
			15 00 00 00 01 00 02 BE ED
			15 00 00 00 01 00 02 BF 01
			15 00 00 00 01 00 02 C0 F1
			15 00 00 00 01 00 02 C1 02
			15 00 00 00 01 00 02 C2 00
			15 00 00 00 01 00 02 C3 02
			15 00 00 00 01 00 02 C4 0D
			15 00 00 00 01 00 02 C5 02
			15 00 00 00 01 00 02 C6 26
			15 00 00 00 01 00 02 C7 02
			15 00 00 00 01 00 02 C8 3C
			15 00 00 00 01 00 02 C9 02
			15 00 00 00 01 00 02 CA 64
			15 00 00 00 01 00 02 CB 02
			15 00 00 00 01 00 02 CC 8C
			15 00 00 00 01 00 02 CD 02
			15 00 00 00 01 00 02 CE 8D
			15 00 00 00 01 00 02 CF 02
			15 00 00 00 01 00 02 D0 B7
			15 00 00 00 01 00 02 D1 02
			15 00 00 00 01 00 02 D2 E5
			15 00 00 00 01 00 02 D3 03
			15 00 00 00 01 00 02 D4 02
			15 00 00 00 01 00 02 D5 03
			15 00 00 00 01 00 02 D6 36
			15 00 00 00 01 00 02 D7 03
			15 00 00 00 01 00 02 D8 52
			15 00 00 00 01 00 02 D9 03
			15 00 00 00 01 00 02 DA 76
			15 00 00 00 01 00 02 DB 03
			15 00 00 00 01 00 02 DC 81
			15 00 00 00 01 00 02 DD 03
			15 00 00 00 01 00 02 DE 8E
			15 00 00 00 01 00 02 DF 03
			15 00 00 00 01 00 02 E0 9D
			15 00 00 00 01 00 02 E1 03
			15 00 00 00 01 00 02 E2 AD
			15 00 00 00 01 00 02 E3 03
			15 00 00 00 01 00 02 E4 BC
			15 00 00 00 01 00 02 E5 03
			15 00 00 00 01 00 02 E6 C8
			15 00 00 00 01 00 02 E7 03
			15 00 00 00 01 00 02 E8 F7
			15 00 00 00 01 00 02 E9 03
			15 00 00 00 01 00 02 EA F8
			15 00 00 00 01 00 02 FB 01
			15 01 00 00 01 00 02 FF 10
			];
		qcom,mdss-dsi-dispparam-papermode3-state = "dsi_hs_mode";
		qcom,mdss-dsi-dispparam-papermode4-command = [
			15 00 00 00 01 00 02 FF 20
			15 00 00 00 01 00 02 FB 01
			15 00 00 00 01 00 02 75 00
			15 00 00 00 01 00 02 76 00
			15 00 00 00 01 00 02 77 00
			15 00 00 00 01 00 02 78 41
			15 00 00 00 01 00 02 79 00
			15 00 00 00 01 00 02 7A 80
			15 00 00 00 01 00 02 7B 00
			15 00 00 00 01 00 02 7C A7
			15 00 00 00 01 00 02 7D 00
			15 00 00 00 01 00 02 7E C6
			15 00 00 00 01 00 02 7F 00
			15 00 00 00 01 00 02 80 DD
			15 00 00 00 01 00 02 81 00
			15 00 00 00 01 00 02 82 F3
			15 00 00 00 01 00 02 83 01
			15 00 00 00 01 00 02 84 06
			15 00 00 00 01 00 02 85 01
			15 00 00 00 01 00 02 86 15
			15 00 00 00 01 00 02 87 01
			15 00 00 00 01 00 02 88 4B
			15 00 00 00 01 00 02 89 01
			15 00 00 00 01 00 02 8A 74
			15 00 00 00 01 00 02 8B 01
			15 00 00 00 01 00 02 8C B1
			15 00 00 00 01 00 02 8D 01
			15 00 00 00 01 00 02 8E E2
			15 00 00 00 01 00 02 8F 02
			15 00 00 00 01 00 02 90 28
			15 00 00 00 01 00 02 91 02
			15 00 00 00 01 00 02 92 5B
			15 00 00 00 01 00 02 93 02
			15 00 00 00 01 00 02 94 5C
			15 00 00 00 01 00 02 95 02
			15 00 00 00 01 00 02 96 8E
			15 00 00 00 01 00 02 97 02
			15 00 00 00 01 00 02 98 C8
			15 00 00 00 01 00 02 99 02
			15 00 00 00 01 00 02 9A EC
			15 00 00 00 01 00 02 9B 03
			15 00 00 00 01 00 02 9C 1B
			15 00 00 00 01 00 02 9D 03
			15 00 00 00 01 00 02 9E 39
			15 00 00 00 01 00 02 9F 03
			15 00 00 00 01 00 02 A0 5F
			15 00 00 00 01 00 02 A2 03
			15 00 00 00 01 00 02 A3 6B
			15 00 00 00 01 00 02 A4 03
			15 00 00 00 01 00 02 A5 78
			15 00 00 00 01 00 02 A6 03
			15 00 00 00 01 00 02 A7 86
			15 00 00 00 01 00 02 A9 03
			15 00 00 00 01 00 02 AA 95
			15 00 00 00 01 00 02 AB 03
			15 00 00 00 01 00 02 AC A8
			15 00 00 00 01 00 02 AD 03
			15 00 00 00 01 00 02 AE BA
			15 00 00 00 01 00 02 AF 03
			15 00 00 00 01 00 02 B0 CC
			15 00 00 00 01 00 02 B1 03
			15 00 00 00 01 00 02 B2 D0
			15 00 00 00 01 00 02 B3 00
			15 00 00 00 01 00 02 B4 4C
			15 00 00 00 01 00 02 B5 00
			15 00 00 00 01 00 02 B6 8D
			15 00 00 00 01 00 02 B7 00
			15 00 00 00 01 00 02 B8 CB
			15 00 00 00 01 00 02 B9 00
			15 00 00 00 01 00 02 BA F0
			15 00 00 00 01 00 02 BB 01
			15 00 00 00 01 00 02 BC 0D
			15 00 00 00 01 00 02 BD 01
			15 00 00 00 01 00 02 BE 24
			15 00 00 00 01 00 02 BF 01
			15 00 00 00 01 00 02 C0 38
			15 00 00 00 01 00 02 C1 01
			15 00 00 00 01 00 02 C2 49
			15 00 00 00 01 00 02 C3 01
			15 00 00 00 01 00 02 C4 58
			15 00 00 00 01 00 02 C5 01
			15 00 00 00 01 00 02 C6 88
			15 00 00 00 01 00 02 C7 01
			15 00 00 00 01 00 02 C8 AB
			15 00 00 00 01 00 02 C9 01
			15 00 00 00 01 00 02 CA DE
			15 00 00 00 01 00 02 CB 02
			15 00 00 00 01 00 02 CC 03
			15 00 00 00 01 00 02 CD 02
			15 00 00 00 01 00 02 CE 3B
			15 00 00 00 01 00 02 CF 02
			15 00 00 00 01 00 02 D0 6E
			15 00 00 00 01 00 02 D1 02
			15 00 00 00 01 00 02 D2 6F
			15 00 00 00 01 00 02 D3 02
			15 00 00 00 01 00 02 D4 A1
			15 00 00 00 01 00 02 D5 02
			15 00 00 00 01 00 02 D6 D7
			15 00 00 00 01 00 02 D7 02
			15 00 00 00 01 00 02 D8 F9
			15 00 00 00 01 00 02 D9 03
			15 00 00 00 01 00 02 DA 24
			15 00 00 00 01 00 02 DB 03
			15 00 00 00 01 00 02 DC 40
			15 00 00 00 01 00 02 DD 03
			15 00 00 00 01 00 02 DE 64
			15 00 00 00 01 00 02 DF 03
			15 00 00 00 01 00 02 E0 6F
			15 00 00 00 01 00 02 E1 03
			15 00 00 00 01 00 02 E2 7B
			15 00 00 00 01 00 02 E3 03
			15 00 00 00 01 00 02 E4 89
			15 00 00 00 01 00 02 E5 03
			15 00 00 00 01 00 02 E6 97
			15 00 00 00 01 00 02 E7 03
			15 00 00 00 01 00 02 E8 A9
			15 00 00 00 01 00 02 E9 03
			15 00 00 00 01 00 02 EA BB
			15 00 00 00 01 00 02 EB 03
			15 00 00 00 01 00 02 EC CD
			15 00 00 00 01 00 02 ED 03
			15 00 00 00 01 00 02 EE D0
			15 00 00 00 01 00 02 EF 00
			15 00 00 00 01 00 02 F0 00
			15 00 00 00 01 00 02 F1 00
			15 00 00 00 01 00 02 F2 41
			15 00 00 00 01 00 02 F3 00
			15 00 00 00 01 00 02 F4 80
			15 00 00 00 01 00 02 F5 00
			15 00 00 00 01 00 02 F6 A7
			15 00 00 00 01 00 02 F7 00
			15 00 00 00 01 00 02 F8 C6
			15 00 00 00 01 00 02 F9 00
			15 01 00 00 01 00 02 FA DD

			15 00 00 00 01 00 02 FF 21
			15 00 00 00 01 00 02 FB 01
			15 00 00 00 01 00 02 00 00
			15 00 00 00 01 00 02 01 F3
			15 00 00 00 01 00 02 02 01
			15 00 00 00 01 00 02 03 06
			15 00 00 00 01 00 02 04 01
			15 00 00 00 01 00 02 05 15
			15 00 00 00 01 00 02 06 01
			15 00 00 00 01 00 02 07 4B
			15 00 00 00 01 00 02 08 01
			15 00 00 00 01 00 02 09 74
			15 00 00 00 01 00 02 0A 01
			15 00 00 00 01 00 02 0B B1
			15 00 00 00 01 00 02 0C 01
			15 00 00 00 01 00 02 0D E2
			15 00 00 00 01 00 02 0E 02
			15 00 00 00 01 00 02 0F 28
			15 00 00 00 01 00 02 10 02
			15 00 00 00 01 00 02 11 5B
			15 00 00 00 01 00 02 12 02
			15 00 00 00 01 00 02 13 5C
			15 00 00 00 01 00 02 14 02
			15 00 00 00 01 00 02 15 8E
			15 00 00 00 01 00 02 16 02
			15 00 00 00 01 00 02 17 C8
			15 00 00 00 01 00 02 18 02
			15 00 00 00 01 00 02 19 EC
			15 00 00 00 01 00 02 1A 03
			15 00 00 00 01 00 02 1B 1B
			15 00 00 00 01 00 02 1C 03
			15 00 00 00 01 00 02 1D 39
			15 00 00 00 01 00 02 1E 03
			15 00 00 00 01 00 02 1F 5F
			15 00 00 00 01 00 02 20 03
			15 00 00 00 01 00 02 21 6B
			15 00 00 00 01 00 02 22 03
			15 00 00 00 01 00 02 23 78
			15 00 00 00 01 00 02 24 03
			15 00 00 00 01 00 02 25 86
			15 00 00 00 01 00 02 26 03
			15 00 00 00 01 00 02 27 95
			15 00 00 00 01 00 02 28 03
			15 00 00 00 01 00 02 29 A8
			15 00 00 00 01 00 02 2A 03
			15 00 00 00 01 00 02 2B BA
			15 00 00 00 01 00 02 2D 03
			15 00 00 00 01 00 02 2F CC
			15 00 00 00 01 00 02 30 03
			15 00 00 00 01 00 02 31 D0
			15 00 00 00 01 00 02 32 00
			15 00 00 00 01 00 02 33 4C
			15 00 00 00 01 00 02 34 00
			15 00 00 00 01 00 02 35 8D
			15 00 00 00 01 00 02 36 00
			15 00 00 00 01 00 02 37 CB
			15 00 00 00 01 00 02 38 00
			15 00 00 00 01 00 02 39 F0
			15 00 00 00 01 00 02 3A 01
			15 00 00 00 01 00 02 3B 0D
			15 00 00 00 01 00 02 3D 01
			15 00 00 00 01 00 02 3F 24
			15 00 00 00 01 00 02 40 01
			15 00 00 00 01 00 02 41 38
			15 00 00 00 01 00 02 42 01
			15 00 00 00 01 00 02 43 49
			15 00 00 00 01 00 02 44 01
			15 00 00 00 01 00 02 45 58
			15 00 00 00 01 00 02 46 01
			15 00 00 00 01 00 02 47 88
			15 00 00 00 01 00 02 48 01
			15 00 00 00 01 00 02 49 AB
			15 00 00 00 01 00 02 4A 01
			15 00 00 00 01 00 02 4B DE
			15 00 00 00 01 00 02 4C 02
			15 00 00 00 01 00 02 4D 03
			15 00 00 00 01 00 02 4E 02
			15 00 00 00 01 00 02 4F 3B
			15 00 00 00 01 00 02 50 02
			15 00 00 00 01 00 02 51 6E
			15 00 00 00 01 00 02 52 02
			15 00 00 00 01 00 02 53 6F
			15 00 00 00 01 00 02 54 02
			15 00 00 00 01 00 02 55 A1
			15 00 00 00 01 00 02 56 02
			15 00 00 00 01 00 02 58 D7
			15 00 00 00 01 00 02 59 02
			15 00 00 00 01 00 02 5A F9
			15 00 00 00 01 00 02 5B 03
			15 00 00 00 01 00 02 5C 24
			15 00 00 00 01 00 02 5D 03
			15 00 00 00 01 00 02 5E 40
			15 00 00 00 01 00 02 5F 03
			15 00 00 00 01 00 02 60 64
			15 00 00 00 01 00 02 61 03
			15 00 00 00 01 00 02 62 6F
			15 00 00 00 01 00 02 63 03
			15 00 00 00 01 00 02 64 7B
			15 00 00 00 01 00 02 65 03
			15 00 00 00 01 00 02 66 89
			15 00 00 00 01 00 02 67 03
			15 00 00 00 01 00 02 68 97
			15 00 00 00 01 00 02 69 03
			15 00 00 00 01 00 02 6A A9
			15 00 00 00 01 00 02 6B 03
			15 00 00 00 01 00 02 6C BB
			15 00 00 00 01 00 02 6D 03
			15 00 00 00 01 00 02 6E CD
			15 00 00 00 01 00 02 6F 03
			15 00 00 00 01 00 02 70 D0
			15 00 00 00 01 00 02 71 01
			15 00 00 00 01 00 02 72 AE
			15 00 00 00 01 00 02 73 01
			15 00 00 00 01 00 02 74 B1
			15 00 00 00 01 00 02 75 01
			15 00 00 00 01 00 02 76 B7
			15 00 00 00 01 00 02 77 01
			15 00 00 00 01 00 02 78 BC
			15 00 00 00 01 00 02 79 01
			15 00 00 00 01 00 02 7A C2
			15 00 00 00 01 00 02 7B 01
			15 00 00 00 01 00 02 7C C7
			15 00 00 00 01 00 02 7D 01
			15 00 00 00 01 00 02 7E CC
			15 00 00 00 01 00 02 7F 01
			15 00 00 00 01 00 02 80 D1
			15 00 00 00 01 00 02 81 01
			15 00 00 00 01 00 02 82 D6
			15 00 00 00 01 00 02 83 01
			15 00 00 00 01 00 02 84 E7
			15 00 00 00 01 00 02 85 01
			15 00 00 00 01 00 02 86 F7
			15 00 00 00 01 00 02 87 02
			15 00 00 00 01 00 02 88 14
			15 00 00 00 01 00 02 89 02
			15 00 00 00 01 00 02 8A 2C
			15 00 00 00 01 00 02 8B 02
			15 00 00 00 01 00 02 8C 58
			15 00 00 00 01 00 02 8D 02
			15 00 00 00 01 00 02 8E 82
			15 00 00 00 01 00 02 8F 02
			15 00 00 00 01 00 02 90 84
			15 00 00 00 01 00 02 91 02
			15 00 00 00 01 00 02 92 AE
			15 00 00 00 01 00 02 93 02
			15 00 00 00 01 00 02 94 DE
			15 00 00 00 01 00 02 95 02
			15 00 00 00 01 00 02 96 FC
			15 00 00 00 01 00 02 97 03
			15 00 00 00 01 00 02 98 30
			15 00 00 00 01 00 02 99 03
			15 00 00 00 01 00 02 9A 4C
			15 00 00 00 01 00 02 9B 03
			15 00 00 00 01 00 02 9C 6F
			15 00 00 00 01 00 02 9D 03
			15 00 00 00 01 00 02 9E 7A
			15 00 00 00 01 00 02 9F 03
			15 00 00 00 01 00 02 A0 86
			15 00 00 00 01 00 02 A2 03
			15 00 00 00 01 00 02 A3 93
			15 00 00 00 01 00 02 A4 03
			15 00 00 00 01 00 02 A5 A3
			15 00 00 00 01 00 02 A6 03
			15 00 00 00 01 00 02 A7 B5
			15 00 00 00 01 00 02 A9 03
			15 00 00 00 01 00 02 AA C5
			15 00 00 00 01 00 02 AB 03
			15 00 00 00 01 00 02 AC CF
			15 00 00 00 01 00 02 AD 03
			15 00 00 00 01 00 02 AE D0
			15 00 00 00 01 00 02 AF 01
			15 00 00 00 01 00 02 B0 FA
			15 00 00 00 01 00 02 B1 01
			15 00 00 00 01 00 02 B2 FC
			15 00 00 00 01 00 02 B3 01
			15 00 00 00 01 00 02 B4 FF
			15 00 00 00 01 00 02 B5 02
			15 00 00 00 01 00 02 B6 02
			15 00 00 00 01 00 02 B7 02
			15 00 00 00 01 00 02 B8 05
			15 00 00 00 01 00 02 B9 02
			15 00 00 00 01 00 02 BA 09
			15 00 00 00 01 00 02 BB 02
			15 00 00 00 01 00 02 BC 0C
			15 00 00 00 01 00 02 BD 02
			15 00 00 00 01 00 02 BE 0F
			15 00 00 00 01 00 02 BF 02
			15 00 00 00 01 00 02 C0 12
			15 00 00 00 01 00 02 C1 02
			15 00 00 00 01 00 02 C2 1D
			15 00 00 00 01 00 02 C3 02
			15 00 00 00 01 00 02 C4 27
			15 00 00 00 01 00 02 C5 02
			15 00 00 00 01 00 02 C6 3C
			15 00 00 00 01 00 02 C7 02
			15 00 00 00 01 00 02 C8 4F
			15 00 00 00 01 00 02 C9 02
			15 00 00 00 01 00 02 CA 74
			15 00 00 00 01 00 02 CB 02
			15 00 00 00 01 00 02 CC 99
			15 00 00 00 01 00 02 CD 02
			15 00 00 00 01 00 02 CE 9A
			15 00 00 00 01 00 02 CF 02
			15 00 00 00 01 00 02 D0 C0
			15 00 00 00 01 00 02 D1 02
			15 00 00 00 01 00 02 D2 ED
			15 00 00 00 01 00 02 D3 03
			15 00 00 00 01 00 02 D4 0A
			15 00 00 00 01 00 02 D5 03
			15 00 00 00 01 00 02 D6 3E
			15 00 00 00 01 00 02 D7 03
			15 00 00 00 01 00 02 D8 59
			15 00 00 00 01 00 02 D9 03
			15 00 00 00 01 00 02 DA 7D
			15 00 00 00 01 00 02 DB 03
			15 00 00 00 01 00 02 DC 88
			15 00 00 00 01 00 02 DD 03
			15 00 00 00 01 00 02 DE 94
			15 00 00 00 01 00 02 DF 03
			15 00 00 00 01 00 02 E0 A2
			15 00 00 00 01 00 02 E1 03
			15 00 00 00 01 00 02 E2 B1
			15 00 00 00 01 00 02 E3 03
			15 00 00 00 01 00 02 E4 BF
			15 00 00 00 01 00 02 E5 03
			15 00 00 00 01 00 02 E6 CA
			15 00 00 00 01 00 02 E7 03
			15 00 00 00 01 00 02 E8 F7
			15 00 00 00 01 00 02 E9 03
			15 00 00 00 01 00 02 EA F8
			15 00 00 00 01 00 02 FB 01
			15 01 00 00 01 00 02 FF 10
			];
		qcom,mdss-dsi-dispparam-papermode4-state = "dsi_hs_mode";
		qcom,mdss-dsi-dispparam-papermode5-command = [
			15 00 00 00 01 00 02 FF 20
			15 00 00 00 01 00 02 FB 01
			15 00 00 00 01 00 02 75 00
			15 00 00 00 01 00 02 76 00
			15 00 00 00 01 00 02 77 00
			15 00 00 00 01 00 02 78 41
			15 00 00 00 01 00 02 79 00
			15 00 00 00 01 00 02 7A 80
			15 00 00 00 01 00 02 7B 00
			15 00 00 00 01 00 02 7C A7
			15 00 00 00 01 00 02 7D 00
			15 00 00 00 01 00 02 7E C6
			15 00 00 00 01 00 02 7F 00
			15 00 00 00 01 00 02 80 DD
			15 00 00 00 01 00 02 81 00
			15 00 00 00 01 00 02 82 F3
			15 00 00 00 01 00 02 83 01
			15 00 00 00 01 00 02 84 06
			15 00 00 00 01 00 02 85 01
			15 00 00 00 01 00 02 86 15
			15 00 00 00 01 00 02 87 01
			15 00 00 00 01 00 02 88 4B
			15 00 00 00 01 00 02 89 01
			15 00 00 00 01 00 02 8A 74
			15 00 00 00 01 00 02 8B 01
			15 00 00 00 01 00 02 8C B1
			15 00 00 00 01 00 02 8D 01
			15 00 00 00 01 00 02 8E E2
			15 00 00 00 01 00 02 8F 02
			15 00 00 00 01 00 02 90 28
			15 00 00 00 01 00 02 91 02
			15 00 00 00 01 00 02 92 5B
			15 00 00 00 01 00 02 93 02
			15 00 00 00 01 00 02 94 5C
			15 00 00 00 01 00 02 95 02
			15 00 00 00 01 00 02 96 8E
			15 00 00 00 01 00 02 97 02
			15 00 00 00 01 00 02 98 C8
			15 00 00 00 01 00 02 99 02
			15 00 00 00 01 00 02 9A EC
			15 00 00 00 01 00 02 9B 03
			15 00 00 00 01 00 02 9C 1B
			15 00 00 00 01 00 02 9D 03
			15 00 00 00 01 00 02 9E 39
			15 00 00 00 01 00 02 9F 03
			15 00 00 00 01 00 02 A0 5F
			15 00 00 00 01 00 02 A2 03
			15 00 00 00 01 00 02 A3 6B
			15 00 00 00 01 00 02 A4 03
			15 00 00 00 01 00 02 A5 78
			15 00 00 00 01 00 02 A6 03
			15 00 00 00 01 00 02 A7 86
			15 00 00 00 01 00 02 A9 03
			15 00 00 00 01 00 02 AA 95
			15 00 00 00 01 00 02 AB 03
			15 00 00 00 01 00 02 AC A8
			15 00 00 00 01 00 02 AD 03
			15 00 00 00 01 00 02 AE BA
			15 00 00 00 01 00 02 AF 03
			15 00 00 00 01 00 02 B0 CC
			15 00 00 00 01 00 02 B1 03
			15 00 00 00 01 00 02 B2 D0
			15 00 00 00 01 00 02 B3 00
			15 00 00 00 01 00 02 B4 4C
			15 00 00 00 01 00 02 B5 00
			15 00 00 00 01 00 02 B6 8D
			15 00 00 00 01 00 02 B7 00
			15 00 00 00 01 00 02 B8 CB
			15 00 00 00 01 00 02 B9 00
			15 00 00 00 01 00 02 BA F0
			15 00 00 00 01 00 02 BB 01
			15 00 00 00 01 00 02 BC 0D
			15 00 00 00 01 00 02 BD 01
			15 00 00 00 01 00 02 BE 24
			15 00 00 00 01 00 02 BF 01
			15 00 00 00 01 00 02 C0 38
			15 00 00 00 01 00 02 C1 01
			15 00 00 00 01 00 02 C2 49
			15 00 00 00 01 00 02 C3 01
			15 00 00 00 01 00 02 C4 58
			15 00 00 00 01 00 02 C5 01
			15 00 00 00 01 00 02 C6 88
			15 00 00 00 01 00 02 C7 01
			15 00 00 00 01 00 02 C8 AB
			15 00 00 00 01 00 02 C9 01
			15 00 00 00 01 00 02 CA DE
			15 00 00 00 01 00 02 CB 02
			15 00 00 00 01 00 02 CC 03
			15 00 00 00 01 00 02 CD 02
			15 00 00 00 01 00 02 CE 3B
			15 00 00 00 01 00 02 CF 02
			15 00 00 00 01 00 02 D0 6E
			15 00 00 00 01 00 02 D1 02
			15 00 00 00 01 00 02 D2 6F
			15 00 00 00 01 00 02 D3 02
			15 00 00 00 01 00 02 D4 A1
			15 00 00 00 01 00 02 D5 02
			15 00 00 00 01 00 02 D6 D7
			15 00 00 00 01 00 02 D7 02
			15 00 00 00 01 00 02 D8 F9
			15 00 00 00 01 00 02 D9 03
			15 00 00 00 01 00 02 DA 24
			15 00 00 00 01 00 02 DB 03
			15 00 00 00 01 00 02 DC 40
			15 00 00 00 01 00 02 DD 03
			15 00 00 00 01 00 02 DE 64
			15 00 00 00 01 00 02 DF 03
			15 00 00 00 01 00 02 E0 6F
			15 00 00 00 01 00 02 E1 03
			15 00 00 00 01 00 02 E2 7B
			15 00 00 00 01 00 02 E3 03
			15 00 00 00 01 00 02 E4 89
			15 00 00 00 01 00 02 E5 03
			15 00 00 00 01 00 02 E6 97
			15 00 00 00 01 00 02 E7 03
			15 00 00 00 01 00 02 E8 A9
			15 00 00 00 01 00 02 E9 03
			15 00 00 00 01 00 02 EA BB
			15 00 00 00 01 00 02 EB 03
			15 00 00 00 01 00 02 EC CD
			15 00 00 00 01 00 02 ED 03
			15 00 00 00 01 00 02 EE D0
			15 00 00 00 01 00 02 EF 00
			15 00 00 00 01 00 02 F0 00
			15 00 00 00 01 00 02 F1 00
			15 00 00 00 01 00 02 F2 41
			15 00 00 00 01 00 02 F3 00
			15 00 00 00 01 00 02 F4 80
			15 00 00 00 01 00 02 F5 00
			15 00 00 00 01 00 02 F6 A7
			15 00 00 00 01 00 02 F7 00
			15 00 00 00 01 00 02 F8 C6
			15 00 00 00 01 00 02 F9 00
			15 01 00 00 01 00 02 FA DD

			15 00 00 00 01 00 02 FF 21
			15 00 00 00 01 00 02 FB 01
			15 00 00 00 01 00 02 00 00
			15 00 00 00 01 00 02 01 F3
			15 00 00 00 01 00 02 02 01
			15 00 00 00 01 00 02 03 06
			15 00 00 00 01 00 02 04 01
			15 00 00 00 01 00 02 05 15
			15 00 00 00 01 00 02 06 01
			15 00 00 00 01 00 02 07 4B
			15 00 00 00 01 00 02 08 01
			15 00 00 00 01 00 02 09 74
			15 00 00 00 01 00 02 0A 01
			15 00 00 00 01 00 02 0B B1
			15 00 00 00 01 00 02 0C 01
			15 00 00 00 01 00 02 0D E2
			15 00 00 00 01 00 02 0E 02
			15 00 00 00 01 00 02 0F 28
			15 00 00 00 01 00 02 10 02
			15 00 00 00 01 00 02 11 5B
			15 00 00 00 01 00 02 12 02
			15 00 00 00 01 00 02 13 5C
			15 00 00 00 01 00 02 14 02
			15 00 00 00 01 00 02 15 8E
			15 00 00 00 01 00 02 16 02
			15 00 00 00 01 00 02 17 C8
			15 00 00 00 01 00 02 18 02
			15 00 00 00 01 00 02 19 EC
			15 00 00 00 01 00 02 1A 03
			15 00 00 00 01 00 02 1B 1B
			15 00 00 00 01 00 02 1C 03
			15 00 00 00 01 00 02 1D 39
			15 00 00 00 01 00 02 1E 03
			15 00 00 00 01 00 02 1F 5F
			15 00 00 00 01 00 02 20 03
			15 00 00 00 01 00 02 21 6B
			15 00 00 00 01 00 02 22 03
			15 00 00 00 01 00 02 23 78
			15 00 00 00 01 00 02 24 03
			15 00 00 00 01 00 02 25 86
			15 00 00 00 01 00 02 26 03
			15 00 00 00 01 00 02 27 95
			15 00 00 00 01 00 02 28 03
			15 00 00 00 01 00 02 29 A8
			15 00 00 00 01 00 02 2A 03
			15 00 00 00 01 00 02 2B BA
			15 00 00 00 01 00 02 2D 03
			15 00 00 00 01 00 02 2F CC
			15 00 00 00 01 00 02 30 03
			15 00 00 00 01 00 02 31 D0
			15 00 00 00 01 00 02 32 00
			15 00 00 00 01 00 02 33 4C
			15 00 00 00 01 00 02 34 00
			15 00 00 00 01 00 02 35 8D
			15 00 00 00 01 00 02 36 00
			15 00 00 00 01 00 02 37 CB
			15 00 00 00 01 00 02 38 00
			15 00 00 00 01 00 02 39 F0
			15 00 00 00 01 00 02 3A 01
			15 00 00 00 01 00 02 3B 0D
			15 00 00 00 01 00 02 3D 01
			15 00 00 00 01 00 02 3F 24
			15 00 00 00 01 00 02 40 01
			15 00 00 00 01 00 02 41 38
			15 00 00 00 01 00 02 42 01
			15 00 00 00 01 00 02 43 49
			15 00 00 00 01 00 02 44 01
			15 00 00 00 01 00 02 45 58
			15 00 00 00 01 00 02 46 01
			15 00 00 00 01 00 02 47 88
			15 00 00 00 01 00 02 48 01
			15 00 00 00 01 00 02 49 AB
			15 00 00 00 01 00 02 4A 01
			15 00 00 00 01 00 02 4B DE
			15 00 00 00 01 00 02 4C 02
			15 00 00 00 01 00 02 4D 03
			15 00 00 00 01 00 02 4E 02
			15 00 00 00 01 00 02 4F 3B
			15 00 00 00 01 00 02 50 02
			15 00 00 00 01 00 02 51 6E
			15 00 00 00 01 00 02 52 02
			15 00 00 00 01 00 02 53 6F
			15 00 00 00 01 00 02 54 02
			15 00 00 00 01 00 02 55 A1
			15 00 00 00 01 00 02 56 02
			15 00 00 00 01 00 02 58 D7
			15 00 00 00 01 00 02 59 02
			15 00 00 00 01 00 02 5A F9
			15 00 00 00 01 00 02 5B 03
			15 00 00 00 01 00 02 5C 24
			15 00 00 00 01 00 02 5D 03
			15 00 00 00 01 00 02 5E 40
			15 00 00 00 01 00 02 5F 03
			15 00 00 00 01 00 02 60 64
			15 00 00 00 01 00 02 61 03
			15 00 00 00 01 00 02 62 6F
			15 00 00 00 01 00 02 63 03
			15 00 00 00 01 00 02 64 7B
			15 00 00 00 01 00 02 65 03
			15 00 00 00 01 00 02 66 89
			15 00 00 00 01 00 02 67 03
			15 00 00 00 01 00 02 68 97
			15 00 00 00 01 00 02 69 03
			15 00 00 00 01 00 02 6A A9
			15 00 00 00 01 00 02 6B 03
			15 00 00 00 01 00 02 6C BB
			15 00 00 00 01 00 02 6D 03
			15 00 00 00 01 00 02 6E CD
			15 00 00 00 01 00 02 6F 03
			15 00 00 00 01 00 02 70 D0
			15 00 00 00 01 00 02 71 01
			15 00 00 00 01 00 02 72 CD
			15 00 00 00 01 00 02 73 01
			15 00 00 00 01 00 02 74 CF
			15 00 00 00 01 00 02 75 01
			15 00 00 00 01 00 02 76 D4
			15 00 00 00 01 00 02 77 01
			15 00 00 00 01 00 02 78 D8
			15 00 00 00 01 00 02 79 01
			15 00 00 00 01 00 02 7A DD
			15 00 00 00 01 00 02 7B 01
			15 00 00 00 01 00 02 7C E1
			15 00 00 00 01 00 02 7D 01
			15 00 00 00 01 00 02 7E E5
			15 00 00 00 01 00 02 7F 01
			15 00 00 00 01 00 02 80 E9
			15 00 00 00 01 00 02 81 01
			15 00 00 00 01 00 02 82 ED
			15 00 00 00 01 00 02 83 01
			15 00 00 00 01 00 02 84 FC
			15 00 00 00 01 00 02 85 02
			15 00 00 00 01 00 02 86 0A
			15 00 00 00 01 00 02 87 02
			15 00 00 00 01 00 02 88 22
			15 00 00 00 01 00 02 89 02
			15 00 00 00 01 00 02 8A 38
			15 00 00 00 01 00 02 8B 02
			15 00 00 00 01 00 02 8C 62
			15 00 00 00 01 00 02 8D 02
			15 00 00 00 01 00 02 8E 8A
			15 00 00 00 01 00 02 8F 02
			15 00 00 00 01 00 02 90 8B
			15 00 00 00 01 00 02 91 02
			15 00 00 00 01 00 02 92 B4
			15 00 00 00 01 00 02 93 02
			15 00 00 00 01 00 02 94 E3
			15 00 00 00 01 00 02 95 03
			15 00 00 00 01 00 02 96 00
			15 00 00 00 01 00 02 97 03
			15 00 00 00 01 00 02 98 35
			15 00 00 00 01 00 02 99 03
			15 00 00 00 01 00 02 9A 50
			15 00 00 00 01 00 02 9B 03
			15 00 00 00 01 00 02 9C 72
			15 00 00 00 01 00 02 9D 03
			15 00 00 00 01 00 02 9E 7D
			15 00 00 00 01 00 02 9F 03
			15 00 00 00 01 00 02 A0 89
			15 00 00 00 01 00 02 A2 03
			15 00 00 00 01 00 02 A3 96
			15 00 00 00 01 00 02 A4 03
			15 00 00 00 01 00 02 A5 A6
			15 00 00 00 01 00 02 A6 03
			15 00 00 00 01 00 02 A7 B7
			15 00 00 00 01 00 02 A9 03
			15 00 00 00 01 00 02 AA C6
			15 00 00 00 01 00 02 AB 03
			15 00 00 00 01 00 02 AC CF
			15 00 00 00 01 00 02 AD 03
			15 00 00 00 01 00 02 AE D0
			15 00 00 00 01 00 02 AF 02
			15 00 00 00 01 00 02 B0 19
			15 00 00 00 01 00 02 B1 02
			15 00 00 00 01 00 02 B2 1A
			15 00 00 00 01 00 02 B3 02
			15 00 00 00 01 00 02 B4 1D
			15 00 00 00 01 00 02 B5 02
			15 00 00 00 01 00 02 B6 1F
			15 00 00 00 01 00 02 B7 02
			15 00 00 00 01 00 02 B8 22
			15 00 00 00 01 00 02 B9 02
			15 00 00 00 01 00 02 BA 24
			15 00 00 00 01 00 02 BB 02
			15 00 00 00 01 00 02 BC 27
			15 00 00 00 01 00 02 BD 02
			15 00 00 00 01 00 02 BE 29
			15 00 00 00 01 00 02 BF 02
			15 00 00 00 01 00 02 C0 2B
			15 00 00 00 01 00 02 C1 02
			15 00 00 00 01 00 02 C2 35
			15 00 00 00 01 00 02 C3 02
			15 00 00 00 01 00 02 C4 3E
			15 00 00 00 01 00 02 C5 02
			15 00 00 00 01 00 02 C6 50
			15 00 00 00 01 00 02 C7 02
			15 00 00 00 01 00 02 C8 61
			15 00 00 00 01 00 02 C9 02
			15 00 00 00 01 00 02 CA 82
			15 00 00 00 01 00 02 CB 02
			15 00 00 00 01 00 02 CC A5
			15 00 00 00 01 00 02 CD 02
			15 00 00 00 01 00 02 CE A6
			15 00 00 00 01 00 02 CF 02
			15 00 00 00 01 00 02 D0 CA
			15 00 00 00 01 00 02 D1 02
			15 00 00 00 01 00 02 D2 F5
			15 00 00 00 01 00 02 D3 03
			15 00 00 00 01 00 02 D4 13
			15 00 00 00 01 00 02 D5 03
			15 00 00 00 01 00 02 D6 45
			15 00 00 00 01 00 02 D7 03
			15 00 00 00 01 00 02 D8 60
			15 00 00 00 01 00 02 D9 03
			15 00 00 00 01 00 02 DA 83
			15 00 00 00 01 00 02 DB 03
			15 00 00 00 01 00 02 DC 8E
			15 00 00 00 01 00 02 DD 03
			15 00 00 00 01 00 02 DE 9A
			15 00 00 00 01 00 02 DF 03
			15 00 00 00 01 00 02 E0 A8
			15 00 00 00 01 00 02 E1 03
			15 00 00 00 01 00 02 E2 B5
			15 00 00 00 01 00 02 E3 03
			15 00 00 00 01 00 02 E4 C1
			15 00 00 00 01 00 02 E5 03
			15 00 00 00 01 00 02 E6 CB
			15 00 00 00 01 00 02 E7 03
			15 00 00 00 01 00 02 E8 F7
			15 00 00 00 01 00 02 E9 03
			15 00 00 00 01 00 02 EA F8
			15 00 00 00 01 00 02 FB 01
			15 01 00 00 01 00 02 FF 10
			];
		qcom,mdss-dsi-dispparam-papermode5-state = "dsi_hs_mode";
		qcom,mdss-dsi-dispparam-papermode6-command = [
			15 00 00 00 01 00 02 FF 20
			15 00 00 00 01 00 02 FB 01
			15 00 00 00 01 00 02 75 00
			15 00 00 00 01 00 02 76 00
			15 00 00 00 01 00 02 77 00
			15 00 00 00 01 00 02 78 41
			15 00 00 00 01 00 02 79 00
			15 00 00 00 01 00 02 7A 80
			15 00 00 00 01 00 02 7B 00
			15 00 00 00 01 00 02 7C A7
			15 00 00 00 01 00 02 7D 00
			15 00 00 00 01 00 02 7E C6
			15 00 00 00 01 00 02 7F 00
			15 00 00 00 01 00 02 80 DD
			15 00 00 00 01 00 02 81 00
			15 00 00 00 01 00 02 82 F3
			15 00 00 00 01 00 02 83 01
			15 00 00 00 01 00 02 84 06
			15 00 00 00 01 00 02 85 01
			15 00 00 00 01 00 02 86 15
			15 00 00 00 01 00 02 87 01
			15 00 00 00 01 00 02 88 4B
			15 00 00 00 01 00 02 89 01
			15 00 00 00 01 00 02 8A 74
			15 00 00 00 01 00 02 8B 01
			15 00 00 00 01 00 02 8C B1
			15 00 00 00 01 00 02 8D 01
			15 00 00 00 01 00 02 8E E2
			15 00 00 00 01 00 02 8F 02
			15 00 00 00 01 00 02 90 28
			15 00 00 00 01 00 02 91 02
			15 00 00 00 01 00 02 92 5B
			15 00 00 00 01 00 02 93 02
			15 00 00 00 01 00 02 94 5C
			15 00 00 00 01 00 02 95 02
			15 00 00 00 01 00 02 96 8E
			15 00 00 00 01 00 02 97 02
			15 00 00 00 01 00 02 98 C8
			15 00 00 00 01 00 02 99 02
			15 00 00 00 01 00 02 9A EC
			15 00 00 00 01 00 02 9B 03
			15 00 00 00 01 00 02 9C 1B
			15 00 00 00 01 00 02 9D 03
			15 00 00 00 01 00 02 9E 39
			15 00 00 00 01 00 02 9F 03
			15 00 00 00 01 00 02 A0 5F
			15 00 00 00 01 00 02 A2 03
			15 00 00 00 01 00 02 A3 6B
			15 00 00 00 01 00 02 A4 03
			15 00 00 00 01 00 02 A5 78
			15 00 00 00 01 00 02 A6 03
			15 00 00 00 01 00 02 A7 86
			15 00 00 00 01 00 02 A9 03
			15 00 00 00 01 00 02 AA 95
			15 00 00 00 01 00 02 AB 03
			15 00 00 00 01 00 02 AC A8
			15 00 00 00 01 00 02 AD 03
			15 00 00 00 01 00 02 AE BA
			15 00 00 00 01 00 02 AF 03
			15 00 00 00 01 00 02 B0 CC
			15 00 00 00 01 00 02 B1 03
			15 00 00 00 01 00 02 B2 D0
			15 00 00 00 01 00 02 B3 00
			15 00 00 00 01 00 02 B4 4C
			15 00 00 00 01 00 02 B5 00
			15 00 00 00 01 00 02 B6 8D
			15 00 00 00 01 00 02 B7 00
			15 00 00 00 01 00 02 B8 CB
			15 00 00 00 01 00 02 B9 00
			15 00 00 00 01 00 02 BA F0
			15 00 00 00 01 00 02 BB 01
			15 00 00 00 01 00 02 BC 0D
			15 00 00 00 01 00 02 BD 01
			15 00 00 00 01 00 02 BE 24
			15 00 00 00 01 00 02 BF 01
			15 00 00 00 01 00 02 C0 38
			15 00 00 00 01 00 02 C1 01
			15 00 00 00 01 00 02 C2 49
			15 00 00 00 01 00 02 C3 01
			15 00 00 00 01 00 02 C4 58
			15 00 00 00 01 00 02 C5 01
			15 00 00 00 01 00 02 C6 88
			15 00 00 00 01 00 02 C7 01
			15 00 00 00 01 00 02 C8 AB
			15 00 00 00 01 00 02 C9 01
			15 00 00 00 01 00 02 CA DE
			15 00 00 00 01 00 02 CB 02
			15 00 00 00 01 00 02 CC 03
			15 00 00 00 01 00 02 CD 02
			15 00 00 00 01 00 02 CE 3B
			15 00 00 00 01 00 02 CF 02
			15 00 00 00 01 00 02 D0 6E
			15 00 00 00 01 00 02 D1 02
			15 00 00 00 01 00 02 D2 6F
			15 00 00 00 01 00 02 D3 02
			15 00 00 00 01 00 02 D4 A1
			15 00 00 00 01 00 02 D5 02
			15 00 00 00 01 00 02 D6 D7
			15 00 00 00 01 00 02 D7 02
			15 00 00 00 01 00 02 D8 F9
			15 00 00 00 01 00 02 D9 03
			15 00 00 00 01 00 02 DA 24
			15 00 00 00 01 00 02 DB 03
			15 00 00 00 01 00 02 DC 40
			15 00 00 00 01 00 02 DD 03
			15 00 00 00 01 00 02 DE 64
			15 00 00 00 01 00 02 DF 03
			15 00 00 00 01 00 02 E0 6F
			15 00 00 00 01 00 02 E1 03
			15 00 00 00 01 00 02 E2 7B
			15 00 00 00 01 00 02 E3 03
			15 00 00 00 01 00 02 E4 89
			15 00 00 00 01 00 02 E5 03
			15 00 00 00 01 00 02 E6 97
			15 00 00 00 01 00 02 E7 03
			15 00 00 00 01 00 02 E8 A9
			15 00 00 00 01 00 02 E9 03
			15 00 00 00 01 00 02 EA BB
			15 00 00 00 01 00 02 EB 03
			15 00 00 00 01 00 02 EC CD
			15 00 00 00 01 00 02 ED 03
			15 00 00 00 01 00 02 EE D0
			15 00 00 00 01 00 02 EF 00
			15 00 00 00 01 00 02 F0 00
			15 00 00 00 01 00 02 F1 00
			15 00 00 00 01 00 02 F2 41
			15 00 00 00 01 00 02 F3 00
			15 00 00 00 01 00 02 F4 80
			15 00 00 00 01 00 02 F5 00
			15 00 00 00 01 00 02 F6 A7
			15 00 00 00 01 00 02 F7 00
			15 00 00 00 01 00 02 F8 C6
			15 00 00 00 01 00 02 F9 00
			15 01 00 00 01 00 02 FA DD

			15 00 00 00 01 00 02 FF 21
			15 00 00 00 01 00 02 FB 01
			15 00 00 00 01 00 02 00 00
			15 00 00 00 01 00 02 01 F3
			15 00 00 00 01 00 02 02 01
			15 00 00 00 01 00 02 03 06
			15 00 00 00 01 00 02 04 01
			15 00 00 00 01 00 02 05 15
			15 00 00 00 01 00 02 06 01
			15 00 00 00 01 00 02 07 4B
			15 00 00 00 01 00 02 08 01
			15 00 00 00 01 00 02 09 74
			15 00 00 00 01 00 02 0A 01
			15 00 00 00 01 00 02 0B B1
			15 00 00 00 01 00 02 0C 01
			15 00 00 00 01 00 02 0D E2
			15 00 00 00 01 00 02 0E 02
			15 00 00 00 01 00 02 0F 28
			15 00 00 00 01 00 02 10 02
			15 00 00 00 01 00 02 11 5B
			15 00 00 00 01 00 02 12 02
			15 00 00 00 01 00 02 13 5C
			15 00 00 00 01 00 02 14 02
			15 00 00 00 01 00 02 15 8E
			15 00 00 00 01 00 02 16 02
			15 00 00 00 01 00 02 17 C8
			15 00 00 00 01 00 02 18 02
			15 00 00 00 01 00 02 19 EC
			15 00 00 00 01 00 02 1A 03
			15 00 00 00 01 00 02 1B 1B
			15 00 00 00 01 00 02 1C 03
			15 00 00 00 01 00 02 1D 39
			15 00 00 00 01 00 02 1E 03
			15 00 00 00 01 00 02 1F 5F
			15 00 00 00 01 00 02 20 03
			15 00 00 00 01 00 02 21 6B
			15 00 00 00 01 00 02 22 03
			15 00 00 00 01 00 02 23 78
			15 00 00 00 01 00 02 24 03
			15 00 00 00 01 00 02 25 86
			15 00 00 00 01 00 02 26 03
			15 00 00 00 01 00 02 27 95
			15 00 00 00 01 00 02 28 03
			15 00 00 00 01 00 02 29 A8
			15 00 00 00 01 00 02 2A 03
			15 00 00 00 01 00 02 2B BA
			15 00 00 00 01 00 02 2D 03
			15 00 00 00 01 00 02 2F CC
			15 00 00 00 01 00 02 30 03
			15 00 00 00 01 00 02 31 D0
			15 00 00 00 01 00 02 32 00
			15 00 00 00 01 00 02 33 4C
			15 00 00 00 01 00 02 34 00
			15 00 00 00 01 00 02 35 8D
			15 00 00 00 01 00 02 36 00
			15 00 00 00 01 00 02 37 CB
			15 00 00 00 01 00 02 38 00
			15 00 00 00 01 00 02 39 F0
			15 00 00 00 01 00 02 3A 01
			15 00 00 00 01 00 02 3B 0D
			15 00 00 00 01 00 02 3D 01
			15 00 00 00 01 00 02 3F 24
			15 00 00 00 01 00 02 40 01
			15 00 00 00 01 00 02 41 38
			15 00 00 00 01 00 02 42 01
			15 00 00 00 01 00 02 43 49
			15 00 00 00 01 00 02 44 01
			15 00 00 00 01 00 02 45 58
			15 00 00 00 01 00 02 46 01
			15 00 00 00 01 00 02 47 88
			15 00 00 00 01 00 02 48 01
			15 00 00 00 01 00 02 49 AB
			15 00 00 00 01 00 02 4A 01
			15 00 00 00 01 00 02 4B DE
			15 00 00 00 01 00 02 4C 02
			15 00 00 00 01 00 02 4D 03
			15 00 00 00 01 00 02 4E 02
			15 00 00 00 01 00 02 4F 3B
			15 00 00 00 01 00 02 50 02
			15 00 00 00 01 00 02 51 6E
			15 00 00 00 01 00 02 52 02
			15 00 00 00 01 00 02 53 6F
			15 00 00 00 01 00 02 54 02
			15 00 00 00 01 00 02 55 A1
			15 00 00 00 01 00 02 56 02
			15 00 00 00 01 00 02 58 D7
			15 00 00 00 01 00 02 59 02
			15 00 00 00 01 00 02 5A F9
			15 00 00 00 01 00 02 5B 03
			15 00 00 00 01 00 02 5C 24
			15 00 00 00 01 00 02 5D 03
			15 00 00 00 01 00 02 5E 40
			15 00 00 00 01 00 02 5F 03
			15 00 00 00 01 00 02 60 64
			15 00 00 00 01 00 02 61 03
			15 00 00 00 01 00 02 62 6F
			15 00 00 00 01 00 02 63 03
			15 00 00 00 01 00 02 64 7B
			15 00 00 00 01 00 02 65 03
			15 00 00 00 01 00 02 66 89
			15 00 00 00 01 00 02 67 03
			15 00 00 00 01 00 02 68 97
			15 00 00 00 01 00 02 69 03
			15 00 00 00 01 00 02 6A A9
			15 00 00 00 01 00 02 6B 03
			15 00 00 00 01 00 02 6C BB
			15 00 00 00 01 00 02 6D 03
			15 00 00 00 01 00 02 6E CD
			15 00 00 00 01 00 02 6F 03
			15 00 00 00 01 00 02 70 D0
			15 00 00 00 01 00 02 71 01
			15 00 00 00 01 00 02 72 E8
			15 00 00 00 01 00 02 73 01
			15 00 00 00 01 00 02 74 EA
			15 00 00 00 01 00 02 75 01
			15 00 00 00 01 00 02 76 ED
			15 00 00 00 01 00 02 77 01
			15 00 00 00 01 00 02 78 F1
			15 00 00 00 01 00 02 79 01
			15 00 00 00 01 00 02 7A F5
			15 00 00 00 01 00 02 7B 01
			15 00 00 00 01 00 02 7C F8
			15 00 00 00 01 00 02 7D 01
			15 00 00 00 01 00 02 7E FC
			15 00 00 00 01 00 02 7F 01
			15 00 00 00 01 00 02 80 FF
			15 00 00 00 01 00 02 81 02
			15 00 00 00 01 00 02 82 03
			15 00 00 00 01 00 02 83 02
			15 00 00 00 01 00 02 84 0F
			15 00 00 00 01 00 02 85 02
			15 00 00 00 01 00 02 86 1B
			15 00 00 00 01 00 02 87 02
			15 00 00 00 01 00 02 88 31
			15 00 00 00 01 00 02 89 02
			15 00 00 00 01 00 02 8A 45
			15 00 00 00 01 00 02 8B 02
			15 00 00 00 01 00 02 8C 6C
			15 00 00 00 01 00 02 8D 02
			15 00 00 00 01 00 02 8E 92
			15 00 00 00 01 00 02 8F 02
			15 00 00 00 01 00 02 90 93
			15 00 00 00 01 00 02 91 02
			15 00 00 00 01 00 02 92 BB
			15 00 00 00 01 00 02 93 02
			15 00 00 00 01 00 02 94 E8
			15 00 00 00 01 00 02 95 03
			15 00 00 00 01 00 02 96 05
			15 00 00 00 01 00 02 97 03
			15 00 00 00 01 00 02 98 39
			15 00 00 00 01 00 02 99 03
			15 00 00 00 01 00 02 9A 54
			15 00 00 00 01 00 02 9B 03
			15 00 00 00 01 00 02 9C 76
			15 00 00 00 01 00 02 9D 03
			15 00 00 00 01 00 02 9E 81
			15 00 00 00 01 00 02 9F 03
			15 00 00 00 01 00 02 A0 8C
			15 00 00 00 01 00 02 A2 03
			15 00 00 00 01 00 02 A3 9A
			15 00 00 00 01 00 02 A4 03
			15 00 00 00 01 00 02 A5 A9
			15 00 00 00 01 00 02 A6 03
			15 00 00 00 01 00 02 A7 B9
			15 00 00 00 01 00 02 A9 03
			15 00 00 00 01 00 02 AA C7
			15 00 00 00 01 00 02 AB 03
			15 00 00 00 01 00 02 AC CF
			15 00 00 00 01 00 02 AD 03
			15 00 00 00 01 00 02 AE D0
			15 00 00 00 01 00 02 AF 02
			15 00 00 00 01 00 02 B0 34
			15 00 00 00 01 00 02 B1 02
			15 00 00 00 01 00 02 B2 35
			15 00 00 00 01 00 02 B3 02
			15 00 00 00 01 00 02 B4 37
			15 00 00 00 01 00 02 B5 02
			15 00 00 00 01 00 02 B6 39
			15 00 00 00 01 00 02 B7 02
			15 00 00 00 01 00 02 B8 3B
			15 00 00 00 01 00 02 B9 02
			15 00 00 00 01 00 02 BA 3D
			15 00 00 00 01 00 02 BB 02
			15 00 00 00 01 00 02 BC 3F
			15 00 00 00 01 00 02 BD 02
			15 00 00 00 01 00 02 BE 41
			15 00 00 00 01 00 02 BF 02
			15 00 00 00 01 00 02 C0 43
			15 00 00 00 01 00 02 C1 02
			15 00 00 00 01 00 02 C2 4B
			15 00 00 00 01 00 02 C3 02
			15 00 00 00 01 00 02 C4 53
			15 00 00 00 01 00 02 C5 02
			15 00 00 00 01 00 02 C6 63
			15 00 00 00 01 00 02 C7 02
			15 00 00 00 01 00 02 C8 72
			15 00 00 00 01 00 02 C9 02
			15 00 00 00 01 00 02 CA 91
			15 00 00 00 01 00 02 CB 02
			15 00 00 00 01 00 02 CC B1
			15 00 00 00 01 00 02 CD 02
			15 00 00 00 01 00 02 CE B2
			15 00 00 00 01 00 02 CF 02
			15 00 00 00 01 00 02 D0 D4
			15 00 00 00 01 00 02 D1 02
			15 00 00 00 01 00 02 D2 FE
			15 00 00 00 01 00 02 D3 03
			15 00 00 00 01 00 02 D4 1D
			15 00 00 00 01 00 02 D5 03
			15 00 00 00 01 00 02 D6 4E
			15 00 00 00 01 00 02 D7 03
			15 00 00 00 01 00 02 D8 68
			15 00 00 00 01 00 02 D9 03
			15 00 00 00 01 00 02 DA 8A
			15 00 00 00 01 00 02 DB 03
			15 00 00 00 01 00 02 DC 95
			15 00 00 00 01 00 02 DD 03
			15 00 00 00 01 00 02 DE A1
			15 00 00 00 01 00 02 DF 03
			15 00 00 00 01 00 02 E0 AD
			15 00 00 00 01 00 02 E1 03
			15 00 00 00 01 00 02 E2 B9
			15 00 00 00 01 00 02 E3 03
			15 00 00 00 01 00 02 E4 C3
			15 00 00 00 01 00 02 E5 03
			15 00 00 00 01 00 02 E6 CB
			15 00 00 00 01 00 02 E7 03
			15 00 00 00 01 00 02 E8 F7
			15 00 00 00 01 00 02 E9 03
			15 00 00 00 01 00 02 EA F8
			15 00 00 00 01 00 02 FB 01
			15 01 00 00 01 00 02 FF 10
			];
		qcom,mdss-dsi-dispparam-papermode6-state = "dsi_hs_mode";
		qcom,mdss-dsi-dispparam-papermode7-command = [
			15 00 00 00 01 00 02 FF 20
			15 00 00 00 01 00 02 FB 01
			15 00 00 00 01 00 02 75 00
			15 00 00 00 01 00 02 76 00
			15 00 00 00 01 00 02 77 00
			15 00 00 00 01 00 02 78 41
			15 00 00 00 01 00 02 79 00
			15 00 00 00 01 00 02 7A 80
			15 00 00 00 01 00 02 7B 00
			15 00 00 00 01 00 02 7C A7
			15 00 00 00 01 00 02 7D 00
			15 00 00 00 01 00 02 7E C6
			15 00 00 00 01 00 02 7F 00
			15 00 00 00 01 00 02 80 DD
			15 00 00 00 01 00 02 81 00
			15 00 00 00 01 00 02 82 F3
			15 00 00 00 01 00 02 83 01
			15 00 00 00 01 00 02 84 06
			15 00 00 00 01 00 02 85 01
			15 00 00 00 01 00 02 86 15
			15 00 00 00 01 00 02 87 01
			15 00 00 00 01 00 02 88 4B
			15 00 00 00 01 00 02 89 01
			15 00 00 00 01 00 02 8A 74
			15 00 00 00 01 00 02 8B 01
			15 00 00 00 01 00 02 8C B1
			15 00 00 00 01 00 02 8D 01
			15 00 00 00 01 00 02 8E E2
			15 00 00 00 01 00 02 8F 02
			15 00 00 00 01 00 02 90 28
			15 00 00 00 01 00 02 91 02
			15 00 00 00 01 00 02 92 5B
			15 00 00 00 01 00 02 93 02
			15 00 00 00 01 00 02 94 5C
			15 00 00 00 01 00 02 95 02
			15 00 00 00 01 00 02 96 8E
			15 00 00 00 01 00 02 97 02
			15 00 00 00 01 00 02 98 C8
			15 00 00 00 01 00 02 99 02
			15 00 00 00 01 00 02 9A EC
			15 00 00 00 01 00 02 9B 03
			15 00 00 00 01 00 02 9C 1B
			15 00 00 00 01 00 02 9D 03
			15 00 00 00 01 00 02 9E 39
			15 00 00 00 01 00 02 9F 03
			15 00 00 00 01 00 02 A0 5F
			15 00 00 00 01 00 02 A2 03
			15 00 00 00 01 00 02 A3 6B
			15 00 00 00 01 00 02 A4 03
			15 00 00 00 01 00 02 A5 78
			15 00 00 00 01 00 02 A6 03
			15 00 00 00 01 00 02 A7 86
			15 00 00 00 01 00 02 A9 03
			15 00 00 00 01 00 02 AA 95
			15 00 00 00 01 00 02 AB 03
			15 00 00 00 01 00 02 AC A8
			15 00 00 00 01 00 02 AD 03
			15 00 00 00 01 00 02 AE BA
			15 00 00 00 01 00 02 AF 03
			15 00 00 00 01 00 02 B0 CC
			15 00 00 00 01 00 02 B1 03
			15 00 00 00 01 00 02 B2 D0
			15 00 00 00 01 00 02 B3 00
			15 00 00 00 01 00 02 B4 4C
			15 00 00 00 01 00 02 B5 00
			15 00 00 00 01 00 02 B6 8D
			15 00 00 00 01 00 02 B7 00
			15 00 00 00 01 00 02 B8 CB
			15 00 00 00 01 00 02 B9 00
			15 00 00 00 01 00 02 BA F0
			15 00 00 00 01 00 02 BB 01
			15 00 00 00 01 00 02 BC 0D
			15 00 00 00 01 00 02 BD 01
			15 00 00 00 01 00 02 BE 24
			15 00 00 00 01 00 02 BF 01
			15 00 00 00 01 00 02 C0 38
			15 00 00 00 01 00 02 C1 01
			15 00 00 00 01 00 02 C2 49
			15 00 00 00 01 00 02 C3 01
			15 00 00 00 01 00 02 C4 58
			15 00 00 00 01 00 02 C5 01
			15 00 00 00 01 00 02 C6 88
			15 00 00 00 01 00 02 C7 01
			15 00 00 00 01 00 02 C8 AB
			15 00 00 00 01 00 02 C9 01
			15 00 00 00 01 00 02 CA DE
			15 00 00 00 01 00 02 CB 02
			15 00 00 00 01 00 02 CC 03
			15 00 00 00 01 00 02 CD 02
			15 00 00 00 01 00 02 CE 3B
			15 00 00 00 01 00 02 CF 02
			15 00 00 00 01 00 02 D0 6E
			15 00 00 00 01 00 02 D1 02
			15 00 00 00 01 00 02 D2 6F
			15 00 00 00 01 00 02 D3 02
			15 00 00 00 01 00 02 D4 A1
			15 00 00 00 01 00 02 D5 02
			15 00 00 00 01 00 02 D6 D7
			15 00 00 00 01 00 02 D7 02
			15 00 00 00 01 00 02 D8 F9
			15 00 00 00 01 00 02 D9 03
			15 00 00 00 01 00 02 DA 24
			15 00 00 00 01 00 02 DB 03
			15 00 00 00 01 00 02 DC 40
			15 00 00 00 01 00 02 DD 03
			15 00 00 00 01 00 02 DE 64
			15 00 00 00 01 00 02 DF 03
			15 00 00 00 01 00 02 E0 6F
			15 00 00 00 01 00 02 E1 03
			15 00 00 00 01 00 02 E2 7B
			15 00 00 00 01 00 02 E3 03
			15 00 00 00 01 00 02 E4 89
			15 00 00 00 01 00 02 E5 03
			15 00 00 00 01 00 02 E6 97
			15 00 00 00 01 00 02 E7 03
			15 00 00 00 01 00 02 E8 A9
			15 00 00 00 01 00 02 E9 03
			15 00 00 00 01 00 02 EA BB
			15 00 00 00 01 00 02 EB 03
			15 00 00 00 01 00 02 EC CD
			15 00 00 00 01 00 02 ED 03
			15 00 00 00 01 00 02 EE D0
			15 00 00 00 01 00 02 EF 00
			15 00 00 00 01 00 02 F0 00
			15 00 00 00 01 00 02 F1 00
			15 00 00 00 01 00 02 F2 41
			15 00 00 00 01 00 02 F3 00
			15 00 00 00 01 00 02 F4 80
			15 00 00 00 01 00 02 F5 00
			15 00 00 00 01 00 02 F6 A7
			15 00 00 00 01 00 02 F7 00
			15 00 00 00 01 00 02 F8 C6
			15 00 00 00 01 00 02 F9 00
			15 01 00 00 01 00 02 FA DD

			15 00 00 00 01 00 02 FF 21
			15 00 00 00 01 00 02 FB 01
			15 00 00 00 01 00 02 00 00
			15 00 00 00 01 00 02 01 F3
			15 00 00 00 01 00 02 02 01
			15 00 00 00 01 00 02 03 06
			15 00 00 00 01 00 02 04 01
			15 00 00 00 01 00 02 05 15
			15 00 00 00 01 00 02 06 01
			15 00 00 00 01 00 02 07 4B
			15 00 00 00 01 00 02 08 01
			15 00 00 00 01 00 02 09 74
			15 00 00 00 01 00 02 0A 01
			15 00 00 00 01 00 02 0B B1
			15 00 00 00 01 00 02 0C 01
			15 00 00 00 01 00 02 0D E2
			15 00 00 00 01 00 02 0E 02
			15 00 00 00 01 00 02 0F 28
			15 00 00 00 01 00 02 10 02
			15 00 00 00 01 00 02 11 5B
			15 00 00 00 01 00 02 12 02
			15 00 00 00 01 00 02 13 5C
			15 00 00 00 01 00 02 14 02
			15 00 00 00 01 00 02 15 8E
			15 00 00 00 01 00 02 16 02
			15 00 00 00 01 00 02 17 C8
			15 00 00 00 01 00 02 18 02
			15 00 00 00 01 00 02 19 EC
			15 00 00 00 01 00 02 1A 03
			15 00 00 00 01 00 02 1B 1B
			15 00 00 00 01 00 02 1C 03
			15 00 00 00 01 00 02 1D 39
			15 00 00 00 01 00 02 1E 03
			15 00 00 00 01 00 02 1F 5F
			15 00 00 00 01 00 02 20 03
			15 00 00 00 01 00 02 21 6B
			15 00 00 00 01 00 02 22 03
			15 00 00 00 01 00 02 23 78
			15 00 00 00 01 00 02 24 03
			15 00 00 00 01 00 02 25 86
			15 00 00 00 01 00 02 26 03
			15 00 00 00 01 00 02 27 95
			15 00 00 00 01 00 02 28 03
			15 00 00 00 01 00 02 29 A8
			15 00 00 00 01 00 02 2A 03
			15 00 00 00 01 00 02 2B BA
			15 00 00 00 01 00 02 2D 03
			15 00 00 00 01 00 02 2F CC
			15 00 00 00 01 00 02 30 03
			15 00 00 00 01 00 02 31 D0
			15 00 00 00 01 00 02 32 00
			15 00 00 00 01 00 02 33 4C
			15 00 00 00 01 00 02 34 00
			15 00 00 00 01 00 02 35 8D
			15 00 00 00 01 00 02 36 00
			15 00 00 00 01 00 02 37 CB
			15 00 00 00 01 00 02 38 00
			15 00 00 00 01 00 02 39 F0
			15 00 00 00 01 00 02 3A 01
			15 00 00 00 01 00 02 3B 0D
			15 00 00 00 01 00 02 3D 01
			15 00 00 00 01 00 02 3F 24
			15 00 00 00 01 00 02 40 01
			15 00 00 00 01 00 02 41 38
			15 00 00 00 01 00 02 42 01
			15 00 00 00 01 00 02 43 49
			15 00 00 00 01 00 02 44 01
			15 00 00 00 01 00 02 45 58
			15 00 00 00 01 00 02 46 01
			15 00 00 00 01 00 02 47 88
			15 00 00 00 01 00 02 48 01
			15 00 00 00 01 00 02 49 AB
			15 00 00 00 01 00 02 4A 01
			15 00 00 00 01 00 02 4B DE
			15 00 00 00 01 00 02 4C 02
			15 00 00 00 01 00 02 4D 03
			15 00 00 00 01 00 02 4E 02
			15 00 00 00 01 00 02 4F 3B
			15 00 00 00 01 00 02 50 02
			15 00 00 00 01 00 02 51 6E
			15 00 00 00 01 00 02 52 02
			15 00 00 00 01 00 02 53 6F
			15 00 00 00 01 00 02 54 02
			15 00 00 00 01 00 02 55 A1
			15 00 00 00 01 00 02 56 02
			15 00 00 00 01 00 02 58 D7
			15 00 00 00 01 00 02 59 02
			15 00 00 00 01 00 02 5A F9
			15 00 00 00 01 00 02 5B 03
			15 00 00 00 01 00 02 5C 24
			15 00 00 00 01 00 02 5D 03
			15 00 00 00 01 00 02 5E 40
			15 00 00 00 01 00 02 5F 03
			15 00 00 00 01 00 02 60 64
			15 00 00 00 01 00 02 61 03
			15 00 00 00 01 00 02 62 6F
			15 00 00 00 01 00 02 63 03
			15 00 00 00 01 00 02 64 7B
			15 00 00 00 01 00 02 65 03
			15 00 00 00 01 00 02 66 89
			15 00 00 00 01 00 02 67 03
			15 00 00 00 01 00 02 68 97
			15 00 00 00 01 00 02 69 03
			15 00 00 00 01 00 02 6A A9
			15 00 00 00 01 00 02 6B 03
			15 00 00 00 01 00 02 6C BB
			15 00 00 00 01 00 02 6D 03
			15 00 00 00 01 00 02 6E CD
			15 00 00 00 01 00 02 6F 03
			15 00 00 00 01 00 02 70 D0
			15 00 00 00 01 00 02 71 02
			15 00 00 00 01 00 02 72 00
			15 00 00 00 01 00 02 73 02
			15 00 00 00 01 00 02 74 02
			15 00 00 00 01 00 02 75 02
			15 00 00 00 01 00 02 76 05
			15 00 00 00 01 00 02 77 02
			15 00 00 00 01 00 02 78 08
			15 00 00 00 01 00 02 79 02
			15 00 00 00 01 00 02 7A 0B
			15 00 00 00 01 00 02 7B 02
			15 00 00 00 01 00 02 7C 0E
			15 00 00 00 01 00 02 7D 02
			15 00 00 00 01 00 02 7E 10
			15 00 00 00 01 00 02 7F 02
			15 00 00 00 01 00 02 80 13
			15 00 00 00 01 00 02 81 02
			15 00 00 00 01 00 02 82 16
			15 00 00 00 01 00 02 83 02
			15 00 00 00 01 00 02 84 21
			15 00 00 00 01 00 02 85 02
			15 00 00 00 01 00 02 86 2B
			15 00 00 00 01 00 02 87 02
			15 00 00 00 01 00 02 88 3F
			15 00 00 00 01 00 02 89 02
			15 00 00 00 01 00 02 8A 51
			15 00 00 00 01 00 02 8B 02
			15 00 00 00 01 00 02 8C 76
			15 00 00 00 01 00 02 8D 02
			15 00 00 00 01 00 02 8E 9A
			15 00 00 00 01 00 02 8F 02
			15 00 00 00 01 00 02 90 9B
			15 00 00 00 01 00 02 91 02
			15 00 00 00 01 00 02 92 C1
			15 00 00 00 01 00 02 93 02
			15 00 00 00 01 00 02 94 ED
			15 00 00 00 01 00 02 95 03
			15 00 00 00 01 00 02 96 0B
			15 00 00 00 01 00 02 97 03
			15 00 00 00 01 00 02 98 3F
			15 00 00 00 01 00 02 99 03
			15 00 00 00 01 00 02 9A 59
			15 00 00 00 01 00 02 9B 03
			15 00 00 00 01 00 02 9C 7A
			15 00 00 00 01 00 02 9D 03
			15 00 00 00 01 00 02 9E 84
			15 00 00 00 01 00 02 9F 03
			15 00 00 00 01 00 02 A0 90
			15 00 00 00 01 00 02 A2 03
			15 00 00 00 01 00 02 A3 9D
			15 00 00 00 01 00 02 A4 03
			15 00 00 00 01 00 02 A5 AC
			15 00 00 00 01 00 02 A6 03
			15 00 00 00 01 00 02 A7 BB
			15 00 00 00 01 00 02 A9 03
			15 00 00 00 01 00 02 AA C8
			15 00 00 00 01 00 02 AB 03
			15 00 00 00 01 00 02 AC CF
			15 00 00 00 01 00 02 AD 03
			15 00 00 00 01 00 02 AE D0
			15 00 00 00 01 00 02 AF 02
			15 00 00 00 01 00 02 B0 4C
			15 00 00 00 01 00 02 B1 02
			15 00 00 00 01 00 02 B2 4D
			15 00 00 00 01 00 02 B3 02
			15 00 00 00 01 00 02 B4 4F
			15 00 00 00 01 00 02 B5 02
			15 00 00 00 01 00 02 B6 50
			15 00 00 00 01 00 02 B7 02
			15 00 00 00 01 00 02 B8 52
			15 00 00 00 01 00 02 B9 02
			15 00 00 00 01 00 02 BA 54
			15 00 00 00 01 00 02 BB 02
			15 00 00 00 01 00 02 BC 56
			15 00 00 00 01 00 02 BD 02
			15 00 00 00 01 00 02 BE 58
			15 00 00 00 01 00 02 BF 02
			15 00 00 00 01 00 02 C0 59
			15 00 00 00 01 00 02 C1 02
			15 00 00 00 01 00 02 C2 60
			15 00 00 00 01 00 02 C3 02
			15 00 00 00 01 00 02 C4 67
			15 00 00 00 01 00 02 C5 02
			15 00 00 00 01 00 02 C6 75
			15 00 00 00 01 00 02 C7 02
			15 00 00 00 01 00 02 C8 83
			15 00 00 00 01 00 02 C9 02
			15 00 00 00 01 00 02 CA A0
			15 00 00 00 01 00 02 CB 02
			15 00 00 00 01 00 02 CC BD
			15 00 00 00 01 00 02 CD 02
			15 00 00 00 01 00 02 CE BE
			15 00 00 00 01 00 02 CF 02
			15 00 00 00 01 00 02 D0 DF
			15 00 00 00 01 00 02 D1 03
			15 00 00 00 01 00 02 D2 08
			15 00 00 00 01 00 02 D3 03
			15 00 00 00 01 00 02 D4 2F
			15 00 00 00 01 00 02 D5 03
			15 00 00 00 01 00 02 D6 57
			15 00 00 00 01 00 02 D7 03
			15 00 00 00 01 00 02 D8 70
			15 00 00 00 01 00 02 D9 03
			15 00 00 00 01 00 02 DA 91
			15 00 00 00 01 00 02 DB 03
			15 00 00 00 01 00 02 DC 9C
			15 00 00 00 01 00 02 DD 03
			15 00 00 00 01 00 02 DE A7
			15 00 00 00 01 00 02 DF 03
			15 00 00 00 01 00 02 E0 B2
			15 00 00 00 01 00 02 E1 03
			15 00 00 00 01 00 02 E2 BD
			15 00 00 00 01 00 02 E3 03
			15 00 00 00 01 00 02 E4 C6
			15 00 00 00 01 00 02 E5 03
			15 00 00 00 01 00 02 E6 F9
			15 00 00 00 01 00 02 E7 03
			15 00 00 00 01 00 02 E8 FA
			15 00 00 00 01 00 02 E9 03
			15 00 00 00 01 00 02 EA FB
			15 00 00 00 01 00 02 FB 01
			15 01 00 00 01 00 02 FF 10
			];
		qcom,mdss-dsi-dispparam-papermode7-state = "dsi_hs_mode";
	};
};
