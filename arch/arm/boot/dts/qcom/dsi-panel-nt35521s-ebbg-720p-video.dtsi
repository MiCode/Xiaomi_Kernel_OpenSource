/* Copyright (c) 2013, The Linux Foundation. All rights reserved.
 *
 * This program is free software; you can redistribute it and/or modify
 * it under the terms of the GNU General Public License version 2 and
 * only version 2 as published by the Free Software Foundation.
 *
 * This program is distributed in the hope that it will be useful,
 * but WITHOUT ANY WARRANTY; without even the implied warranty of
 * MERCHANTABILITY or FITNESS FOR A PARTICULAR PURPOSE.  See the
 * GNU General Public License for more details.
 */

/*---------------------------------------------------------------------------
 * This file is autogenerated file using gcdb parser. Please do not edit it.
 * Update input XML file to add a new entry or update variable in this file
 * VERSION = "1.0"
 *---------------------------------------------------------------------------*/
&mdss_mdp {
	dsi_nt35521s_ebbg_720_video: qcom,mdss_dsi_nt35521s_ebbg_720p_video {
		qcom,mdss-dsi-panel-name = "nt35521s_HD720p_video_EBBG";
		qcom,mdss-dsi-panel-controller = <&mdss_dsi0>;
		qcom,mdss-dsi-panel-type = "dsi_video_mode";
		qcom,mdss-dsi-panel-destination = "display_1";
		qcom,mdss-dsi-panel-framerate = <60>;
		qcom,mdss-dsi-virtual-channel-id = <0>;
		qcom,mdss-dsi-stream = <0>;
		qcom,mdss-dsi-panel-width = <720>;
		qcom,mdss-dsi-panel-height = <1280>;
		qcom,mdss-pan-physical-width-dimension = <62>;
		qcom,mdss-pan-physical-height-dimension = <110>;
		qcom,mdss-dsi-h-front-porch = <200>;
		qcom,mdss-dsi-h-back-porch = <200>;
		qcom,mdss-dsi-h-pulse-width = <20>;
		qcom,mdss-dsi-h-sync-skew = <0>;
		qcom,mdss-dsi-v-back-porch = <28>;
		qcom,mdss-dsi-v-front-porch = <35>;
		qcom,mdss-dsi-v-pulse-width = <2>;
		qcom,mdss-dsi-h-left-border = <0>;
		qcom,mdss-dsi-h-right-border = <0>;
		qcom,mdss-dsi-v-top-border = <0>;
		qcom,mdss-dsi-v-bottom-border = <20>;
		qcom,mdss-dsi-bpp = <24>;
		qcom,mdss-dsi-underflow-color = <0x00>;
		qcom,mdss-dsi-border-color = <0>;
		qcom,mdss-dsi-on-command = [29 01 00 00 00 00 06 F0 55 AA 52 08 00
				29 01 00 00 00 00 02 B1 6C
				29 01 00 00 00 00 02 C8 83
				29 01 00 00 00 00 02 6F 02
				29 01 00 00 00 00 02 B2 02
				29 01 00 00 00 00 05 FF AA 55 25 01
				29 01 00 00 00 00 02 6F 10
				29 01 00 00 00 00 02 F7 1D
				29 01 00 00 00 00 02 6F 14
				29 01 00 00 00 00 02 F7 40
				29 01 00 00 00 00 05 FF AA 55 25 00
				29 01 00 00 00 00 02 35 00
				05 01 00 00 78 00 02 11 00
				05 01 00 00 20 00 02 29 00];
		qcom,mdss-dsi-off-command = [05 01 00 00 00 00 02 28 00
				05 01 00 00 78 00 02 10 00];
		qcom,mdss-dsi-on-command-state = "dsi_lp_mode";
		qcom,mdss-dsi-off-command-state = "dsi_lp_mode";
		qcom,mdss-dsi-panel-warm-command = [29 01 00 00 00 00 06 F0 55 AA 52 08 00
				29 01 00 00 00 00 02 26 01
				29 01 00 00 00 00 02 26 02];
		qcom,mdss-dsi-panel-cool-command = [29 01 00 00 00 00 06 F0 55 AA 52 08 00
				29 01 00 00 00 00 02 26 02
				29 01 00 00 00 00 02 26 04];
		qcom,mdss-dsi-panel-nature-command = [29 01 00 00 00 00 06 F0 55 AA 52 08 00
				29 01 00 00 00 00 02 26 02
				29 01 00 00 00 00 02 26 01];
		qcom,mdss-dsi-panel-gamma-command-state = "dsi_lp_mode";
		qcom,mdss-dsi-panel-ce-std-command = [29 00 00 00 00 00 06 F0 55 AA 52 08 00
				29 01 00 00 00 00 02 55 00];
		qcom,mdss-dsi-panel-ce-vivid-command = [29 00 00 00 00 00 06 F0 55 AA 52 08 00
				29 01 00 00 00 00 02 55 80];
		qcom,mdss-dsi-panel-ce-command-state = "dsi_lp_mode";
		qcom,mdss-dsi-init-last;
		qcom,mdss-dsi-h-sync-pulse = <1>;
		qcom,mdss-dsi-traffic-mode = "burst_mode";
		qcom,mdss-dsi-bllp-eof-power-mode;
		qcom,mdss-dsi-bllp-power-mode;
		qcom,mdss-dsi-lane-0-state;
		qcom,mdss-dsi-lane-1-state;
		qcom,mdss-dsi-lane-2-state;
		qcom,mdss-dsi-lane-3-state;
		qcom,mdss-dsi-panel-timings = [98 22 16 00 4A 4C 1C 26 19 03 04 00];
		qcom,mdss-dsi-t-clk-post = <0x04>;
		qcom,mdss-dsi-t-clk-pre = <0x1E>;
		qcom,mdss-dsi-bl-min-level = <100>;
		qcom,mdss-dsi-bl-max-level = <4095>;
		qcom,mdss-dsi-dma-trigger = "trigger_sw";
		qcom,mdss-dsi-mdp-trigger = "none";
		qcom,mdss-dsi-bl-pmic-control-type = "bl_ctrl_wled";
		qcom,mdss-dsi-reset-sequence = <1 20>, <0 20>, <1 20>;
		qcom,mdss-dsi-hbp-power-mode;
		qcom,esd-check-enabled;
		qcom,mdss-dsi-panel-status-command = [06 01 00 01 05 00 02 0A 08];
		qcom,mdss-dsi-panel-status-command-state = "dsi_lp_mode";
		qcom,mdss-dsi-panel-status-check-mode = "reg_read";
		qcom,mdss-dsi-panel-status-value = <0x9c>;
		qcom,mdss-dsi-panel-status-read-length = <1>;

		qcom,mdss-dsi-lp11-init;
		qcom,mdss-dsi-init-delay-us = <50000>;

	};
};
