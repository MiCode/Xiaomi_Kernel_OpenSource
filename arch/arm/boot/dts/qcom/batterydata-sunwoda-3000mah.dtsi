qcom,sunwoda-3000mah {
	qcom,max-voltage-uv = <4400000>;
	qcom,nom-batt-capacity-mah = <3080>;
	qcom,batt-id-kohm = <330>;
	qcom,battery-beta = <3380>;
	qcom,battery-type = "sunwoda_3000mah";
	qcom,chg-rslow-comp-c1 = <4217666>;
	qcom,chg-rslow-comp-c2 = <7592018>;
	qcom,chg-rs-to-rslow = <1365080>;
	qcom,chg-rslow-comp-thr = <0xB8>;
	qcom,checksum = <0x14E2>;
	qcom,gui-version = "PMI8950GUI - 2.0.0.16";
	qcom,fg-profile-data = [
			13 88 CB 7E
			2F 82 57 7C
			3E 83 42 72
			C8 7D B8 7A
			DE 81 39 A0
			22 C4 81 D1
			8B 10 F5 83
			07 7D 20 81
			2E 77 32 83
			FF 79 17 8C
			76 88 24 82
			9F 9B 2B C4
			51 D2 6A 0E
			F3 0B F7 59
			14 70 A5 FD
			0A 3A 8B 46
			1D 3E 00 00
			F0 47 54 40
			FE 1A 00 00
			00 00 00 00
			00 00 00 00
			23 73 73 70
			E8 86 B5 73
			D3 7D B2 73
			AA 6F F5 72
			15 76 53 6A
			61 57 D2 9A
			3F F8 61 15
			64 A0 71 0C
			28 00 FF 36
			F0 11 30 03
			00 00 00 0C
			];
};
