/* Copyright (c) 2013, The Linux Foundation. All rights reserved.
 * Copyright (C) 2016 XiaoMi, Inc.
 *
 * This program is free software; you can redistribute it and/or modify
 * it under the terms of the GNU General Public License version 2 and
 * only version 2 as published by the Free Software Foundation.
 *
 * This program is distributed in the hope that it will be useful,
 * but WITHOUT ANY WARRANTY; without even the implied warranty of
 * MERCHANTABILITY or FITNESS FOR A PARTICULAR PURPOSE.  See the
 * GNU General Public License for more details.
 */

/*---------------------------------------------------------------------------
 * This file is autogenerated file using gcdb parser. Please do not edit it.
 * Update input XML file to add a new entry or update variable in this file
 * VERSION = "1.0"
 *---------------------------------------------------------------------------*/
&mdss_mdp {
	dsi_r61308_720p_video: qcom,mdss_dsi_r61308_720p_video {
		qcom,mdss-dsi-panel-name = "r61308_HD720p_video_AUO3.5";
		qcom,mdss-dsi-panel-controller = <&mdss_dsi0>;
		qcom,mdss-dsi-panel-type = "dsi_video_mode";
		qcom,mdss-dsi-panel-destination = "display_1";
		qcom,mdss-dsi-panel-framerate = <60>;
		qcom,mdss-dsi-virtual-channel-id = <0>;
		qcom,mdss-dsi-stream = <0>;
		qcom,mdss-dsi-panel-width = <720>;
		qcom,mdss-dsi-panel-height = <1280>;
		qcom,mdss-pan-physical-width-dimension = <58>;
		qcom,mdss-pan-physical-height-dimension = <103>;
		qcom,mdss-dsi-h-front-porch = <120>;
		qcom,mdss-dsi-h-back-porch = <50>;
		qcom,mdss-dsi-h-pulse-width = <2>;
		qcom,mdss-dsi-h-sync-skew = <0>;
		qcom,mdss-dsi-v-back-porch = <14>;
		qcom,mdss-dsi-v-front-porch = <6>;
		qcom,mdss-dsi-v-pulse-width = <1>;
		qcom,mdss-dsi-h-left-border = <0>;
		qcom,mdss-dsi-h-right-border = <0>;
		qcom,mdss-dsi-v-top-border = <0>;
		qcom,mdss-dsi-v-bottom-border = <0>;
		qcom,mdss-dsi-bpp = <24>;
		qcom,mdss-dsi-color-order = "rgb_swap_rgb";
		qcom,mdss-dsi-underflow-color = <0xff>;
		qcom,mdss-dsi-border-color = <0>;
		qcom,mdss-dsi-on-command = [05 01 00 00 78 00 02 11 00
				39 01 00 00 00 00 02 36 00
				39 01 00 00 00 00 02 3A 07
				29 01 00 00 00 00 02 B0 04
				29 01 00 00 00 00 08 C1 50 02 22 00 00 ED 11
				29 01 00 00 00 00 19 C8 1A 24 29 2D 32 37 14 13 10 0C 0A 06 1A 24 28 2D 32 37 14 13 10 0C 0A 06
				29 01 00 00 00 00 09 CB 10 20 40 80 A0 C0 D0 E0
				29 01 00 00 00 00 04 CC C8 D8 FF
				29 01 00 00 00 00 08 CD 1C 1E 1E 1D 1C 1E 1E
				29 01 00 00 00 00 08 CE 1E 1E 1E 1D 1D 1E 1E
				29 01 00 00 00 00 08 CF 1E 1F 20 20 20 20 21
				29 01 00 00 00 00 02 B0 03
				05 01 00 00 0A 00 02 29 00];
		qcom,mdss-dsi-off-command = [05 01 00 00 32 00 02 28 00
				05 01 00 00 78 00 02 10 00];
		qcom,mdss-dsi-on-command-state = "dsi_lp_mode";
		qcom,mdss-dsi-off-command-state = "dsi_hs_mode";
		qcom,mdss-dsi-h-sync-pulse = <1>;
		qcom,mdss-dsi-traffic-mode = "burst_mode";
		qcom,mdss-dsi-bllp-eof-power-mode;
		qcom,mdss-dsi-bllp-power-mode;
		qcom,mdss-dsi-lane-0-state;
		qcom,mdss-dsi-lane-1-state;
		qcom,mdss-dsi-lane-2-state;
		qcom,mdss-dsi-panel-timings = [9B 22 18 00 4A 4C 1C 26 1D 03 04 00];
		qcom,mdss-dsi-t-clk-post = <0x04>;
		qcom,mdss-dsi-t-clk-pre = <0x1F>;
		qcom,mdss-dsi-tx-eot-append;
		qcom,esd-check-enabled;
		qcom,mdss-dsi-panel-status-check-mode = "reg_read";
				qcom,mdss-dsi-panel-status-command-state = "dsi_lp_mode";
				qcom,mdss-dsi-panel-status-command1 = [06 01 00 01 05 00 02 0A 08];
				qcom,mdss-dsi-panel-status-command-num = <1>;
				qcom,mdss-dsi-panel-status-value1 = <1 0x1C>;
		qcom,mdss-dsi-panel-warm-command = [29 01 00 00 00 00 02 B0 04
				29 01 00 00 00 00 08 C1 50 02 22 00 00 6D 11
				29 01 00 00 00 00 19 C8 1A 24 29 2D 32 36 14 13 10 0C 0A 06 1A 24 28 2D 32 36 14 13 10 0C 0A 06
				29 01 00 00 00 00 02 B0 03];
		qcom,mdss-dsi-panel-cool-command = [29 01 00 00 00 00 02 B0 04
				29 01 00 00 00 00 08 C1 50 02 22 00 00 ED 11
				29 01 00 00 00 00 19 C8 1A 24 29 2D 32 36 14 13 10 0C 0A 06 1A 24 28 2D 32 36 14 13 10 0C 0A 06
				29 01 00 00 00 00 09 CB 10 20 40 80 A0 C0 D0 E0
				29 01 00 00 00 00 04 CC 9F D3 FF
				29 01 00 00 00 00 08 CD 22 22 22 23 1E 24 24
				29 01 00 00 00 00 08 CE 1C 1C 1C 1E 1A 1B 1B
				29 01 00 00 00 00 08 CF 20 20 20 20 25 20 20
				29 01 00 00 00 00 02 B0 03];
		qcom,mdss-dsi-panel-nature-command = [29 01 00 00 00 00 02 B0 04
				29 01 00 00 00 00 08 C1 50 02 22 00 00 ED 11
				29 01 00 00 00 00 19 C8 1A 24 29 2D 32 37 14 13 10 0C 0A 06 1A 24 28 2D 32 37 14 13 10 0C 0A 06
				29 01 00 00 00 00 09 CB 10 20 40 80 A0 C0 D0 E0
				29 01 00 00 00 00 04 CC C8 D8 FF
				29 01 00 00 00 00 08 CD 1C 1E 1E 1D 1C 1E 1E
				29 01 00 00 00 00 08 CE 1E 1E 1E 1D 1D 1E 1E
				29 01 00 00 00 00 08 CF 1E 1F 20 20 20 20 21
				29 01 00 00 00 00 02 B0 03];
		qcom,mdss-dsi-panel-ce-std-command = [29 01 00 00 00 00 02 B0 04
				29 01 00 00 00 00 0C C9 01 80 80 80 A0 80 A0 80 08 20 80
				29 01 00 00 00 00 16 CA 80 10 4A 00 FF 00 FF 06 06 20 10 3F 3F 00 00 10 10 3F 3F 3F 3F
				29 01 00 00 00 00 02 B0 03];
		qcom,mdss-dsi-panel-ce-vivid-command = [29 01 00 00 00 00 02 B0 04
				29 01 00 00 00 00 0C C9 01 C0 C0 80 E0 80 E0 80 08 20 80
				29 01 00 00 00 00 16 CA 80 10 4A 00 FF 00 FF 06 06 20 10 3F 3F 00 00 10 10 3F 3F 3F 3F
				29 01 00 00 00 00 02 B0 03];
		qcom,mdss-dsi-panel-ce-bright-command = [29 01 00 00 00 00 02 B0 04
				29 01 00 00 00 00 0C C9 01 E0 E0 80 E0 80 E0 80 08 20 80
				29 01 00 00 00 00 16 CA 80 10 4A 00 FF 00 FF 06 06 20 10 3F 3F 00 00 10 10 3F 3F 3F 3F
				29 01 00 00 00 00 02 B0 03];
		qcom,mdss-dsi-panel-gamma-command-state = "dsi_hs_mode";
		qcom,mdss-dsi-panel-ce-command-state = "dsi_hs_mode";
		qcom,mdss-dsi-bl-min-level = <1>;
		qcom,mdss-dsi-bl-max-level = <255>;
		qcom,mdss-dsi-bl-pmic-pwm-frequency = <100>;
		qcom,mdss-dsi-bl-pmic-bank-select = <0>;
		qcom,mdss-dsi-dma-trigger = "trigger_sw";
		qcom,mdss-dsi-mdp-trigger = "none";
		qcom,mdss-dsi-bl-pmic-control-type = "bl_ctrl_pwm";
		qcom,mdss-dsi-reset-sequence = <1 5>, <0 10>, <1 30>;
		qcom,mdss-dsi-lp11-init;
		qcom,mdss-dsi-init-delay-us = <50000>;
	};
};
