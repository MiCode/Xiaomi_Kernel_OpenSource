/* Copyright (c) 2014, The Linux Foundation. All rights reserved.
 *
 * This program is free software; you can redistribute it and/or modify
 * it under the terms of the GNU General Public License version 2 and
 * only version 2 as published by the Free Software Foundation.
 *
 * This program is distributed in the hope that it will be useful,
 * but WITHOUT ANY WARRANTY; without even the implied warranty of
 * MERCHANTABILITY or FITNESS FOR A PARTICULAR PURPOSE.  See the
 * GNU General Public License for more details.
 */

/ {
	qcom,msm_qpic@f9ac0000 {
		compatible = "qcom,mdss_qpic";
		reg = <0xf9ac0000 0x24000>;
		reg-names = "qpic_base";
		interrupts = <0 251 0>;

		qcom,msm-bus,name = "mdss_qpic";
		qcom,msm-bus,num-cases = <2>;
		qcom,msm-bus,num-paths = <1>;

		qcom,msm-bus,vectors-KBps =
			<91 512 0 0>,
			/* Voting for max b/w on PNOC bus for now */
			<91 512 400000 800000>;

		vdd-supply = <&pmd9635_l6>;
		avdd-supply = <&pmd9635_l12>;
		qcom,cs-gpio = <&msmgpio 21 0>;
		qcom,te-gpio = <&msmgpio 22 0>;
		qcom,rst-gpio = <&msmgpio 23 0>;
		qcom,ad8-gpio = <&msmgpio 20 0>;
		qcom,bl-gpio = <&msmgpio 84 0>;
	};
};
