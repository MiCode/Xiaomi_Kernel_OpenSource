/*
 * Copyright (c) 2015, The Linux Foundation. All rights reserved.
 *
 * This program is free software; you can redistribute it and/or modify
 * it under the terms of the GNU General Public License version 2 and
 * only version 2 as published by the Free Software Foundation.
 *
 * This program is distributed in the hope that it will be useful,
 * but WITHOUT ANY WARRANTY; without even the implied warranty of
 * MERCHANTABILITY or FITNESS FOR A PARTICULAR PURPOSE.  See the
 * GNU General Public License for more details.
 */

/dts-v1/;

#include "apqgold.dtsi"
#include "msmgold-pmi8937-cdp.dtsi"

/ {
	model = "Qualcomm Technologies, Inc. APQGOLD-PMI8937 CDP";
	compatible = "qcom,apqgold-cdp", "qcom,apqgold", "qcom,cdp";
	qcom,board-id= <1 0>;
	qcom,pmic-id = <0x10019 0x020037 0x0 0x0>;
};
