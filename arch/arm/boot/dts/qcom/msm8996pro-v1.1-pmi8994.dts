/* Copyright (c) 2019, The Linux Foundation. All rights reserved.
 *
 * This program is free software; you can redistribute it and/or modify
 * it under the terms of the GNU General Public License version 2 and
 * only version 2 as published by the Free Software Foundation.
 *
 * This program is distributed in the hope that it will be useful,
 * but WITHOUT ANY WARRANTY; without even the implied warranty of
 * MERCHANTABILITY or FITNESS FOR A PARTICULAR PURPOSE.  See the
 * GNU General Public License for more details.
 */

/dts-v1/;

#include "msm8996pro-v1.1.dtsi"
#include "msm8996-pm8994-pmi8994-pm8004.dtsi"

/ {
	model = "Qualcomm Technologies, Inc. MSM 8996pro v1.1 + PMI8994";
	compatible = "qcom,msm8996";
	qcom,pmic-id = <0x20009 0x2000A 0x1000C 0x0>;
	qcom,msm-id = <305 0x10001>;
	qcom,pmic-name = "PMI8994";
};
