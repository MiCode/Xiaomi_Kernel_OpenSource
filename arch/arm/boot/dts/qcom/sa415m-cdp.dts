/* Copyright (c) 2019, The Linux Foundation. All rights reserved.
 *
 * This program is free software; you can redistribute it and/or modify
 * it under the terms of the GNU General Public License version 2 and
 * only version 2 as published by the Free Software Foundation.
 *
 * This program is distributed in the hope that it will be useful,
 * but WITHOUT ANY WARRANTY; without even the implied warranty of
 * MERCHANTABILITY or FITNESS FOR A PARTICULAR PURPOSE.  See the
 * GNU General Public License for more details.
 */

/dts-v1/;

#include "sa415m-cdp.dtsi"
#include "sdxpoorwills-display.dtsi"
#include "qpic-panel-ili-hvga.dtsi"

/ {
	model = "Qualcomm Technologies, Inc. SA415M CDP";
	compatible = "qcom,sdxpoorwills-cdp",
		"qcom,sdxpoorwills", "qcom,cdp";
	qcom,board-id = <1 0x104>;
};

&blsp1_uart2b_hs {
	status = "okay";
};

&mss_mem {
	reg = <0x86400000 0x9300000>;
};
