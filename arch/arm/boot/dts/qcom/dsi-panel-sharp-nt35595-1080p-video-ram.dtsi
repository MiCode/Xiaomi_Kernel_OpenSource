/* Copyright (c) 2015, The Linux Foundation. All rights reserved.
 * Copyright (C) 2018 XiaoMi, Inc.
 *
 * This program is free software; you can redistribute it and/or modify
 * it under the terms of the GNU General Public License version 2 and
 * only version 2 as published by the Free Software Foundation.
 *
 * This program is distributed in the hope that it will be useful,
 * but WITHOUT ANY WARRANTY; without even the implied warranty of
 * MERCHANTABILITY or FITNESS FOR A PARTICULAR PURPOSE.  See the
 * GNU General Public License for more details.
 */

 /*---------------------------------------------------------------------------
 * This file is autogenerated file using gcdb parser. Please do not edit it.
 * Update input XML file to add a new entry or update variable in this file
 * VERSION = "1.0"
 *---------------------------------------------------------------------------*/
&mdss_mdp {
	dsi_sharp_nt35595_1080_vid: qcom,mdss_dsi_sharp_nt35595_1080p_video {
		qcom,mdss-dsi-panel-name = "sharp nt35595 1080p video mode dsi panel";
		qcom,mdss-dsi-panel-id = <8>;
		qcom,mdss-dsi-panel-controller = <&mdss_dsi0>;
		qcom,mdss-dsi-panel-type = "dsi_video_mode";
		qcom,mdss-dsi-panel-destination = "display_1";
		qcom,mdss-dsi-panel-framerate = <60>;
		qcom,mdss-dsi-virtual-channel-id = <0>;
		qcom,mdss-dsi-stream = <0>;
		qcom,mdss-dsi-panel-width = <1080>;
		qcom,mdss-dsi-panel-height = <1920>;
		qcom,mdss-dsi-h-front-porch = <102>;
		qcom,mdss-dsi-h-back-porch = <48>;
		qcom,mdss-dsi-h-pulse-width = <12>;
		qcom,mdss-dsi-h-sync-skew = <0>;
		qcom,mdss-dsi-v-back-porch = <5>;
		qcom,mdss-dsi-v-front-porch = <4>;
		qcom,mdss-dsi-v-pulse-width = <2>;
		qcom,mdss-dsi-h-left-border = <0>;
		qcom,mdss-dsi-h-right-border = <0>;
		qcom,mdss-dsi-v-top-border = <0>;
		qcom,mdss-dsi-v-bottom-border = <0>;
		qcom,mdss-dsi-bpp = <24>;
		qcom,mdss-dsi-underflow-color = <0xff>;
		qcom,mdss-dsi-border-color = <0>;
		qcom,mdss-dsi-pixel-packing = "tight";
		qcom,mdss-dsi-pan-enable-dynamic-fps;
		qcom,mdss-dsi-pan-fps-update = "dfps_immediate_porch_mode_vfp";
		qcom,mdss-dsi-min-refresh-rate = <55>;
		qcom,mdss-dsi-max-refresh-rate = <60>;
		qcom,mdss-dsi-on-command = [
				15 00 00 00 01 00 02 FF 10
				15 00 00 00 01 00 02 BB 03
				15 00 00 00 01 00 02 B0 03
				39 00 00 00 01 00 06 3B 03 06 04 3C 66
				39 00 00 00 01 00 03 44 00 00
				15 00 00 00 01 00 02 FF 24
				15 00 00 00 01 00 02 C4 69
				15 00 00 00 01 00 02 C9 00
				15 00 00 00 01 00 02 FB 01

				15 00 00 00 01 00 02 FF 10
				15 01 00 00 01 00 02 34 00
				05 01 00 00 78 00 02 11 00
				15 00 00 00 01 00 02 51 FF
				15 00 00 00 01 00 02 53 2c
				15 00 00 00 01 00 02 55 81
				15 00 00 00 01 00 02 FF F0
				15 00 00 00 01 00 02 92 01
				15 00 00 00 01 00 02 13 01
				15 00 00 00 01 00 02 FF 22
				15 00 00 00 01 00 02 54 01
				15 00 00 00 01 00 02 56 00
				15 00 00 00 01 00 02 FB 01
				15 01 00 00 01 00 02 FF 10
				05 01 00 00 28 00 02 29 00

				15 01 00 00 01 00 02 FF 20
				15 00 00 00 01 00 02 FB 01
				15 00 00 00 01 00 02 75 01
				15 00 00 00 01 00 02 76 27
				15 00 00 00 01 00 02 77 01
				15 00 00 00 01 00 02 78 2D
				15 00 00 00 01 00 02 79 01
				15 00 00 00 01 00 02 7A 37
				15 00 00 00 01 00 02 7B 01
				15 00 00 00 01 00 02 7C 40
				15 00 00 00 01 00 02 7D 01
				15 00 00 00 01 00 02 7E 49
				15 00 00 00 01 00 02 7F 01
				15 00 00 00 01 00 02 80 52
				15 00 00 00 01 00 02 81 01
				15 00 00 00 01 00 02 82 5A
				15 00 00 00 01 00 02 83 01
				15 00 00 00 01 00 02 84 61
				15 00 00 00 01 00 02 85 01
				15 00 00 00 01 00 02 86 69
				15 00 00 00 01 00 02 87 01
				15 00 00 00 01 00 02 88 86
				15 00 00 00 01 00 02 89 01
				15 00 00 00 01 00 02 8A 9F
				15 00 00 00 01 00 02 8B 01
				15 00 00 00 01 00 02 8C CA
				15 00 00 00 01 00 02 8D 01
				15 00 00 00 01 00 02 8E F0
				15 00 00 00 01 00 02 8F 02
				15 00 00 00 01 00 02 90 2E
				15 00 00 00 01 00 02 91 02
				15 00 00 00 01 00 02 92 5B
				15 00 00 00 01 00 02 93 02
				15 00 00 00 01 00 02 94 5C
				15 00 00 00 01 00 02 95 02
				15 00 00 00 01 00 02 96 87
				15 00 00 00 01 00 02 97 02
				15 00 00 00 01 00 02 98 B8
				15 00 00 00 01 00 02 99 02
				15 00 00 00 01 00 02 9A D7
				15 00 00 00 01 00 02 9B 03
				15 01 00 00 01 00 02 9C 05
				15 00 00 00 01 00 02 9D 03
				15 00 00 00 01 00 02 9E 23
				15 00 00 00 01 00 02 9F 03
				15 00 00 00 01 00 02 A0 4B
				15 00 00 00 01 00 02 A2 03
				15 00 00 00 01 00 02 A3 56
				15 00 00 00 01 00 02 A4 03
				15 00 00 00 01 00 02 A5 63
				15 00 00 00 01 00 02 A6 03
				15 00 00 00 01 00 02 A7 6F
				15 00 00 00 01 00 02 A9 03
				15 00 00 00 01 00 02 AA 7D
				15 00 00 00 01 00 02 AB 03
				15 00 00 00 01 00 02 AC 8D
				15 00 00 00 01 00 02 AD 03
				15 00 00 00 01 00 02 AE 9A
				15 00 00 00 01 00 02 AF 03
				15 00 00 00 01 00 02 B0 A3
				15 00 00 00 01 00 02 B1 03
				15 00 00 00 01 00 02 B2 C6
				15 00 00 00 01 00 02 B3 01
				15 00 00 00 01 00 02 B4 5E
				15 00 00 00 01 00 02 B5 01
				15 00 00 00 01 00 02 B6 62
				15 00 00 00 01 00 02 B7 01
				15 00 00 00 01 00 02 B8 6B
				15 00 00 00 01 00 02 B9 01
				15 00 00 00 01 00 02 BA 73
				15 00 00 00 01 00 02 BB 01
				15 00 00 00 01 00 02 BC 7A
				15 00 00 00 01 00 02 BD 01
				15 00 00 00 01 00 02 BE 81
				15 00 00 00 01 00 02 BF 01
				15 00 00 00 01 00 02 C0 88
				15 00 00 00 01 00 02 C1 01
				15 00 00 00 01 00 02 C2 8E
				15 00 00 00 01 00 02 C3 01
				15 00 00 00 01 00 02 C4 94
				15 00 00 00 01 00 02 C5 01
				15 00 00 00 01 00 02 C6 AB
				15 01 00 00 01 00 02 C7 01
				15 00 00 00 01 00 02 C8 BE
				15 00 00 00 01 00 02 C9 01
				15 00 00 00 01 00 02 CA DD
				15 00 00 00 01 00 02 CB 01
				15 00 00 00 01 00 02 CC F7
				15 00 00 00 01 00 02 CD 02
				15 00 00 00 01 00 02 CE 25
				15 00 00 00 01 00 02 CF 02
				15 00 00 00 01 00 02 D0 52
				15 00 00 00 01 00 02 D1 02
				15 00 00 00 01 00 02 D2 53
				15 00 00 00 01 00 02 D3 02
				15 00 00 00 01 00 02 D4 7E
				15 00 00 00 01 00 02 D5 02
				15 00 00 00 01 00 02 D6 B7
				15 00 00 00 01 00 02 D7 02
				15 00 00 00 01 00 02 D8 DC
				15 00 00 00 01 00 02 D9 03
				15 00 00 00 01 00 02 DA 10
				15 00 00 00 01 00 02 DB 03
				15 00 00 00 01 00 02 DC 2A
				15 00 00 00 01 00 02 DD 03
				15 00 00 00 01 00 02 DE 50
				15 00 00 00 01 00 02 DF 03
				15 00 00 00 01 00 02 E0 5B
				15 00 00 00 01 00 02 E1 03
				15 00 00 00 01 00 02 E2 67
				15 00 00 00 01 00 02 E3 03
				15 00 00 00 01 00 02 E4 72
				15 00 00 00 01 00 02 E5 03
				15 00 00 00 01 00 02 E6 80
				15 00 00 00 01 00 02 E7 03
				15 00 00 00 01 00 02 E8 8F
				15 00 00 00 01 00 02 E9 03
				15 00 00 00 01 00 02 EA 9B
				15 00 00 00 01 00 02 EB 03
				15 00 00 00 01 00 02 EC A4
				15 00 00 00 01 00 02 ED 03
				15 00 00 00 01 00 02 EE C6
				15 00 00 00 01 00 02 EF 00
				15 00 00 00 01 00 02 F0 37
				15 00 00 00 01 00 02 F1 00
				15 01 00 00 01 00 02 F2 6A
				15 00 00 00 01 00 02 F3 00
				15 00 00 00 01 00 02 F4 97
				15 00 00 00 01 00 02 F5 00
				15 00 00 00 01 00 02 F6 B4
				15 00 00 00 01 00 02 F7 00
				15 00 00 00 01 00 02 F8 CB
				15 00 00 00 01 00 02 F9 00
				15 00 00 00 01 00 02 FA DE
				15 00 00 00 01 00 02 FF 21
				15 00 00 00 01 00 02 FB 01
				15 00 00 00 01 00 02 00 00
				15 00 00 00 01 00 02 01 F0
				15 00 00 00 01 00 02 02 00
				15 00 00 00 01 00 02 03 FE
				15 00 00 00 01 00 02 04 01
				15 00 00 00 01 00 02 05 0D
				15 00 00 00 01 00 02 06 01
				15 00 00 00 01 00 02 07 3B
				15 00 00 00 01 00 02 08 01
				15 00 00 00 01 00 02 09 61
				15 00 00 00 01 00 02 0A 01
				15 00 00 00 01 00 02 0B 9E
				15 00 00 00 01 00 02 0C 01
				15 00 00 00 01 00 02 0D CF
				15 00 00 00 01 00 02 0E 02
				15 00 00 00 01 00 02 0F 1A
				15 00 00 00 01 00 02 10 02
				15 00 00 00 01 00 02 11 4D
				15 00 00 00 01 00 02 12 02
				15 00 00 00 01 00 02 13 4F
				15 00 00 00 01 00 02 14 02
				15 00 00 00 01 00 02 15 7D
				15 00 00 00 01 00 02 16 02
				15 00 00 00 01 00 02 17 B1
				15 00 00 00 01 00 02 18 02
				15 00 00 00 01 00 02 19 D1
				15 00 00 00 01 00 02 1A 03
				15 00 00 00 01 00 02 1B 03
				15 00 00 00 01 00 02 1C 03
				15 00 00 00 01 00 02 1D 22
				15 01 00 00 01 00 02 1E 03
				15 00 00 00 01 00 02 1F 4A
				15 00 00 00 01 00 02 20 03
				15 00 00 00 01 00 02 21 56
				15 00 00 00 01 00 02 22 03
				15 00 00 00 01 00 02 23 62
				15 00 00 00 01 00 02 24 03
				15 00 00 00 01 00 02 25 70
				15 00 00 00 01 00 02 26 03
				15 00 00 00 01 00 02 27 82
				15 00 00 00 01 00 02 28 03
				15 00 00 00 01 00 02 29 93
				15 00 00 00 01 00 02 2A 03
				15 00 00 00 01 00 02 2B A9
				15 00 00 00 01 00 02 2D 03
				15 00 00 00 01 00 02 2F C0
				15 00 00 00 01 00 02 30 03
				15 00 00 00 01 00 02 31 C6
				15 00 00 00 01 00 02 32 00
				15 00 00 00 01 00 02 33 84
				15 00 00 00 01 00 02 34 00
				15 00 00 00 01 00 02 35 B5
				15 00 00 00 01 00 02 36 00
				15 00 00 00 01 00 02 37 E0
				15 00 00 00 01 00 02 38 00
				15 00 00 00 01 00 02 39 FB
				15 00 00 00 01 00 02 3A 01
				15 00 00 00 01 00 02 3B 11
				15 00 00 00 01 00 02 3D 01
				15 00 00 00 01 00 02 3F 23
				15 00 00 00 01 00 02 40 01
				15 00 00 00 01 00 02 41 31
				15 00 00 00 01 00 02 42 01
				15 00 00 00 01 00 02 43 3E
				15 00 00 00 01 00 02 44 01
				15 00 00 00 01 00 02 45 4B
				15 00 00 00 01 00 02 46 01
				15 00 00 00 01 00 02 47 72
				15 00 00 00 01 00 02 48 01
				15 00 00 00 01 00 02 49 90
				15 01 00 00 01 00 02 4A 01
				15 00 00 00 01 00 02 4B BD
				15 00 00 00 01 00 02 4C 01
				15 00 00 00 01 00 02 4D DE
				15 00 00 00 01 00 02 4E 02
				15 00 00 00 01 00 02 4F 15
				15 00 00 00 01 00 02 50 02
				15 00 00 00 01 00 02 51 48
				15 00 00 00 01 00 02 52 02
				15 00 00 00 01 00 02 53 4A
				15 00 00 00 01 00 02 54 02
				15 00 00 00 01 00 02 55 78
				15 00 00 00 01 00 02 56 02
				15 00 00 00 01 00 02 58 AE
				15 00 00 00 01 00 02 59 02
				15 00 00 00 01 00 02 5A D0
				15 00 00 00 01 00 02 5B 02
				15 00 00 00 01 00 02 5C FE
				15 00 00 00 01 00 02 5D 03
				15 00 00 00 01 00 02 5E 1E
				15 00 00 00 01 00 02 5F 03
				15 00 00 00 01 00 02 60 47
				15 00 00 00 01 00 02 61 03
				15 00 00 00 01 00 02 62 54
				15 00 00 00 01 00 02 63 03
				15 00 00 00 01 00 02 64 61
				15 00 00 00 01 00 02 65 03
				15 00 00 00 01 00 02 66 6F
				15 00 00 00 01 00 02 67 03
				15 00 00 00 01 00 02 68 81
				15 00 00 00 01 00 02 69 03
				15 00 00 00 01 00 02 6A 92
				15 00 00 00 01 00 02 6B 03
				15 00 00 00 01 00 02 6C A8
				15 00 00 00 01 00 02 6D 03
				15 00 00 00 01 00 02 6E BF
				15 00 00 00 01 00 02 6F 03
				15 00 00 00 01 00 02 70 C6
				15 00 00 00 01 00 02 71 01
				15 00 00 00 01 00 02 72 38
				15 01 00 00 01 00 02 73 01
				15 00 00 00 01 00 02 74 3E
				15 00 00 00 01 00 02 75 01
				15 00 00 00 01 00 02 76 46
				15 00 00 00 01 00 02 77 01
				15 00 00 00 01 00 02 78 4F
				15 00 00 00 01 00 02 79 01
				15 00 00 00 01 00 02 7A 56
				15 00 00 00 01 00 02 7B 01
				15 00 00 00 01 00 02 7C 5F
				15 00 00 00 01 00 02 7D 01
				15 00 00 00 01 00 02 7E 66
				15 00 00 00 01 00 02 7F 01
				15 00 00 00 01 00 02 80 6E
				15 00 00 00 01 00 02 81 01
				15 00 00 00 01 00 02 82 74
				15 00 00 00 01 00 02 83 01
				15 00 00 00 01 00 02 84 8F
				15 00 00 00 01 00 02 85 01
				15 00 00 00 01 00 02 86 A6
				15 00 00 00 01 00 02 87 01
				15 00 00 00 01 00 02 88 D1
				15 00 00 00 01 00 02 89 01
				15 00 00 00 01 00 02 8A F6
				15 00 00 00 01 00 02 8B 02
				15 00 00 00 01 00 02 8C 32
				15 00 00 00 01 00 02 8D 02
				15 00 00 00 01 00 02 8E 5F
				15 00 00 00 01 00 02 8F 02
				15 00 00 00 01 00 02 90 60
				15 00 00 00 01 00 02 91 02
				15 00 00 00 01 00 02 92 8A
				15 00 00 00 01 00 02 93 02
				15 00 00 00 01 00 02 94 BF
				15 00 00 00 01 00 02 95 02
				15 00 00 00 01 00 02 96 E0
				15 00 00 00 01 00 02 97 03
				15 00 00 00 01 00 02 98 17
				15 00 00 00 01 00 02 99 03
				15 00 00 00 01 00 02 9A 2D
				15 01 00 00 01 00 02 9B 03
				15 00 00 00 01 00 02 9C 53
				15 00 00 00 01 00 02 9D 03
				15 00 00 00 01 00 02 9E 5F
				15 00 00 00 01 00 02 9F 03
				15 00 00 00 01 00 02 A0 6B
				15 00 00 00 01 00 02 A2 03
				15 00 00 00 01 00 02 A3 78
				15 00 00 00 01 00 02 A4 03
				15 00 00 00 01 00 02 A5 87
				15 00 00 00 01 00 02 A6 03
				15 00 00 00 01 00 02 A7 98
				15 00 00 00 01 00 02 A9 03
				15 00 00 00 01 00 02 AA AB
				15 00 00 00 01 00 02 AB 03
				15 00 00 00 01 00 02 AC C0
				15 00 00 00 01 00 02 AD 03
				15 00 00 00 01 00 02 AE C6
				15 00 00 00 01 00 02 AF 01
				15 00 00 00 01 00 02 B0 73
				15 00 00 00 01 00 02 B1 01
				15 00 00 00 01 00 02 B2 77
				15 00 00 00 01 00 02 B3 01
				15 00 00 00 01 00 02 B4 7F
				15 00 00 00 01 00 02 B5 01
				15 00 00 00 01 00 02 B6 86
				15 00 00 00 01 00 02 B7 01
				15 00 00 00 01 00 02 B8 8B
				15 00 00 00 01 00 02 B9 01
				15 00 00 00 01 00 02 BA 92
				15 00 00 00 01 00 02 BB 01
				15 00 00 00 01 00 02 BC 99
				15 00 00 00 01 00 02 BD 01
				15 00 00 00 01 00 02 BE 9F
				15 00 00 00 01 00 02 BF 01
				15 00 00 00 01 00 02 C0 A3
				15 00 00 00 01 00 02 C1 01
				15 00 00 00 01 00 02 C2 B8
				15 00 00 00 01 00 02 C3 01
				15 00 00 00 01 00 02 C4 C9
				15 00 00 00 01 00 02 C5 01
				15 00 00 00 01 00 02 C6 E8
				15 01 00 00 01 00 02 C7 02
				15 00 00 00 01 00 02 C8 01
				15 00 00 00 01 00 02 C9 02
				15 00 00 00 01 00 02 CA 2D
				15 00 00 00 01 00 02 CB 02
				15 00 00 00 01 00 02 CC 5A
				15 00 00 00 01 00 02 CD 02
				15 00 00 00 01 00 02 CE 5B
				15 00 00 00 01 00 02 CF 02
				15 00 00 00 01 00 02 D0 85
				15 00 00 00 01 00 02 D1 02
				15 00 00 00 01 00 02 D2 BC
				15 00 00 00 01 00 02 D3 02
				15 00 00 00 01 00 02 D4 DF
				15 00 00 00 01 00 02 D5 03
				15 00 00 00 01 00 02 D6 12
				15 00 00 00 01 00 02 D7 03
				15 00 00 00 01 00 02 D8 29
				15 00 00 00 01 00 02 D9 03
				15 00 00 00 01 00 02 DA 50
				15 00 00 00 01 00 02 DB 03
				15 00 00 00 01 00 02 DC 5C
				15 00 00 00 01 00 02 DD 03
				15 00 00 00 01 00 02 DE 6A
				15 00 00 00 01 00 02 DF 03
				15 00 00 00 01 00 02 E0 77
				15 00 00 00 01 00 02 E1 03
				15 00 00 00 01 00 02 E2 86
				15 00 00 00 01 00 02 E3 03
				15 00 00 00 01 00 02 E4 97
				15 00 00 00 01 00 02 E5 03
				15 00 00 00 01 00 02 E6 AA
				15 00 00 00 01 00 02 E7 03
				15 00 00 00 01 00 02 E8 BF
				15 00 00 00 01 00 02 E9 03
				15 00 00 00 01 00 02 EA C6
				15 01 00 00 01 00 02 FF 10
		];

		qcom,mdss-dsi-off-command = [
				15 01 00 00 00 00 02 FF 10
				39 01 00 00 11 00 02 28 00
				39 01 00 00 44 00 02 10 00
				15 01 00 00 09 00 02 4F 01
		];
		qcom,mdss-dsi-on-command-state = "dsi_lp_mode";
		qcom,mdss-dsi-off-command-state = "dsi_hs_mode";
		qcom,mdss-dsi-h-sync-pulse = <0>;
		qcom,mdss-dsi-traffic-mode = "non_burst_sync_pulse";
		qcom,mdss-dsi-bllp-eof-power-mode;
		qcom,mdss-dsi-bllp-power-mode;
		qcom,mdss-dsi-lane-0-state;
		qcom,mdss-dsi-lane-1-state;
		qcom,mdss-dsi-lane-2-state;
		qcom,mdss-dsi-lane-3-state;
		qcom,mdss-dsi-lp11-init;
		qcom,mdss-dsi-panel-timings = [E0 4A 36 00 A9 AA 2B 4E 3C 03 04 00];//883M
		qcom,mdss-dsi-t-clk-post = <0x19>;
		qcom,mdss-dsi-t-clk-pre = <0x2f>;
		qcom,mdss-dsi-bl-min-level = <1>;
		qcom,mdss-dsi-bl-max-level = <4095>;
		qcom,mdss-brightness-max-level = <4095>;
		qcom,mdss-dsi-dma-trigger = "trigger_sw";
		qcom,mdss-dsi-mdp-trigger = "none";
		qcom,mdss-dsi-bl-pmic-control-type = "bl_ctrl_wled";
		qcom,mdss-dsi-reset-sequence = <1 5>, <0 5>, <1 10>;
		qcom,mdss-pan-physical-width-dimension = <61>;
		qcom,mdss-pan-physical-height-dimension = <109>;
		qcom,cont-splash-enabled;
		qcom,dispparam-enabled;
		qcom,mdss-night-brightness = <11 16 20 26>;
		qcom,mdss-dsi-dispparam-ceon-command = [
				];
		qcom,mdss-dsi-dispparam-ceon-command-state = "dsi_hs_mode";
		qcom,mdss-dsi-dispparam-ceoff-command = [
				];
		qcom,mdss-dsi-dispparam-ceoff-command-state = "dsi_hs_mode";

		qcom,mdss-dsi-dispparam-warm-command = [
				15 00 00 00 01 00 02 FF 20
				15 00 00 00 01 00 02 FB 01
				15 00 00 00 01 00 02 75 00
				15 00 00 00 01 00 02 76 F1
				15 00 00 00 01 00 02 77 00
				15 00 00 00 01 00 02 78 F8
				15 00 00 00 01 00 02 79 01
				15 00 00 00 01 00 02 7A 06
				15 00 00 00 01 00 02 7B 01
				15 00 00 00 01 00 02 7C 13
				15 00 00 00 01 00 02 7D 01
				15 00 00 00 01 00 02 7E 1F
				15 00 00 00 01 00 02 7F 01
				15 00 00 00 01 00 02 80 2A
				15 00 00 00 01 00 02 81 01
				15 00 00 00 01 00 02 82 35
				15 00 00 00 01 00 02 83 01
				15 00 00 00 01 00 02 84 3E
				15 00 00 00 01 00 02 85 01
				15 00 00 00 01 00 02 86 48
				15 00 00 00 01 00 02 87 01
				15 00 00 00 01 00 02 88 69
				15 00 00 00 01 00 02 89 01
				15 00 00 00 01 00 02 8A 87
				15 00 00 00 01 00 02 8B 01
				15 00 00 00 01 00 02 8C B8
				15 00 00 00 01 00 02 8D 01
				15 00 00 00 01 00 02 8E E3
				15 00 00 00 01 00 02 8F 02
				15 00 00 00 01 00 02 90 25
				15 00 00 00 01 00 02 91 02
				15 00 00 00 01 00 02 92 54
				15 00 00 00 01 00 02 93 02
				15 00 00 00 01 00 02 94 56
				15 00 00 00 01 00 02 95 02
				15 00 00 00 01 00 02 96 82
				15 00 00 00 01 00 02 97 02
				15 00 00 00 01 00 02 98 B5
				15 00 00 00 01 00 02 99 02
				15 00 00 00 01 00 02 9A D5
				15 00 00 00 01 00 02 9B 03
				15 01 00 00 01 00 02 9C 06
				15 00 00 00 01 00 02 9D 03
				15 00 00 00 01 00 02 9E 30
				15 00 00 00 01 00 02 9F 03
				15 00 00 00 01 00 02 A0 58
				15 00 00 00 01 00 02 A2 03
				15 00 00 00 01 00 02 A3 64
				15 00 00 00 01 00 02 A4 03
				15 00 00 00 01 00 02 A5 6F
				15 00 00 00 01 00 02 A6 03
				15 00 00 00 01 00 02 A7 7D
				15 00 00 00 01 00 02 A9 03
				15 00 00 00 01 00 02 AA 8D
				15 00 00 00 01 00 02 AB 03
				15 00 00 00 01 00 02 AC 9E
				15 00 00 00 01 00 02 AD 03
				15 00 00 00 01 00 02 AE B1
				15 00 00 00 01 00 02 AF 03
				15 00 00 00 01 00 02 B0 C3
				15 00 00 00 01 00 02 B1 03
				15 00 00 00 01 00 02 B2 C6
				15 00 00 00 01 00 02 B3 01
				15 00 00 00 01 00 02 B4 30
				15 00 00 00 01 00 02 B5 01
				15 00 00 00 01 00 02 B6 35
				15 00 00 00 01 00 02 B7 01
				15 00 00 00 01 00 02 B8 41
				15 00 00 00 01 00 02 B9 01
				15 00 00 00 01 00 02 BA 4E
				15 00 00 00 01 00 02 BB 01
				15 00 00 00 01 00 02 BC 58
				15 00 00 00 01 00 02 BD 01
				15 00 00 00 01 00 02 BE 61
				15 00 00 00 01 00 02 BF 01
				15 00 00 00 01 00 02 C0 6A
				15 00 00 00 01 00 02 C1 01
				15 00 00 00 01 00 02 C2 72
				15 00 00 00 01 00 02 C3 01
				15 00 00 00 01 00 02 C4 7B
				15 00 00 00 01 00 02 C5 01
				15 00 00 00 01 00 02 C6 95
				15 01 00 00 01 00 02 C7 01
				15 00 00 00 01 00 02 C8 AC
				15 00 00 00 01 00 02 C9 01
				15 00 00 00 01 00 02 CA D1
				15 00 00 00 01 00 02 CB 01
				15 00 00 00 01 00 02 CC EE
				15 00 00 00 01 00 02 CD 02
				15 00 00 00 01 00 02 CE 20
				15 00 00 00 01 00 02 CF 02
				15 00 00 00 01 00 02 D0 4F
				15 00 00 00 01 00 02 D1 02
				15 00 00 00 01 00 02 D2 51
				15 00 00 00 01 00 02 D3 02
				15 00 00 00 01 00 02 D4 7D
				15 00 00 00 01 00 02 D5 02
				15 00 00 00 01 00 02 D6 B2
				15 00 00 00 01 00 02 D7 02
				15 00 00 00 01 00 02 D8 D4
				15 00 00 00 01 00 02 D9 03
				15 00 00 00 01 00 02 DA 01
				15 00 00 00 01 00 02 DB 03
				15 00 00 00 01 00 02 DC 2C
				15 00 00 00 01 00 02 DD 03
				15 00 00 00 01 00 02 DE 55
				15 00 00 00 01 00 02 DF 03
				15 00 00 00 01 00 02 E0 61
				15 00 00 00 01 00 02 E1 03
				15 00 00 00 01 00 02 E2 6E
				15 00 00 00 01 00 02 E3 03
				15 00 00 00 01 00 02 E4 7C
				15 00 00 00 01 00 02 E5 03
				15 00 00 00 01 00 02 E6 8C
				15 00 00 00 01 00 02 E7 03
				15 00 00 00 01 00 02 E8 9D
				15 00 00 00 01 00 02 E9 03
				15 00 00 00 01 00 02 EA B0
				15 00 00 00 01 00 02 EB 03
				15 00 00 00 01 00 02 EC C2
				15 00 00 00 01 00 02 ED 03
				15 00 00 00 01 00 02 EE C6
				15 00 00 00 01 00 02 EF 00
				15 00 00 00 01 00 02 F0 37
				15 00 00 00 01 00 02 F1 00
				15 01 00 00 01 00 02 F2 73
				15 00 00 00 01 00 02 F3 00
				15 00 00 00 01 00 02 F4 9D
				15 00 00 00 01 00 02 F5 00
				15 00 00 00 01 00 02 F6 B9
				15 00 00 00 01 00 02 F7 00
				15 00 00 00 01 00 02 F8 CF
				15 00 00 00 01 00 02 F9 00
				15 00 00 00 01 00 02 FA E2
				15 00 00 00 01 00 02 FF 21
				15 00 00 00 01 00 02 FB 01
				15 00 00 00 01 00 02 00 00
				15 00 00 00 01 00 02 01 F3
				15 00 00 00 01 00 02 02 01
				15 00 00 00 01 00 02 03 02
				15 00 00 00 01 00 02 04 01
				15 00 00 00 01 00 02 05 0F
				15 00 00 00 01 00 02 06 01
				15 00 00 00 01 00 02 07 3D
				15 00 00 00 01 00 02 08 01
				15 00 00 00 01 00 02 09 62
				15 00 00 00 01 00 02 0A 01
				15 00 00 00 01 00 02 0B 9F
				15 00 00 00 01 00 02 0C 01
				15 00 00 00 01 00 02 0D D0
				15 00 00 00 01 00 02 0E 02
				15 00 00 00 01 00 02 0F 1A
				15 00 00 00 01 00 02 10 02
				15 00 00 00 01 00 02 11 4D
				15 00 00 00 01 00 02 12 02
				15 00 00 00 01 00 02 13 4F
				15 00 00 00 01 00 02 14 02
				15 00 00 00 01 00 02 15 7C
				15 00 00 00 01 00 02 16 02
				15 00 00 00 01 00 02 17 AF
				15 00 00 00 01 00 02 18 02
				15 00 00 00 01 00 02 19 CF
				15 00 00 00 01 00 02 1A 02
				15 00 00 00 01 00 02 1B FD
				15 00 00 00 01 00 02 1C 03
				15 00 00 00 01 00 02 1D 21
				15 01 00 00 01 00 02 1E 03
				15 00 00 00 01 00 02 1F 47
				15 00 00 00 01 00 02 20 03
				15 00 00 00 01 00 02 21 51
				15 00 00 00 01 00 02 22 03
				15 00 00 00 01 00 02 23 5E
				15 00 00 00 01 00 02 24 03
				15 00 00 00 01 00 02 25 6D
				15 00 00 00 01 00 02 26 03
				15 00 00 00 01 00 02 27 7E
				15 00 00 00 01 00 02 28 03
				15 00 00 00 01 00 02 29 8E
				15 00 00 00 01 00 02 2A 03
				15 00 00 00 01 00 02 2B A3
				15 00 00 00 01 00 02 2D 03
				15 00 00 00 01 00 02 2F C1
				15 00 00 00 01 00 02 30 03
				15 00 00 00 01 00 02 31 C6
				15 00 00 00 01 00 02 32 00
				15 00 00 00 01 00 02 33 84
				15 00 00 00 01 00 02 34 00
				15 00 00 00 01 00 02 35 BE
				15 00 00 00 01 00 02 36 00
				15 00 00 00 01 00 02 37 E6
				15 00 00 00 01 00 02 38 01
				15 00 00 00 01 00 02 39 01
				15 00 00 00 01 00 02 3A 01
				15 00 00 00 01 00 02 3B 15
				15 00 00 00 01 00 02 3D 01
				15 00 00 00 01 00 02 3F 26
				15 00 00 00 01 00 02 40 01
				15 00 00 00 01 00 02 41 34
				15 00 00 00 01 00 02 42 01
				15 00 00 00 01 00 02 43 42
				15 00 00 00 01 00 02 44 01
				15 00 00 00 01 00 02 45 4E
				15 00 00 00 01 00 02 46 01
				15 00 00 00 01 00 02 47 74
				15 00 00 00 01 00 02 48 01
				15 00 00 00 01 00 02 49 91
				15 01 00 00 01 00 02 4A 01
				15 00 00 00 01 00 02 4B BE
				15 00 00 00 01 00 02 4C 01
				15 00 00 00 01 00 02 4D DF
				15 00 00 00 01 00 02 4E 02
				15 00 00 00 01 00 02 4F 15
				15 00 00 00 01 00 02 50 02
				15 00 00 00 01 00 02 51 48
				15 00 00 00 01 00 02 52 02
				15 00 00 00 01 00 02 53 4A
				15 00 00 00 01 00 02 54 02
				15 00 00 00 01 00 02 55 77
				15 00 00 00 01 00 02 56 02
				15 00 00 00 01 00 02 58 AC
				15 00 00 00 01 00 02 59 02
				15 00 00 00 01 00 02 5A CE
				15 00 00 00 01 00 02 5B 02
				15 00 00 00 01 00 02 5C F9
				15 00 00 00 01 00 02 5D 03
				15 00 00 00 01 00 02 5E 1D
				15 00 00 00 01 00 02 5F 03
				15 00 00 00 01 00 02 60 44
				15 00 00 00 01 00 02 61 03
				15 00 00 00 01 00 02 62 4F
				15 00 00 00 01 00 02 63 03
				15 00 00 00 01 00 02 64 5D
				15 00 00 00 01 00 02 65 03
				15 00 00 00 01 00 02 66 6C
				15 00 00 00 01 00 02 67 03
				15 00 00 00 01 00 02 68 7D
				15 00 00 00 01 00 02 69 03
				15 00 00 00 01 00 02 6A 8D
				15 00 00 00 01 00 02 6B 03
				15 00 00 00 01 00 02 6C A2
				15 00 00 00 01 00 02 6D 03
				15 00 00 00 01 00 02 6E C0
				15 00 00 00 01 00 02 6F 03
				15 00 00 00 01 00 02 70 C6
				15 00 00 00 01 00 02 71 01
				15 00 00 00 01 00 02 72 73
				15 01 00 00 01 00 02 73 01
				15 00 00 00 01 00 02 74 75
				15 00 00 00 01 00 02 75 01
				15 00 00 00 01 00 02 76 7C
				15 00 00 00 01 00 02 77 01
				15 00 00 00 01 00 02 78 81
				15 00 00 00 01 00 02 79 01
				15 00 00 00 01 00 02 7A 87
				15 00 00 00 01 00 02 7B 01
				15 00 00 00 01 00 02 7C 8D
				15 00 00 00 01 00 02 7D 01
				15 00 00 00 01 00 02 7E 92
				15 00 00 00 01 00 02 7F 01
				15 00 00 00 01 00 02 80 98
				15 00 00 00 01 00 02 81 01
				15 00 00 00 01 00 02 82 9D
				15 00 00 00 01 00 02 83 01
				15 00 00 00 01 00 02 84 B2
				15 00 00 00 01 00 02 85 01
				15 00 00 00 01 00 02 86 C6
				15 00 00 00 01 00 02 87 01
				15 00 00 00 01 00 02 88 EA
				15 00 00 00 01 00 02 89 02
				15 00 00 00 01 00 02 8A 0C
				15 00 00 00 01 00 02 8B 02
				15 00 00 00 01 00 02 8C 3F
				15 00 00 00 01 00 02 8D 02
				15 00 00 00 01 00 02 8E 68
				15 00 00 00 01 00 02 8F 02
				15 00 00 00 01 00 02 90 6A
				15 00 00 00 01 00 02 91 02
				15 00 00 00 01 00 02 92 92
				15 00 00 00 01 00 02 93 02
				15 00 00 00 01 00 02 94 C1
				15 00 00 00 01 00 02 95 02
				15 00 00 00 01 00 02 96 E0
				15 00 00 00 01 00 02 97 03
				15 00 00 00 01 00 02 98 10
				15 00 00 00 01 00 02 99 03
				15 00 00 00 01 00 02 9A 3A
				15 01 00 00 01 00 02 9B 03
				15 00 00 00 01 00 02 9C 5A
				15 00 00 00 01 00 02 9D 03
				15 00 00 00 01 00 02 9E 66
				15 00 00 00 01 00 02 9F 03
				15 00 00 00 01 00 02 A0 71
				15 00 00 00 01 00 02 A2 03
				15 00 00 00 01 00 02 A3 7E
				15 00 00 00 01 00 02 A4 03
				15 00 00 00 01 00 02 A5 8B
				15 00 00 00 01 00 02 A6 03
				15 00 00 00 01 00 02 A7 99
				15 00 00 00 01 00 02 A9 03
				15 00 00 00 01 00 02 AA B0
				15 00 00 00 01 00 02 AB 03
				15 00 00 00 01 00 02 AC BE
				15 00 00 00 01 00 02 AD 03
				15 00 00 00 01 00 02 AE C6
				15 00 00 00 01 00 02 AF 01
				15 00 00 00 01 00 02 B0 A7
				15 00 00 00 01 00 02 B1 01
				15 00 00 00 01 00 02 B2 AA
				15 00 00 00 01 00 02 B3 01
				15 00 00 00 01 00 02 B4 AF
				15 00 00 00 01 00 02 B5 01
				15 00 00 00 01 00 02 B6 B2
				15 00 00 00 01 00 02 B7 01
				15 00 00 00 01 00 02 B8 B8
				15 00 00 00 01 00 02 B9 01
				15 00 00 00 01 00 02 BA BC
				15 00 00 00 01 00 02 BB 01
				15 00 00 00 01 00 02 BC BF
				15 00 00 00 01 00 02 BD 01
				15 00 00 00 01 00 02 BE C3
				15 00 00 00 01 00 02 BF 01
				15 00 00 00 01 00 02 C0 C7
				15 00 00 00 01 00 02 C1 01
				15 00 00 00 01 00 02 C2 D7
				15 00 00 00 01 00 02 C3 01
				15 00 00 00 01 00 02 C4 E5
				15 00 00 00 01 00 02 C5 01
				15 00 00 00 01 00 02 C6 FD
				15 01 00 00 01 00 02 C7 02
				15 00 00 00 01 00 02 C8 13
				15 00 00 00 01 00 02 C9 02
				15 00 00 00 01 00 02 CA 38
				15 00 00 00 01 00 02 CB 02
				15 00 00 00 01 00 02 CC 61
				15 00 00 00 01 00 02 CD 02
				15 00 00 00 01 00 02 CE 63
				15 00 00 00 01 00 02 CF 02
				15 00 00 00 01 00 02 D0 8B
				15 00 00 00 01 00 02 D1 02
				15 00 00 00 01 00 02 D2 C2
				15 00 00 00 01 00 02 D3 02
				15 00 00 00 01 00 02 D4 E7
				15 00 00 00 01 00 02 D5 03
				15 00 00 00 01 00 02 D6 1E
				15 00 00 00 01 00 02 D7 03
				15 00 00 00 01 00 02 D8 45
				15 00 00 00 01 00 02 D9 03
				15 00 00 00 01 00 02 DA 61
				15 00 00 00 01 00 02 DB 03
				15 00 00 00 01 00 02 DC 6B
				15 00 00 00 01 00 02 DD 03
				15 00 00 00 01 00 02 DE 76
				15 00 00 00 01 00 02 DF 03
				15 00 00 00 01 00 02 E0 81
				15 00 00 00 01 00 02 E1 03
				15 00 00 00 01 00 02 E2 8E
				15 00 00 00 01 00 02 E3 03
				15 00 00 00 01 00 02 E4 9B
				15 00 00 00 01 00 02 E5 03
				15 00 00 00 01 00 02 E6 B1
				15 00 00 00 01 00 02 E7 03
				15 00 00 00 01 00 02 E8 BF
				15 00 00 00 01 00 02 E9 03
				15 00 00 00 01 00 02 EA C6
				15 01 00 00 01 00 02 FF 10
			];
		qcom,mdss-dsi-dispparam-warm-command-state = "dsi_hs_mode";

		qcom,mdss-dsi-dispparam-default-command = [
				15 01 00 00 01 00 02 FF 20
				15 00 00 00 01 00 02 FB 01
				15 00 00 00 01 00 02 75 01
				15 00 00 00 01 00 02 76 27
				15 00 00 00 01 00 02 77 01
				15 00 00 00 01 00 02 78 2D
				15 00 00 00 01 00 02 79 01
				15 00 00 00 01 00 02 7A 37
				15 00 00 00 01 00 02 7B 01
				15 00 00 00 01 00 02 7C 40
				15 00 00 00 01 00 02 7D 01
				15 00 00 00 01 00 02 7E 49
				15 00 00 00 01 00 02 7F 01
				15 00 00 00 01 00 02 80 52
				15 00 00 00 01 00 02 81 01
				15 00 00 00 01 00 02 82 5A
				15 00 00 00 01 00 02 83 01
				15 00 00 00 01 00 02 84 61
				15 00 00 00 01 00 02 85 01
				15 00 00 00 01 00 02 86 69
				15 00 00 00 01 00 02 87 01
				15 00 00 00 01 00 02 88 86
				15 00 00 00 01 00 02 89 01
				15 00 00 00 01 00 02 8A 9F
				15 00 00 00 01 00 02 8B 01
				15 00 00 00 01 00 02 8C CA
				15 00 00 00 01 00 02 8D 01
				15 00 00 00 01 00 02 8E F0
				15 00 00 00 01 00 02 8F 02
				15 00 00 00 01 00 02 90 2E
				15 00 00 00 01 00 02 91 02
				15 00 00 00 01 00 02 92 5B
				15 00 00 00 01 00 02 93 02
				15 00 00 00 01 00 02 94 5C
				15 00 00 00 01 00 02 95 02
				15 00 00 00 01 00 02 96 87
				15 00 00 00 01 00 02 97 02
				15 00 00 00 01 00 02 98 B8
				15 00 00 00 01 00 02 99 02
				15 00 00 00 01 00 02 9A D7
				15 00 00 00 01 00 02 9B 03
				15 01 00 00 01 00 02 9C 05
				15 00 00 00 01 00 02 9D 03
				15 00 00 00 01 00 02 9E 23
				15 00 00 00 01 00 02 9F 03
				15 00 00 00 01 00 02 A0 4B
				15 00 00 00 01 00 02 A2 03
				15 00 00 00 01 00 02 A3 56
				15 00 00 00 01 00 02 A4 03
				15 00 00 00 01 00 02 A5 63
				15 00 00 00 01 00 02 A6 03
				15 00 00 00 01 00 02 A7 6F
				15 00 00 00 01 00 02 A9 03
				15 00 00 00 01 00 02 AA 7D
				15 00 00 00 01 00 02 AB 03
				15 00 00 00 01 00 02 AC 8D
				15 00 00 00 01 00 02 AD 03
				15 00 00 00 01 00 02 AE 9A
				15 00 00 00 01 00 02 AF 03
				15 00 00 00 01 00 02 B0 A3
				15 00 00 00 01 00 02 B1 03
				15 00 00 00 01 00 02 B2 C6
				15 00 00 00 01 00 02 B3 01
				15 00 00 00 01 00 02 B4 5E
				15 00 00 00 01 00 02 B5 01
				15 00 00 00 01 00 02 B6 62
				15 00 00 00 01 00 02 B7 01
				15 00 00 00 01 00 02 B8 6B
				15 00 00 00 01 00 02 B9 01
				15 00 00 00 01 00 02 BA 73
				15 00 00 00 01 00 02 BB 01
				15 00 00 00 01 00 02 BC 7A
				15 00 00 00 01 00 02 BD 01
				15 00 00 00 01 00 02 BE 81
				15 00 00 00 01 00 02 BF 01
				15 00 00 00 01 00 02 C0 88
				15 00 00 00 01 00 02 C1 01
				15 00 00 00 01 00 02 C2 8E
				15 00 00 00 01 00 02 C3 01
				15 00 00 00 01 00 02 C4 94
				15 00 00 00 01 00 02 C5 01
				15 00 00 00 01 00 02 C6 AB
				15 01 00 00 01 00 02 C7 01
				15 00 00 00 01 00 02 C8 BE
				15 00 00 00 01 00 02 C9 01
				15 00 00 00 01 00 02 CA DD
				15 00 00 00 01 00 02 CB 01
				15 00 00 00 01 00 02 CC F7
				15 00 00 00 01 00 02 CD 02
				15 00 00 00 01 00 02 CE 25
				15 00 00 00 01 00 02 CF 02
				15 00 00 00 01 00 02 D0 52
				15 00 00 00 01 00 02 D1 02
				15 00 00 00 01 00 02 D2 53
				15 00 00 00 01 00 02 D3 02
				15 00 00 00 01 00 02 D4 7E
				15 00 00 00 01 00 02 D5 02
				15 00 00 00 01 00 02 D6 B7
				15 00 00 00 01 00 02 D7 02
				15 00 00 00 01 00 02 D8 DC
				15 00 00 00 01 00 02 D9 03
				15 00 00 00 01 00 02 DA 10
				15 00 00 00 01 00 02 DB 03
				15 00 00 00 01 00 02 DC 2A
				15 00 00 00 01 00 02 DD 03
				15 00 00 00 01 00 02 DE 50
				15 00 00 00 01 00 02 DF 03
				15 00 00 00 01 00 02 E0 5B
				15 00 00 00 01 00 02 E1 03
				15 00 00 00 01 00 02 E2 67
				15 00 00 00 01 00 02 E3 03
				15 00 00 00 01 00 02 E4 72
				15 00 00 00 01 00 02 E5 03
				15 00 00 00 01 00 02 E6 80
				15 00 00 00 01 00 02 E7 03
				15 00 00 00 01 00 02 E8 8F
				15 00 00 00 01 00 02 E9 03
				15 00 00 00 01 00 02 EA 9B
				15 00 00 00 01 00 02 EB 03
				15 00 00 00 01 00 02 EC A4
				15 00 00 00 01 00 02 ED 03
				15 00 00 00 01 00 02 EE C6
				15 00 00 00 01 00 02 EF 00
				15 00 00 00 01 00 02 F0 37
				15 00 00 00 01 00 02 F1 00
				15 01 00 00 01 00 02 F2 6A
				15 00 00 00 01 00 02 F3 00
				15 00 00 00 01 00 02 F4 97
				15 00 00 00 01 00 02 F5 00
				15 00 00 00 01 00 02 F6 B4
				15 00 00 00 01 00 02 F7 00
				15 00 00 00 01 00 02 F8 CB
				15 00 00 00 01 00 02 F9 00
				15 00 00 00 01 00 02 FA DE
				15 00 00 00 01 00 02 FF 21
				15 00 00 00 01 00 02 FB 01
				15 00 00 00 01 00 02 00 00
				15 00 00 00 01 00 02 01 F0
				15 00 00 00 01 00 02 02 00
				15 00 00 00 01 00 02 03 FE
				15 00 00 00 01 00 02 04 01
				15 00 00 00 01 00 02 05 0D
				15 00 00 00 01 00 02 06 01
				15 00 00 00 01 00 02 07 3B
				15 00 00 00 01 00 02 08 01
				15 00 00 00 01 00 02 09 61
				15 00 00 00 01 00 02 0A 01
				15 00 00 00 01 00 02 0B 9E
				15 00 00 00 01 00 02 0C 01
				15 00 00 00 01 00 02 0D CF
				15 00 00 00 01 00 02 0E 02
				15 00 00 00 01 00 02 0F 1A
				15 00 00 00 01 00 02 10 02
				15 00 00 00 01 00 02 11 4D
				15 00 00 00 01 00 02 12 02
				15 00 00 00 01 00 02 13 4F
				15 00 00 00 01 00 02 14 02
				15 00 00 00 01 00 02 15 7D
				15 00 00 00 01 00 02 16 02
				15 00 00 00 01 00 02 17 B1
				15 00 00 00 01 00 02 18 02
				15 00 00 00 01 00 02 19 D1
				15 00 00 00 01 00 02 1A 03
				15 00 00 00 01 00 02 1B 03
				15 00 00 00 01 00 02 1C 03
				15 00 00 00 01 00 02 1D 22
				15 01 00 00 01 00 02 1E 03
				15 00 00 00 01 00 02 1F 4A
				15 00 00 00 01 00 02 20 03
				15 00 00 00 01 00 02 21 56
				15 00 00 00 01 00 02 22 03
				15 00 00 00 01 00 02 23 62
				15 00 00 00 01 00 02 24 03
				15 00 00 00 01 00 02 25 70
				15 00 00 00 01 00 02 26 03
				15 00 00 00 01 00 02 27 82
				15 00 00 00 01 00 02 28 03
				15 00 00 00 01 00 02 29 93
				15 00 00 00 01 00 02 2A 03
				15 00 00 00 01 00 02 2B A9
				15 00 00 00 01 00 02 2D 03
				15 00 00 00 01 00 02 2F C0
				15 00 00 00 01 00 02 30 03
				15 00 00 00 01 00 02 31 C6
				15 00 00 00 01 00 02 32 00
				15 00 00 00 01 00 02 33 84
				15 00 00 00 01 00 02 34 00
				15 00 00 00 01 00 02 35 B5
				15 00 00 00 01 00 02 36 00
				15 00 00 00 01 00 02 37 E0
				15 00 00 00 01 00 02 38 00
				15 00 00 00 01 00 02 39 FB
				15 00 00 00 01 00 02 3A 01
				15 00 00 00 01 00 02 3B 11
				15 00 00 00 01 00 02 3D 01
				15 00 00 00 01 00 02 3F 23
				15 00 00 00 01 00 02 40 01
				15 00 00 00 01 00 02 41 31
				15 00 00 00 01 00 02 42 01
				15 00 00 00 01 00 02 43 3E
				15 00 00 00 01 00 02 44 01
				15 00 00 00 01 00 02 45 4B
				15 00 00 00 01 00 02 46 01
				15 00 00 00 01 00 02 47 72
				15 00 00 00 01 00 02 48 01
				15 00 00 00 01 00 02 49 90
				15 01 00 00 01 00 02 4A 01
				15 00 00 00 01 00 02 4B BD
				15 00 00 00 01 00 02 4C 01
				15 00 00 00 01 00 02 4D DE
				15 00 00 00 01 00 02 4E 02
				15 00 00 00 01 00 02 4F 15
				15 00 00 00 01 00 02 50 02
				15 00 00 00 01 00 02 51 48
				15 00 00 00 01 00 02 52 02
				15 00 00 00 01 00 02 53 4A
				15 00 00 00 01 00 02 54 02
				15 00 00 00 01 00 02 55 78
				15 00 00 00 01 00 02 56 02
				15 00 00 00 01 00 02 58 AE
				15 00 00 00 01 00 02 59 02
				15 00 00 00 01 00 02 5A D0
				15 00 00 00 01 00 02 5B 02
				15 00 00 00 01 00 02 5C FE
				15 00 00 00 01 00 02 5D 03
				15 00 00 00 01 00 02 5E 1E
				15 00 00 00 01 00 02 5F 03
				15 00 00 00 01 00 02 60 47
				15 00 00 00 01 00 02 61 03
				15 00 00 00 01 00 02 62 54
				15 00 00 00 01 00 02 63 03
				15 00 00 00 01 00 02 64 61
				15 00 00 00 01 00 02 65 03
				15 00 00 00 01 00 02 66 6F
				15 00 00 00 01 00 02 67 03
				15 00 00 00 01 00 02 68 81
				15 00 00 00 01 00 02 69 03
				15 00 00 00 01 00 02 6A 92
				15 00 00 00 01 00 02 6B 03
				15 00 00 00 01 00 02 6C A8
				15 00 00 00 01 00 02 6D 03
				15 00 00 00 01 00 02 6E BF
				15 00 00 00 01 00 02 6F 03
				15 00 00 00 01 00 02 70 C6
				15 00 00 00 01 00 02 71 01
				15 00 00 00 01 00 02 72 38
				15 01 00 00 01 00 02 73 01
				15 00 00 00 01 00 02 74 3E
				15 00 00 00 01 00 02 75 01
				15 00 00 00 01 00 02 76 46
				15 00 00 00 01 00 02 77 01
				15 00 00 00 01 00 02 78 4F
				15 00 00 00 01 00 02 79 01
				15 00 00 00 01 00 02 7A 56
				15 00 00 00 01 00 02 7B 01
				15 00 00 00 01 00 02 7C 5F
				15 00 00 00 01 00 02 7D 01
				15 00 00 00 01 00 02 7E 66
				15 00 00 00 01 00 02 7F 01
				15 00 00 00 01 00 02 80 6E
				15 00 00 00 01 00 02 81 01
				15 00 00 00 01 00 02 82 74
				15 00 00 00 01 00 02 83 01
				15 00 00 00 01 00 02 84 8F
				15 00 00 00 01 00 02 85 01
				15 00 00 00 01 00 02 86 A6
				15 00 00 00 01 00 02 87 01
				15 00 00 00 01 00 02 88 D1
				15 00 00 00 01 00 02 89 01
				15 00 00 00 01 00 02 8A F6
				15 00 00 00 01 00 02 8B 02
				15 00 00 00 01 00 02 8C 32
				15 00 00 00 01 00 02 8D 02
				15 00 00 00 01 00 02 8E 5F
				15 00 00 00 01 00 02 8F 02
				15 00 00 00 01 00 02 90 60
				15 00 00 00 01 00 02 91 02
				15 00 00 00 01 00 02 92 8A
				15 00 00 00 01 00 02 93 02
				15 00 00 00 01 00 02 94 BF
				15 00 00 00 01 00 02 95 02
				15 00 00 00 01 00 02 96 E0
				15 00 00 00 01 00 02 97 03
				15 00 00 00 01 00 02 98 17
				15 00 00 00 01 00 02 99 03
				15 00 00 00 01 00 02 9A 2D
				15 01 00 00 01 00 02 9B 03
				15 00 00 00 01 00 02 9C 53
				15 00 00 00 01 00 02 9D 03
				15 00 00 00 01 00 02 9E 5F
				15 00 00 00 01 00 02 9F 03
				15 00 00 00 01 00 02 A0 6B
				15 00 00 00 01 00 02 A2 03
				15 00 00 00 01 00 02 A3 78
				15 00 00 00 01 00 02 A4 03
				15 00 00 00 01 00 02 A5 87
				15 00 00 00 01 00 02 A6 03
				15 00 00 00 01 00 02 A7 98
				15 00 00 00 01 00 02 A9 03
				15 00 00 00 01 00 02 AA AB
				15 00 00 00 01 00 02 AB 03
				15 00 00 00 01 00 02 AC C0
				15 00 00 00 01 00 02 AD 03
				15 00 00 00 01 00 02 AE C6
				15 00 00 00 01 00 02 AF 01
				15 00 00 00 01 00 02 B0 73
				15 00 00 00 01 00 02 B1 01
				15 00 00 00 01 00 02 B2 77
				15 00 00 00 01 00 02 B3 01
				15 00 00 00 01 00 02 B4 7F
				15 00 00 00 01 00 02 B5 01
				15 00 00 00 01 00 02 B6 86
				15 00 00 00 01 00 02 B7 01
				15 00 00 00 01 00 02 B8 8B
				15 00 00 00 01 00 02 B9 01
				15 00 00 00 01 00 02 BA 92
				15 00 00 00 01 00 02 BB 01
				15 00 00 00 01 00 02 BC 99
				15 00 00 00 01 00 02 BD 01
				15 00 00 00 01 00 02 BE 9F
				15 00 00 00 01 00 02 BF 01
				15 00 00 00 01 00 02 C0 A3
				15 00 00 00 01 00 02 C1 01
				15 00 00 00 01 00 02 C2 B8
				15 00 00 00 01 00 02 C3 01
				15 00 00 00 01 00 02 C4 C9
				15 00 00 00 01 00 02 C5 01
				15 00 00 00 01 00 02 C6 E8
				15 01 00 00 01 00 02 C7 02
				15 00 00 00 01 00 02 C8 01
				15 00 00 00 01 00 02 C9 02
				15 00 00 00 01 00 02 CA 2D
				15 00 00 00 01 00 02 CB 02
				15 00 00 00 01 00 02 CC 5A
				15 00 00 00 01 00 02 CD 02
				15 00 00 00 01 00 02 CE 5B
				15 00 00 00 01 00 02 CF 02
				15 00 00 00 01 00 02 D0 85
				15 00 00 00 01 00 02 D1 02
				15 00 00 00 01 00 02 D2 BC
				15 00 00 00 01 00 02 D3 02
				15 00 00 00 01 00 02 D4 DF
				15 00 00 00 01 00 02 D5 03
				15 00 00 00 01 00 02 D6 12
				15 00 00 00 01 00 02 D7 03
				15 00 00 00 01 00 02 D8 29
				15 00 00 00 01 00 02 D9 03
				15 00 00 00 01 00 02 DA 50
				15 00 00 00 01 00 02 DB 03
				15 00 00 00 01 00 02 DC 5C
				15 00 00 00 01 00 02 DD 03
				15 00 00 00 01 00 02 DE 6A
				15 00 00 00 01 00 02 DF 03
				15 00 00 00 01 00 02 E0 77
				15 00 00 00 01 00 02 E1 03
				15 00 00 00 01 00 02 E2 86
				15 00 00 00 01 00 02 E3 03
				15 00 00 00 01 00 02 E4 97
				15 00 00 00 01 00 02 E5 03
				15 00 00 00 01 00 02 E6 AA
				15 00 00 00 01 00 02 E7 03
				15 00 00 00 01 00 02 E8 BF
				15 00 00 00 01 00 02 E9 03
				15 00 00 00 01 00 02 EA C6
				15 01 00 00 01 00 02 FF 10				];
		qcom,mdss-dsi-dispparam-default-command-state = "dsi_hs_mode";

		qcom,mdss-dsi-dispparam-cold-command = [
				15 00 00 00 01 00 02 FF 20
				15 00 00 00 01 00 02 FB 01
				15 00 00 00 01 00 02 75 01
				15 00 00 00 01 00 02 76 4C
				15 00 00 00 01 00 02 77 01
				15 00 00 00 01 00 02 78 4F
				15 00 00 00 01 00 02 79 01
				15 00 00 00 01 00 02 7A 58
				15 00 00 00 01 00 02 7B 01
				15 00 00 00 01 00 02 7C 60
				15 00 00 00 01 00 02 7D 01
				15 00 00 00 01 00 02 7E 69
				15 00 00 00 01 00 02 7F 01
				15 00 00 00 01 00 02 80 70
				15 00 00 00 01 00 02 81 01
				15 00 00 00 01 00 02 82 77
				15 00 00 00 01 00 02 83 01
				15 00 00 00 01 00 02 84 7E
				15 00 00 00 01 00 02 85 01
				15 00 00 00 01 00 02 86 86
				15 00 00 00 01 00 02 87 01
				15 00 00 00 01 00 02 88 A0
				15 00 00 00 01 00 02 89 01
				15 00 00 00 01 00 02 8A B6
				15 00 00 00 01 00 02 8B 01
				15 00 00 00 01 00 02 8C DC
				15 00 00 00 01 00 02 8D 02
				15 00 00 00 01 00 02 8E 01
				15 00 00 00 01 00 02 8F 02
				15 00 00 00 01 00 02 90 35
				15 00 00 00 01 00 02 91 02
				15 00 00 00 01 00 02 92 61
				15 00 00 00 01 00 02 93 02
				15 00 00 00 01 00 02 94 62
				15 00 00 00 01 00 02 95 02
				15 00 00 00 01 00 02 96 8F
				15 00 00 00 01 00 02 97 02
				15 00 00 00 01 00 02 98 BE
				15 00 00 00 01 00 02 99 02
				15 00 00 00 01 00 02 9A DD
				15 00 00 00 01 00 02 9B 03
				15 01 00 00 01 00 02 9C 0A
				15 00 00 00 01 00 02 9D 03
				15 00 00 00 01 00 02 9E 2A
				15 00 00 00 01 00 02 9F 03
				15 00 00 00 01 00 02 A0 52
				15 00 00 00 01 00 02 A2 03
				15 00 00 00 01 00 02 A3 5D
				15 00 00 00 01 00 02 A4 03
				15 00 00 00 01 00 02 A5 6C
				15 00 00 00 01 00 02 A6 03
				15 00 00 00 01 00 02 A7 78
				15 00 00 00 01 00 02 A9 03
				15 00 00 00 01 00 02 AA 87
				15 00 00 00 01 00 02 AB 03
				15 00 00 00 01 00 02 AC 97
				15 00 00 00 01 00 02 AD 03
				15 00 00 00 01 00 02 AE A9
				15 00 00 00 01 00 02 AF 03
				15 00 00 00 01 00 02 B0 B9
				15 00 00 00 01 00 02 B1 03
				15 00 00 00 01 00 02 B2 C6
				15 00 00 00 01 00 02 B3 01
				15 00 00 00 01 00 02 B4 81
				15 00 00 00 01 00 02 B5 01
				15 00 00 00 01 00 02 B6 83
				15 00 00 00 01 00 02 B7 01
				15 00 00 00 01 00 02 B8 8B
				15 00 00 00 01 00 02 B9 01
				15 00 00 00 01 00 02 BA 91
				15 00 00 00 01 00 02 BB 01
				15 00 00 00 01 00 02 BC 98
				15 00 00 00 01 00 02 BD 01
				15 00 00 00 01 00 02 BE 9E
				15 00 00 00 01 00 02 BF 01
				15 00 00 00 01 00 02 C0 A4
				15 00 00 00 01 00 02 C1 01
				15 00 00 00 01 00 02 C2 A9
				15 00 00 00 01 00 02 C3 01
				15 00 00 00 01 00 02 C4 AF
				15 00 00 00 01 00 02 C5 01
				15 00 00 00 01 00 02 C6 C3
				15 01 00 00 01 00 02 C7 01
				15 00 00 00 01 00 02 C8 D3
				15 00 00 00 01 00 02 C9 01
				15 00 00 00 01 00 02 CA EE
				15 00 00 00 01 00 02 CB 02
				15 00 00 00 01 00 02 CC 07
				15 00 00 00 01 00 02 CD 02
				15 00 00 00 01 00 02 CE 2C
				15 00 00 00 01 00 02 CF 02
				15 00 00 00 01 00 02 D0 58
				15 00 00 00 01 00 02 D1 02
				15 00 00 00 01 00 02 D2 59
				15 00 00 00 01 00 02 D3 02
				15 00 00 00 01 00 02 D4 85
				15 00 00 00 01 00 02 D5 02
				15 00 00 00 01 00 02 D6 BC
				15 00 00 00 01 00 02 D7 02
				15 00 00 00 01 00 02 D8 E2
				15 00 00 00 01 00 02 D9 03
				15 00 00 00 01 00 02 DA 15
				15 00 00 00 01 00 02 DB 03
				15 00 00 00 01 00 02 DC 33
				15 00 00 00 01 00 02 DD 03
				15 00 00 00 01 00 02 DE 57
				15 00 00 00 01 00 02 DF 03
				15 00 00 00 01 00 02 E0 62
				15 00 00 00 01 00 02 E1 03
				15 00 00 00 01 00 02 E2 70
				15 00 00 00 01 00 02 E3 03
				15 00 00 00 01 00 02 E4 7B
				15 00 00 00 01 00 02 E5 03
				15 00 00 00 01 00 02 E6 8A
				15 00 00 00 01 00 02 E7 03
				15 00 00 00 01 00 02 E8 98
				15 00 00 00 01 00 02 E9 03
				15 00 00 00 01 00 02 EA AA
				15 00 00 00 01 00 02 EB 03
				15 00 00 00 01 00 02 EC BA
				15 00 00 00 01 00 02 ED 03
				15 00 00 00 01 00 02 EE C6
				15 00 00 00 01 00 02 EF 00
				15 00 00 00 01 00 02 F0 37
				15 00 00 00 01 00 02 F1 00
				15 01 00 00 01 00 02 F2 73
				15 00 00 00 01 00 02 F3 00
				15 00 00 00 01 00 02 F4 9D
				15 00 00 00 01 00 02 F5 00
				15 00 00 00 01 00 02 F6 B9
				15 00 00 00 01 00 02 F7 00
				15 00 00 00 01 00 02 F8 CF
				15 00 00 00 01 00 02 F9 00
				15 00 00 00 01 00 02 FA E2
				15 00 00 00 01 00 02 FF 21
				15 00 00 00 01 00 02 FB 01
				15 00 00 00 01 00 02 00 00
				15 00 00 00 01 00 02 01 F3
				15 00 00 00 01 00 02 02 01
				15 00 00 00 01 00 02 03 02
				15 00 00 00 01 00 02 04 01
				15 00 00 00 01 00 02 05 0F
				15 00 00 00 01 00 02 06 01
				15 00 00 00 01 00 02 07 3D
				15 00 00 00 01 00 02 08 01
				15 00 00 00 01 00 02 09 62
				15 00 00 00 01 00 02 0A 01
				15 00 00 00 01 00 02 0B 9F
				15 00 00 00 01 00 02 0C 01
				15 00 00 00 01 00 02 0D D0
				15 00 00 00 01 00 02 0E 02
				15 00 00 00 01 00 02 0F 1A
				15 00 00 00 01 00 02 10 02
				15 00 00 00 01 00 02 11 4D
				15 00 00 00 01 00 02 12 02
				15 00 00 00 01 00 02 13 4F
				15 00 00 00 01 00 02 14 02
				15 00 00 00 01 00 02 15 7E
				15 00 00 00 01 00 02 16 02
				15 00 00 00 01 00 02 17 B2
				15 00 00 00 01 00 02 18 02
				15 00 00 00 01 00 02 19 D2
				15 00 00 00 01 00 02 1A 03
				15 00 00 00 01 00 02 1B 04
				15 00 00 00 01 00 02 1C 03
				15 00 00 00 01 00 02 1D 29
				15 01 00 00 01 00 02 1E 03
				15 00 00 00 01 00 02 1F 4E
				15 00 00 00 01 00 02 20 03
				15 00 00 00 01 00 02 21 58
				15 00 00 00 01 00 02 22 03
				15 00 00 00 01 00 02 23 65
				15 00 00 00 01 00 02 24 03
				15 00 00 00 01 00 02 25 72
				15 00 00 00 01 00 02 26 03
				15 00 00 00 01 00 02 27 83
				15 00 00 00 01 00 02 28 03
				15 00 00 00 01 00 02 29 93
				15 00 00 00 01 00 02 2A 03
				15 00 00 00 01 00 02 2B AA
				15 00 00 00 01 00 02 2D 03
				15 00 00 00 01 00 02 2F C1
				15 00 00 00 01 00 02 30 03
				15 00 00 00 01 00 02 31 C6
				15 00 00 00 01 00 02 32 00
				15 00 00 00 01 00 02 33 84
				15 00 00 00 01 00 02 34 00
				15 00 00 00 01 00 02 35 BE
				15 00 00 00 01 00 02 36 00
				15 00 00 00 01 00 02 37 E6
				15 00 00 00 01 00 02 38 01
				15 00 00 00 01 00 02 39 01
				15 00 00 00 01 00 02 3A 01
				15 00 00 00 01 00 02 3B 15
				15 00 00 00 01 00 02 3D 01
				15 00 00 00 01 00 02 3F 26
				15 00 00 00 01 00 02 40 01
				15 00 00 00 01 00 02 41 34
				15 00 00 00 01 00 02 42 01
				15 00 00 00 01 00 02 43 42
				15 00 00 00 01 00 02 44 01
				15 00 00 00 01 00 02 45 4E
				15 00 00 00 01 00 02 46 01
				15 00 00 00 01 00 02 47 74
				15 00 00 00 01 00 02 48 01
				15 00 00 00 01 00 02 49 91
				15 01 00 00 01 00 02 4A 01
				15 00 00 00 01 00 02 4B BE
				15 00 00 00 01 00 02 4C 01
				15 00 00 00 01 00 02 4D DF
				15 00 00 00 01 00 02 4E 02
				15 00 00 00 01 00 02 4F 15
				15 00 00 00 01 00 02 50 02
				15 00 00 00 01 00 02 51 48
				15 00 00 00 01 00 02 52 02
				15 00 00 00 01 00 02 53 4A
				15 00 00 00 01 00 02 54 02
				15 00 00 00 01 00 02 55 79
				15 00 00 00 01 00 02 56 02
				15 00 00 00 01 00 02 58 AF
				15 00 00 00 01 00 02 59 02
				15 00 00 00 01 00 02 5A D1
				15 00 00 00 01 00 02 5B 02
				15 00 00 00 01 00 02 5C FF
				15 00 00 00 01 00 02 5D 03
				15 00 00 00 01 00 02 5E 25
				15 00 00 00 01 00 02 5F 03
				15 00 00 00 01 00 02 60 4B
				15 00 00 00 01 00 02 61 03
				15 00 00 00 01 00 02 62 56
				15 00 00 00 01 00 02 63 03
				15 00 00 00 01 00 02 64 64
				15 00 00 00 01 00 02 65 03
				15 00 00 00 01 00 02 66 71
				15 00 00 00 01 00 02 67 03
				15 00 00 00 01 00 02 68 82
				15 00 00 00 01 00 02 69 03
				15 00 00 00 01 00 02 6A 92
				15 00 00 00 01 00 02 6B 03
				15 00 00 00 01 00 02 6C A9
				15 00 00 00 01 00 02 6D 03
				15 00 00 00 01 00 02 6E C0
				15 00 00 00 01 00 02 6F 03
				15 00 00 00 01 00 02 70 C6
				15 00 00 00 01 00 02 71 01
				15 00 00 00 01 00 02 72 27
				15 01 00 00 01 00 02 73 01
				15 00 00 00 01 00 02 74 2C
				15 00 00 00 01 00 02 75 01
				15 00 00 00 01 00 02 76 35
				15 00 00 00 01 00 02 77 01
				15 00 00 00 01 00 02 78 40
				15 00 00 00 01 00 02 79 01
				15 00 00 00 01 00 02 7A 48
				15 00 00 00 01 00 02 7B 01
				15 00 00 00 01 00 02 7C 51
				15 00 00 00 01 00 02 7D 01
				15 00 00 00 01 00 02 7E 58
				15 00 00 00 01 00 02 7F 01
				15 00 00 00 01 00 02 80 61
				15 00 00 00 01 00 02 81 01
				15 00 00 00 01 00 02 82 69
				15 00 00 00 01 00 02 83 01
				15 00 00 00 01 00 02 84 84
				15 00 00 00 01 00 02 85 01
				15 00 00 00 01 00 02 86 9D
				15 00 00 00 01 00 02 87 01
				15 00 00 00 01 00 02 88 C9
				15 00 00 00 01 00 02 89 01
				15 00 00 00 01 00 02 8A F0
				15 00 00 00 01 00 02 8B 02
				15 00 00 00 01 00 02 8C 2E
				15 00 00 00 01 00 02 8D 02
				15 00 00 00 01 00 02 8E 5B
				15 00 00 00 01 00 02 8F 02
				15 00 00 00 01 00 02 90 5D
				15 00 00 00 01 00 02 91 02
				15 00 00 00 01 00 02 92 8A
				15 00 00 00 01 00 02 93 02
				15 00 00 00 01 00 02 94 BE
				15 00 00 00 01 00 02 95 02
				15 00 00 00 01 00 02 96 E1
				15 00 00 00 01 00 02 97 03
				15 00 00 00 01 00 02 98 17
				15 00 00 00 01 00 02 99 03
				15 00 00 00 01 00 02 9A 2E
				15 01 00 00 01 00 02 9B 03
				15 00 00 00 01 00 02 9C 55
				15 00 00 00 01 00 02 9D 03
				15 00 00 00 01 00 02 9E 62
				15 00 00 00 01 00 02 9F 03
				15 00 00 00 01 00 02 A0 6D
				15 00 00 00 01 00 02 A2 03
				15 00 00 00 01 00 02 A3 7B
				15 00 00 00 01 00 02 A4 03
				15 00 00 00 01 00 02 A5 8A
				15 00 00 00 01 00 02 A6 03
				15 00 00 00 01 00 02 A7 9B
				15 00 00 00 01 00 02 A9 03
				15 00 00 00 01 00 02 AA AA
				15 00 00 00 01 00 02 AB 03
				15 00 00 00 01 00 02 AC BC
				15 00 00 00 01 00 02 AD 03
				15 00 00 00 01 00 02 AE C6
				15 00 00 00 01 00 02 AF 01
				15 00 00 00 01 00 02 B0 62
				15 00 00 00 01 00 02 B1 01
				15 00 00 00 01 00 02 B2 66
				15 00 00 00 01 00 02 B3 01
				15 00 00 00 01 00 02 B4 6E
				15 00 00 00 01 00 02 B5 01
				15 00 00 00 01 00 02 B6 77
				15 00 00 00 01 00 02 B7 01
				15 00 00 00 01 00 02 B8 7D
				15 00 00 00 01 00 02 B9 01
				15 00 00 00 01 00 02 BA 85
				15 00 00 00 01 00 02 BB 01
				15 00 00 00 01 00 02 BC 8B
				15 00 00 00 01 00 02 BD 01
				15 00 00 00 01 00 02 BE 92
				15 00 00 00 01 00 02 BF 01
				15 00 00 00 01 00 02 C0 98
				15 00 00 00 01 00 02 C1 01
				15 00 00 00 01 00 02 C2 AD
				15 00 00 00 01 00 02 C3 01
				15 00 00 00 01 00 02 C4 C0
				15 00 00 00 01 00 02 C5 01
				15 00 00 00 01 00 02 C6 E0
				15 01 00 00 01 00 02 C7 01
				15 00 00 00 01 00 02 C8 FB
				15 00 00 00 01 00 02 C9 02
				15 00 00 00 01 00 02 CA 29
				15 00 00 00 01 00 02 CB 02
				15 00 00 00 01 00 02 CC 56
				15 00 00 00 01 00 02 CD 02
				15 00 00 00 01 00 02 CE 58
				15 00 00 00 01 00 02 CF 02
				15 00 00 00 01 00 02 D0 85
				15 00 00 00 01 00 02 D1 02
				15 00 00 00 01 00 02 D2 BB
				15 00 00 00 01 00 02 D3 02
				15 00 00 00 01 00 02 D4 E0
				15 00 00 00 01 00 02 D5 03
				15 00 00 00 01 00 02 D6 12
				15 00 00 00 01 00 02 D7 03
				15 00 00 00 01 00 02 D8 2A
				15 00 00 00 01 00 02 D9 03
				15 00 00 00 01 00 02 DA 52
				15 00 00 00 01 00 02 DB 03
				15 00 00 00 01 00 02 DC 60
				15 00 00 00 01 00 02 DD 03
				15 00 00 00 01 00 02 DE 6C
				15 00 00 00 01 00 02 DF 03
				15 00 00 00 01 00 02 E0 7A
				15 00 00 00 01 00 02 E1 03
				15 00 00 00 01 00 02 E2 89
				15 00 00 00 01 00 02 E3 03
				15 00 00 00 01 00 02 E4 9A
				15 00 00 00 01 00 02 E5 03
				15 00 00 00 01 00 02 E6 A9
				15 00 00 00 01 00 02 E7 03
				15 00 00 00 01 00 02 E8 BB
				15 00 00 00 01 00 02 E9 03
				15 00 00 00 01 00 02 EA C6
				15 01 00 00 01 00 02 FF 10
				];
		qcom,mdss-dsi-dispparam-cold-command-state = "dsi_hs_mode";

		qcom,mdss-dsi-dispparam-cabcon-command = [
				15 00 00 00 01 00 02 FF 10
				15 01 00 00 01 00 02 55 01
			];
		qcom,mdss-dsi-dispparam-cabcon-command-state = "dsi_hs_mode";
		qcom,mdss-dsi-dispparam-cabcguion-command = [
				15 00 00 00 01 00 02 FF 10
				15 01 00 00 01 00 02 55 01
			];
		qcom,mdss-dsi-dispparam-cabcguion-command-state = "dsi_hs_mode";
		qcom,mdss-dsi-dispparam-cabcstillon-command = [
				15 00 00 00 01 00 02 FF 10
				15 01 00 00 01 00 02 55 02
			];
		qcom,mdss-dsi-dispparam-cabcstillon-command-state = "dsi_hs_mode";
		qcom,mdss-dsi-dispparam-cabcmovieon-command = [
				15 00 00 00 01 00 02 FF 10
				15 01 00 00 01 00 02 55 03
			];
		qcom,mdss-dsi-dispparam-cabcmovieon-command-state = "dsi_hs_mode";
		qcom,mdss-dsi-dispparam-cabcoff-command = [
				15 00 00 00 01 00 02 FF 10
				15 01 00 00 01 00 02 55 00
			];
		qcom,mdss-dsi-dispparam-cabcoff-command-state = "dsi_hs_mode";

		qcom,mdss-dsi-dispparam-papermode1-command = [
				15 00 00 00 01 00 02 FF 20
				15 00 00 00 01 00 02 FB 01
				15 00 00 00 01 00 02 75 00
				15 00 00 00 01 00 02 76 C9
				15 00 00 00 01 00 02 77 00
				15 00 00 00 01 00 02 78 D6
				15 00 00 00 01 00 02 79 00
				15 00 00 00 01 00 02 7A ED
				15 00 00 00 01 00 02 7B 00
				15 00 00 00 01 00 02 7C FF
				15 00 00 00 01 00 02 7D 01
				15 00 00 00 01 00 02 7E 0F
				15 00 00 00 01 00 02 7F 01
				15 00 00 00 01 00 02 80 1E
				15 00 00 00 01 00 02 81 01
				15 00 00 00 01 00 02 82 2A
				15 00 00 00 01 00 02 83 01
				15 00 00 00 01 00 02 84 36
				15 00 00 00 01 00 02 85 01
				15 00 00 00 01 00 02 86 41
				15 00 00 00 01 00 02 87 01
				15 00 00 00 01 00 02 88 65
				15 00 00 00 01 00 02 89 01
				15 00 00 00 01 00 02 8A 82
				15 00 00 00 01 00 02 8B 01
				15 00 00 00 01 00 02 8C B2
				15 00 00 00 01 00 02 8D 01
				15 00 00 00 01 00 02 8E DA
				15 00 00 00 01 00 02 8F 02
				15 00 00 00 01 00 02 90 18
				15 00 00 00 01 00 02 91 02
				15 00 00 00 01 00 02 92 4A
				15 00 00 00 01 00 02 93 02
				15 00 00 00 01 00 02 94 4A
				15 00 00 00 01 00 02 95 02
				15 00 00 00 01 00 02 96 78
				15 00 00 00 01 00 02 97 02
				15 00 00 00 01 00 02 98 AB
				15 00 00 00 01 00 02 99 02
				15 00 00 00 01 00 02 9A D6
				15 00 00 00 01 00 02 9B 03
				15 00 00 00 01 00 02 9C 03
				15 01 00 00 01 00 02 9D 03
				15 00 00 00 01 00 02 9E 23
				15 00 00 00 01 00 02 9F 03
				15 00 00 00 01 00 02 A0 4B
				15 00 00 00 01 00 02 A2 03
				15 00 00 00 01 00 02 A3 59
				15 00 00 00 01 00 02 A4 03
				15 00 00 00 01 00 02 A5 69
				15 00 00 00 01 00 02 A6 03
				15 00 00 00 01 00 02 A7 7E
				15 00 00 00 01 00 02 A9 03
				15 00 00 00 01 00 02 AA 9B
				15 00 00 00 01 00 02 AB 03
				15 00 00 00 01 00 02 AC B4
				15 00 00 00 01 00 02 AD 03
				15 00 00 00 01 00 02 AE C3
				15 00 00 00 01 00 02 AF 03
				15 00 00 00 01 00 02 B0 C6
				15 00 00 00 01 00 02 B1 03
				15 00 00 00 01 00 02 B2 CA
				15 00 00 00 01 00 02 B3 00
				15 00 00 00 01 00 02 B4 C9
				15 00 00 00 01 00 02 B5 00
				15 00 00 00 01 00 02 B6 D6
				15 00 00 00 01 00 02 B7 00
				15 00 00 00 01 00 02 B8 ED
				15 00 00 00 01 00 02 B9 00
				15 00 00 00 01 00 02 BA FF
				15 00 00 00 01 00 02 BB 01
				15 00 00 00 01 00 02 BC 0F
				15 00 00 00 01 00 02 BD 01
				15 00 00 00 01 00 02 BE 1E
				15 00 00 00 01 00 02 BF 01
				15 00 00 00 01 00 02 C0 2A
				15 00 00 00 01 00 02 C1 01
				15 00 00 00 01 00 02 C2 36
				15 00 00 00 01 00 02 C3 01
				15 00 00 00 01 00 02 C4 41
				15 00 00 00 01 00 02 C5 01
				15 00 00 00 01 00 02 C6 65
				15 00 00 00 01 00 02 C7 01
				15 00 00 00 01 00 02 C8 82
				15 01 00 00 01 00 02 C9 01
				15 00 00 00 01 00 02 CA B2
				15 00 00 00 01 00 02 CB 01
				15 00 00 00 01 00 02 CC DA
				15 00 00 00 01 00 02 CD 02
				15 00 00 00 01 00 02 CE 18
				15 00 00 00 01 00 02 CF 02
				15 00 00 00 01 00 02 D0 4A
				15 00 00 00 01 00 02 D1 02
				15 00 00 00 01 00 02 D2 4A
				15 00 00 00 01 00 02 D3 02
				15 00 00 00 01 00 02 D4 78
				15 00 00 00 01 00 02 D5 02
				15 00 00 00 01 00 02 D6 AB
				15 00 00 00 01 00 02 D7 02
				15 00 00 00 01 00 02 D8 D6
				15 00 00 00 01 00 02 D9 03
				15 00 00 00 01 00 02 DA 03
				15 00 00 00 01 00 02 DB 03
				15 00 00 00 01 00 02 DC 23
				15 00 00 00 01 00 02 DD 03
				15 00 00 00 01 00 02 DE 4B
				15 00 00 00 01 00 02 DF 03
				15 00 00 00 01 00 02 E0 59
				15 00 00 00 01 00 02 E1 03
				15 00 00 00 01 00 02 E2 69
				15 00 00 00 01 00 02 E3 03
				15 00 00 00 01 00 02 E4 7E
				15 00 00 00 01 00 02 E5 03
				15 00 00 00 01 00 02 E6 9B
				15 00 00 00 01 00 02 E7 03
				15 00 00 00 01 00 02 E8 B4
				15 00 00 00 01 00 02 E9 03
				15 00 00 00 01 00 02 EA C3
				15 00 00 00 01 00 02 EB 03
				15 00 00 00 01 00 02 EC C6
				15 00 00 00 01 00 02 ED 03
				15 00 00 00 01 00 02 EE CA
				15 00 00 00 01 00 02 EF 00
				15 00 00 00 01 00 02 F0 37
				15 00 00 00 01 00 02 F1 00
				15 00 00 00 01 00 02 F2 73
				15 00 00 00 01 00 02 F3 00
				15 01 00 00 01 00 02 F4 A5
				15 00 00 00 01 00 02 F5 00
				15 00 00 00 01 00 02 F6 C6
				15 00 00 00 01 00 02 F7 00
				15 00 00 00 01 00 02 F8 DF
				15 00 00 00 01 00 02 F9 00
				15 00 00 00 01 00 02 FA F3
				15 00 00 00 01 00 02 FF 21
				15 00 00 00 01 00 02 FB 01
				15 00 00 00 01 00 02 00 01
				15 00 00 00 01 00 02 01 05
				15 00 00 00 01 00 02 02 01
				15 00 00 00 01 00 02 03 14
				15 00 00 00 01 00 02 04 01
				15 00 00 00 01 00 02 05 22
				15 00 00 00 01 00 02 06 01
				15 00 00 00 01 00 02 07 4E
				15 00 00 00 01 00 02 08 01
				15 00 00 00 01 00 02 09 70
				15 00 00 00 01 00 02 0A 01
				15 00 00 00 01 00 02 0B A5
				15 00 00 00 01 00 02 0C 01
				15 00 00 00 01 00 02 0D D0
				15 00 00 00 01 00 02 0E 02
				15 00 00 00 01 00 02 0F 12
				15 00 00 00 01 00 02 10 02
				15 00 00 00 01 00 02 11 46
				15 00 00 00 01 00 02 12 02
				15 00 00 00 01 00 02 13 46
				15 00 00 00 01 00 02 14 02
				15 00 00 00 01 00 02 15 76
				15 00 00 00 01 00 02 16 02
				15 00 00 00 01 00 02 17 A9
				15 00 00 00 01 00 02 18 02
				15 00 00 00 01 00 02 19 D3
				15 00 00 00 01 00 02 1A 03
				15 00 00 00 01 00 02 1B 00
				15 00 00 00 01 00 02 1C 03
				15 00 00 00 01 00 02 1D 21
				15 00 00 00 01 00 02 1E 03
				15 00 00 00 01 00 02 1F 49
				15 00 00 00 01 00 02 20 03
				15 01 00 00 01 00 02 21 55
				15 00 00 00 01 00 02 22 03
				15 00 00 00 01 00 02 23 63
				15 00 00 00 01 00 02 24 03
				15 00 00 00 01 00 02 25 75
				15 00 00 00 01 00 02 26 03
				15 00 00 00 01 00 02 27 8E
				15 00 00 00 01 00 02 28 03
				15 00 00 00 01 00 02 29 AC
				15 00 00 00 01 00 02 2A 03
				15 00 00 00 01 00 02 2B C0
				15 00 00 00 01 00 02 2D 03
				15 00 00 00 01 00 02 2F C6
				15 00 00 00 01 00 02 30 03
				15 00 00 00 01 00 02 31 CA
				15 00 00 00 01 00 02 32 00
				15 00 00 00 01 00 02 33 37
				15 00 00 00 01 00 02 34 00
				15 00 00 00 01 00 02 35 73
				15 00 00 00 01 00 02 36 00
				15 00 00 00 01 00 02 37 A5
				15 00 00 00 01 00 02 38 00
				15 00 00 00 01 00 02 39 C6
				15 00 00 00 01 00 02 3A 00
				15 00 00 00 01 00 02 3B DF
				15 00 00 00 01 00 02 3D 00
				15 00 00 00 01 00 02 3F F3
				15 00 00 00 01 00 02 40 01
				15 00 00 00 01 00 02 41 05
				15 00 00 00 01 00 02 42 01
				15 00 00 00 01 00 02 43 14
				15 00 00 00 01 00 02 44 01
				15 00 00 00 01 00 02 45 22
				15 00 00 00 01 00 02 46 01
				15 00 00 00 01 00 02 47 4E
				15 00 00 00 01 00 02 48 01
				15 00 00 00 01 00 02 49 70
				15 00 00 00 01 00 02 4A 01
				15 00 00 00 01 00 02 4B A5
				15 00 00 00 01 00 02 4C 01
				15 00 00 00 01 00 02 4D D0
				15 01 00 00 01 00 02 4E 02
				15 00 00 00 01 00 02 4F 12
				15 00 00 00 01 00 02 50 02
				15 00 00 00 01 00 02 51 46
				15 00 00 00 01 00 02 52 02
				15 00 00 00 01 00 02 53 46
				15 00 00 00 01 00 02 54 02
				15 00 00 00 01 00 02 55 76
				15 00 00 00 01 00 02 56 02
				15 00 00 00 01 00 02 58 A9
				15 00 00 00 01 00 02 59 02
				15 00 00 00 01 00 02 5A D3
				15 00 00 00 01 00 02 5B 03
				15 00 00 00 01 00 02 5C 00
				15 00 00 00 01 00 02 5D 03
				15 00 00 00 01 00 02 5E 21
				15 00 00 00 01 00 02 5F 03
				15 00 00 00 01 00 02 60 49
				15 00 00 00 01 00 02 61 03
				15 00 00 00 01 00 02 62 55
				15 00 00 00 01 00 02 63 03
				15 00 00 00 01 00 02 64 63
				15 00 00 00 01 00 02 65 03
				15 00 00 00 01 00 02 66 75
				15 00 00 00 01 00 02 67 03
				15 00 00 00 01 00 02 68 8E
				15 00 00 00 01 00 02 69 03
				15 00 00 00 01 00 02 6A AC
				15 00 00 00 01 00 02 6B 03
				15 00 00 00 01 00 02 6C C0
				15 00 00 00 01 00 02 6D 03
				15 00 00 00 01 00 02 6E C6
				15 00 00 00 01 00 02 6F 03
				15 00 00 00 01 00 02 70 CA
				15 00 00 00 01 00 02 71 01
				15 00 00 00 01 00 02 72 90
				15 00 00 00 01 00 02 73 01
				15 00 00 00 01 00 02 74 93
				15 00 00 00 01 00 02 75 01
				15 00 00 00 01 00 02 76 98
				15 01 00 00 01 00 02 77 01
				15 00 00 00 01 00 02 78 9D
				15 00 00 00 01 00 02 79 01
				15 00 00 00 01 00 02 7A A2
				15 00 00 00 01 00 02 7B 01
				15 00 00 00 01 00 02 7C A7
				15 00 00 00 01 00 02 7D 01
				15 00 00 00 01 00 02 7E AC
				15 00 00 00 01 00 02 7F 01
				15 00 00 00 01 00 02 80 B1
				15 00 00 00 01 00 02 81 01
				15 00 00 00 01 00 02 82 B6
				15 00 00 00 01 00 02 83 01
				15 00 00 00 01 00 02 84 C7
				15 00 00 00 01 00 02 85 01
				15 00 00 00 01 00 02 86 D7
				15 00 00 00 01 00 02 87 01
				15 00 00 00 01 00 02 88 F3
				15 00 00 00 01 00 02 89 02
				15 00 00 00 01 00 02 8A 0F
				15 00 00 00 01 00 02 8B 02
				15 00 00 00 01 00 02 8C 3C
				15 00 00 00 01 00 02 8D 02
				15 00 00 00 01 00 02 8E 64
				15 00 00 00 01 00 02 8F 02
				15 00 00 00 01 00 02 90 64
				15 00 00 00 01 00 02 91 02
				15 00 00 00 01 00 02 92 8E
				15 00 00 00 01 00 02 93 02
				15 00 00 00 01 00 02 94 C0
				15 00 00 00 01 00 02 95 02
				15 00 00 00 01 00 02 96 E5
				15 00 00 00 01 00 02 97 03
				15 00 00 00 01 00 02 98 14
				15 00 00 00 01 00 02 99 03
				15 00 00 00 01 00 02 9A 32
				15 00 00 00 01 00 02 9B 03
				15 00 00 00 01 00 02 9C 5D
				15 00 00 00 01 00 02 9D 03
				15 00 00 00 01 00 02 9E 6E
				15 01 00 00 01 00 02 9F 03
				15 00 00 00 01 00 02 A0 85
				15 00 00 00 01 00 02 A2 03
				15 00 00 00 01 00 02 A3 9E
				15 00 00 00 01 00 02 A4 03
				15 00 00 00 01 00 02 A5 B1
				15 00 00 00 01 00 02 A6 03
				15 00 00 00 01 00 02 A7 BE
				15 00 00 00 01 00 02 A9 03
				15 00 00 00 01 00 02 AA C4
				15 00 00 00 01 00 02 AB 03
				15 00 00 00 01 00 02 AC C6
				15 00 00 00 01 00 02 AD 03
				15 00 00 00 01 00 02 AE CA
				15 00 00 00 01 00 02 AF 01
				15 00 00 00 01 00 02 B0 90
				15 00 00 00 01 00 02 B1 01
				15 00 00 00 01 00 02 B2 93
				15 00 00 00 01 00 02 B3 01
				15 00 00 00 01 00 02 B4 98
				15 00 00 00 01 00 02 B5 01
				15 00 00 00 01 00 02 B6 9D
				15 00 00 00 01 00 02 B7 01
				15 00 00 00 01 00 02 B8 A2
				15 00 00 00 01 00 02 B9 01
				15 00 00 00 01 00 02 BA A7
				15 00 00 00 01 00 02 BB 01
				15 00 00 00 01 00 02 BC AC
				15 00 00 00 01 00 02 BD 01
				15 00 00 00 01 00 02 BE B1
				15 00 00 00 01 00 02 BF 01
				15 00 00 00 01 00 02 C0 B6
				15 00 00 00 01 00 02 C1 01
				15 00 00 00 01 00 02 C2 C7
				15 00 00 00 01 00 02 C3 01
				15 00 00 00 01 00 02 C4 D7
				15 00 00 00 01 00 02 C5 01
				15 00 00 00 01 00 02 C6 F3
				15 00 00 00 01 00 02 C7 02
				15 00 00 00 01 00 02 C8 0F
				15 01 00 00 01 00 02 C9 02
				15 00 00 00 01 00 02 CA 3C
				15 00 00 00 01 00 02 CB 02
				15 00 00 00 01 00 02 CC 64
				15 00 00 00 01 00 02 CD 02
				15 00 00 00 01 00 02 CE 64
				15 00 00 00 01 00 02 CF 02
				15 00 00 00 01 00 02 D0 8E
				15 00 00 00 01 00 02 D1 02
				15 00 00 00 01 00 02 D2 C0
				15 00 00 00 01 00 02 D3 02
				15 00 00 00 01 00 02 D4 E5
				15 00 00 00 01 00 02 D5 03
				15 00 00 00 01 00 02 D6 14
				15 00 00 00 01 00 02 D7 03
				15 00 00 00 01 00 02 D8 32
				15 00 00 00 01 00 02 D9 03
				15 00 00 00 01 00 02 DA 5D
				15 00 00 00 01 00 02 DB 03
				15 00 00 00 01 00 02 DC 6E
				15 00 00 00 01 00 02 DD 03
				15 00 00 00 01 00 02 DE 85
				15 00 00 00 01 00 02 DF 03
				15 00 00 00 01 00 02 E0 9E
				15 00 00 00 01 00 02 E1 03
				15 00 00 00 01 00 02 E2 B1
				15 00 00 00 01 00 02 E3 03
				15 00 00 00 01 00 02 E4 BE
				15 00 00 00 01 00 02 E5 03
				15 00 00 00 01 00 02 E6 C4
				15 00 00 00 01 00 02 E7 03
				15 00 00 00 01 00 02 E8 C6
				15 00 00 00 01 00 02 E9 03
				15 00 00 00 01 00 02 EA CA
				15 00 00 00 01 00 02 FB 01
				15 01 00 00 01 00 02 FF 10
			];
		qcom,mdss-dsi-dispparam-papermode1-command-state = "dsi_hs_mode";
		qcom,mdss-dsi-dispparam-papermode2-command = [
				15 00 00 00 00 00 02 FF 20
				15 00 00 00 01 00 02 FB 01
				15 00 00 00 01 00 02 75 00
				15 00 00 00 01 00 02 76 C9
				15 00 00 00 01 00 02 77 00
				15 00 00 00 01 00 02 78 D6
				15 00 00 00 01 00 02 79 00
				15 00 00 00 01 00 02 7A ED
				15 00 00 00 01 00 02 7B 00
				15 00 00 00 01 00 02 7C FF
				15 00 00 00 01 00 02 7D 01
				15 00 00 00 01 00 02 7E 0F
				15 00 00 00 01 00 02 7F 01
				15 00 00 00 01 00 02 80 1E
				15 00 00 00 01 00 02 81 01
				15 00 00 00 01 00 02 82 2A
				15 00 00 00 01 00 02 83 01
				15 00 00 00 01 00 02 84 36
				15 00 00 00 01 00 02 85 01
				15 00 00 00 01 00 02 86 41
				15 00 00 00 01 00 02 87 01
				15 00 00 00 01 00 02 88 65
				15 00 00 00 01 00 02 89 01
				15 00 00 00 01 00 02 8A 82
				15 00 00 00 01 00 02 8B 01
				15 00 00 00 01 00 02 8C B2
				15 00 00 00 01 00 02 8D 01
				15 00 00 00 01 00 02 8E DA
				15 00 00 00 01 00 02 8F 02
				15 00 00 00 01 00 02 90 18
				15 00 00 00 01 00 02 91 02
				15 00 00 00 01 00 02 92 4A
				15 00 00 00 01 00 02 93 02
				15 00 00 00 01 00 02 94 4A
				15 00 00 00 01 00 02 95 02
				15 00 00 00 01 00 02 96 78
				15 00 00 00 01 00 02 97 02
				15 00 00 00 01 00 02 98 AB
				15 00 00 00 01 00 02 99 02
				15 00 00 00 01 00 02 9A D6
				15 00 00 00 01 00 02 9B 03
				15 01 00 00 01 00 02 9C 03
				15 00 00 00 01 00 02 9D 03
				15 00 00 00 01 00 02 9E 23
				15 00 00 00 01 00 02 9F 03
				15 00 00 00 01 00 02 A0 4B
				15 00 00 00 01 00 02 A2 03
				15 00 00 00 01 00 02 A3 59
				15 00 00 00 01 00 02 A4 03
				15 00 00 00 01 00 02 A5 69
				15 00 00 00 01 00 02 A6 03
				15 00 00 00 01 00 02 A7 7E
				15 00 00 00 01 00 02 A9 03
				15 00 00 00 01 00 02 AA 9B
				15 00 00 00 01 00 02 AB 03
				15 00 00 00 01 00 02 AC B4
				15 00 00 00 01 00 02 AD 03
				15 00 00 00 01 00 02 AE C3
				15 00 00 00 01 00 02 AF 03
				15 00 00 00 01 00 02 B0 C6
				15 00 00 00 01 00 02 B1 03
				15 00 00 00 01 00 02 B2 CA
				15 00 00 00 01 00 02 B3 00
				15 00 00 00 01 00 02 B4 C9
				15 00 00 00 01 00 02 B5 00
				15 00 00 00 01 00 02 B6 D6
				15 00 00 00 01 00 02 B7 00
				15 00 00 00 01 00 02 B8 ED
				15 00 00 00 01 00 02 B9 00
				15 00 00 00 01 00 02 BA FF
				15 00 00 00 01 00 02 BB 01
				15 00 00 00 01 00 02 BC 0F
				15 00 00 00 01 00 02 BD 01
				15 00 00 00 01 00 02 BE 1E
				15 00 00 00 01 00 02 BF 01
				15 00 00 00 01 00 02 C0 2A
				15 00 00 00 01 00 02 C1 01
				15 00 00 00 01 00 02 C2 36
				15 00 00 00 01 00 02 C3 01
				15 00 00 00 01 00 02 C4 41
				15 00 00 00 01 00 02 C5 01
				15 00 00 00 01 00 02 C6 65
				15 00 00 00 01 00 02 C7 01
				15 01 00 00 01 00 02 C8 82
				15 00 00 00 01 00 02 C9 01
				15 00 00 00 01 00 02 CA B2
				15 00 00 00 01 00 02 CB 01
				15 00 00 00 01 00 02 CC DA
				15 00 00 00 01 00 02 CD 02
				15 00 00 00 01 00 02 CE 18
				15 00 00 00 01 00 02 CF 02
				15 00 00 00 01 00 02 D0 4A
				15 00 00 00 01 00 02 D1 02
				15 00 00 00 01 00 02 D2 4A
				15 00 00 00 01 00 02 D3 02
				15 00 00 00 01 00 02 D4 78
				15 00 00 00 01 00 02 D5 02
				15 00 00 00 01 00 02 D6 AB
				15 00 00 00 01 00 02 D7 02
				15 00 00 00 01 00 02 D8 D6
				15 00 00 00 01 00 02 D9 03
				15 00 00 00 01 00 02 DA 03
				15 00 00 00 01 00 02 DB 03
				15 00 00 00 01 00 02 DC 23
				15 00 00 00 01 00 02 DD 03
				15 00 00 00 01 00 02 DE 4B
				15 00 00 00 01 00 02 DF 03
				15 00 00 00 01 00 02 E0 59
				15 00 00 00 01 00 02 E1 03
				15 00 00 00 01 00 02 E2 69
				15 00 00 00 01 00 02 E3 03
				15 00 00 00 01 00 02 E4 7E
				15 00 00 00 01 00 02 E5 03
				15 00 00 00 01 00 02 E6 9B
				15 00 00 00 01 00 02 E7 03
				15 00 00 00 01 00 02 E8 B4
				15 00 00 00 01 00 02 E9 03
				15 00 00 00 01 00 02 EA C3
				15 00 00 00 01 00 02 EB 03
				15 00 00 00 01 00 02 EC C6
				15 00 00 00 01 00 02 ED 03
				15 00 00 00 01 00 02 EE CA
				15 00 00 00 01 00 02 EF 00
				15 01 00 00 01 00 02 F0 37
				15 00 00 00 01 00 02 F1 00
				15 00 00 00 01 00 02 F2 73
				15 00 00 00 01 00 02 F3 00
				15 00 00 00 01 00 02 F4 A5
				15 00 00 00 01 00 02 F5 00
				15 00 00 00 01 00 02 F6 C6
				15 00 00 00 01 00 02 F7 00
				15 00 00 00 01 00 02 F8 DF
				15 00 00 00 01 00 02 F9 00
				15 00 00 00 01 00 02 FA F3
				15 00 00 00 01 00 02 FF 21
				15 00 00 00 01 00 02 FB 01
				15 00 00 00 01 00 02 00 01
				15 00 00 00 01 00 02 01 05
				15 00 00 00 01 00 02 02 01
				15 00 00 00 01 00 02 03 14
				15 00 00 00 01 00 02 04 01
				15 00 00 00 01 00 02 05 22
				15 00 00 00 01 00 02 06 01
				15 00 00 00 01 00 02 07 4E
				15 00 00 00 01 00 02 08 01
				15 00 00 00 01 00 02 09 70
				15 00 00 00 01 00 02 0A 01
				15 00 00 00 01 00 02 0B A5
				15 00 00 00 01 00 02 0C 01
				15 00 00 00 01 00 02 0D D0
				15 00 00 00 01 00 02 0E 02
				15 00 00 00 01 00 02 0F 12
				15 00 00 00 01 00 02 10 02
				15 00 00 00 01 00 02 11 46
				15 00 00 00 01 00 02 12 02
				15 00 00 00 01 00 02 13 46
				15 00 00 00 01 00 02 14 02
				15 00 00 00 01 00 02 15 76
				15 00 00 00 01 00 02 16 02
				15 00 00 00 01 00 02 17 A9
				15 00 00 00 01 00 02 18 02
				15 00 00 00 01 00 02 19 D3
				15 00 00 00 01 00 02 1A 03
				15 00 00 00 01 00 02 1B 00
				15 00 00 00 01 00 02 1C 03
				15 01 00 00 01 00 02 1D 21
				15 00 00 00 01 00 02 1E 03
				15 00 00 00 01 00 02 1F 49
				15 00 00 00 01 00 02 20 03
				15 00 00 00 01 00 02 21 55
				15 00 00 00 01 00 02 22 03
				15 00 00 00 01 00 02 23 63
				15 00 00 00 01 00 02 24 03
				15 00 00 00 01 00 02 25 75
				15 00 00 00 01 00 02 26 03
				15 00 00 00 01 00 02 27 8E
				15 00 00 00 01 00 02 28 03
				15 00 00 00 01 00 02 29 AC
				15 00 00 00 01 00 02 2A 03
				15 00 00 00 01 00 02 2B C0
				15 00 00 00 01 00 02 2D 03
				15 00 00 00 01 00 02 2F C6
				15 00 00 00 01 00 02 30 03
				15 00 00 00 01 00 02 31 CA
				15 00 00 00 01 00 02 32 00
				15 00 00 00 01 00 02 33 37
				15 00 00 00 01 00 02 34 00
				15 00 00 00 01 00 02 35 73
				15 00 00 00 01 00 02 36 00
				15 00 00 00 01 00 02 37 A5
				15 00 00 00 01 00 02 38 00
				15 00 00 00 01 00 02 39 C6
				15 00 00 00 01 00 02 3A 00
				15 00 00 00 01 00 02 3B DF
				15 00 00 00 01 00 02 3D 00
				15 00 00 00 01 00 02 3F F3
				15 00 00 00 01 00 02 40 01
				15 00 00 00 01 00 02 41 05
				15 00 00 00 01 00 02 42 01
				15 00 00 00 01 00 02 43 14
				15 00 00 00 01 00 02 44 01
				15 00 00 00 01 00 02 45 22
				15 00 00 00 01 00 02 46 01
				15 00 00 00 01 00 02 47 4E
				15 00 00 00 01 00 02 48 01
				15 00 00 00 01 00 02 49 70
				15 00 00 00 01 00 02 4A 01
				15 01 00 00 01 00 02 4B A5
				15 00 00 00 01 00 02 4C 01
				15 00 00 00 01 00 02 4D D0
				15 00 00 00 01 00 02 4E 02
				15 00 00 00 01 00 02 4F 12
				15 00 00 00 01 00 02 50 02
				15 00 00 00 01 00 02 51 46
				15 00 00 00 01 00 02 52 02
				15 00 00 00 01 00 02 53 46
				15 00 00 00 01 00 02 54 02
				15 00 00 00 01 00 02 55 76
				15 00 00 00 01 00 02 56 02
				15 00 00 00 01 00 02 58 A9
				15 00 00 00 01 00 02 59 02
				15 00 00 00 01 00 02 5A D3
				15 00 00 00 01 00 02 5B 03
				15 00 00 00 01 00 02 5C 00
				15 00 00 00 01 00 02 5D 03
				15 00 00 00 01 00 02 5E 21
				15 00 00 00 01 00 02 5F 03
				15 00 00 00 01 00 02 60 49
				15 00 00 00 01 00 02 61 03
				15 00 00 00 01 00 02 62 55
				15 00 00 00 01 00 02 63 03
				15 00 00 00 01 00 02 64 63
				15 00 00 00 01 00 02 65 03
				15 00 00 00 01 00 02 66 75
				15 00 00 00 01 00 02 67 03
				15 00 00 00 01 00 02 68 8E
				15 00 00 00 01 00 02 69 03
				15 00 00 00 01 00 02 6A AC
				15 00 00 00 01 00 02 6B 03
				15 00 00 00 01 00 02 6C C0
				15 00 00 00 01 00 02 6D 03
				15 00 00 00 01 00 02 6E C6
				15 00 00 00 01 00 02 6F 03
				15 00 00 00 01 00 02 70 CA
				15 00 00 00 01 00 02 71 01
				15 00 00 00 01 00 02 72 B0
				15 00 00 00 01 00 02 73 01
				15 00 00 00 01 00 02 74 B2
				15 01 00 00 01 00 02 75 01
				15 00 00 00 01 00 02 76 B7
				15 00 00 00 01 00 02 77 01
				15 00 00 00 01 00 02 78 BB
				15 00 00 00 01 00 02 79 01
				15 00 00 00 01 00 02 7A BF
				15 00 00 00 01 00 02 7B 01
				15 00 00 00 01 00 02 7C C3
				15 00 00 00 01 00 02 7D 01
				15 00 00 00 01 00 02 7E C7
				15 00 00 00 01 00 02 7F 01
				15 00 00 00 01 00 02 80 CB
				15 00 00 00 01 00 02 81 01
				15 00 00 00 01 00 02 82 CF
				15 00 00 00 01 00 02 83 01
				15 00 00 00 01 00 02 84 DE
				15 00 00 00 01 00 02 85 01
				15 00 00 00 01 00 02 86 EC
				15 00 00 00 01 00 02 87 02
				15 00 00 00 01 00 02 88 06
				15 00 00 00 01 00 02 89 02
				15 00 00 00 01 00 02 8A 1E
				15 00 00 00 01 00 02 8B 02
				15 00 00 00 01 00 02 8C 46
				15 00 00 00 01 00 02 8D 02
				15 00 00 00 01 00 02 8E 6B
				15 00 00 00 01 00 02 8F 02
				15 00 00 00 01 00 02 90 6D
				15 00 00 00 01 00 02 91 02
				15 00 00 00 01 00 02 92 94
				15 00 00 00 01 00 02 93 02
				15 00 00 00 01 00 02 94 C7
				15 00 00 00 01 00 02 95 02
				15 00 00 00 01 00 02 96 EB
				15 00 00 00 01 00 02 97 03
				15 00 00 00 01 00 02 98 19
				15 00 00 00 01 00 02 99 03
				15 00 00 00 01 00 02 9A 37
				15 00 00 00 01 00 02 9B 03
				15 00 00 00 01 00 02 9C 63
				15 00 00 00 01 00 02 9D 03
				15 01 00 00 01 00 02 9E 74
				15 00 00 00 01 00 02 9F 03
				15 00 00 00 01 00 02 A0 8C
				15 00 00 00 01 00 02 A2 03
				15 00 00 00 01 00 02 A3 A3
				15 00 00 00 01 00 02 A4 03
				15 00 00 00 01 00 02 A5 B4
				15 00 00 00 01 00 02 A6 03
				15 00 00 00 01 00 02 A7 C0
				15 00 00 00 01 00 02 A9 03
				15 00 00 00 01 00 02 AA C4
				15 00 00 00 01 00 02 AB 03
				15 00 00 00 01 00 02 AC C6
				15 00 00 00 01 00 02 AD 03
				15 00 00 00 01 00 02 AE CA
				15 00 00 00 01 00 02 AF 01
				15 00 00 00 01 00 02 B0 B0
				15 00 00 00 01 00 02 B1 01
				15 00 00 00 01 00 02 B2 B2
				15 00 00 00 01 00 02 B3 01
				15 00 00 00 01 00 02 B4 B7
				15 00 00 00 01 00 02 B5 01
				15 00 00 00 01 00 02 B6 BB
				15 00 00 00 01 00 02 B7 01
				15 00 00 00 01 00 02 B8 BF
				15 00 00 00 01 00 02 B9 01
				15 00 00 00 01 00 02 BA C3
				15 00 00 00 01 00 02 BB 01
				15 00 00 00 01 00 02 BC C7
				15 00 00 00 01 00 02 BD 01
				15 00 00 00 01 00 02 BE CB
				15 00 00 00 01 00 02 BF 01
				15 00 00 00 01 00 02 C0 CF
				15 00 00 00 01 00 02 C1 01
				15 00 00 00 01 00 02 C2 DE
				15 00 00 00 01 00 02 C3 01
				15 00 00 00 01 00 02 C4 EC
				15 00 00 00 01 00 02 C5 02
				15 00 00 00 01 00 02 C6 06
				15 00 00 00 01 00 02 C7 02
				15 00 00 00 01 00 02 C8 1E
				15 00 00 00 01 00 02 C9 02
				15 01 00 00 01 00 02 CA 46
				15 00 00 00 01 00 02 CB 02
				15 00 00 00 01 00 02 CC 6B
				15 00 00 00 01 00 02 CD 02
				15 00 00 00 01 00 02 CE 6D
				15 00 00 00 01 00 02 CF 02
				15 00 00 00 01 00 02 D0 94
				15 00 00 00 01 00 02 D1 02
				15 00 00 00 01 00 02 D2 C7
				15 00 00 00 01 00 02 D3 02
				15 00 00 00 01 00 02 D4 EB
				15 00 00 00 01 00 02 D5 03
				15 00 00 00 01 00 02 D6 19
				15 00 00 00 01 00 02 D7 03
				15 00 00 00 01 00 02 D8 37
				15 00 00 00 01 00 02 D9 03
				15 00 00 00 01 00 02 DA 63
				15 00 00 00 01 00 02 DB 03
				15 00 00 00 01 00 02 DC 74
				15 00 00 00 01 00 02 DD 03
				15 00 00 00 01 00 02 DE 8C
				15 00 00 00 01 00 02 DF 03
				15 00 00 00 01 00 02 E0 A3
				15 00 00 00 01 00 02 E1 03
				15 00 00 00 01 00 02 E2 B4
				15 00 00 00 01 00 02 E3 03
				15 00 00 00 01 00 02 E4 C0
				15 00 00 00 01 00 02 E5 03
				15 00 00 00 01 00 02 E6 C4
				15 00 00 00 01 00 02 E7 03
				15 00 00 00 01 00 02 E8 C6
				15 00 00 00 01 00 02 E9 03
				15 00 00 00 01 00 02 EA CA
				15 00 00 00 01 00 02 FB 01
				15 01 00 00 01 00 02 FF 10
			];
		qcom,mdss-dsi-dispparam-papermode2-command-state = "dsi_hs_mode";
		qcom,mdss-dsi-dispparam-papermode3-command = [
				15 00 00 00 01 00 02 FF 20
				15 00 00 00 01 00 02 FB 01
				15 00 00 00 01 00 02 75 00
				15 00 00 00 01 00 02 76 C9
				15 00 00 00 01 00 02 77 00
				15 00 00 00 01 00 02 78 D6
				15 00 00 00 01 00 02 79 00
				15 00 00 00 01 00 02 7A ED
				15 00 00 00 01 00 02 7B 00
				15 00 00 00 01 00 02 7C FF
				15 00 00 00 01 00 02 7D 01
				15 00 00 00 01 00 02 7E 0F
				15 00 00 00 01 00 02 7F 01
				15 00 00 00 01 00 02 80 1E
				15 00 00 00 01 00 02 81 01
				15 00 00 00 01 00 02 82 2A
				15 00 00 00 01 00 02 83 01
				15 00 00 00 01 00 02 84 36
				15 00 00 00 01 00 02 85 01
				15 00 00 00 01 00 02 86 41
				15 00 00 00 01 00 02 87 01
				15 00 00 00 01 00 02 88 65
				15 00 00 00 01 00 02 89 01
				15 00 00 00 01 00 02 8A 82
				15 00 00 00 01 00 02 8B 01
				15 00 00 00 01 00 02 8C B2
				15 00 00 00 01 00 02 8D 01
				15 00 00 00 01 00 02 8E DA
				15 00 00 00 01 00 02 8F 02
				15 00 00 00 01 00 02 90 18
				15 00 00 00 01 00 02 91 02
				15 00 00 00 01 00 02 92 4A
				15 00 00 00 01 00 02 93 02
				15 00 00 00 01 00 02 94 4A
				15 00 00 00 01 00 02 95 02
				15 00 00 00 01 00 02 96 78
				15 00 00 00 01 00 02 97 02
				15 00 00 00 01 00 02 98 AB
				15 00 00 00 01 00 02 99 02
				15 00 00 00 01 00 02 9A D6
				15 00 00 00 01 00 02 9B 03
				15 00 00 00 01 00 02 9C 03
				15 01 00 00 01 00 02 9D 03
				15 00 00 00 01 00 02 9E 23
				15 00 00 00 01 00 02 9F 03
				15 00 00 00 01 00 02 A0 4B
				15 00 00 00 01 00 02 A2 03
				15 00 00 00 01 00 02 A3 59
				15 00 00 00 01 00 02 A4 03
				15 00 00 00 01 00 02 A5 69
				15 00 00 00 01 00 02 A6 03
				15 00 00 00 01 00 02 A7 7E
				15 00 00 00 01 00 02 A9 03
				15 00 00 00 01 00 02 AA 9B
				15 00 00 00 01 00 02 AB 03
				15 00 00 00 01 00 02 AC B4
				15 00 00 00 01 00 02 AD 03
				15 00 00 00 01 00 02 AE C3
				15 00 00 00 01 00 02 AF 03
				15 00 00 00 01 00 02 B0 C6
				15 00 00 00 01 00 02 B1 03
				15 00 00 00 01 00 02 B2 CA
				15 00 00 00 01 00 02 B3 00
				15 00 00 00 01 00 02 B4 C9
				15 00 00 00 01 00 02 B5 00
				15 00 00 00 01 00 02 B6 D6
				15 00 00 00 01 00 02 B7 00
				15 00 00 00 01 00 02 B8 ED
				15 00 00 00 01 00 02 B9 00
				15 00 00 00 01 00 02 BA FF
				15 00 00 00 01 00 02 BB 01
				15 00 00 00 01 00 02 BC 0F
				15 00 00 00 01 00 02 BD 01
				15 00 00 00 01 00 02 BE 1E
				15 00 00 00 01 00 02 BF 01
				15 00 00 00 01 00 02 C0 2A
				15 00 00 00 01 00 02 C1 01
				15 00 00 00 01 00 02 C2 36
				15 00 00 00 01 00 02 C3 01
				15 00 00 00 01 00 02 C4 41
				15 00 00 00 01 00 02 C5 01
				15 00 00 00 01 00 02 C6 65
				15 00 00 00 01 00 02 C7 01
				15 01 00 00 01 00 02 C8 82
				15 00 00 00 01 00 02 C9 01
				15 00 00 00 01 00 02 CA B2
				15 00 00 00 01 00 02 CB 01
				15 00 00 00 01 00 02 CC DA
				15 00 00 00 01 00 02 CD 02
				15 00 00 00 01 00 02 CE 18
				15 00 00 00 01 00 02 CF 02
				15 00 00 00 01 00 02 D0 4A
				15 00 00 00 01 00 02 D1 02
				15 00 00 00 01 00 02 D2 4A
				15 00 00 00 01 00 02 D3 02
				15 00 00 00 01 00 02 D4 78
				15 00 00 00 01 00 02 D5 02
				15 00 00 00 01 00 02 D6 AB
				15 00 00 00 01 00 02 D7 02
				15 00 00 00 01 00 02 D8 D6
				15 00 00 00 01 00 02 D9 03
				15 00 00 00 01 00 02 DA 03
				15 00 00 00 01 00 02 DB 03
				15 00 00 00 01 00 02 DC 23
				15 00 00 00 01 00 02 DD 03
				15 00 00 00 01 00 02 DE 4B
				15 00 00 00 01 00 02 DF 03
				15 00 00 00 01 00 02 E0 59
				15 00 00 00 01 00 02 E1 03
				15 00 00 00 01 00 02 E2 69
				15 00 00 00 01 00 02 E3 03
				15 00 00 00 01 00 02 E4 7E
				15 00 00 00 01 00 02 E5 03
				15 00 00 00 01 00 02 E6 9B
				15 00 00 00 01 00 02 E7 03
				15 00 00 00 01 00 02 E8 B4
				15 00 00 00 01 00 02 E9 03
				15 00 00 00 01 00 02 EA C3
				15 00 00 00 01 00 02 EB 03
				15 00 00 00 01 00 02 EC C6
				15 00 00 00 01 00 02 ED 03
				15 00 00 00 01 00 02 EE CA
				15 00 00 00 01 00 02 EF 00
				15 00 00 00 01 00 02 F0 37
				15 01 00 00 01 00 02 F1 00
				15 00 00 00 01 00 02 F2 73
				15 00 00 00 01 00 02 F3 00
				15 00 00 00 01 00 02 F4 A5
				15 00 00 00 01 00 02 F5 00
				15 00 00 00 01 00 02 F6 C6
				15 00 00 00 01 00 02 F7 00
				15 00 00 00 01 00 02 F8 DF
				15 00 00 00 01 00 02 F9 00
				15 00 00 00 01 00 02 FA F3
				15 00 00 00 01 00 02 FF 21
				15 00 00 00 01 00 02 FB 01
				15 00 00 00 01 00 02 00 01
				15 00 00 00 01 00 02 01 05
				15 00 00 00 01 00 02 02 01
				15 00 00 00 01 00 02 03 14
				15 00 00 00 01 00 02 04 01
				15 00 00 00 01 00 02 05 22
				15 00 00 00 01 00 02 06 01
				15 00 00 00 01 00 02 07 4E
				15 00 00 00 01 00 02 08 01
				15 00 00 00 01 00 02 09 70
				15 00 00 00 01 00 02 0A 01
				15 00 00 00 01 00 02 0B A5
				15 00 00 00 01 00 02 0C 01
				15 00 00 00 01 00 02 0D D0
				15 00 00 00 01 00 02 0E 02
				15 00 00 00 01 00 02 0F 12
				15 00 00 00 01 00 02 10 02
				15 00 00 00 01 00 02 11 46
				15 00 00 00 01 00 02 12 02
				15 00 00 00 01 00 02 13 46
				15 00 00 00 01 00 02 14 02
				15 00 00 00 01 00 02 15 76
				15 00 00 00 01 00 02 16 02
				15 00 00 00 01 00 02 17 A9
				15 00 00 00 01 00 02 18 02
				15 00 00 00 01 00 02 19 D3
				15 00 00 00 01 00 02 1A 03
				15 00 00 00 01 00 02 1B 00
				15 01 00 00 01 00 02 1C 03
				15 00 00 00 01 00 02 1D 21
				15 00 00 00 01 00 02 1E 03
				15 00 00 00 01 00 02 1F 49
				15 00 00 00 01 00 02 20 03
				15 00 00 00 01 00 02 21 55
				15 00 00 00 01 00 02 22 03
				15 00 00 00 01 00 02 23 63
				15 00 00 00 01 00 02 24 03
				15 00 00 00 01 00 02 25 75
				15 00 00 00 01 00 02 26 03
				15 00 00 00 01 00 02 27 8E
				15 00 00 00 01 00 02 28 03
				15 00 00 00 01 00 02 29 AC
				15 00 00 00 01 00 02 2A 03
				15 00 00 00 01 00 02 2B C0
				15 00 00 00 01 00 02 2D 03
				15 00 00 00 01 00 02 2F C6
				15 00 00 00 01 00 02 30 03
				15 00 00 00 01 00 02 31 CA
				15 00 00 00 01 00 02 32 00
				15 00 00 00 01 00 02 33 37
				15 00 00 00 01 00 02 34 00
				15 00 00 00 01 00 02 35 73
				15 00 00 00 01 00 02 36 00
				15 00 00 00 01 00 02 37 A5
				15 00 00 00 01 00 02 38 00
				15 00 00 00 01 00 02 39 C6
				15 00 00 00 01 00 02 3A 00
				15 00 00 00 01 00 02 3B DF
				15 00 00 00 01 00 02 3D 00
				15 00 00 00 01 00 02 3F F3
				15 00 00 00 01 00 02 40 01
				15 00 00 00 01 00 02 41 05
				15 00 00 00 01 00 02 42 01
				15 00 00 00 01 00 02 43 14
				15 00 00 00 01 00 02 44 01
				15 00 00 00 01 00 02 45 22
				15 00 00 00 01 00 02 46 01
				15 00 00 00 01 00 02 47 4E
				15 00 00 00 01 00 02 48 01
				15 01 00 00 01 00 02 49 70
				15 00 00 00 01 00 02 4A 01
				15 00 00 00 01 00 02 4B A5
				15 00 00 00 01 00 02 4C 01
				15 00 00 00 01 00 02 4D D0
				15 00 00 00 01 00 02 4E 02
				15 00 00 00 01 00 02 4F 12
				15 00 00 00 01 00 02 50 02
				15 00 00 00 01 00 02 51 46
				15 00 00 00 01 00 02 52 02
				15 00 00 00 01 00 02 53 46
				15 00 00 00 01 00 02 54 02
				15 00 00 00 01 00 02 55 76
				15 00 00 00 01 00 02 56 02
				15 00 00 00 01 00 02 58 A9
				15 00 00 00 01 00 02 59 02
				15 00 00 00 01 00 02 5A D3
				15 00 00 00 01 00 02 5B 03
				15 00 00 00 01 00 02 5C 00
				15 00 00 00 01 00 02 5D 03
				15 00 00 00 01 00 02 5E 21
				15 00 00 00 01 00 02 5F 03
				15 00 00 00 01 00 02 60 49
				15 00 00 00 01 00 02 61 03
				15 00 00 00 01 00 02 62 55
				15 00 00 00 01 00 02 63 03
				15 00 00 00 01 00 02 64 63
				15 00 00 00 01 00 02 65 03
				15 00 00 00 01 00 02 66 75
				15 00 00 00 01 00 02 67 03
				15 00 00 00 01 00 02 68 8E
				15 00 00 00 01 00 02 69 03
				15 00 00 00 01 00 02 6A AC
				15 00 00 00 01 00 02 6B 03
				15 00 00 00 01 00 02 6C C0
				15 00 00 00 01 00 02 6D 03
				15 00 00 00 01 00 02 6E C6
				15 00 00 00 01 00 02 6F 03
				15 00 00 00 01 00 02 70 CA
				15 00 00 00 01 00 02 71 01
				15 01 00 00 01 00 02 72 D0
				15 00 00 00 01 00 02 73 01
				15 00 00 00 01 00 02 74 D2
				15 00 00 00 01 00 02 75 01
				15 00 00 00 01 00 02 76 D5
				15 00 00 00 01 00 02 77 01
				15 00 00 00 01 00 02 78 D9
				15 00 00 00 01 00 02 79 01
				15 00 00 00 01 00 02 7A DC
				15 00 00 00 01 00 02 7B 01
				15 00 00 00 01 00 02 7C E0
				15 00 00 00 01 00 02 7D 01
				15 00 00 00 01 00 02 7E E3
				15 00 00 00 01 00 02 7F 01
				15 00 00 00 01 00 02 80 E6
				15 00 00 00 01 00 02 81 01
				15 00 00 00 01 00 02 82 E9
				15 00 00 00 01 00 02 83 01
				15 00 00 00 01 00 02 84 F5
				15 00 00 00 01 00 02 85 02
				15 00 00 00 01 00 02 86 02
				15 00 00 00 01 00 02 87 02
				15 00 00 00 01 00 02 88 19
				15 00 00 00 01 00 02 89 02
				15 00 00 00 01 00 02 8A 2D
				15 00 00 00 01 00 02 8B 02
				15 00 00 00 01 00 02 8C 51
				15 00 00 00 01 00 02 8D 02
				15 00 00 00 01 00 02 8E 75
				15 00 00 00 01 00 02 8F 02
				15 00 00 00 01 00 02 90 75
				15 00 00 00 01 00 02 91 02
				15 00 00 00 01 00 02 92 9C
				15 00 00 00 01 00 02 93 02
				15 00 00 00 01 00 02 94 CF
				15 00 00 00 01 00 02 95 02
				15 00 00 00 01 00 02 96 F2
				15 00 00 00 01 00 02 97 03
				15 00 00 00 01 00 02 98 20
				15 00 00 00 01 00 02 99 03
				15 00 00 00 01 00 02 9A 3D
				15 01 00 00 01 00 02 9B 03
				15 00 00 00 01 00 02 9C 6A
				15 00 00 00 01 00 02 9D 03
				15 00 00 00 01 00 02 9E 7D
				15 00 00 00 01 00 02 9F 03
				15 00 00 00 01 00 02 A0 94
				15 00 00 00 01 00 02 A2 03
				15 00 00 00 01 00 02 A3 A8
				15 00 00 00 01 00 02 A4 03
				15 00 00 00 01 00 02 A5 B7
				15 00 00 00 01 00 02 A6 03
				15 00 00 00 01 00 02 A7 C1
				15 00 00 00 01 00 02 A9 03
				15 00 00 00 01 00 02 AA C4
				15 00 00 00 01 00 02 AB 03
				15 00 00 00 01 00 02 AC C6
				15 00 00 00 01 00 02 AD 03
				15 00 00 00 01 00 02 AE CA
				15 00 00 00 01 00 02 AF 01
				15 00 00 00 01 00 02 B0 D0
				15 00 00 00 01 00 02 B1 01
				15 00 00 00 01 00 02 B2 D2
				15 00 00 00 01 00 02 B3 01
				15 00 00 00 01 00 02 B4 D5
				15 00 00 00 01 00 02 B5 01
				15 00 00 00 01 00 02 B6 D9
				15 00 00 00 01 00 02 B7 01
				15 00 00 00 01 00 02 B8 DC
				15 00 00 00 01 00 02 B9 01
				15 00 00 00 01 00 02 BA E0
				15 00 00 00 01 00 02 BB 01
				15 00 00 00 01 00 02 BC E3
				15 00 00 00 01 00 02 BD 01
				15 00 00 00 01 00 02 BE E6
				15 00 00 00 01 00 02 BF 01
				15 00 00 00 01 00 02 C0 E9
				15 00 00 00 01 00 02 C1 01
				15 00 00 00 01 00 02 C2 F5
				15 00 00 00 01 00 02 C3 02
				15 00 00 00 01 00 02 C4 02
				15 00 00 00 01 00 02 C5 02
				15 01 00 00 01 00 02 C6 19
				15 00 00 00 01 00 02 C7 02
				15 00 00 00 01 00 02 C8 2D
				15 00 00 00 01 00 02 C9 02
				15 00 00 00 01 00 02 CA 51
				15 00 00 00 01 00 02 CB 02
				15 00 00 00 01 00 02 CC 75
				15 00 00 00 01 00 02 CD 02
				15 00 00 00 01 00 02 CE 75
				15 00 00 00 01 00 02 CF 02
				15 00 00 00 01 00 02 D0 9C
				15 00 00 00 01 00 02 D1 02
				15 00 00 00 01 00 02 D2 CF
				15 00 00 00 01 00 02 D3 02
				15 00 00 00 01 00 02 D4 F2
				15 00 00 00 01 00 02 D5 03
				15 00 00 00 01 00 02 D6 20
				15 00 00 00 01 00 02 D7 03
				15 00 00 00 01 00 02 D8 3D
				15 00 00 00 01 00 02 D9 03
				15 00 00 00 01 00 02 DA 6A
				15 00 00 00 01 00 02 DB 03
				15 00 00 00 01 00 02 DC 7D
				15 00 00 00 01 00 02 DD 03
				15 00 00 00 01 00 02 DE 94
				15 00 00 00 01 00 02 DF 03
				15 00 00 00 01 00 02 E0 A8
				15 00 00 00 01 00 02 E1 03
				15 00 00 00 01 00 02 E2 B7
				15 00 00 00 01 00 02 E3 03
				15 00 00 00 01 00 02 E4 C1
				15 00 00 00 01 00 02 E5 03
				15 00 00 00 01 00 02 E6 C4
				15 00 00 00 01 00 02 E7 03
				15 00 00 00 01 00 02 E8 C6
				15 00 00 00 01 00 02 E9 03
				15 00 00 00 01 00 02 EA CA
				15 00 00 00 01 00 02 FB 01
				15 01 00 00 01 00 02 FF 10
			];
		qcom,mdss-dsi-dispparam-papermode3-command-state = "dsi_hs_mode";
		qcom,mdss-dsi-dispparam-papermode4-command = [
				15 00 00 00 01 00 02 FF 20
				15 00 00 00 01 00 02 FB 01
				15 00 00 00 01 00 02 75 00
				15 00 00 00 01 00 02 76 C9
				15 00 00 00 01 00 02 77 00
				15 00 00 00 01 00 02 78 D7
				15 00 00 00 01 00 02 79 00
				15 00 00 00 01 00 02 7A EE
				15 00 00 00 01 00 02 7B 01
				15 00 00 00 01 00 02 7C 01
				15 00 00 00 01 00 02 7D 01
				15 00 00 00 01 00 02 7E 11
				15 00 00 00 01 00 02 7F 01
				15 00 00 00 01 00 02 80 20
				15 00 00 00 01 00 02 81 01
				15 00 00 00 01 00 02 82 2D
				15 00 00 00 01 00 02 83 01
				15 00 00 00 01 00 02 84 39
				15 00 00 00 01 00 02 85 01
				15 00 00 00 01 00 02 86 44
				15 00 00 00 01 00 02 87 01
				15 00 00 00 01 00 02 88 68
				15 00 00 00 01 00 02 89 01
				15 00 00 00 01 00 02 8A 86
				15 00 00 00 01 00 02 8B 01
				15 00 00 00 01 00 02 8C B7
				15 00 00 00 01 00 02 8D 01
				15 00 00 00 01 00 02 8E DF
				15 00 00 00 01 00 02 8F 02
				15 00 00 00 01 00 02 90 1E
				15 00 00 00 01 00 02 91 02
				15 00 00 00 01 00 02 92 4F
				15 00 00 00 01 00 02 93 02
				15 00 00 00 01 00 02 94 51
				15 00 00 00 01 00 02 95 02
				15 00 00 00 01 00 02 96 7E
				15 00 00 00 01 00 02 97 02
				15 00 00 00 01 00 02 98 B3
				15 00 00 00 01 00 02 99 02
				15 00 00 00 01 00 02 9A E0
				15 00 00 00 01 00 02 9B 03
				15 00 00 00 01 00 02 9C 0D
				15 00 00 00 01 00 02 9D 03
				15 01 00 00 01 00 02 9E 2D
				15 00 00 00 01 00 02 9F 03
				15 00 00 00 01 00 02 A0 58
				15 00 00 00 01 00 02 A2 03
				15 00 00 00 01 00 02 A3 67
				15 00 00 00 01 00 02 A4 03
				15 00 00 00 01 00 02 A5 7B
				15 00 00 00 01 00 02 A6 03
				15 00 00 00 01 00 02 A7 96
				15 00 00 00 01 00 02 A9 03
				15 00 00 00 01 00 02 AA B2
				15 00 00 00 01 00 02 AB 03
				15 00 00 00 01 00 02 AC C4
				15 00 00 00 01 00 02 AD 03
				15 00 00 00 01 00 02 AE D1
				15 00 00 00 01 00 02 AF 03
				15 00 00 00 01 00 02 B0 D7
				15 00 00 00 01 00 02 B1 03
				15 00 00 00 01 00 02 B2 D8
				15 00 00 00 01 00 02 B3 00
				15 00 00 00 01 00 02 B4 C9
				15 00 00 00 01 00 02 B5 00
				15 00 00 00 01 00 02 B6 D7
				15 00 00 00 01 00 02 B7 00
				15 00 00 00 01 00 02 B8 EE
				15 00 00 00 01 00 02 B9 01
				15 00 00 00 01 00 02 BA 01
				15 00 00 00 01 00 02 BB 01
				15 00 00 00 01 00 02 BC 11
				15 00 00 00 01 00 02 BD 01
				15 00 00 00 01 00 02 BE 20
				15 00 00 00 01 00 02 BF 01
				15 00 00 00 01 00 02 C0 2D
				15 00 00 00 01 00 02 C1 01
				15 00 00 00 01 00 02 C2 39
				15 00 00 00 01 00 02 C3 01
				15 00 00 00 01 00 02 C4 44
				15 00 00 00 01 00 02 C5 01
				15 00 00 00 01 00 02 C6 68
				15 00 00 00 01 00 02 C7 01
				15 01 00 00 01 00 02 C8 86
				15 00 00 00 01 00 02 C9 01
				15 00 00 00 01 00 02 CA B7
				15 00 00 00 01 00 02 CB 01
				15 00 00 00 01 00 02 CC DF
				15 00 00 00 01 00 02 CD 02
				15 00 00 00 01 00 02 CE 1E
				15 00 00 00 01 00 02 CF 02
				15 00 00 00 01 00 02 D0 4F
				15 00 00 00 01 00 02 D1 02
				15 00 00 00 01 00 02 D2 51
				15 00 00 00 01 00 02 D3 02
				15 00 00 00 01 00 02 D4 7E
				15 00 00 00 01 00 02 D5 02
				15 00 00 00 01 00 02 D6 B3
				15 00 00 00 01 00 02 D7 02
				15 00 00 00 01 00 02 D8 E0
				15 00 00 00 01 00 02 D9 03
				15 00 00 00 01 00 02 DA 0D
				15 00 00 00 01 00 02 DB 03
				15 00 00 00 01 00 02 DC 2D
				15 00 00 00 01 00 02 DD 03
				15 00 00 00 01 00 02 DE 58
				15 00 00 00 01 00 02 DF 03
				15 00 00 00 01 00 02 E0 67
				15 00 00 00 01 00 02 E1 03
				15 00 00 00 01 00 02 E2 7B
				15 00 00 00 01 00 02 E3 03
				15 00 00 00 01 00 02 E4 96
				15 00 00 00 01 00 02 E5 03
				15 00 00 00 01 00 02 E6 B2
				15 00 00 00 01 00 02 E7 03
				15 00 00 00 01 00 02 E8 C4
				15 00 00 00 01 00 02 E9 03
				15 00 00 00 01 00 02 EA D1
				15 00 00 00 01 00 02 EB 03
				15 00 00 00 01 00 02 EC D7
				15 00 00 00 01 00 02 ED 03
				15 00 00 00 01 00 02 EE D8
				15 00 00 00 01 00 02 EF 00
				15 00 00 00 01 00 02 F0 37
				15 00 00 00 01 00 02 F1 00
				15 01 00 00 01 00 02 F2 75
				15 00 00 00 01 00 02 F3 00
				15 00 00 00 01 00 02 F4 A8
				15 00 00 00 01 00 02 F5 00
				15 00 00 00 01 00 02 F6 C9
				15 00 00 00 01 00 02 F7 00
				15 00 00 00 01 00 02 F8 E2
				15 00 00 00 01 00 02 F9 00
				15 00 00 00 01 00 02 FA F7
				15 00 00 00 01 00 02 FF 21
				15 00 00 00 01 00 02 FB 01
				15 00 00 00 01 00 02 00 01
				15 00 00 00 01 00 02 01 09
				15 00 00 00 01 00 02 02 01
				15 00 00 00 01 00 02 03 18
				15 00 00 00 01 00 02 04 01
				15 00 00 00 01 00 02 05 26
				15 00 00 00 01 00 02 06 01
				15 00 00 00 01 00 02 07 52
				15 00 00 00 01 00 02 08 01
				15 00 00 00 01 00 02 09 75
				15 00 00 00 01 00 02 0A 01
				15 00 00 00 01 00 02 0B AA
				15 00 00 00 01 00 02 0C 01
				15 00 00 00 01 00 02 0D D5
				15 00 00 00 01 00 02 0E 02
				15 00 00 00 01 00 02 0F 18
				15 00 00 00 01 00 02 10 02
				15 00 00 00 01 00 02 11 4B
				15 00 00 00 01 00 02 12 02
				15 00 00 00 01 00 02 13 4D
				15 00 00 00 01 00 02 14 02
				15 00 00 00 01 00 02 15 7B
				15 00 00 00 01 00 02 16 02
				15 00 00 00 01 00 02 17 B1
				15 00 00 00 01 00 02 18 02
				15 00 00 00 01 00 02 19 DD
				15 00 00 00 01 00 02 1A 03
				15 00 00 00 01 00 02 1B 0A
				15 00 00 00 01 00 02 1C 03
				15 00 00 00 01 00 02 1D 2B
				15 01 00 00 01 00 02 1E 03
				15 00 00 00 01 00 02 1F 54
				15 00 00 00 01 00 02 20 03
				15 00 00 00 01 00 02 21 61
				15 00 00 00 01 00 02 22 03
				15 00 00 00 01 00 02 23 72
				15 00 00 00 01 00 02 24 03
				15 00 00 00 01 00 02 25 87
				15 00 00 00 01 00 02 26 03
				15 00 00 00 01 00 02 27 A5
				15 00 00 00 01 00 02 28 03
				15 00 00 00 01 00 02 29 BE
				15 00 00 00 01 00 02 2A 03
				15 00 00 00 01 00 02 2B CF
				15 00 00 00 01 00 02 2D 03
				15 00 00 00 01 00 02 2F D7
				15 00 00 00 01 00 02 30 03
				15 00 00 00 01 00 02 31 D8
				15 00 00 00 01 00 02 32 00
				15 00 00 00 01 00 02 33 37
				15 00 00 00 01 00 02 34 00
				15 00 00 00 01 00 02 35 75
				15 00 00 00 01 00 02 36 00
				15 00 00 00 01 00 02 37 A8
				15 00 00 00 01 00 02 38 00
				15 00 00 00 01 00 02 39 C9
				15 00 00 00 01 00 02 3A 00
				15 00 00 00 01 00 02 3B E2
				15 00 00 00 01 00 02 3D 00
				15 00 00 00 01 00 02 3F F7
				15 00 00 00 01 00 02 40 01
				15 00 00 00 01 00 02 41 09
				15 00 00 00 01 00 02 42 01
				15 00 00 00 01 00 02 43 18
				15 00 00 00 01 00 02 44 01
				15 00 00 00 01 00 02 45 26
				15 00 00 00 01 00 02 46 01
				15 00 00 00 01 00 02 47 52
				15 00 00 00 01 00 02 48 01
				15 00 00 00 01 00 02 49 75
				15 01 00 00 01 00 02 4A 01
				15 00 00 00 01 00 02 4B AA
				15 00 00 00 01 00 02 4C 01
				15 00 00 00 01 00 02 4D D5
				15 00 00 00 01 00 02 4E 02
				15 00 00 00 01 00 02 4F 18
				15 00 00 00 01 00 02 50 02
				15 00 00 00 01 00 02 51 4B
				15 00 00 00 01 00 02 52 02
				15 00 00 00 01 00 02 53 4D
				15 00 00 00 01 00 02 54 02
				15 00 00 00 01 00 02 55 7B
				15 00 00 00 01 00 02 56 02
				15 00 00 00 01 00 02 58 B1
				15 00 00 00 01 00 02 59 02
				15 00 00 00 01 00 02 5A DD
				15 00 00 00 01 00 02 5B 03
				15 00 00 00 01 00 02 5C 0A
				15 00 00 00 01 00 02 5D 03
				15 00 00 00 01 00 02 5E 2B
				15 00 00 00 01 00 02 5F 03
				15 00 00 00 01 00 02 60 54
				15 00 00 00 01 00 02 61 03
				15 00 00 00 01 00 02 62 61
				15 00 00 00 01 00 02 63 03
				15 00 00 00 01 00 02 64 72
				15 00 00 00 01 00 02 65 03
				15 00 00 00 01 00 02 66 87
				15 00 00 00 01 00 02 67 03
				15 00 00 00 01 00 02 68 A5
				15 00 00 00 01 00 02 69 03
				15 00 00 00 01 00 02 6A BE
				15 00 00 00 01 00 02 6B 03
				15 00 00 00 01 00 02 6C CF
				15 00 00 00 01 00 02 6D 03
				15 00 00 00 01 00 02 6E D7
				15 00 00 00 01 00 02 6F 03
				15 00 00 00 01 00 02 70 D8
				15 00 00 00 01 00 02 71 01
				15 00 00 00 01 00 02 72 EC
				15 00 00 00 01 00 02 73 01
				15 01 00 00 01 00 02 74 EE
				15 00 00 00 01 00 02 75 01
				15 00 00 00 01 00 02 76 F1
				15 00 00 00 01 00 02 77 01
				15 00 00 00 01 00 02 78 F3
				15 00 00 00 01 00 02 79 01
				15 00 00 00 01 00 02 7A F6
				15 00 00 00 01 00 02 7B 01
				15 00 00 00 01 00 02 7C F9
				15 00 00 00 01 00 02 7D 01
				15 00 00 00 01 00 02 7E FD
				15 00 00 00 01 00 02 7F 02
				15 00 00 00 01 00 02 80 00
				15 00 00 00 01 00 02 81 02
				15 00 00 00 01 00 02 82 03
				15 00 00 00 01 00 02 83 02
				15 00 00 00 01 00 02 84 0E
				15 00 00 00 01 00 02 85 02
				15 00 00 00 01 00 02 86 19
				15 00 00 00 01 00 02 87 02
				15 00 00 00 01 00 02 88 2C
				15 00 00 00 01 00 02 89 02
				15 00 00 00 01 00 02 8A 3E
				15 00 00 00 01 00 02 8B 02
				15 00 00 00 01 00 02 8C 60
				15 00 00 00 01 00 02 8D 02
				15 00 00 00 01 00 02 8E 82
				15 00 00 00 01 00 02 8F 02
				15 00 00 00 01 00 02 90 83
				15 00 00 00 01 00 02 91 02
				15 00 00 00 01 00 02 92 A9
				15 00 00 00 01 00 02 93 02
				15 00 00 00 01 00 02 94 DF
				15 00 00 00 01 00 02 95 03
				15 00 00 00 01 00 02 96 03
				15 00 00 00 01 00 02 97 03
				15 00 00 00 01 00 02 98 30
				15 00 00 00 01 00 02 99 03
				15 00 00 00 01 00 02 9A 4F
				15 00 00 00 01 00 02 9B 03
				15 00 00 00 01 00 02 9C 8B
				15 00 00 00 01 00 02 9D 03
				15 01 00 00 01 00 02 9E A0
				15 00 00 00 01 00 02 9F 03
				15 00 00 00 01 00 02 A0 B1
				15 00 00 00 01 00 02 A2 03
				15 00 00 00 01 00 02 A3 BE
				15 00 00 00 01 00 02 A4 03
				15 00 00 00 01 00 02 A5 C8
				15 00 00 00 01 00 02 A6 03
				15 00 00 00 01 00 02 A7 CF
				15 00 00 00 01 00 02 A9 03
				15 00 00 00 01 00 02 AA D5
				15 00 00 00 01 00 02 AB 03
				15 00 00 00 01 00 02 AC D8
				15 00 00 00 01 00 02 AD 03
				15 00 00 00 01 00 02 AE D9
				15 00 00 00 01 00 02 AF 01
				15 00 00 00 01 00 02 B0 EC
				15 00 00 00 01 00 02 B1 01
				15 00 00 00 01 00 02 B2 EE
				15 00 00 00 01 00 02 B3 01
				15 00 00 00 01 00 02 B4 F1
				15 00 00 00 01 00 02 B5 01
				15 00 00 00 01 00 02 B6 F3
				15 00 00 00 01 00 02 B7 01
				15 00 00 00 01 00 02 B8 F6
				15 00 00 00 01 00 02 B9 01
				15 00 00 00 01 00 02 BA F9
				15 00 00 00 01 00 02 BB 01
				15 00 00 00 01 00 02 BC FD
				15 00 00 00 01 00 02 BD 02
				15 00 00 00 01 00 02 BE 00
				15 00 00 00 01 00 02 BF 02
				15 00 00 00 01 00 02 C0 03
				15 00 00 00 01 00 02 C1 02
				15 00 00 00 01 00 02 C2 0E
				15 00 00 00 01 00 02 C3 02
				15 00 00 00 01 00 02 C4 19
				15 00 00 00 01 00 02 C5 02
				15 00 00 00 01 00 02 C6 2C
				15 00 00 00 01 00 02 C7 02
				15 00 00 00 01 00 02 C8 3E
				15 00 00 00 01 00 02 C9 02
				15 00 00 00 01 00 02 CA 60
				15 01 00 00 01 00 02 CB 02
				15 00 00 00 01 00 02 CC 82
				15 00 00 00 01 00 02 CD 02
				15 00 00 00 01 00 02 CE 83
				15 00 00 00 01 00 02 CF 02
				15 00 00 00 01 00 02 D0 A9
				15 00 00 00 01 00 02 D1 02
				15 00 00 00 01 00 02 D2 DF
				15 00 00 00 01 00 02 D3 03
				15 00 00 00 01 00 02 D4 03
				15 00 00 00 01 00 02 D5 03
				15 00 00 00 01 00 02 D6 30
				15 00 00 00 01 00 02 D7 03
				15 00 00 00 01 00 02 D8 4F
				15 00 00 00 01 00 02 D9 03
				15 00 00 00 01 00 02 DA 8B
				15 00 00 00 01 00 02 DB 03
				15 00 00 00 01 00 02 DC A0
				15 00 00 00 01 00 02 DD 03
				15 00 00 00 01 00 02 DE B1
				15 00 00 00 01 00 02 DF 03
				15 00 00 00 01 00 02 E0 BE
				15 00 00 00 01 00 02 E1 03
				15 00 00 00 01 00 02 E2 C8
				15 00 00 00 01 00 02 E3 03
				15 00 00 00 01 00 02 E4 CF
				15 00 00 00 01 00 02 E5 03
				15 00 00 00 01 00 02 E6 D5
				15 00 00 00 01 00 02 E7 03
				15 00 00 00 01 00 02 E8 D8
				15 00 00 00 01 00 02 E9 03
				15 00 00 00 01 00 02 EA D9
				15 00 00 00 01 00 02 FB 01
				15 01 00 00 01 00 02 FF 10
			];
		qcom,mdss-dsi-dispparam-papermode4-command-state = "dsi_hs_mode";
		qcom,mdss-dsi-dispparam-papermode5-command = [
				15 00 00 00 01 00 02 FF 20
				15 00 00 00 01 00 02 FB 01
				15 00 00 00 01 00 02 75 00
				15 00 00 00 01 00 02 76 C9
				15 00 00 00 01 00 02 77 00
				15 00 00 00 01 00 02 78 D7
				15 00 00 00 01 00 02 79 00
				15 00 00 00 01 00 02 7A EE
				15 00 00 00 01 00 02 7B 01
				15 00 00 00 01 00 02 7C 01
				15 00 00 00 01 00 02 7D 01
				15 00 00 00 01 00 02 7E 11
				15 00 00 00 01 00 02 7F 01
				15 00 00 00 01 00 02 80 20
				15 00 00 00 01 00 02 81 01
				15 00 00 00 01 00 02 82 2D
				15 00 00 00 01 00 02 83 01
				15 00 00 00 01 00 02 84 39
				15 00 00 00 01 00 02 85 01
				15 00 00 00 01 00 02 86 44
				15 00 00 00 01 00 02 87 01
				15 00 00 00 01 00 02 88 68
				15 00 00 00 01 00 02 89 01
				15 00 00 00 01 00 02 8A 86
				15 00 00 00 01 00 02 8B 01
				15 00 00 00 01 00 02 8C B7
				15 00 00 00 01 00 02 8D 01
				15 00 00 00 01 00 02 8E DF
				15 00 00 00 01 00 02 8F 02
				15 00 00 00 01 00 02 90 1E
				15 00 00 00 01 00 02 91 02
				15 00 00 00 01 00 02 92 4F
				15 00 00 00 01 00 02 93 02
				15 00 00 00 01 00 02 94 51
				15 00 00 00 01 00 02 95 02
				15 00 00 00 01 00 02 96 7E
				15 00 00 00 01 00 02 97 02
				15 00 00 00 01 00 02 98 B3
				15 00 00 00 01 00 02 99 02
				15 00 00 00 01 00 02 9A E0
				15 00 00 00 01 00 02 9B 03
				15 01 00 00 01 00 02 9C 0D
				15 00 00 00 01 00 02 9D 03
				15 00 00 00 01 00 02 9E 2D
				15 00 00 00 01 00 02 9F 03
				15 00 00 00 01 00 02 A0 58
				15 00 00 00 01 00 02 A2 03
				15 00 00 00 01 00 02 A3 67
				15 00 00 00 01 00 02 A4 03
				15 00 00 00 01 00 02 A5 7B
				15 00 00 00 01 00 02 A6 03
				15 00 00 00 01 00 02 A7 96
				15 00 00 00 01 00 02 A9 03
				15 00 00 00 01 00 02 AA B2
				15 00 00 00 01 00 02 AB 03
				15 00 00 00 01 00 02 AC C4
				15 00 00 00 01 00 02 AD 03
				15 00 00 00 01 00 02 AE D1
				15 00 00 00 01 00 02 AF 03
				15 00 00 00 01 00 02 B0 D7
				15 00 00 00 01 00 02 B1 03
				15 00 00 00 01 00 02 B2 D8
				15 00 00 00 01 00 02 B3 00
				15 00 00 00 01 00 02 B4 C9
				15 00 00 00 01 00 02 B5 00
				15 00 00 00 01 00 02 B6 D7
				15 00 00 00 01 00 02 B7 00
				15 00 00 00 01 00 02 B8 EE
				15 00 00 00 01 00 02 B9 01
				15 00 00 00 01 00 02 BA 01
				15 00 00 00 01 00 02 BB 01
				15 00 00 00 01 00 02 BC 11
				15 00 00 00 01 00 02 BD 01
				15 00 00 00 01 00 02 BE 20
				15 00 00 00 01 00 02 BF 01
				15 00 00 00 01 00 02 C0 2D
				15 00 00 00 01 00 02 C1 01
				15 00 00 00 01 00 02 C2 39
				15 00 00 00 01 00 02 C3 01
				15 00 00 00 01 00 02 C4 44
				15 00 00 00 01 00 02 C5 01
				15 00 00 00 01 00 02 C6 68
				15 01 00 00 01 00 02 C7 01
				15 00 00 00 01 00 02 C8 86
				15 00 00 00 01 00 02 C9 01
				15 00 00 00 01 00 02 CA B7
				15 00 00 00 01 00 02 CB 01
				15 00 00 00 01 00 02 CC DF
				15 00 00 00 01 00 02 CD 02
				15 00 00 00 01 00 02 CE 1E
				15 00 00 00 01 00 02 CF 02
				15 00 00 00 01 00 02 D0 4F
				15 00 00 00 01 00 02 D1 02
				15 00 00 00 01 00 02 D2 51
				15 00 00 00 01 00 02 D3 02
				15 00 00 00 01 00 02 D4 7E
				15 00 00 00 01 00 02 D5 02
				15 00 00 00 01 00 02 D6 B3
				15 00 00 00 01 00 02 D7 02
				15 00 00 00 01 00 02 D8 E0
				15 00 00 00 01 00 02 D9 03
				15 00 00 00 01 00 02 DA 0D
				15 00 00 00 01 00 02 DB 03
				15 00 00 00 01 00 02 DC 2D
				15 00 00 00 01 00 02 DD 03
				15 00 00 00 01 00 02 DE 58
				15 00 00 00 01 00 02 DF 03
				15 00 00 00 01 00 02 E0 67
				15 00 00 00 01 00 02 E1 03
				15 00 00 00 01 00 02 E2 7B
				15 00 00 00 01 00 02 E3 03
				15 00 00 00 01 00 02 E4 96
				15 00 00 00 01 00 02 E5 03
				15 00 00 00 01 00 02 E6 B2
				15 00 00 00 01 00 02 E7 03
				15 00 00 00 01 00 02 E8 C4
				15 00 00 00 01 00 02 E9 03
				15 00 00 00 01 00 02 EA D1
				15 00 00 00 01 00 02 EB 03
				15 00 00 00 01 00 02 EC D7
				15 00 00 00 01 00 02 ED 03
				15 00 00 00 01 00 02 EE D8
				15 00 00 00 01 00 02 EF 00
				15 01 00 00 01 00 02 F0 37
				15 00 00 00 01 00 02 F1 00
				15 00 00 00 01 00 02 F2 75
				15 00 00 00 01 00 02 F3 00
				15 00 00 00 01 00 02 F4 A8
				15 00 00 00 01 00 02 F5 00
				15 00 00 00 01 00 02 F6 C9
				15 00 00 00 01 00 02 F7 00
				15 00 00 00 01 00 02 F8 E2
				15 00 00 00 01 00 02 F9 00
				15 00 00 00 01 00 02 FA F7
				15 00 00 00 01 00 02 FF 21
				15 00 00 00 01 00 02 FB 01
				15 00 00 00 01 00 02 00 01
				15 00 00 00 01 00 02 01 09
				15 00 00 00 01 00 02 02 01
				15 00 00 00 01 00 02 03 18
				15 00 00 00 01 00 02 04 01
				15 00 00 00 01 00 02 05 26
				15 00 00 00 01 00 02 06 01
				15 00 00 00 01 00 02 07 52
				15 00 00 00 01 00 02 08 01
				15 00 00 00 01 00 02 09 75
				15 00 00 00 01 00 02 0A 01
				15 00 00 00 01 00 02 0B AA
				15 00 00 00 01 00 02 0C 01
				15 00 00 00 01 00 02 0D D5
				15 00 00 00 01 00 02 0E 02
				15 00 00 00 01 00 02 0F 18
				15 00 00 00 01 00 02 10 02
				15 00 00 00 01 00 02 11 4B
				15 00 00 00 01 00 02 12 02
				15 00 00 00 01 00 02 13 4D
				15 00 00 00 01 00 02 14 02
				15 00 00 00 01 00 02 15 7B
				15 00 00 00 01 00 02 16 02
				15 00 00 00 01 00 02 17 B1
				15 00 00 00 01 00 02 18 02
				15 00 00 00 01 00 02 19 DD
				15 00 00 00 01 00 02 1A 03
				15 00 00 00 01 00 02 1B 0A
				15 00 00 00 01 00 02 1C 03
				15 01 00 00 01 00 02 1D 2B
				15 00 00 00 01 00 02 1E 03
				15 00 00 00 01 00 02 1F 54
				15 00 00 00 01 00 02 20 03
				15 00 00 00 01 00 02 21 61
				15 00 00 00 01 00 02 22 03
				15 00 00 00 01 00 02 23 72
				15 00 00 00 01 00 02 24 03
				15 00 00 00 01 00 02 25 87
				15 00 00 00 01 00 02 26 03
				15 00 00 00 01 00 02 27 A5
				15 00 00 00 01 00 02 28 03
				15 00 00 00 01 00 02 29 BE
				15 00 00 00 01 00 02 2A 03
				15 00 00 00 01 00 02 2B CF
				15 00 00 00 01 00 02 2D 03
				15 00 00 00 01 00 02 2F D7
				15 00 00 00 01 00 02 30 03
				15 00 00 00 01 00 02 31 D8
				15 00 00 00 01 00 02 32 00
				15 00 00 00 01 00 02 33 37
				15 00 00 00 01 00 02 34 00
				15 00 00 00 01 00 02 35 75
				15 00 00 00 01 00 02 36 00
				15 00 00 00 01 00 02 37 A8
				15 00 00 00 01 00 02 38 00
				15 00 00 00 01 00 02 39 C9
				15 00 00 00 01 00 02 3A 00
				15 00 00 00 01 00 02 3B E2
				15 00 00 00 01 00 02 3D 00
				15 00 00 00 01 00 02 3F F7
				15 00 00 00 01 00 02 40 01
				15 00 00 00 01 00 02 41 09
				15 00 00 00 01 00 02 42 01
				15 00 00 00 01 00 02 43 18
				15 00 00 00 01 00 02 44 01
				15 00 00 00 01 00 02 45 26
				15 00 00 00 01 00 02 46 01
				15 00 00 00 01 00 02 47 52
				15 00 00 00 01 00 02 48 01
				15 00 00 00 01 00 02 49 75
				15 00 00 00 01 00 02 4A 01
				15 01 00 00 01 00 02 4B AA
				15 00 00 00 01 00 02 4C 01
				15 00 00 00 01 00 02 4D D5
				15 00 00 00 01 00 02 4E 02
				15 00 00 00 01 00 02 4F 18
				15 00 00 00 01 00 02 50 02
				15 00 00 00 01 00 02 51 4B
				15 00 00 00 01 00 02 52 02
				15 00 00 00 01 00 02 53 4D
				15 00 00 00 01 00 02 54 02
				15 00 00 00 01 00 02 55 7B
				15 00 00 00 01 00 02 56 02
				15 00 00 00 01 00 02 58 B1
				15 00 00 00 01 00 02 59 02
				15 00 00 00 01 00 02 5A DD
				15 00 00 00 01 00 02 5B 03
				15 00 00 00 01 00 02 5C 0A
				15 00 00 00 01 00 02 5D 03
				15 00 00 00 01 00 02 5E 2B
				15 00 00 00 01 00 02 5F 03
				15 00 00 00 01 00 02 60 54
				15 00 00 00 01 00 02 61 03
				15 00 00 00 01 00 02 62 61
				15 00 00 00 01 00 02 63 03
				15 00 00 00 01 00 02 64 72
				15 00 00 00 01 00 02 65 03
				15 00 00 00 01 00 02 66 87
				15 00 00 00 01 00 02 67 03
				15 00 00 00 01 00 02 68 A5
				15 00 00 00 01 00 02 69 03
				15 00 00 00 01 00 02 6A BE
				15 00 00 00 01 00 02 6B 03
				15 00 00 00 01 00 02 6C CF
				15 00 00 00 01 00 02 6D 03
				15 00 00 00 01 00 02 6E D7
				15 00 00 00 01 00 02 6F 03
				15 00 00 00 01 00 02 70 D8
				15 00 00 00 01 00 02 71 02
				15 00 00 00 01 00 02 72 01
				15 00 00 00 01 00 02 73 02
				15 00 00 00 01 00 02 74 02
				15 00 00 00 01 00 02 75 02
				15 01 00 00 01 00 02 76 05
				15 00 00 00 01 00 02 77 02
				15 00 00 00 01 00 02 78 08
				15 00 00 00 01 00 02 79 02
				15 00 00 00 01 00 02 7A 0B
				15 00 00 00 01 00 02 7B 02
				15 00 00 00 01 00 02 7C 0D
				15 00 00 00 01 00 02 7D 02
				15 00 00 00 01 00 02 7E 10
				15 00 00 00 01 00 02 7F 02
				15 00 00 00 01 00 02 80 12
				15 00 00 00 01 00 02 81 02
				15 00 00 00 01 00 02 82 15
				15 00 00 00 01 00 02 83 02
				15 00 00 00 01 00 02 84 1E
				15 00 00 00 01 00 02 85 02
				15 00 00 00 01 00 02 86 27
				15 00 00 00 01 00 02 87 02
				15 00 00 00 01 00 02 88 39
				15 00 00 00 01 00 02 89 02
				15 00 00 00 01 00 02 8A 49
				15 00 00 00 01 00 02 8B 02
				15 00 00 00 01 00 02 8C 69
				15 00 00 00 01 00 02 8D 02
				15 00 00 00 01 00 02 8E 8A
				15 00 00 00 01 00 02 8F 02
				15 00 00 00 01 00 02 90 8B
				15 00 00 00 01 00 02 91 02
				15 00 00 00 01 00 02 92 B0
				15 00 00 00 01 00 02 93 02
				15 00 00 00 01 00 02 94 E6
				15 00 00 00 01 00 02 95 03
				15 00 00 00 01 00 02 96 09
				15 00 00 00 01 00 02 97 03
				15 00 00 00 01 00 02 98 36
				15 00 00 00 01 00 02 99 03
				15 00 00 00 01 00 02 9A 56
				15 00 00 00 01 00 02 9B 03
				15 00 00 00 01 00 02 9C 93
				15 00 00 00 01 00 02 9D 03
				15 00 00 00 01 00 02 9E A6
				15 01 00 00 01 00 02 9F 03
				15 00 00 00 01 00 02 A0 B5
				15 00 00 00 01 00 02 A2 03
				15 00 00 00 01 00 02 A3 C0
				15 00 00 00 01 00 02 A4 03
				15 00 00 00 01 00 02 A5 C9
				15 00 00 00 01 00 02 A6 03
				15 00 00 00 01 00 02 A7 D0
				15 00 00 00 01 00 02 A9 03
				15 00 00 00 01 00 02 AA D5
				15 00 00 00 01 00 02 AB 03
				15 00 00 00 01 00 02 AC D8
				15 00 00 00 01 00 02 AD 03
				15 00 00 00 01 00 02 AE D9
				15 00 00 00 01 00 02 AF 02
				15 00 00 00 01 00 02 B0 01
				15 00 00 00 01 00 02 B1 02
				15 00 00 00 01 00 02 B2 02
				15 00 00 00 01 00 02 B3 02
				15 00 00 00 01 00 02 B4 05
				15 00 00 00 01 00 02 B5 02
				15 00 00 00 01 00 02 B6 08
				15 00 00 00 01 00 02 B7 02
				15 00 00 00 01 00 02 B8 0B
				15 00 00 00 01 00 02 B9 02
				15 00 00 00 01 00 02 BA 0D
				15 00 00 00 01 00 02 BB 02
				15 00 00 00 01 00 02 BC 10
				15 00 00 00 01 00 02 BD 02
				15 00 00 00 01 00 02 BE 12
				15 00 00 00 01 00 02 BF 02
				15 00 00 00 01 00 02 C0 15
				15 00 00 00 01 00 02 C1 02
				15 00 00 00 01 00 02 C2 1E
				15 00 00 00 01 00 02 C3 02
				15 00 00 00 01 00 02 C4 27
				15 00 00 00 01 00 02 C5 02
				15 00 00 00 01 00 02 C6 39
				15 00 00 00 01 00 02 C7 02
				15 00 00 00 01 00 02 C8 49
				15 00 00 00 01 00 02 C9 02
				15 01 00 00 01 00 02 CA 69
				15 00 00 00 01 00 02 CB 02
				15 00 00 00 01 00 02 CC 8A
				15 00 00 00 01 00 02 CD 02
				15 00 00 00 01 00 02 CE 8B
				15 00 00 00 01 00 02 CF 02
				15 00 00 00 01 00 02 D0 B0
				15 00 00 00 01 00 02 D1 02
				15 00 00 00 01 00 02 D2 E6
				15 00 00 00 01 00 02 D3 03
				15 00 00 00 01 00 02 D4 09
				15 00 00 00 01 00 02 D5 03
				15 00 00 00 01 00 02 D6 36
				15 00 00 00 01 00 02 D7 03
				15 00 00 00 01 00 02 D8 56
				15 00 00 00 01 00 02 D9 03
				15 00 00 00 01 00 02 DA 93
				15 00 00 00 01 00 02 DB 03
				15 00 00 00 01 00 02 DC A6
				15 00 00 00 01 00 02 DD 03
				15 00 00 00 01 00 02 DE B5
				15 00 00 00 01 00 02 DF 03
				15 00 00 00 01 00 02 E0 C0
				15 00 00 00 01 00 02 E1 03
				15 00 00 00 01 00 02 E2 C9
				15 00 00 00 01 00 02 E3 03
				15 00 00 00 01 00 02 E4 D0
				15 00 00 00 01 00 02 E5 03
				15 00 00 00 01 00 02 E6 D5
				15 00 00 00 01 00 02 E7 03
				15 00 00 00 01 00 02 E8 D8
				15 00 00 00 01 00 02 E9 03
				15 00 00 00 01 00 02 EA D9
				15 00 00 00 01 00 02 FB 01
				15 01 00 00 01 00 02 FF 10
			];
		qcom,mdss-dsi-dispparam-papermode5-command-state = "dsi_hs_mode";
		qcom,mdss-dsi-dispparam-papermode6-command = [
				15 00 00 00 01 00 02 FF 20
				15 00 00 00 01 00 02 FB 01
				15 00 00 00 01 00 02 75 00
				15 00 00 00 01 00 02 76 C9
				15 00 00 00 01 00 02 77 00
				15 00 00 00 01 00 02 78 D6
				15 00 00 00 01 00 02 79 00
				15 00 00 00 01 00 02 7A ED
				15 00 00 00 01 00 02 7B 00
				15 00 00 00 01 00 02 7C FF
				15 00 00 00 01 00 02 7D 01
				15 00 00 00 01 00 02 7E 0F
				15 00 00 00 01 00 02 7F 01
				15 00 00 00 01 00 02 80 1E
				15 00 00 00 01 00 02 81 01
				15 00 00 00 01 00 02 82 2A
				15 00 00 00 01 00 02 83 01
				15 00 00 00 01 00 02 84 36
				15 00 00 00 01 00 02 85 01
				15 00 00 00 01 00 02 86 41
				15 00 00 00 01 00 02 87 01
				15 00 00 00 01 00 02 88 65
				15 00 00 00 01 00 02 89 01
				15 00 00 00 01 00 02 8A 82
				15 00 00 00 01 00 02 8B 01
				15 00 00 00 01 00 02 8C B2
				15 00 00 00 01 00 02 8D 01
				15 00 00 00 01 00 02 8E DA
				15 00 00 00 01 00 02 8F 02
				15 00 00 00 01 00 02 90 18
				15 00 00 00 01 00 02 91 02
				15 00 00 00 01 00 02 92 4A
				15 00 00 00 01 00 02 93 02
				15 00 00 00 01 00 02 94 4A
				15 00 00 00 01 00 02 95 02
				15 00 00 00 01 00 02 96 78
				15 00 00 00 01 00 02 97 02
				15 00 00 00 01 00 02 98 AB
				15 00 00 00 01 00 02 99 02
				15 00 00 00 01 00 02 9A D6
				15 01 00 00 01 00 02 9B 03
				15 00 00 00 01 00 02 9C 03
				15 00 00 00 01 00 02 9D 03
				15 00 00 00 01 00 02 9E 23
				15 00 00 00 01 00 02 9F 03
				15 00 00 00 01 00 02 A0 4B
				15 00 00 00 01 00 02 A2 03
				15 00 00 00 01 00 02 A3 59
				15 00 00 00 01 00 02 A4 03
				15 00 00 00 01 00 02 A5 69
				15 00 00 00 01 00 02 A6 03
				15 00 00 00 01 00 02 A7 7E
				15 00 00 00 01 00 02 A9 03
				15 00 00 00 01 00 02 AA 9B
				15 00 00 00 01 00 02 AB 03
				15 00 00 00 01 00 02 AC B4
				15 00 00 00 01 00 02 AD 03
				15 00 00 00 01 00 02 AE C3
				15 00 00 00 01 00 02 AF 03
				15 00 00 00 01 00 02 B0 C6
				15 00 00 00 01 00 02 B1 03
				15 00 00 00 01 00 02 B2 CA
				15 00 00 00 01 00 02 B3 00
				15 00 00 00 01 00 02 B4 C9
				15 00 00 00 01 00 02 B5 00
				15 00 00 00 01 00 02 B6 D6
				15 00 00 00 01 00 02 B7 00
				15 00 00 00 01 00 02 B8 ED
				15 00 00 00 01 00 02 B9 00
				15 00 00 00 01 00 02 BA FF
				15 00 00 00 01 00 02 BB 01
				15 00 00 00 01 00 02 BC 0F
				15 00 00 00 01 00 02 BD 01
				15 00 00 00 01 00 02 BE 1E
				15 00 00 00 01 00 02 BF 01
				15 00 00 00 01 00 02 C0 2A
				15 00 00 00 01 00 02 C1 01
				15 00 00 00 01 00 02 C2 36
				15 00 00 00 01 00 02 C3 01
				15 00 00 00 01 00 02 C4 41
				15 00 00 00 01 00 02 C5 01
				15 01 00 00 01 00 02 C6 65
				15 00 00 00 01 00 02 C7 01
				15 00 00 00 01 00 02 C8 82
				15 00 00 00 01 00 02 C9 01
				15 00 00 00 01 00 02 CA B2
				15 00 00 00 01 00 02 CB 01
				15 00 00 00 01 00 02 CC DA
				15 00 00 00 01 00 02 CD 02
				15 00 00 00 01 00 02 CE 18
				15 00 00 00 01 00 02 CF 02
				15 00 00 00 01 00 02 D0 4A
				15 00 00 00 01 00 02 D1 02
				15 00 00 00 01 00 02 D2 4A
				15 00 00 00 01 00 02 D3 02
				15 00 00 00 01 00 02 D4 78
				15 00 00 00 01 00 02 D5 02
				15 00 00 00 01 00 02 D6 AB
				15 00 00 00 01 00 02 D7 02
				15 00 00 00 01 00 02 D8 D6
				15 00 00 00 01 00 02 D9 03
				15 00 00 00 01 00 02 DA 03
				15 00 00 00 01 00 02 DB 03
				15 00 00 00 01 00 02 DC 23
				15 00 00 00 01 00 02 DD 03
				15 00 00 00 01 00 02 DE 4B
				15 00 00 00 01 00 02 DF 03
				15 00 00 00 01 00 02 E0 59
				15 00 00 00 01 00 02 E1 03
				15 00 00 00 01 00 02 E2 69
				15 00 00 00 01 00 02 E3 03
				15 00 00 00 01 00 02 E4 7E
				15 00 00 00 01 00 02 E5 03
				15 00 00 00 01 00 02 E6 9B
				15 00 00 00 01 00 02 E7 03
				15 00 00 00 01 00 02 E8 B4
				15 00 00 00 01 00 02 E9 03
				15 00 00 00 01 00 02 EA C3
				15 00 00 00 01 00 02 EB 03
				15 00 00 00 01 00 02 EC C6
				15 00 00 00 01 00 02 ED 03
				15 00 00 00 01 00 02 EE CA
				15 01 00 00 01 00 02 EF 00
				15 00 00 00 01 00 02 F0 37
				15 00 00 00 01 00 02 F1 00
				15 00 00 00 01 00 02 F2 73
				15 00 00 00 01 00 02 F3 00
				15 00 00 00 01 00 02 F4 A5
				15 00 00 00 01 00 02 F5 00
				15 00 00 00 01 00 02 F6 C6
				15 00 00 00 01 00 02 F7 00
				15 00 00 00 01 00 02 F8 DF
				15 00 00 00 01 00 02 F9 00
				15 00 00 00 01 00 02 FA F3
				15 00 00 00 01 00 02 FF 21
				15 00 00 00 01 00 02 FB 01
				15 00 00 00 01 00 02 00 01
				15 00 00 00 01 00 02 01 05
				15 00 00 00 01 00 02 02 01
				15 00 00 00 01 00 02 03 14
				15 00 00 00 01 00 02 04 01
				15 00 00 00 01 00 02 05 22
				15 00 00 00 01 00 02 06 01
				15 00 00 00 01 00 02 07 4E
				15 00 00 00 01 00 02 08 01
				15 00 00 00 01 00 02 09 70
				15 00 00 00 01 00 02 0A 01
				15 00 00 00 01 00 02 0B A5
				15 00 00 00 01 00 02 0C 01
				15 00 00 00 01 00 02 0D D0
				15 00 00 00 01 00 02 0E 02
				15 00 00 00 01 00 02 0F 12
				15 00 00 00 01 00 02 10 02
				15 00 00 00 01 00 02 11 46
				15 00 00 00 01 00 02 12 02
				15 00 00 00 01 00 02 13 46
				15 00 00 00 01 00 02 14 02
				15 00 00 00 01 00 02 15 76
				15 00 00 00 01 00 02 16 02
				15 00 00 00 01 00 02 17 A9
				15 00 00 00 01 00 02 18 02
				15 00 00 00 01 00 02 19 D3
				15 01 00 00 01 00 02 1A 03
				15 00 00 00 01 00 02 1B 00
				15 00 00 00 01 00 02 1C 03
				15 00 00 00 01 00 02 1D 21
				15 00 00 00 01 00 02 1E 03
				15 00 00 00 01 00 02 1F 49
				15 00 00 00 01 00 02 20 03
				15 00 00 00 01 00 02 21 55
				15 00 00 00 01 00 02 22 03
				15 00 00 00 01 00 02 23 63
				15 00 00 00 01 00 02 24 03
				15 00 00 00 01 00 02 25 75
				15 00 00 00 01 00 02 26 03
				15 00 00 00 01 00 02 27 8E
				15 00 00 00 01 00 02 28 03
				15 00 00 00 01 00 02 29 AC
				15 00 00 00 01 00 02 2A 03
				15 00 00 00 01 00 02 2B C0
				15 00 00 00 01 00 02 2D 03
				15 00 00 00 01 00 02 2F C6
				15 00 00 00 01 00 02 30 03
				15 00 00 00 01 00 02 31 CA
				15 00 00 00 01 00 02 32 00
				15 00 00 00 01 00 02 33 37
				15 00 00 00 01 00 02 34 00
				15 00 00 00 01 00 02 35 73
				15 00 00 00 01 00 02 36 00
				15 00 00 00 01 00 02 37 A5
				15 00 00 00 01 00 02 38 00
				15 00 00 00 01 00 02 39 C6
				15 00 00 00 01 00 02 3A 00
				15 00 00 00 01 00 02 3B DF
				15 00 00 00 01 00 02 3D 00
				15 00 00 00 01 00 02 3F F3
				15 00 00 00 01 00 02 40 01
				15 00 00 00 01 00 02 41 05
				15 00 00 00 01 00 02 42 01
				15 00 00 00 01 00 02 43 14
				15 00 00 00 01 00 02 44 01
				15 00 00 00 01 00 02 45 22
				15 00 00 00 01 00 02 46 01
				15 01 00 00 01 00 02 47 4E
				15 00 00 00 01 00 02 48 01
				15 00 00 00 01 00 02 49 70
				15 00 00 00 01 00 02 4A 01
				15 00 00 00 01 00 02 4B A5
				15 00 00 00 01 00 02 4C 01
				15 00 00 00 01 00 02 4D D0
				15 00 00 00 01 00 02 4E 02
				15 00 00 00 01 00 02 4F 12
				15 00 00 00 01 00 02 50 02
				15 00 00 00 01 00 02 51 46
				15 00 00 00 01 00 02 52 02
				15 00 00 00 01 00 02 53 46
				15 00 00 00 01 00 02 54 02
				15 00 00 00 01 00 02 55 76
				15 00 00 00 01 00 02 56 02
				15 00 00 00 01 00 02 58 A9
				15 00 00 00 01 00 02 59 02
				15 00 00 00 01 00 02 5A D3
				15 00 00 00 01 00 02 5B 03
				15 00 00 00 01 00 02 5C 00
				15 00 00 00 01 00 02 5D 03
				15 00 00 00 01 00 02 5E 21
				15 00 00 00 01 00 02 5F 03
				15 00 00 00 01 00 02 60 49
				15 00 00 00 01 00 02 61 03
				15 00 00 00 01 00 02 62 55
				15 00 00 00 01 00 02 63 03
				15 00 00 00 01 00 02 64 63
				15 00 00 00 01 00 02 65 03
				15 00 00 00 01 00 02 66 75
				15 00 00 00 01 00 02 67 03
				15 00 00 00 01 00 02 68 8E
				15 00 00 00 01 00 02 69 03
				15 00 00 00 01 00 02 6A AC
				15 00 00 00 01 00 02 6B 03
				15 00 00 00 01 00 02 6C C0
				15 00 00 00 01 00 02 6D 03
				15 00 00 00 01 00 02 6E C6
				15 00 00 00 01 00 02 6F 03
				15 01 00 00 01 00 02 70 CA
				15 00 00 00 01 00 02 71 02
				15 00 00 00 01 00 02 72 15
				15 00 00 00 01 00 02 73 02
				15 00 00 00 01 00 02 74 15
				15 00 00 00 01 00 02 75 02
				15 00 00 00 01 00 02 76 18
				15 00 00 00 01 00 02 77 02
				15 00 00 00 01 00 02 78 1A
				15 00 00 00 01 00 02 79 02
				15 00 00 00 01 00 02 7A 1D
				15 00 00 00 01 00 02 7B 02
				15 00 00 00 01 00 02 7C 1F
				15 00 00 00 01 00 02 7D 02
				15 00 00 00 01 00 02 7E 21
				15 00 00 00 01 00 02 7F 02
				15 00 00 00 01 00 02 80 23
				15 00 00 00 01 00 02 81 02
				15 00 00 00 01 00 02 82 25
				15 00 00 00 01 00 02 83 02
				15 00 00 00 01 00 02 84 2D
				15 00 00 00 01 00 02 85 02
				15 00 00 00 01 00 02 86 35
				15 00 00 00 01 00 02 87 02
				15 00 00 00 01 00 02 88 44
				15 00 00 00 01 00 02 89 02
				15 00 00 00 01 00 02 8A 53
				15 00 00 00 01 00 02 8B 02
				15 00 00 00 01 00 02 8C 70
				15 00 00 00 01 00 02 8D 02
				15 00 00 00 01 00 02 8E 8E
				15 00 00 00 01 00 02 8F 02
				15 00 00 00 01 00 02 90 8E
				15 00 00 00 01 00 02 91 02
				15 00 00 00 01 00 02 92 B3
				15 00 00 00 01 00 02 93 02
				15 00 00 00 01 00 02 94 E6
				15 00 00 00 01 00 02 95 03
				15 00 00 00 01 00 02 96 08
				15 00 00 00 01 00 02 97 03
				15 00 00 00 01 00 02 98 32
				15 01 00 00 01 00 02 99 03
				15 00 00 00 01 00 02 9A 50
				15 00 00 00 01 00 02 9B 03
				15 00 00 00 01 00 02 9C 83
				15 00 00 00 01 00 02 9D 03
				15 00 00 00 01 00 02 9E 97
				15 00 00 00 01 00 02 9F 03
				15 00 00 00 01 00 02 A0 A7
				15 00 00 00 01 00 02 A2 03
				15 00 00 00 01 00 02 A3 B4
				15 00 00 00 01 00 02 A4 03
				15 00 00 00 01 00 02 A5 BD
				15 00 00 00 01 00 02 A6 03
				15 00 00 00 01 00 02 A7 C2
				15 00 00 00 01 00 02 A9 03
				15 00 00 00 01 00 02 AA C4
				15 00 00 00 01 00 02 AB 03
				15 00 00 00 01 00 02 AC C6
				15 00 00 00 01 00 02 AD 03
				15 00 00 00 01 00 02 AE CA
				15 00 00 00 01 00 02 AF 02
				15 00 00 00 01 00 02 B0 15
				15 00 00 00 01 00 02 B1 02
				15 00 00 00 01 00 02 B2 15
				15 00 00 00 01 00 02 B3 02
				15 00 00 00 01 00 02 B4 18
				15 00 00 00 01 00 02 B5 02
				15 00 00 00 01 00 02 B6 1A
				15 00 00 00 01 00 02 B7 02
				15 00 00 00 01 00 02 B8 1D
				15 00 00 00 01 00 02 B9 02
				15 00 00 00 01 00 02 BA 1F
				15 00 00 00 01 00 02 BB 02
				15 00 00 00 01 00 02 BC 21
				15 00 00 00 01 00 02 BD 02
				15 00 00 00 01 00 02 BE 23
				15 00 00 00 01 00 02 BF 02
				15 00 00 00 01 00 02 C0 25
				15 00 00 00 01 00 02 C1 02
				15 00 00 00 01 00 02 C2 2D
				15 01 00 00 01 00 02 C3 02
				15 00 00 00 01 00 02 C4 35
				15 00 00 00 01 00 02 C5 02
				15 00 00 00 01 00 02 C6 44
				15 00 00 00 01 00 02 C7 02
				15 00 00 00 01 00 02 C8 53
				15 00 00 00 01 00 02 C9 02
				15 00 00 00 01 00 02 CA 70
				15 00 00 00 01 00 02 CB 02
				15 00 00 00 01 00 02 CC 8E
				15 00 00 00 01 00 02 CD 02
				15 00 00 00 01 00 02 CE 8E
				15 00 00 00 01 00 02 CF 02
				15 00 00 00 01 00 02 D0 B3
				15 00 00 00 01 00 02 D1 02
				15 00 00 00 01 00 02 D2 E6
				15 00 00 00 01 00 02 D3 03
				15 00 00 00 01 00 02 D4 08
				15 00 00 00 01 00 02 D5 03
				15 00 00 00 01 00 02 D6 32
				15 00 00 00 01 00 02 D7 03
				15 00 00 00 01 00 02 D8 50
				15 00 00 00 01 00 02 D9 03
				15 00 00 00 01 00 02 DA 83
				15 00 00 00 01 00 02 DB 03
				15 00 00 00 01 00 02 DC 97
				15 00 00 00 01 00 02 DD 03
				15 00 00 00 01 00 02 DE A7
				15 00 00 00 01 00 02 DF 03
				15 00 00 00 01 00 02 E0 B4
				15 00 00 00 01 00 02 E1 03
				15 00 00 00 01 00 02 E2 BD
				15 00 00 00 01 00 02 E3 03
				15 00 00 00 01 00 02 E4 C2
				15 00 00 00 01 00 02 E5 03
				15 00 00 00 01 00 02 E6 C4
				15 00 00 00 01 00 02 E7 03
				15 00 00 00 01 00 02 E8 C6
				15 00 00 00 01 00 02 E9 03
				15 00 00 00 01 00 02 EA CA
				15 00 00 00 01 00 02 FB 01
				15 01 00 00 01 00 02 FF 10
			];
		qcom,mdss-dsi-dispparam-papermode6-command-state = "dsi_hs_mode";
		qcom,mdss-dsi-dispparam-papermode7-command = [
				15 00 00 00 01 00 02 FF 20
				15 00 00 00 01 00 02 FB 01
				15 00 00 00 01 00 02 75 00
				15 00 00 00 01 00 02 76 C9
				15 00 00 00 01 00 02 77 00
				15 00 00 00 01 00 02 78 D6
				15 00 00 00 01 00 02 79 00
				15 00 00 00 01 00 02 7A ED
				15 00 00 00 01 00 02 7B 00
				15 00 00 00 01 00 02 7C FF
				15 00 00 00 01 00 02 7D 01
				15 00 00 00 01 00 02 7E 0F
				15 00 00 00 01 00 02 7F 01
				15 00 00 00 01 00 02 80 1E
				15 00 00 00 01 00 02 81 01
				15 00 00 00 01 00 02 82 2A
				15 00 00 00 01 00 02 83 01
				15 00 00 00 01 00 02 84 36
				15 00 00 00 01 00 02 85 01
				15 00 00 00 01 00 02 86 41
				15 00 00 00 01 00 02 87 01
				15 00 00 00 01 00 02 88 65
				15 00 00 00 01 00 02 89 01
				15 00 00 00 01 00 02 8A 82
				15 00 00 00 01 00 02 8B 01
				15 00 00 00 01 00 02 8C B2
				15 00 00 00 01 00 02 8D 01
				15 00 00 00 01 00 02 8E DA
				15 00 00 00 01 00 02 8F 02
				15 00 00 00 01 00 02 90 18
				15 00 00 00 01 00 02 91 02
				15 00 00 00 01 00 02 92 4A
				15 00 00 00 01 00 02 93 02
				15 00 00 00 01 00 02 94 4A
				15 00 00 00 01 00 02 95 02
				15 00 00 00 01 00 02 96 78
				15 00 00 00 01 00 02 97 02
				15 00 00 00 01 00 02 98 AB
				15 00 00 00 01 00 02 99 02
				15 00 00 00 01 00 02 9A D6
				15 01 00 00 01 00 02 9B 03
				15 00 00 00 01 00 02 9C 03
				15 00 00 00 01 00 02 9D 03
				15 00 00 00 01 00 02 9E 23
				15 00 00 00 01 00 02 9F 03
				15 00 00 00 01 00 02 A0 4B
				15 00 00 00 01 00 02 A2 03
				15 00 00 00 01 00 02 A3 59
				15 00 00 00 01 00 02 A4 03
				15 00 00 00 01 00 02 A5 69
				15 00 00 00 01 00 02 A6 03
				15 00 00 00 01 00 02 A7 7E
				15 00 00 00 01 00 02 A9 03
				15 00 00 00 01 00 02 AA 9B
				15 00 00 00 01 00 02 AB 03
				15 00 00 00 01 00 02 AC B4
				15 00 00 00 01 00 02 AD 03
				15 00 00 00 01 00 02 AE C3
				15 00 00 00 01 00 02 AF 03
				15 00 00 00 01 00 02 B0 C6
				15 00 00 00 01 00 02 B1 03
				15 00 00 00 01 00 02 B2 CA
				15 00 00 00 01 00 02 B3 00
				15 00 00 00 01 00 02 B4 C9
				15 00 00 00 01 00 02 B5 00
				15 00 00 00 01 00 02 B6 D6
				15 00 00 00 01 00 02 B7 00
				15 00 00 00 01 00 02 B8 ED
				15 00 00 00 01 00 02 B9 00
				15 00 00 00 01 00 02 BA FF
				15 00 00 00 01 00 02 BB 01
				15 00 00 00 01 00 02 BC 0F
				15 00 00 00 01 00 02 BD 01
				15 00 00 00 01 00 02 BE 1E
				15 00 00 00 01 00 02 BF 01
				15 00 00 00 01 00 02 C0 2A
				15 00 00 00 01 00 02 C1 01
				15 00 00 00 01 00 02 C2 36
				15 00 00 00 01 00 02 C3 01
				15 00 00 00 01 00 02 C4 41
				15 01 00 00 01 00 02 C5 01
				15 00 00 00 01 00 02 C6 65
				15 00 00 00 01 00 02 C7 01
				15 00 00 00 01 00 02 C8 82
				15 00 00 00 01 00 02 C9 01
				15 00 00 00 01 00 02 CA B2
				15 00 00 00 01 00 02 CB 01
				15 00 00 00 01 00 02 CC DA
				15 00 00 00 01 00 02 CD 02
				15 00 00 00 01 00 02 CE 18
				15 00 00 00 01 00 02 CF 02
				15 00 00 00 01 00 02 D0 4A
				15 00 00 00 01 00 02 D1 02
				15 00 00 00 01 00 02 D2 4A
				15 00 00 00 01 00 02 D3 02
				15 00 00 00 01 00 02 D4 78
				15 00 00 00 01 00 02 D5 02
				15 00 00 00 01 00 02 D6 AB
				15 00 00 00 01 00 02 D7 02
				15 00 00 00 01 00 02 D8 D6
				15 00 00 00 01 00 02 D9 03
				15 00 00 00 01 00 02 DA 03
				15 00 00 00 01 00 02 DB 03
				15 00 00 00 01 00 02 DC 23
				15 00 00 00 01 00 02 DD 03
				15 00 00 00 01 00 02 DE 4B
				15 00 00 00 01 00 02 DF 03
				15 00 00 00 01 00 02 E0 59
				15 00 00 00 01 00 02 E1 03
				15 00 00 00 01 00 02 E2 69
				15 00 00 00 01 00 02 E3 03
				15 00 00 00 01 00 02 E4 7E
				15 00 00 00 01 00 02 E5 03
				15 00 00 00 01 00 02 E6 9B
				15 00 00 00 01 00 02 E7 03
				15 00 00 00 01 00 02 E8 B4
				15 00 00 00 01 00 02 E9 03
				15 00 00 00 01 00 02 EA C3
				15 00 00 00 01 00 02 EB 03
				15 00 00 00 01 00 02 EC C6
				15 00 00 00 01 00 02 ED 03
				15 01 00 00 01 00 02 EE CA
				15 00 00 00 01 00 02 EF 00
				15 00 00 00 01 00 02 F0 37
				15 00 00 00 01 00 02 F1 00
				15 00 00 00 01 00 02 F2 73
				15 00 00 00 01 00 02 F3 00
				15 00 00 00 01 00 02 F4 A5
				15 00 00 00 01 00 02 F5 00
				15 00 00 00 01 00 02 F6 C6
				15 00 00 00 01 00 02 F7 00
				15 00 00 00 01 00 02 F8 DF
				15 00 00 00 01 00 02 F9 00
				15 00 00 00 01 00 02 FA F3
				15 00 00 00 01 00 02 FF 21
				15 00 00 00 01 00 02 FB 01
				15 00 00 00 01 00 02 00 01
				15 00 00 00 01 00 02 01 05
				15 00 00 00 01 00 02 02 01
				15 00 00 00 01 00 02 03 14
				15 00 00 00 01 00 02 04 01
				15 00 00 00 01 00 02 05 22
				15 00 00 00 01 00 02 06 01
				15 00 00 00 01 00 02 07 4E
				15 00 00 00 01 00 02 08 01
				15 00 00 00 01 00 02 09 70
				15 00 00 00 01 00 02 0A 01
				15 00 00 00 01 00 02 0B A5
				15 00 00 00 01 00 02 0C 01
				15 00 00 00 01 00 02 0D D0
				15 00 00 00 01 00 02 0E 02
				15 00 00 00 01 00 02 0F 12
				15 00 00 00 01 00 02 10 02
				15 00 00 00 01 00 02 11 46
				15 00 00 00 01 00 02 12 02
				15 00 00 00 01 00 02 13 46
				15 00 00 00 01 00 02 14 02
				15 00 00 00 01 00 02 15 76
				15 00 00 00 01 00 02 16 02
				15 00 00 00 01 00 02 17 A9
				15 00 00 00 01 00 02 18 02
				15 01 00 00 01 00 02 19 D3
				15 00 00 00 01 00 02 1A 03
				15 00 00 00 01 00 02 1B 00
				15 00 00 00 01 00 02 1C 03
				15 00 00 00 01 00 02 1D 21
				15 00 00 00 01 00 02 1E 03
				15 00 00 00 01 00 02 1F 49
				15 00 00 00 01 00 02 20 03
				15 00 00 00 01 00 02 21 55
				15 00 00 00 01 00 02 22 03
				15 00 00 00 01 00 02 23 63
				15 00 00 00 01 00 02 24 03
				15 00 00 00 01 00 02 25 75
				15 00 00 00 01 00 02 26 03
				15 00 00 00 01 00 02 27 8E
				15 00 00 00 01 00 02 28 03
				15 00 00 00 01 00 02 29 AC
				15 00 00 00 01 00 02 2A 03
				15 00 00 00 01 00 02 2B C0
				15 00 00 00 01 00 02 2D 03
				15 00 00 00 01 00 02 2F C6
				15 00 00 00 01 00 02 30 03
				15 00 00 00 01 00 02 31 CA
				15 00 00 00 01 00 02 32 00
				15 00 00 00 01 00 02 33 37
				15 00 00 00 01 00 02 34 00
				15 00 00 00 01 00 02 35 73
				15 00 00 00 01 00 02 36 00
				15 00 00 00 01 00 02 37 A5
				15 00 00 00 01 00 02 38 00
				15 00 00 00 01 00 02 39 C6
				15 00 00 00 01 00 02 3A 00
				15 00 00 00 01 00 02 3B DF
				15 00 00 00 01 00 02 3D 00
				15 00 00 00 01 00 02 3F F3
				15 00 00 00 01 00 02 40 01
				15 00 00 00 01 00 02 41 05
				15 00 00 00 01 00 02 42 01
				15 00 00 00 01 00 02 43 14
				15 00 00 00 01 00 02 44 01
				15 01 00 00 01 00 02 45 22
				15 00 00 00 01 00 02 46 01
				15 00 00 00 01 00 02 47 4E
				15 00 00 00 01 00 02 48 01
				15 00 00 00 01 00 02 49 70
				15 00 00 00 01 00 02 4A 01
				15 00 00 00 01 00 02 4B A5
				15 00 00 00 01 00 02 4C 01
				15 00 00 00 01 00 02 4D D0
				15 00 00 00 01 00 02 4E 02
				15 00 00 00 01 00 02 4F 12
				15 00 00 00 01 00 02 50 02
				15 00 00 00 01 00 02 51 46
				15 00 00 00 01 00 02 52 02
				15 00 00 00 01 00 02 53 46
				15 00 00 00 01 00 02 54 02
				15 00 00 00 01 00 02 55 76
				15 00 00 00 01 00 02 56 02
				15 00 00 00 01 00 02 58 A9
				15 00 00 00 01 00 02 59 02
				15 00 00 00 01 00 02 5A D3
				15 00 00 00 01 00 02 5B 03
				15 00 00 00 01 00 02 5C 00
				15 00 00 00 01 00 02 5D 03
				15 00 00 00 01 00 02 5E 21
				15 00 00 00 01 00 02 5F 03
				15 00 00 00 01 00 02 60 49
				15 00 00 00 01 00 02 61 03
				15 00 00 00 01 00 02 62 55
				15 00 00 00 01 00 02 63 03
				15 00 00 00 01 00 02 64 63
				15 00 00 00 01 00 02 65 03
				15 00 00 00 01 00 02 66 75
				15 00 00 00 01 00 02 67 03
				15 00 00 00 01 00 02 68 8E
				15 00 00 00 01 00 02 69 03
				15 00 00 00 01 00 02 6A AC
				15 00 00 00 01 00 02 6B 03
				15 00 00 00 01 00 02 6C C0
				15 00 00 00 01 00 02 6D 03
				15 01 00 00 01 00 02 6E C6
				15 00 00 00 01 00 02 6F 03
				15 00 00 00 01 00 02 70 CA
				15 00 00 00 01 00 02 71 02
				15 00 00 00 01 00 02 72 28
				15 00 00 00 01 00 02 73 02
				15 00 00 00 01 00 02 74 28
				15 00 00 00 01 00 02 75 02
				15 00 00 00 01 00 02 76 2B
				15 00 00 00 01 00 02 77 02
				15 00 00 00 01 00 02 78 2D
				15 00 00 00 01 00 02 79 02
				15 00 00 00 01 00 02 7A 2F
				15 00 00 00 01 00 02 7B 02
				15 00 00 00 01 00 02 7C 2F
				15 00 00 00 01 00 02 7D 02
				15 00 00 00 01 00 02 7E 32
				15 00 00 00 01 00 02 7F 02
				15 00 00 00 01 00 02 80 34
				15 00 00 00 01 00 02 81 02
				15 00 00 00 01 00 02 82 36
				15 00 00 00 01 00 02 83 02
				15 00 00 00 01 00 02 84 3D
				15 00 00 00 01 00 02 85 02
				15 00 00 00 01 00 02 86 44
				15 00 00 00 01 00 02 87 02
				15 00 00 00 01 00 02 88 52
				15 00 00 00 01 00 02 89 02
				15 00 00 00 01 00 02 8A 5F
				15 00 00 00 01 00 02 8B 02
				15 00 00 00 01 00 02 8C 7A
				15 00 00 00 01 00 02 8D 02
				15 00 00 00 01 00 02 8E 96
				15 00 00 00 01 00 02 8F 02
				15 00 00 00 01 00 02 90 96
				15 00 00 00 01 00 02 91 02
				15 00 00 00 01 00 02 92 BB
				15 00 00 00 01 00 02 93 02
				15 00 00 00 01 00 02 94 ED
				15 00 00 00 01 00 02 95 03
				15 01 00 00 01 00 02 96 0F
				15 00 00 00 01 00 02 97 03
				15 00 00 00 01 00 02 98 39
				15 00 00 00 01 00 02 99 03
				15 00 00 00 01 00 02 9A 53
				15 00 00 00 01 00 02 9B 03
				15 00 00 00 01 00 02 9C 79
				15 00 00 00 01 00 02 9D 03
				15 00 00 00 01 00 02 9E 87
				15 00 00 00 01 00 02 9F 03
				15 00 00 00 01 00 02 A0 98
				15 00 00 00 01 00 02 A2 03
				15 00 00 00 01 00 02 A3 A9
				15 00 00 00 01 00 02 A4 03
				15 00 00 00 01 00 02 A5 B7
				15 00 00 00 01 00 02 A6 03
				15 00 00 00 01 00 02 A7 C1
				15 00 00 00 01 00 02 A9 03
				15 00 00 00 01 00 02 AA C4
				15 00 00 00 01 00 02 AB 03
				15 00 00 00 01 00 02 AC C6
				15 00 00 00 01 00 02 AD 03
				15 00 00 00 01 00 02 AE CA
				15 00 00 00 01 00 02 AF 02
				15 00 00 00 01 00 02 B0 28
				15 00 00 00 01 00 02 B1 02
				15 00 00 00 01 00 02 B2 28
				15 00 00 00 01 00 02 B3 02
				15 00 00 00 01 00 02 B4 2B
				15 00 00 00 01 00 02 B5 02
				15 00 00 00 01 00 02 B6 2D
				15 00 00 00 01 00 02 B7 02
				15 00 00 00 01 00 02 B8 2F
				15 00 00 00 01 00 02 B9 02
				15 00 00 00 01 00 02 BA 2F
				15 00 00 00 01 00 02 BB 02
				15 00 00 00 01 00 02 BC 32
				15 00 00 00 01 00 02 BD 02
				15 00 00 00 01 00 02 BE 34
				15 00 00 00 01 00 02 BF 02
				15 00 00 00 01 00 02 C0 36
				15 01 00 00 01 00 02 C1 02
				15 00 00 00 01 00 02 C2 3D
				15 00 00 00 01 00 02 C3 02
				15 00 00 00 01 00 02 C4 44
				15 00 00 00 01 00 02 C5 02
				15 00 00 00 01 00 02 C6 52
				15 00 00 00 01 00 02 C7 02
				15 00 00 00 01 00 02 C8 5F
				15 00 00 00 01 00 02 C9 02
				15 00 00 00 01 00 02 CA 7A
				15 00 00 00 01 00 02 CB 02
				15 00 00 00 01 00 02 CC 96
				15 00 00 00 01 00 02 CD 02
				15 00 00 00 01 00 02 CE 96
				15 00 00 00 01 00 02 CF 02
				15 00 00 00 01 00 02 D0 BB
				15 00 00 00 01 00 02 D1 02
				15 00 00 00 01 00 02 D2 ED
				15 00 00 00 01 00 02 D3 03
				15 00 00 00 01 00 02 D4 0F
				15 00 00 00 01 00 02 D5 03
				15 00 00 00 01 00 02 D6 39
				15 00 00 00 01 00 02 D7 03
				15 00 00 00 01 00 02 D8 53
				15 00 00 00 01 00 02 D9 03
				15 00 00 00 01 00 02 DA 79
				15 00 00 00 01 00 02 DB 03
				15 00 00 00 01 00 02 DC 87
				15 00 00 00 01 00 02 DD 03
				15 00 00 00 01 00 02 DE 98
				15 00 00 00 01 00 02 DF 03
				15 00 00 00 01 00 02 E0 A9
				15 00 00 00 01 00 02 E1 03
				15 00 00 00 01 00 02 E2 B7
				15 00 00 00 01 00 02 E3 03
				15 00 00 00 01 00 02 E4 C1
				15 00 00 00 01 00 02 E5 03
				15 00 00 00 01 00 02 E6 C4
				15 00 00 00 01 00 02 E7 03
				15 00 00 00 01 00 02 E8 C6
				15 00 00 00 01 00 02 E9 03
				15 00 00 00 01 00 02 EA CA
				15 00 00 00 01 00 02 FB 01
				15 01 00 00 01 00 02 FF 10
			];
		qcom,mdss-dsi-dispparam-papermode7-command-state = "dsi_hs_mode";
		qcom,mdss-dsi-dispparam-papermode-command = [
				15 00 00 00 01 00 02 FF 20
				15 00 00 00 01 00 02 FB 01
				15 00 00 00 01 00 02 75 00
				15 00 00 00 01 00 02 76 C9
				15 00 00 00 01 00 02 77 00
				15 00 00 00 01 00 02 78 D6
				15 00 00 00 01 00 02 79 00
				15 00 00 00 01 00 02 7A ED
				15 00 00 00 01 00 02 7B 00
				15 00 00 00 01 00 02 7C FF
				15 00 00 00 01 00 02 7D 01
				15 00 00 00 01 00 02 7E 0F
				15 00 00 00 01 00 02 7F 01
				15 00 00 00 01 00 02 80 1E
				15 00 00 00 01 00 02 81 01
				15 00 00 00 01 00 02 82 2A
				15 00 00 00 01 00 02 83 01
				15 00 00 00 01 00 02 84 36
				15 00 00 00 01 00 02 85 01
				15 00 00 00 01 00 02 86 41
				15 00 00 00 01 00 02 87 01
				15 00 00 00 01 00 02 88 65
				15 00 00 00 01 00 02 89 01
				15 00 00 00 01 00 02 8A 82
				15 00 00 00 01 00 02 8B 01
				15 00 00 00 01 00 02 8C B2
				15 00 00 00 01 00 02 8D 01
				15 00 00 00 01 00 02 8E DA
				15 00 00 00 01 00 02 8F 02
				15 00 00 00 01 00 02 90 18
				15 00 00 00 01 00 02 91 02
				15 00 00 00 01 00 02 92 4A
				15 00 00 00 01 00 02 93 02
				15 00 00 00 01 00 02 94 4A
				15 00 00 00 01 00 02 95 02
				15 00 00 00 01 00 02 96 78
				15 00 00 00 01 00 02 97 02
				15 00 00 00 01 00 02 98 AB
				15 00 00 00 01 00 02 99 02
				15 01 00 00 01 00 02 9A D6
				15 00 00 00 01 00 02 9B 03
				15 00 00 00 01 00 02 9C 03
				15 00 00 00 01 00 02 9D 03
				15 00 00 00 01 00 02 9E 23
				15 00 00 00 01 00 02 9F 03
				15 00 00 00 01 00 02 A0 4B
				15 00 00 00 01 00 02 A2 03
				15 00 00 00 01 00 02 A3 59
				15 00 00 00 01 00 02 A4 03
				15 00 00 00 01 00 02 A5 69
				15 00 00 00 01 00 02 A6 03
				15 00 00 00 01 00 02 A7 7E
				15 00 00 00 01 00 02 A9 03
				15 00 00 00 01 00 02 AA 9B
				15 00 00 00 01 00 02 AB 03
				15 00 00 00 01 00 02 AC B4
				15 00 00 00 01 00 02 AD 03
				15 00 00 00 01 00 02 AE C3
				15 00 00 00 01 00 02 AF 03
				15 00 00 00 01 00 02 B0 C6
				15 00 00 00 01 00 02 B1 03
				15 00 00 00 01 00 02 B2 CA
				15 00 00 00 01 00 02 B3 00
				15 00 00 00 01 00 02 B4 C9
				15 00 00 00 01 00 02 B5 00
				15 00 00 00 01 00 02 B6 D6
				15 00 00 00 01 00 02 B7 00
				15 00 00 00 01 00 02 B8 ED
				15 00 00 00 01 00 02 B9 00
				15 00 00 00 01 00 02 BA FF
				15 00 00 00 01 00 02 BB 01
				15 00 00 00 01 00 02 BC 0F
				15 00 00 00 01 00 02 BD 01
				15 00 00 00 01 00 02 BE 1E
				15 00 00 00 01 00 02 BF 01
				15 00 00 00 01 00 02 C0 2A
				15 00 00 00 01 00 02 C1 01
				15 00 00 00 01 00 02 C2 36
				15 00 00 00 01 00 02 C3 01
				15 00 00 00 01 00 02 C4 41
				15 01 00 00 01 00 02 C5 01
				15 00 00 00 01 00 02 C6 65
				15 00 00 00 01 00 02 C7 01
				15 00 00 00 01 00 02 C8 82
				15 00 00 00 01 00 02 C9 01
				15 00 00 00 01 00 02 CA B2
				15 00 00 00 01 00 02 CB 01
				15 00 00 00 01 00 02 CC DA
				15 00 00 00 01 00 02 CD 02
				15 00 00 00 01 00 02 CE 18
				15 00 00 00 01 00 02 CF 02
				15 00 00 00 01 00 02 D0 4A
				15 00 00 00 01 00 02 D1 02
				15 00 00 00 01 00 02 D2 4A
				15 00 00 00 01 00 02 D3 02
				15 00 00 00 01 00 02 D4 78
				15 00 00 00 01 00 02 D5 02
				15 00 00 00 01 00 02 D6 AB
				15 00 00 00 01 00 02 D7 02
				15 00 00 00 01 00 02 D8 D6
				15 00 00 00 01 00 02 D9 03
				15 00 00 00 01 00 02 DA 03
				15 00 00 00 01 00 02 DB 03
				15 00 00 00 01 00 02 DC 23
				15 00 00 00 01 00 02 DD 03
				15 00 00 00 01 00 02 DE 4B
				15 00 00 00 01 00 02 DF 03
				15 00 00 00 01 00 02 E0 59
				15 00 00 00 01 00 02 E1 03
				15 00 00 00 01 00 02 E2 69
				15 00 00 00 01 00 02 E3 03
				15 00 00 00 01 00 02 E4 7E
				15 00 00 00 01 00 02 E5 03
				15 00 00 00 01 00 02 E6 9B
				15 00 00 00 01 00 02 E7 03
				15 00 00 00 01 00 02 E8 B4
				15 00 00 00 01 00 02 E9 03
				15 00 00 00 01 00 02 EA C3
				15 00 00 00 01 00 02 EB 03
				15 00 00 00 01 00 02 EC C6
				15 01 00 00 01 00 02 ED 03
				15 00 00 00 01 00 02 EE CA
				15 00 00 00 01 00 02 EF 00
				15 00 00 00 01 00 02 F0 37
				15 00 00 00 01 00 02 F1 00
				15 00 00 00 01 00 02 F2 73
				15 00 00 00 01 00 02 F3 00
				15 00 00 00 01 00 02 F4 A5
				15 00 00 00 01 00 02 F5 00
				15 00 00 00 01 00 02 F6 C6
				15 00 00 00 01 00 02 F7 00
				15 00 00 00 01 00 02 F8 DF
				15 00 00 00 01 00 02 F9 00
				15 00 00 00 01 00 02 FA F3
				15 00 00 00 01 00 02 FF 21
				15 00 00 00 01 00 02 FB 01
				15 00 00 00 01 00 02 00 01
				15 00 00 00 01 00 02 01 05
				15 00 00 00 01 00 02 02 01
				15 00 00 00 01 00 02 03 14
				15 00 00 00 01 00 02 04 01
				15 00 00 00 01 00 02 05 22
				15 00 00 00 01 00 02 06 01
				15 00 00 00 01 00 02 07 4E
				15 00 00 00 01 00 02 08 01
				15 00 00 00 01 00 02 09 70
				15 00 00 00 01 00 02 0A 01
				15 00 00 00 01 00 02 0B A5
				15 00 00 00 01 00 02 0C 01
				15 00 00 00 01 00 02 0D D0
				15 00 00 00 01 00 02 0E 02
				15 00 00 00 01 00 02 0F 12
				15 00 00 00 01 00 02 10 02
				15 00 00 00 01 00 02 11 46
				15 00 00 00 01 00 02 12 02
				15 00 00 00 01 00 02 13 46
				15 00 00 00 01 00 02 14 02
				15 00 00 00 01 00 02 15 76
				15 00 00 00 01 00 02 16 02
				15 00 00 00 01 00 02 17 A9
				15 00 00 00 01 00 02 18 02
				15 01 00 00 01 00 02 19 D3
				15 00 00 00 01 00 02 1A 03
				15 00 00 00 01 00 02 1B 00
				15 00 00 00 01 00 02 1C 03
				15 00 00 00 01 00 02 1D 21
				15 00 00 00 01 00 02 1E 03
				15 00 00 00 01 00 02 1F 49
				15 00 00 00 01 00 02 20 03
				15 00 00 00 01 00 02 21 55
				15 00 00 00 01 00 02 22 03
				15 00 00 00 01 00 02 23 63
				15 00 00 00 01 00 02 24 03
				15 00 00 00 01 00 02 25 75
				15 00 00 00 01 00 02 26 03
				15 00 00 00 01 00 02 27 8E
				15 00 00 00 01 00 02 28 03
				15 00 00 00 01 00 02 29 AC
				15 00 00 00 01 00 02 2A 03
				15 00 00 00 01 00 02 2B C0
				15 00 00 00 01 00 02 2D 03
				15 00 00 00 01 00 02 2F C6
				15 00 00 00 01 00 02 30 03
				15 00 00 00 01 00 02 31 CA
				15 00 00 00 01 00 02 32 00
				15 00 00 00 01 00 02 33 37
				15 00 00 00 01 00 02 34 00
				15 00 00 00 01 00 02 35 73
				15 00 00 00 01 00 02 36 00
				15 00 00 00 01 00 02 37 A5
				15 00 00 00 01 00 02 38 00
				15 00 00 00 01 00 02 39 C6
				15 00 00 00 01 00 02 3A 00
				15 00 00 00 01 00 02 3B DF
				15 00 00 00 01 00 02 3D 00
				15 00 00 00 01 00 02 3F F3
				15 00 00 00 01 00 02 40 01
				15 00 00 00 01 00 02 41 05
				15 00 00 00 01 00 02 42 01
				15 00 00 00 01 00 02 43 14
				15 00 00 00 01 00 02 44 01
				15 00 00 00 01 00 02 45 22
				15 01 00 00 01 00 02 46 01
				15 00 00 00 01 00 02 47 4E
				15 00 00 00 01 00 02 48 01
				15 00 00 00 01 00 02 49 70
				15 00 00 00 01 00 02 4A 01
				15 00 00 00 01 00 02 4B A5
				15 00 00 00 01 00 02 4C 01
				15 00 00 00 01 00 02 4D D0
				15 00 00 00 01 00 02 4E 02
				15 00 00 00 01 00 02 4F 12
				15 00 00 00 01 00 02 50 02
				15 00 00 00 01 00 02 51 46
				15 00 00 00 01 00 02 52 02
				15 00 00 00 01 00 02 53 46
				15 00 00 00 01 00 02 54 02
				15 00 00 00 01 00 02 55 76
				15 00 00 00 01 00 02 56 02
				15 00 00 00 01 00 02 58 A9
				15 00 00 00 01 00 02 59 02
				15 00 00 00 01 00 02 5A D3
				15 00 00 00 01 00 02 5B 03
				15 00 00 00 01 00 02 5C 00
				15 00 00 00 01 00 02 5D 03
				15 00 00 00 01 00 02 5E 21
				15 00 00 00 01 00 02 5F 03
				15 00 00 00 01 00 02 60 49
				15 00 00 00 01 00 02 61 03
				15 00 00 00 01 00 02 62 55
				15 00 00 00 01 00 02 63 03
				15 00 00 00 01 00 02 64 63
				15 00 00 00 01 00 02 65 03
				15 00 00 00 01 00 02 66 75
				15 00 00 00 01 00 02 67 03
				15 00 00 00 01 00 02 68 8E
				15 00 00 00 01 00 02 69 03
				15 00 00 00 01 00 02 6A AC
				15 00 00 00 01 00 02 6B 03
				15 00 00 00 01 00 02 6C C0
				15 00 00 00 01 00 02 6D 03
				15 00 00 00 01 00 02 6E C6
				15 01 00 00 01 00 02 6F 03
				15 00 00 00 01 00 02 70 CA
				15 00 00 00 01 00 02 71 02
				15 00 00 00 01 00 02 72 3A
				15 00 00 00 01 00 02 73 02
				15 00 00 00 01 00 02 74 3B
				15 00 00 00 01 00 02 75 02
				15 00 00 00 01 00 02 76 3C
				15 00 00 00 01 00 02 77 02
				15 00 00 00 01 00 02 78 3E
				15 00 00 00 01 00 02 79 02
				15 00 00 00 01 00 02 7A 40
				15 00 00 00 01 00 02 7B 02
				15 00 00 00 01 00 02 7C 40
				15 00 00 00 01 00 02 7D 02
				15 00 00 00 01 00 02 7E 43
				15 00 00 00 01 00 02 7F 02
				15 00 00 00 01 00 02 80 43
				15 00 00 00 01 00 02 81 02
				15 00 00 00 01 00 02 82 46
				15 00 00 00 01 00 02 83 02
				15 00 00 00 01 00 02 84 4C
				15 00 00 00 01 00 02 85 02
				15 00 00 00 01 00 02 86 53
				15 00 00 00 01 00 02 87 02
				15 00 00 00 01 00 02 88 5F
				15 00 00 00 01 00 02 89 02
				15 00 00 00 01 00 02 8A 6B
				15 00 00 00 01 00 02 8B 02
				15 00 00 00 01 00 02 8C 84
				15 00 00 00 01 00 02 8D 02
				15 00 00 00 01 00 02 8E 9F
				15 00 00 00 01 00 02 8F 02
				15 00 00 00 01 00 02 90 9F
				15 00 00 00 01 00 02 91 02
				15 00 00 00 01 00 02 92 C7
				15 00 00 00 01 00 02 93 02
				15 00 00 00 01 00 02 94 F7
				15 00 00 00 01 00 02 95 03
				15 00 00 00 01 00 02 96 18
				15 00 00 00 01 00 02 97 03
				15 00 00 00 01 00 02 98 40
				15 01 00 00 01 00 02 99 03
				15 00 00 00 01 00 02 9A 5C
				15 00 00 00 01 00 02 9B 03
				15 00 00 00 01 00 02 9C 8A
				15 00 00 00 01 00 02 9D 03
				15 00 00 00 01 00 02 9E 9A
				15 00 00 00 01 00 02 9F 03
				15 00 00 00 01 00 02 A0 A9
				15 00 00 00 01 00 02 A2 03
				15 00 00 00 01 00 02 A3 B5
				15 00 00 00 01 00 02 A4 03
				15 00 00 00 01 00 02 A5 BE
				15 00 00 00 01 00 02 A6 03
				15 00 00 00 01 00 02 A7 C2
				15 00 00 00 01 00 02 A9 03
				15 00 00 00 01 00 02 AA C4
				15 00 00 00 01 00 02 AB 03
				15 00 00 00 01 00 02 AC C6
				15 00 00 00 01 00 02 AD 03
				15 00 00 00 01 00 02 AE CA
				15 00 00 00 01 00 02 AF 02
				15 00 00 00 01 00 02 B0 3A
				15 00 00 00 01 00 02 B1 02
				15 00 00 00 01 00 02 B2 3B
				15 00 00 00 01 00 02 B3 02
				15 00 00 00 01 00 02 B4 3C
				15 00 00 00 01 00 02 B5 02
				15 00 00 00 01 00 02 B6 3E
				15 00 00 00 01 00 02 B7 02
				15 00 00 00 01 00 02 B8 40
				15 00 00 00 01 00 02 B9 02
				15 00 00 00 01 00 02 BA 40
				15 00 00 00 01 00 02 BB 02
				15 00 00 00 01 00 02 BC 43
				15 00 00 00 01 00 02 BD 02
				15 00 00 00 01 00 02 BE 43
				15 00 00 00 01 00 02 BF 02
				15 00 00 00 01 00 02 C0 46
				15 00 00 00 01 00 02 C1 02
				15 00 00 00 01 00 02 C2 4C
				15 00 00 00 01 00 02 C3 02
				15 01 00 00 01 00 02 C4 53
				15 00 00 00 01 00 02 C5 02
				15 00 00 00 01 00 02 C6 5F
				15 00 00 00 01 00 02 C7 02
				15 00 00 00 01 00 02 C8 6B
				15 00 00 00 01 00 02 C9 02
				15 00 00 00 01 00 02 CA 84
				15 00 00 00 01 00 02 CB 02
				15 00 00 00 01 00 02 CC 9F
				15 00 00 00 01 00 02 CD 02
				15 00 00 00 01 00 02 CE 9F
				15 00 00 00 01 00 02 CF 02
				15 00 00 00 01 00 02 D0 C7
				15 00 00 00 01 00 02 D1 02
				15 00 00 00 01 00 02 D2 F7
				15 00 00 00 01 00 02 D3 03
				15 00 00 00 01 00 02 D4 18
				15 00 00 00 01 00 02 D5 03
				15 00 00 00 01 00 02 D6 40
				15 00 00 00 01 00 02 D7 03
				15 00 00 00 01 00 02 D8 5C
				15 00 00 00 01 00 02 D9 03
				15 00 00 00 01 00 02 DA 8A
				15 00 00 00 01 00 02 DB 03
				15 00 00 00 01 00 02 DC 9A
				15 00 00 00 01 00 02 DD 03
				15 00 00 00 01 00 02 DE A9
				15 00 00 00 01 00 02 DF 03
				15 00 00 00 01 00 02 E0 B5
				15 00 00 00 01 00 02 E1 03
				15 00 00 00 01 00 02 E2 BE
				15 00 00 00 01 00 02 E3 03
				15 00 00 00 01 00 02 E4 C2
				15 00 00 00 01 00 02 E5 03
				15 00 00 00 01 00 02 E6 C4
				15 00 00 00 01 00 02 E7 03
				15 00 00 00 01 00 02 E8 C6
				15 00 00 00 01 00 02 E9 03
				15 00 00 00 01 00 02 EA CA
				15 00 00 00 01 00 02 FB 01
				15 01 00 00 01 00 02 FF 10
			];
		qcom,mdss-dsi-dispparam-papermode-command-state = "dsi_hs_mode";

	};
	};

