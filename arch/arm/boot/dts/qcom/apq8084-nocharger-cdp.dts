/* Copyright (c) 2014, The Linux Foundation. All rights reserved.
 *
 * This program is free software; you can redistribute it and/or modify
 * it under the terms of the GNU General Public License version 2 and
 * only version 2 as published by the Free Software Foundation.
 *
 * This program is distributed in the hope that it will be useful,
 * but WITHOUT ANY WARRANTY; without even the implied warranty of
 * MERCHANTABILITY or FITNESS FOR A PARTICULAR PURPOSE.  See the
 * GNU General Public License for more details.
 */

/dts-v1/;

#include "apq8084.dtsi"
#include "apq8084-cdp.dtsi"

/ {
	model = "Qualcomm APQ 8084, SMB1357 CDP";
	compatible = "qcom,apq8084-cdp", "qcom,apq8084", "qcom,cdp";
	qcom,board-id = <1 6>;
};

&soc {
	usb_detect {
		compatible = "qcom,qpnp-usbdetect";
		interrupt-parent = <&spmi_bus>;
		interrupts = <0x0 0xca 0x0>;  /* PMA8084 GPIO 11 */
		interrupt-names = "vbus_det_irq";
	};
};
