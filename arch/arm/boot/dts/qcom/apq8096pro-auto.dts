/* Copyright (c) 2019, The Linux Foundation. All rights reserved.
 *
 * This program is free software; you can redistribute it and/or modify
 * it under the terms of the GNU General Public License version 2 and
 * only version 2 as published by the Free Software Foundation.
 *
 * This program is distributed in the hope that it will be useful,
 * but WITHOUT ANY WARRANTY; without even the implied warranty of
 * MERCHANTABILITY or FITNESS FOR A PARTICULAR PURPOSE.  See the
 * GNU General Public License for more details.
 */

/dts-v1/;

#include "apq8096pro-auto.dtsi"

/ {
	model = "Qualcomm Technologies, Inc. APQ 8096pro AUTO SoC";
	compatible = "qcom,apq8096-cdp", "qcom,apq8096", "qcom,cdp";
	qcom,msm-id = <387 0x10000>, <316 0x10000>;
	qcom,pmic-id = <0x20009 0x0 0x0 0x0>;
	qcom,board-id = <0 0>;
};
