/* Copyright (c) 2017-2019, The Linux Foundation. All rights reserved.
 *
 * This program is free software; you can redistribute it and/or modify
 * it under the terms of the GNU General Public License version 2 and
 * only version 2 as published by the Free Software Foundation.
 *
 * This program is distributed in the hope that it will be useful,
 * but WITHOUT ANY WARRANTY; without even the implied warranty of
 * MERCHANTABILITY or FITNESS FOR A PARTICULAR PURPOSE.  See the
 * GNU General Public License for more details.
 */

/dts-v1/;

#include "sa415m-ttp.dtsi"
#include "sdxpoorwills-v2.dtsi"

/ {
	model = "Qualcomm Technologies, Inc. SA415M TTP USB-EP";
	compatible = "qcom,sa415m-ttp",
		"qcom,sdxpoorwills", "qcom,ttp";
	qcom,board-id = <30 0x102>;
};

&blsp1_uart2b_hs {
	status = "okay";
};

&mss_mem {
	reg = <0x86400000 0x9300000>;
};

&ipa_hw {
	qcom,ipa-config-is-auto;
};

