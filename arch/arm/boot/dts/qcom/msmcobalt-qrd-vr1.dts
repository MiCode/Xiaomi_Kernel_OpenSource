/* Copyright (c) 2016, The Linux Foundation. All rights reserved.
 *
 * This program is free software; you can redistribute it and/or modify
 * it under the terms of the GNU General Public License version 2 and
 * only version 2 as published by the Free Software Foundation.
 *
 * This program is distributed in the hope that it will be useful,
 * but WITHOUT ANY WARRANTY; without even the implied warranty of
 * MERCHANTABILITY or FITNESS FOR A PARTICULAR PURPOSE.  See the
 * GNU General Public License for more details.
 */


/dts-v1/;

#include "msmcobalt.dtsi"
#include "msmcobalt-qrd-vr1.dtsi"

/ {
	model = "Qualcomm Technologies, Inc. MSM COBALT VR1 Board";
	compatible = "qcom,msmcobalt-qrd", "qcom,msmcobalt", "qcom,qrd";
	qcom,board-id = <0x02000b 0x80>;
};

&soc {
	sound-tavil {
		qcom,model = "msmcobalt-qvr-tavil-snd-card";
		qcom,audio-routing =
			"RX_BIAS", "MCLK",
			"MADINPUT", "MCLK",
			"AMIC2", "MIC BIAS2",
			"MIC BIAS2", "Headset Mic",
			"DMIC0", "MIC BIAS1",
			"MIC BIAS1", "Digital Mic0",
			"DMIC1", "MIC BIAS1",
			"MIC BIAS1", "Digital Mic1",
			"DMIC2", "MIC BIAS3",
			"MIC BIAS3", "Digital Mic2",
			"DMIC4", "MIC BIAS4",
			"MIC BIAS4", "Digital Mic4",
			"SpkrLeft IN", "SPK1 OUT";

		qcom,msm-mbhc-hphl-swh = <1>;
		/delete-property/ qcom,us-euro-gpios;
		/delete-property/ qcom,hph-en0-gpio;
		/delete-property/ qcom,hph-en0-gpio;

		qcom,wsa-max-devs = <1>;
		qcom,wsa-devs = <&wsa881x_0211>, <&wsa881x_0213>;
		qcom,wsa-aux-dev-prefix = "SpkrLeft", "SpkrLeft";
	};
};
