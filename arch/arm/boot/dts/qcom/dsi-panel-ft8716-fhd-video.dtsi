/* Copyright (c) 2012-2015, The Linux Foundation. All rights reserved.
 *
 * This program is free software; you can redistribute it and/or modify
 * it under the terms of the GNU General Public License version 2 and
 * only version 2 as published by the Free Software Foundation.
 *
 * This program is distributed in the hope that it will be useful,
 * but WITHOUT ANY WARRANTY; without even the implied warranty of
 * MERCHANTABILITY or FITNESS FOR A PARTICULAR PURPOSE.  See the
 * GNU General Public License for more details.
 */

&mdss_mdp {
	dsi_ft8716_fhd_vid: qcom,mdss_dsi_ft8716_fhd_video {
		qcom,mdss-dsi-panel-name = "ft8716 fhd video mode dsi panel";
		qcom,mdss-dsi-panel-type = "dsi_video_mode";
		qcom,mdss-dsi-panel-framerate = <60>;
		qcom,mdss-dsi-virtual-channel-id = <0>;
		qcom,mdss-dsi-stream = <0>;
		qcom,mdss-dsi-panel-width = <1080>;
		qcom,mdss-dsi-panel-height = <1920>;
		qcom,mdss-dsi-h-front-porch = <32>;
		qcom,mdss-dsi-h-back-porch = <32>;
		qcom,mdss-dsi-h-pulse-width = <4>;
		qcom,mdss-dsi-h-sync-skew = <0>;
		qcom,mdss-dsi-v-back-porch = <16>;
		qcom,mdss-dsi-v-front-porch = <16>;
		qcom,mdss-dsi-v-pulse-width = <2>;
		qcom,mdss-dsi-h-left-border = <0>;
		qcom,mdss-dsi-h-right-border = <0>;
		qcom,mdss-dsi-v-top-border = <0>;
		qcom,mdss-dsi-v-bottom-border = <0>;
		qcom,mdss-dsi-bpp = <24>;
		qcom,mdss-dsi-underflow-color = <0xff>;
		qcom,mdss-dsi-border-color = <0>;
		qcom,mdss-dsi-on-command = [
				39 01 00 00 78 00 02 11 00
				39 01 00 00 00 00 02 00 00
				39 01 00 00 00 00 04 FF 87 16 01
				39 01 00 00 00 00 02 00 80
				39 01 00 00 00 00 03 FF 87 16

				39 01 00 00 00 00 02 00 80
				39 01 00 00 00 00 0D D8 00 80 80 80 01 03 03 01 01 82 05 01
				39 01 00 00 00 00 02 00 90
				39 01 00 00 00 00 0D D8 80 81 81 82 82 83 82 83 81 81 83 81
				39 01 00 00 00 00 02 00 A0
				39 01 00 00 00 00 0D D8 01 02 02 04 08 0c 0d 0f 11 0b 14 11
				39 01 00 00 00 00 02 00 B0
				39 01 00 00 00 00 0D D8 81 83 83 85 87 89 8a 8d 8d 8c 8f 8e
				39 01 00 00 00 00 02 00 C0
				39 01 00 00 00 00 0D D8 81 83 84 85 85 86 8a 8e 90 92 8d 92
				39 01 00 00 00 00 02 00 D0
				39 01 00 00 00 00 0D D8 00 00 01 02 03 05 08 0a 0d 0b 0b 0d
				39 01 00 00 00 00 02 00 E0
				39 01 00 00 00 00 04 D8 ff f7 fa
				39 01 00 00 00 00 02 00 C0
				39 01 00 00 00 00 02 D7 01
				39 01 00 00 00 00 02 00 00
				39 01 00 00 00 00 02 94 00
				39 01 00 00 00 00 03 51 ff 03
				39 01 00 00 00 00 02 53 24
				39 01 00 00 14 00 02 29 00];
		qcom,mdss-dsi-off-command = [39 01 00 00 14 00 02 28 00
				39 01 00 00 78 00 02 10 00

				39 01 00 00 00 00 02 00 00
				39 01 00 00 00 00 04 FF 87 16 01
				39 01 00 00 00 00 02 00 80
				39 01 00 00 00 00 03 FF 87 16
				39 01 00 00 00 00 02 00 00
				39 01 00 00 00 00 05 F7 5a a5 87 16
				];
		qcom,mdss-dsi-warm_gamma-command = [
				39 01 00 00 00 00 02 00 00
				39 01 00 00 00 00 02 94 FF
				];

		qcom,mdss-dsi-default_gamma-command = [
				39 01 00 00 00 00 02 00 00
				39 01 00 00 00 00 02 94 00
				];
		qcom,mdss-dsi-cold_gamma-command = [
				39 01 00 00 00 00 02 00 00
				39 01 00 00 00 00 02 94 C0
				];

		qcom,mdss-dsi-on-command-state = "dsi_lp_mode";
		qcom,mdss-dsi-off-command-state = "dsi_lp_mode";
		qcom,mdss-dsi-cold_gamma-command-state = "dsi_lp_mode";
		qcom,mdss-dsi-warm_gamma-command-state = "dsi_lp_mode";
		qcom,mdss-dsi-default_gamma-command-state = "dsi_lp_mode";
		qcom,mdss-dsi-h-sync-pulse = <1>;
		qcom,mdss-dsi-traffic-mode = "burst_mode";
		qcom,mdss-dsi-bllp-eof-power-mode;
		qcom,mdss-dsi-bllp-power-mode;
		qcom,mdss-dsi-lane-0-state;
		qcom,mdss-dsi-lane-1-state;
		qcom,mdss-dsi-lane-2-state;
		qcom,mdss-dsi-lane-3-state;
		qcom,mdss-dsi-panel-timings = [7d 25 1d 00 37 33
			22 27 1e 03 04 00];
		qcom,mdss-dsi-t-clk-post = <0x0d>;
		qcom,mdss-dsi-t-clk-pre = <0x2F>;
		qcom,mdss-dsi-bl-min-level = <1>;
		qcom,mdss-dsi-bl-max-level = <4095>;
		qcom,mdss-brightness-max-level = <4095>;
		qcom,mdss-dsi-dma-trigger = "trigger_sw";
		qcom,mdss-dsi-mdp-trigger = "none";
		qcom,mdss-dsi-bl-pmic-control-type = "bl_ctrl_wled";
		qcom,mdss-dsi-reset-sequence = <1 10>, <0 10>, <1 10>;
		qcom,mdss-dsi-panel-status-command = [06 01 00 01 05 00 01 0A];
		qcom,mdss-dsi-panel-status-command-mode = "dsi_lp_mode";
		qcom,mdss-dsi-panel-status-check-mode = "TE_check_NT35596";
		qcom,mdss-dsi-panel-status-read-length = <1>;
		qcom,mdss-dsi-panel-status-value = <0x9C>;
		qcom,mdss-dsi-panel-max-error-count = <3>;
		qcom,mdss-pan-physical-width-dimension = <69>;
		qcom,mdss-pan-physical-height-dimension = <122>;
	};
};
