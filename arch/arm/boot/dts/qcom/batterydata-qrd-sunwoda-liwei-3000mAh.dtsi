
qcom,2881955_huaqin_d2sunwoda_3000mah_averaged_masterslave_apr18th2017 {
	qcom,max-voltage-uv = <4380000>;
	qcom,nom-batt-capacity-mah = <3000>;
	qcom,batt-id-kohm = <77>;
	qcom,battery-beta = <3380>;
	qcom,battery-type = "batterydata-qrd-sunwoda-liwei";
	qcom,chg-rslow-comp-c1 = <3772651>;
	qcom,chg-rslow-comp-c2 = <6125204>;
	qcom,chg-rs-to-rslow = <1306828>;
	qcom,chg-rslow-comp-thr = <0xB1>;
	qcom,checksum = <0xA973>;
	qcom,gui-version = "PMI8950GUI - 2.0.0.16";
	qcom,fg-profile-data = [
			F6 83 B0 7D
			C4 81 42 7C
			53 83 3C 59
			2D 80 42 87
			1B 82 80 9A
			C5 BD 09 CB
			5B 0E 16 88
			29 7F D2 82
			3F 7D 4A 83
			E6 71 A0 74
			71 6D 5A 82
			24 99 3C BC
			B5 C8 5E 0E
			2C 0C 91 59
			14 70 B2 FD
			2E 24 7D 44
			FE 1A 00 00
			D9 47 CD 23
			FE 32 00 00
			00 00 00 00
			00 00 00 00
			9B 71 66 70
			86 7C CD 88
			22 77 09 70
			E0 74 77 71
			BB 74 79 68
			54 6E 0A AA
			20 D7 62 EB
			64 A0 71 0C
			28 00 FF 36
			F0 11 30 03
			00 00 00 0C
	];
};
