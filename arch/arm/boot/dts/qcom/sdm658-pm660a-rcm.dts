/* Copyright (c) 2016, The Linux Foundation. All rights reserved.
 *
 * This program is free software; you can redistribute it and/or modify
 * it under the terms of the GNU General Public License version 2 and
 * only version 2 as published by the Free Software Foundation.
 *
 * This program is distributed in the hope that it will be useful,
 * but WITHOUT ANY WARRANTY; without even the implied warranty of
 * MERCHANTABILITY or FITNESS FOR A PARTICULAR PURPOSE.  See the
 * GNU General Public License for more details.
 */


/dts-v1/;

#include "sdm658.dtsi"
#include "sdm660-cdp.dtsi"
#include "msm-pm660a.dtsi"

/ {
	model = "Qualcomm Technologies, Inc. SDM 658 PM660 + PM660A RCM";
	compatible = "qcom,sdm658-cdp", "qcom,sdm658", "qcom,cdp";
	qcom,board-id = <21 0>;
	qcom,pmic-id = <0x0001001b 0x0001011a 0x0 0x0>;
};
