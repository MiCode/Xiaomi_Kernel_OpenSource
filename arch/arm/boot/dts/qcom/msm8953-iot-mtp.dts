/*
 * Copyright (c) 2016, The Linux Foundation. All rights reserved.
 *
 * This program is free software; you can redistribute it and/or modify
 * it under the terms of the GNU General Public License version 2 and
 * only version 2 as published by the Free Software Foundation.
 *
 * This program is distributed in the hope that it will be useful,
 * but WITHOUT ANY WARRANTY; without even the implied warranty of
 * MERCHANTABILITY or FITNESS FOR A PARTICULAR PURPOSE.  See the
 * GNU General Public License for more details.
 */

/dts-v1/;

#include "msm8953.dtsi"
#include "msm8953-mtp.dtsi"

/ {
	model = "Qualcomm Technologies, Inc. MSM8953 IOT MTP";
	compatible = "qcom,msm8953-mtp", "qcom,msm8953", "qcom,mtp";
	qcom,board-id= <8 2>;
};

&rpm_bus {
	rpm-regulator-ldoa18 {
		compatible = "qcom,rpm-smd-regulator-resource";
		qcom,resource-name = "ldoa";
		qcom,resource-id = <18>;
		qcom,regulator-type = <0>;
		qcom,hpm-min-load = <10000>;

		pm8953_l18: regulator-l18 {
			compatible = "qcom,rpm-smd-regulator";
			regulator-name = "pm8953_l18";
			qcom,set = <3>;
			regulator-min-microvolt = <2700000>;
			regulator-max-microvolt = <3300000>;
			qcom,init-voltage = <2700000>;
		};
	};
};
