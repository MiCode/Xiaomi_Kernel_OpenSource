/* Copyright (c) 2017, The Linux Foundation. All rights reserved.
 * Copyright (C) 2018 XiaoMi, Inc.
 *
 * This program is free software; you can redistribute it and/or modify
 * it under the terms of the GNU General Public License version 2 and
 * only version 2 as published by the Free Software Foundation.
 *
 * This program is distributed in the hope that it will be useful,
 * but WITHOUT ANY WARRANTY; without even the implied warranty of
 * MERCHANTABILITY or FITNESS FOR A PARTICULAR PURPOSE.  See the
 * GNU General Public License for more details.
 */

&mdss_mdp {
	dsi_nt36672_huaxing_fhd_video: qcom,mdss_dsi_nt36672_huaxing_fhd_video {
		qcom,mdss-dsi-panel-name = "huaxing nt36672 fhd video mode dsi panel";
		qcom,mdss-dsi-panel-controller = <&mdss_dsi0>;
		qcom,mdss-dsi-panel-type = "dsi_video_mode";
		qcom,mdss-dsi-panel-framerate = <60>;
		qcom,mdss-dsi-virtual-channel-id = <0>;
		qcom,mdss-dsi-stream = <0>;
		qcom,mdss-dsi-panel-width = <1080>;
		qcom,mdss-dsi-panel-height = <2160>;
		qcom,mdss-pan-physical-width-dimension = <68>;
		qcom,mdss-pan-physical-height-dimension = <136>;
		qcom,mdss-dsi-h-front-porch = <96>;
		qcom,mdss-dsi-h-back-porch = <56>;
		qcom,mdss-dsi-h-pulse-width = <4>;
		qcom,mdss-dsi-h-sync-skew = <0>;
		qcom,mdss-dsi-v-back-porch = <33>;
		qcom,mdss-dsi-v-front-porch = <4>;
		qcom,mdss-dsi-v-pulse-width = <2>;
		qcom,mdss-dsi-h-left-border = <0>;
		qcom,mdss-dsi-h-right-border = <0>;
		qcom,mdss-dsi-v-top-border = <0>;
		qcom,mdss-dsi-v-bottom-border = <0>;
		qcom,mdss-dsi-bpp = <24>;
		qcom,mdss-dsi-underflow-color = <0xff>;
		qcom,mdss-dsi-border-color = <0>;
		qcom,mdss-dsi-h-sync-pulse = <0>;
		qcom,mdss-dsi-traffic-mode = "burst_mode";
		qcom,mdss-dsi-bllp-eof-power-mode;
		qcom,mdss-dsi-bllp-power-mode;
		qcom,mdss-dsi-lane-0-state;
		qcom,mdss-dsi-lane-1-state;
		qcom,mdss-dsi-lane-2-state;
		qcom,mdss-dsi-lane-3-state;
		qcom,mdss-dsi-panel-timings = [e6 38 26 00 68 6e 2a
				3c 44 03 04 00];
		qcom,mdss-dsi-t-clk-post = <0x0d>;
		qcom,mdss-dsi-t-clk-pre = <0x32>;
		qcom,mdss-dsi-bl-min-level = <1>;
		qcom,mdss-dsi-bl-max-level = <4095>;
		qcom,mdss-brightness-max-level = <4095>;
		qcom,mdss-dsi-dma-trigger = "trigger_sw";
		qcom,mdss-dsi-mdp-trigger = "none";
        qcom,mdss-dsi-on-command = [
            15 01 00 00 00 00 02 ff 20
            15 01 00 00 00 00 02 fb 01
            15 01 00 00 00 00 02 30 10
            15 01 00 00 00 00 02 31 50
            15 01 00 00 00 00 02 32 2f
            15 01 00 00 00 00 02 ff 10
            05 01 00 00 46 00 02 11 00
            15 01 00 00 00 00 02 51 ff
            39 01 00 00 00 00 03 68 03 04
            15 01 00 00 00 00 02 53 2c
            15 01 00 00 00 00 02 55 00
            05 01 00 00 05 00 02 29 00
        ];
        qcom,mdss-dsi-off-command = [
            05 01 00 00 14 00 02 28 00
            05 01 00 00 78 00 02 10 00
        ];
		qcom,mdss-dsi-ce-on-command = [
            15 01 00 00 00 00 02 FF 22
            15 00 00 00 00 00 02 FB 01
            15 00 00 00 00 00 02 00 54
            15 00 00 00 00 00 02 01 54
            15 00 00 00 00 00 02 02 54
            15 00 00 00 00 00 02 03 54
            15 00 00 00 00 00 02 04 54
            15 00 00 00 00 00 02 05 54
            15 00 00 00 00 00 02 06 54
            15 00 00 00 00 00 02 07 54
            15 00 00 00 00 00 02 08 54
            15 00 00 00 00 00 02 09 54
            15 00 00 00 00 00 02 0A 54
            15 00 00 00 00 00 02 0B 54
            15 00 00 00 00 00 02 0C 54
            15 00 00 00 00 00 02 0D 54
            15 00 00 00 00 00 02 0E 54
            15 01 00 00 00 00 02 0F 54
            15 00 00 00 00 00 02 10 54
            15 00 00 00 00 00 02 11 50
            15 00 00 00 00 00 02 12 60
            15 00 00 00 00 00 02 13 70
            15 00 00 00 00 00 02 14 58
            15 00 00 00 00 00 02 15 68
            15 00 00 00 00 00 02 16 78
            15 00 00 00 00 00 02 17 00
            15 00 00 00 00 00 02 18 40
            15 00 00 00 00 00 02 19 40
            15 00 00 00 00 00 02 1A 40
            15 00 00 00 00 00 02 1B 40
            15 00 00 00 00 00 02 1C 40
            15 00 00 00 00 00 02 1D 40
            15 01 00 00 00 00 02 1E 40
            15 00 00 00 00 00 02 1F 40
            15 00 00 00 00 00 02 20 40
            15 00 00 00 00 00 02 21 3D
            15 00 00 00 00 00 02 22 39
            15 00 00 00 00 00 02 23 36
            15 00 00 00 00 00 02 24 32
            15 00 00 00 00 00 02 25 32
            15 00 00 00 00 00 02 26 31
            15 00 00 00 00 00 02 27 2F
            15 00 00 00 00 00 02 28 2D
            15 00 00 00 00 00 02 2D 00
            15 00 00 00 00 00 02 2F 40
            15 00 00 00 00 00 02 30 40
            15 01 00 00 00 00 02 31 40
            15 00 00 00 00 00 02 32 40
            15 00 00 00 00 00 02 33 40
            15 00 00 00 00 00 02 34 40
            15 00 00 00 00 00 02 35 40
            15 00 00 00 00 00 02 36 40
            15 00 00 00 00 00 02 37 40
            15 00 00 00 00 00 02 38 3E
            15 00 00 00 00 00 02 39 3B
            15 00 00 00 00 00 02 3A 39
            15 00 00 00 00 00 02 3B 36
            15 00 00 00 00 00 02 3D 36
            15 00 00 00 00 00 02 3F 36
            15 01 00 00 00 00 02 40 36
            15 00 00 00 00 00 02 41 36
            15 00 00 00 00 00 02 42 40
            15 00 00 00 00 00 02 43 40
            15 00 00 00 00 00 02 44 40
            15 00 00 00 00 00 02 45 40
            15 00 00 00 00 00 02 46 40
            15 00 00 00 00 00 02 47 46
            15 00 00 00 00 00 02 48 4C
            15 00 00 00 00 00 02 49 50
            15 00 00 00 00 00 02 4A 52
            15 00 00 00 00 00 02 4B 52
            15 00 00 00 00 00 02 4C 50
            15 00 00 00 00 00 02 4D 4E
            15 00 00 00 00 00 02 4E 4A
            15 00 00 00 00 00 02 4F 46
            15 01 00 00 00 00 02 50 42
            15 00 00 00 00 00 02 51 41
            15 00 00 00 00 00 02 52 40
            15 00 00 00 00 00 02 53 01
            15 00 00 00 00 00 02 54 01
            15 00 00 00 00 00 02 55 89
            15 00 00 00 00 00 02 56 7F
            15 00 00 00 00 00 02 58 40
            15 00 00 00 00 00 02 59 40
            15 00 00 00 00 00 02 5A C2
            15 00 00 00 00 00 02 5B 44
            15 00 00 00 00 00 02 5C 43
            15 00 00 00 00 00 02 5D 43
            15 00 00 00 00 00 02 5E 42
            15 00 00 00 00 00 02 5F 44
            15 01 00 00 00 00 02 60 44
            15 00 00 00 00 00 02 61 44
            15 00 00 00 00 00 02 62 42
            15 00 00 00 00 00 02 63 42
            15 00 00 00 00 00 02 64 41
            15 00 00 00 00 00 02 65 40
            15 00 00 00 00 00 02 66 3F
            15 00 00 00 00 00 02 67 BD
            15 00 00 00 00 00 02 68 BC
            15 00 00 00 00 00 02 69 BD
            15 00 00 00 00 00 02 6A 3F
            15 00 00 00 00 00 02 6B 40
            15 00 00 00 00 00 02 6C 40
            15 00 00 00 00 00 02 6D 3F
            15 00 00 00 00 00 02 6E 3E
            15 01 00 00 00 00 02 6F BC
            15 00 00 00 00 00 02 70 8C
            15 00 00 00 00 00 02 71 0E
            15 00 00 00 00 00 02 72 00
            15 00 00 00 00 00 02 73 16
            15 00 00 00 00 00 02 74 06
            15 00 00 00 00 00 02 75 0C
            15 00 00 00 00 00 02 76 03
            15 00 00 00 00 00 02 77 09
            15 00 00 00 00 00 02 78 0F
            15 00 00 00 00 00 02 79 68
            15 00 00 00 00 00 02 7A 88
            15 00 00 00 00 00 02 83 01
            15 01 00 00 00 00 02 84 68
            15 00 00 00 00 00 02 85 40
            15 00 00 00 00 00 02 86 40
            15 00 00 00 00 00 02 87 40
            15 00 00 00 00 00 02 88 40
            15 00 00 00 00 00 02 89 CF
            15 00 00 00 00 00 02 8A 40
            15 00 00 00 00 00 02 8B 40
            15 00 00 00 00 00 02 8C 40
            15 00 00 00 00 00 02 8D 40
            15 00 00 00 00 00 02 8E 40
            15 01 00 00 00 00 02 8F 40
            15 00 00 00 00 00 02 90 40
            15 00 00 00 00 00 02 91 40
            15 00 00 00 00 00 02 92 40
            15 00 00 00 00 00 02 93 40
            15 00 00 00 00 00 02 94 40
            15 00 00 00 00 00 02 95 40
            15 00 00 00 00 00 02 96 40
            15 00 00 00 00 00 02 97 40
            15 00 00 00 00 00 02 98 40
            15 00 00 00 00 00 02 99 40
            15 00 00 00 00 00 02 9A 40
            15 00 00 00 00 00 02 9B 40
            15 00 00 00 00 00 02 9C 40
            15 00 00 00 00 00 02 9D 40
            15 01 00 00 00 00 02 9E 40
            15 00 00 00 00 00 02 9F 40
            15 00 00 00 00 00 02 A0 40
            15 00 00 00 00 00 02 A2 20
            15 00 00 00 00 00 02 B3 00
            15 00 00 00 00 00 02 B7 00
            15 00 00 00 00 00 02 B8 00

            15 01 00 00 00 00 02 FF 10
            15 01 00 00 00 00 02 55 80
		];
		qcom,mdss-dsi-ce-off-command = [
            15 01 00 00 00 00 02 FF 22
            15 00 00 00 00 00 02 FB 01
            15 00 00 00 00 00 02 00 54
            15 00 00 00 00 00 02 01 54
            15 00 00 00 00 00 02 02 54
            15 00 00 00 00 00 02 03 54
            15 00 00 00 00 00 02 04 54
            15 00 00 00 00 00 02 05 54
            15 00 00 00 00 00 02 06 54
            15 00 00 00 00 00 02 07 54
            15 00 00 00 00 00 02 08 54
            15 00 00 00 00 00 02 09 54
            15 00 00 00 00 00 02 0A 54
            15 00 00 00 00 00 02 0B 54
            15 00 00 00 00 00 02 0C 54
            15 00 00 00 00 00 02 0D 54
            15 00 00 00 00 00 02 0E 54
            15 01 00 00 00 00 02 0F 54
            15 00 00 00 00 00 02 10 54
            15 00 00 00 00 00 02 11 50
            15 00 00 00 00 00 02 12 60
            15 00 00 00 00 00 02 13 70
            15 00 00 00 00 00 02 14 58
            15 00 00 00 00 00 02 15 68
            15 00 00 00 00 00 02 16 78
            15 00 00 00 00 00 02 17 00
            15 00 00 00 00 00 02 18 40
            15 00 00 00 00 00 02 19 40
            15 00 00 00 00 00 02 1A 40
            15 00 00 00 00 00 02 1B 40
            15 00 00 00 00 00 02 1C 40
            15 00 00 00 00 00 02 1D 40
            15 01 00 00 00 00 02 1E 40
            15 00 00 00 00 00 02 1F 40
            15 00 00 00 00 00 02 20 40
            15 00 00 00 00 00 02 21 3D
            15 00 00 00 00 00 02 22 39
            15 00 00 00 00 00 02 23 36
            15 00 00 00 00 00 02 24 32
            15 00 00 00 00 00 02 25 32
            15 00 00 00 00 00 02 26 31
            15 00 00 00 00 00 02 27 2F
            15 00 00 00 00 00 02 28 2D
            15 00 00 00 00 00 02 2D 00
            15 00 00 00 00 00 02 2F 40
            15 00 00 00 00 00 02 30 40
            15 01 00 00 00 00 02 31 40
            15 00 00 00 00 00 02 32 40
            15 00 00 00 00 00 02 33 40
            15 00 00 00 00 00 02 34 40
            15 00 00 00 00 00 02 35 40
            15 00 00 00 00 00 02 36 40
            15 00 00 00 00 00 02 37 40
            15 00 00 00 00 00 02 38 3E
            15 00 00 00 00 00 02 39 3B
            15 00 00 00 00 00 02 3A 39
            15 00 00 00 00 00 02 3B 36
            15 00 00 00 00 00 02 3D 36
            15 00 00 00 00 00 02 3F 36
            15 01 00 00 00 00 02 40 36
            15 00 00 00 00 00 02 41 36
            15 00 00 00 00 00 02 42 40
            15 00 00 00 00 00 02 43 40
            15 00 00 00 00 00 02 44 40
            15 00 00 00 00 00 02 45 40
            15 00 00 00 00 00 02 46 40
            15 00 00 00 00 00 02 47 46
            15 00 00 00 00 00 02 48 4C
            15 00 00 00 00 00 02 49 50
            15 00 00 00 00 00 02 4A 52
            15 00 00 00 00 00 02 4B 52
            15 00 00 00 00 00 02 4C 50
            15 00 00 00 00 00 02 4D 4E
            15 00 00 00 00 00 02 4E 4A
            15 00 00 00 00 00 02 4F 46
            15 01 00 00 00 00 02 50 42
            15 00 00 00 00 00 02 51 41
            15 00 00 00 00 00 02 52 40
            15 00 00 00 00 00 02 53 01
            15 00 00 00 00 00 02 54 01
            15 00 00 00 00 00 02 55 89
            15 00 00 00 00 00 02 56 7F
            15 00 00 00 00 00 02 58 40
            15 00 00 00 00 00 02 59 40
            15 00 00 00 00 00 02 5A C2
            15 00 00 00 00 00 02 5B 44
            15 00 00 00 00 00 02 5C 43
            15 00 00 00 00 00 02 5D 43
            15 00 00 00 00 00 02 5E 42
            15 00 00 00 00 00 02 5F 44
            15 01 00 00 00 00 02 60 44
            15 00 00 00 00 00 02 61 44
            15 00 00 00 00 00 02 62 42
            15 00 00 00 00 00 02 63 42
            15 00 00 00 00 00 02 64 41
            15 00 00 00 00 00 02 65 40
            15 00 00 00 00 00 02 66 3F
            15 00 00 00 00 00 02 67 BD
            15 00 00 00 00 00 02 68 BC
            15 00 00 00 00 00 02 69 BD
            15 00 00 00 00 00 02 6A 3F
            15 00 00 00 00 00 02 6B 40
            15 00 00 00 00 00 02 6C 40
            15 00 00 00 00 00 02 6D 3F
            15 00 00 00 00 00 02 6E 3E
            15 01 00 00 00 00 02 6F BC
            15 00 00 00 00 00 02 70 8C
            15 00 00 00 00 00 02 71 0E
            15 00 00 00 00 00 02 72 00
            15 00 00 00 00 00 02 73 16
            15 00 00 00 00 00 02 74 06
            15 00 00 00 00 00 02 75 0C
            15 00 00 00 00 00 02 76 03
            15 00 00 00 00 00 02 77 09
            15 00 00 00 00 00 02 78 0F
            15 00 00 00 00 00 02 79 68
            15 00 00 00 00 00 02 7A 88
            15 00 00 00 00 00 02 83 01
            15 01 00 00 00 00 02 84 68
            15 00 00 00 00 00 02 85 40
            15 00 00 00 00 00 02 86 40
            15 00 00 00 00 00 02 87 40
            15 00 00 00 00 00 02 88 40
            15 00 00 00 00 00 02 89 CF
            15 00 00 00 00 00 02 8A 40
            15 00 00 00 00 00 02 8B 40
            15 00 00 00 00 00 02 8C 40
            15 00 00 00 00 00 02 8D 40
            15 00 00 00 00 00 02 8E 40
            15 01 00 00 00 00 02 8F 40
            15 00 00 00 00 00 02 90 40
            15 00 00 00 00 00 02 91 40
            15 00 00 00 00 00 02 92 40
            15 00 00 00 00 00 02 93 40
            15 00 00 00 00 00 02 94 40
            15 00 00 00 00 00 02 95 40
            15 00 00 00 00 00 02 96 40
            15 00 00 00 00 00 02 97 40
            15 00 00 00 00 00 02 98 40
            15 00 00 00 00 00 02 99 40
            15 00 00 00 00 00 02 9A 40
            15 00 00 00 00 00 02 9B 40
            15 00 00 00 00 00 02 9C 40
            15 00 00 00 00 00 02 9D 40
            15 01 00 00 00 00 02 9E 40
            15 00 00 00 00 00 02 9F 40
            15 00 00 00 00 00 02 A0 40
            15 00 00 00 00 00 02 A2 20
            15 00 00 00 00 00 02 B3 00
            15 00 00 00 00 00 02 B7 00
            15 00 00 00 00 00 02 B8 00

            15 01 00 00 00 00 02 FF 10
            15 01 00 00 00 00 02 55 00
		];
		qcom,mdss-dsi-srgb-on-command = [
			15 01 00 00 00 00 02 FF 22
			15 00 00 00 00 00 02 FB 01

			15 00 00 00 00 00 02 17 00
			15 00 00 00 00 00 02 2D 00
			15 00 00 00 00 00 02 53 01
			15 00 00 00 00 00 02 54 00
			15 00 00 00 00 00 02 55 88
			15 00 00 00 00 00 02 56 77
			15 00 00 00 00 00 02 58 34
			15 00 00 00 00 00 02 59 32
			15 00 00 00 00 00 02 5A 30
			15 00 00 00 00 00 02 5B 2F
			15 00 00 00 00 00 02 5C 2D
			15 00 00 00 00 00 02 5D 2C
			15 00 00 00 00 00 02 5E 2A
			15 00 00 00 00 00 02 5F 27
			15 00 00 00 00 00 02 60 2A
			15 00 00 00 00 00 02 61 28
			15 00 00 00 00 00 02 62 2C
			15 00 00 00 00 00 02 63 2F
			15 00 00 00 00 00 02 64 31
			15 00 00 00 00 00 02 65 33
			15 00 00 00 00 00 02 66 35
			15 00 00 00 00 00 02 67 37
			15 00 00 00 00 00 02 68 39
			15 00 00 00 00 00 02 69 37
			15 00 00 00 00 00 02 6A 34
			15 00 00 00 00 00 02 6B 32
			15 00 00 00 00 00 02 6C 32
			15 00 00 00 00 00 02 6D 32
			15 00 00 00 00 00 02 6E 32
			15 00 00 00 00 00 02 6F 32
			15 00 00 00 00 00 02 70 00
			15 00 00 00 00 00 02 71 00
			15 00 00 00 00 00 02 72 00
			15 01 00 00 00 00 02 73 07
			15 00 00 00 00 00 02 83 01
			15 00 00 00 00 00 02 84 29
			15 00 00 00 00 00 02 85 50
			15 00 00 00 00 00 02 86 1C
			15 00 00 00 00 00 02 87 40
			15 00 00 00 00 00 02 A2 20
			15 00 00 00 00 00 02 B3 00
			15 00 00 00 00 00 02 B7 00
			15 00 00 00 00 00 02 B8 00

			15 01 00 00 00 00 02 FF 10
			15 01 00 00 00 00 02 55 80
 		];
		qcom,mdss-dsi-srgb-off-command = [
            15 01 00 00 00 00 02 FF 10
			15 01 00 00 00 00 02 55 00
		];
		qcom,mdss-dsi-cabc-on-command = [
            15 01 00 00 00 00 02 FF 23
            15 00 00 00 00 00 02 FB 01
            15 00 00 00 00 00 02 07 20
            15 00 00 00 00 00 02 08 05
            15 00 00 00 00 00 02 09 00
            15 00 00 00 00 00 02 10 20
            15 00 00 00 00 00 02 11 01
            15 00 00 00 00 00 02 12 A4
            15 00 00 00 00 00 02 15 E6
            15 00 00 00 00 00 02 16 0C
            15 00 00 00 00 00 02 30 FF
            15 00 00 00 00 00 02 31 FF
            15 00 00 00 00 00 02 32 FF
            15 00 00 00 00 00 02 33 FF
            15 00 00 00 00 00 02 34 FF
            15 00 00 00 00 00 02 35 FF
            15 00 00 00 00 00 02 36 FF
            15 00 00 00 00 00 02 37 FF
            15 00 00 00 00 00 02 38 FF
            15 00 00 00 00 00 02 39 FF
            15 00 00 00 00 00 02 3A FF
            15 00 00 00 00 00 02 3B FA
            15 00 00 00 00 00 02 3D F5
            15 00 00 00 00 00 02 3F EA
            15 01 00 00 00 00 02 40 DA
            15 01 00 00 00 00 02 41 98

            15 01 00 00 00 00 02 FF 10
            15 01 00 00 00 00 02 55 81
		];
		qcom,mdss-dsi-cabc-off-command = [
			15 01 00 00 00 00 02 55 00
		];
		qcom,mdss-dsi-gamma0-command = [
            15 00 00 00 00 00 02 FF 20
            15 00 00 00 00 00 02 FB 01

            39 00 00 00 00 00 11 B0 00 00 00 11 00 30 00 4A 00 62 00 77 00 8B 00 9D
            39 00 00 00 00 00 11 B1 00 AD 00 E4 01 10 01 52 01 85 01 D2 02 10 02 12
            39 00 00 00 00 00 11 B2 02 4D 02 91 02 BD 02 F4 03 18 03 46 03 54 03 62
            39 00 00 00 00 00 0D B3 03 73 03 84 03 99 03 C1 03 D5 03 D9

            39 00 00 00 00 00 11 B4 00 00 00 11 00 30 00 4A 00 62 00 77 00 8B 00 9D
            39 00 00 00 00 00 11 B5 00 AD 00 E4 01 10 01 52 01 85 01 D2 02 10 02 12
            39 00 00 00 00 00 11 B6 02 4D 02 91 02 BD 02 F4 03 18 03 46 03 54 03 62
            39 00 00 00 00 00 0D B7 03 73 03 84 03 99 03 C1 03 D5 03 D9

            39 00 00 00 00 00 11 B8 00 00 00 11 00 30 00 4A 00 62 00 77 00 8B 00 9D
            39 00 00 00 00 00 11 B9 00 AD 00 E4 01 10 01 52 01 85 01 D2 02 10 02 12
            39 00 00 00 00 00 11 BA 02 4D 02 91 02 BD 02 F4 03 18 03 46 03 54 03 62
            39 01 00 00 00 00 0D BB 03 73 03 84 03 99 03 C1 03 D5 03 D9

            15 00 00 00 00 00 02 FF 21
            15 00 00 00 00 00 02 FB 01

            39 00 00 00 00 00 11 B0 00 00 00 11 00 30 00 4A 00 62 00 77 00 8B 00 9D
            39 00 00 00 00 00 11 B1 00 AD 00 E4 01 10 01 52 01 85 01 D2 02 10 02 12
            39 00 00 00 00 00 11 B2 02 4D 02 91 02 BD 02 F4 03 18 03 46 03 54 03 62
            39 00 00 00 00 00 0D B3 03 73 03 84 03 99 03 C1 03 D5 03 D9

            39 00 00 00 00 00 11 B4 00 00 00 11 00 30 00 4A 00 62 00 77 00 8B 00 9D
            39 00 00 00 00 00 11 B5 00 AD 00 E4 01 10 01 52 01 85 01 D2 02 10 02 12
            39 00 00 00 00 00 11 B6 02 4D 02 91 02 BD 02 F4 03 18 03 46 03 54 03 62
            39 00 00 00 00 00 0D B7 03 73 03 84 03 99 03 C1 03 D5 03 D9

            39 00 00 00 00 00 11 B8 00 00 00 11 00 30 00 4A 00 62 00 77 00 8B 00 9D
            39 00 00 00 00 00 11 B9 00 AD 00 E4 01 10 01 52 01 85 01 D2 02 10 02 12
            39 00 00 00 00 00 11 BA 02 4D 02 91 02 BD 02 F4 03 18 03 46 03 54 03 62
            39 00 00 00 00 00 0D BB 03 73 03 84 03 99 03 C1 03 D5 03 D9

            15 01 00 00 00 00 02 FF 10
		];
		qcom,mdss-dsi-gamma1-command = [
			15 00 00 00 00 00 02 FF 20
			15 00 00 00 00 00 02 FB 01

			39 00 00 00 00 00 11 B0 00 C0 00 C6 00 D3 00 DE 00 E9 00 F3 00 FD 01 07
			39 00 00 00 00 00 11 B1 01 10 01 30 01 4D 01 7D 01 A5 01 E5 02 1B 02 1D
			39 00 00 00 00 00 11 B2 02 56 02 99 02 C5 02 FA 03 1E 03 4C 03 58 03 66
			39 00 00 00 00 00 0D B3 03 75 03 87 03 9C 03 B6 03 D2 03 D7

			39 00 00 00 00 00 11 B4 00 09 00 19 00 35 00 4D 00 64 00 78 00 8A 00 9B
			39 00 00 00 00 00 11 B5 00 AA 00 DF 01 0B 01 4B 01 7D 01 CB 02 06 02 08
			39 00 00 00 00 00 11 B6 02 45 02 8A 02 B7 02 EF 03 10 03 42 03 4F 03 5E
			39 00 00 00 00 00 0D B7 03 6E 03 81 03 97 03 B2 03 D1 03 D7

			39 00 00 00 00 00 11 B8 00 DF 00 E4 00 EF 00 F9 01 03 01 0C 01 15 01 1D
			39 00 00 00 00 00 11 B9 01 25 01 42 01 5D 01 88 01 AD 01 EA 02 1E 02 20
			39 00 00 00 00 00 11 BA 02 59 02 9C 02 C9 03 00 03 2B 03 66 03 7A 03 89
			39 01 00 00 00 00 0D BB 03 8B 03 8F 03 A4 03 BC 03 D2 03 D7

			15 00 00 00 00 00 02 FF 21
			15 00 00 00 00 00 02 FB 01

			39 00 00 00 00 00 11 B0 00 C0 00 C6 00 D3 00 DE 00 E9 00 F3 00 FD 01 07
			39 00 00 00 00 00 11 B1 01 10 01 30 01 4D 01 7D 01 A5 01 E5 02 1B 02 1D
			39 00 00 00 00 00 11 B2 02 56 02 99 02 C5 02 FA 03 1E 03 4C 03 58 03 66
			39 00 00 00 00 00 0D B3 03 75 03 87 03 9C 03 B6 03 D2 03 D7

			39 00 00 00 00 00 11 B4 00 09 00 19 00 35 00 4D 00 64 00 78 00 8A 00 9B
			39 00 00 00 00 00 11 B5 00 AA 00 DF 01 0B 01 4B 01 7D 01 CB 02 06 02 08
			39 00 00 00 00 00 11 B6 02 45 02 8A 02 B7 02 EF 03 10 03 42 03 4F 03 5E
			39 00 00 00 00 00 0D B7 03 6E 03 81 03 97 03 B2 03 D1 03 D7

			39 00 00 00 00 00 11 B8 00 DF 00 E4 00 EF 00 F9 01 03 01 0C 01 15 01 1D
			39 00 00 00 00 00 11 B9 01 25 01 42 01 5D 01 88 01 AD 01 EA 02 1E 02 20
			39 00 00 00 00 00 11 BA 02 59 02 9C 02 C9 03 00 03 2B 03 66 03 7A 03 89
			39 00 00 00 00 00 0D BB 03 8B 03 8F 03 A4 03 BC 03 D2 03 D7

			15 01 00 00 00 00 02 FF 10

		];
		qcom,mdss-dsi-gamma2-command = [
			15 00 00 00 00 00 02 FF 20
			15 00 00 00 00 00 02 FB 01

			39 00 00 00 00 00 11 B0 00 39 00 46 00 5D 00 72 00 86 00 97 00 A8 00 B7
			39 00 00 00 00 00 11 B1 00 C6 00 F8 01 20 01 5E 01 8E 01 D8 02 14 02 15
			39 00 00 00 00 00 11 B2 02 50 02 93 02 BF 02 F5 03 16 03 46 03 54 03 62
			39 00 00 00 00 00 0D B3 03 72 03 84 03 9A 03 B4 03 D1 03 D7

			39 00 00 00 00 00 11 B4 00 09 00 1A 00 35 00 50 00 66 00 7A 00 8B 00 9D
			39 00 00 00 00 00 11 B5 00 AF 00 E3 01 11 01 50 01 82 01 D1 02 0D 02 0E
			39 00 00 00 00 00 11 B6 02 4A 02 8D 02 BA 02 F1 03 11 03 44 03 51 03 5F
			39 00 00 00 00 00 0D B7 03 6F 03 82 03 98 03 B3 03 D1 03 D7

			39 00 00 00 00 00 11 B8 00 81 00 8B 00 9C 00 AE 00 BD 00 CB 00 D7 00 E4
			39 00 00 00 00 00 11 B9 00 F1 01 18 01 3C 01 70 01 9B 01 E1 02 19 02 1A
			39 00 00 00 00 00 11 BA 02 54 02 97 02 C4 02 FC 03 26 03 61 03 75 03 81
			39 01 00 00 00 00 0D BB 03 84 03 86 03 97 03 AB 03 CE 03 D7

			15 00 00 00 00 00 02 FF 21
			15 00 00 00 00 00 02 FB 01

			39 00 00 00 00 00 11 B0 00 39 00 46 00 5D 00 72 00 86 00 97 00 A8 00 B7
			39 00 00 00 00 00 11 B1 00 C6 00 F8 01 20 01 5E 01 8E 01 D8 02 14 02 15
			39 00 00 00 00 00 11 B2 02 50 02 93 02 BF 02 F5 03 16 03 46 03 54 03 62
			39 00 00 00 00 00 0D B3 03 72 03 84 03 9A 03 B4 03 D1 03 D7

			39 00 00 00 00 00 11 B4 00 09 00 1A 00 35 00 50 00 66 00 7A 00 8B 00 9D
			39 00 00 00 00 00 11 B5 00 AF 00 E3 01 11 01 50 01 82 01 D1 02 0D 02 0E
			39 00 00 00 00 00 11 B6 02 4A 02 8D 02 BA 02 F1 03 11 03 44 03 51 03 5F
			39 00 00 00 00 00 0D B7 03 6F 03 82 03 98 03 B3 03 D1 03 D7

			39 00 00 00 00 00 11 B8 00 81 00 8B 00 9C 00 AE 00 BD 00 CB 00 D7 00 E4
			39 00 00 00 00 00 11 B9 00 F1 01 18 01 3C 01 70 01 9B 01 E1 02 19 02 1A
			39 00 00 00 00 00 11 BA 02 54 02 97 02 C4 02 FC 03 26 03 61 03 75 03 81
			39 00 00 00 00 00 0D BB 03 84 03 86 03 97 03 AB 03 CE 03 D7

			15 01 00 00 00 00 02 FF 10
		];
		qcom,mdss-dsi-gamma3-command = [
			15 00 00 00 00 00 02 FF 20
			15 00 00 00 00 00 02 FB 01
			39 00 00 00 00 00 11 B0 00 0B 00 1C 00 38 00 50 00 66 00 79 00 8C 00 9D
			39 00 00 00 00 00 11 B1 00 AD 00 E3 01 0E 01 51 01 83 01 D0 02 0B 02 0E
			39 00 00 00 00 00 11 B2 02 49 02 8E 02 BB 02 F0 03 11 03 41 03 4D 03 61
			39 00 00 00 00 00 0D B3 03 71 03 84 03 9A 03 B5 03 D2 03 D7
			39 00 00 00 00 00 11 B4 00 75 00 7F 00 91 00 A1 00 B1 00 BF 00 CC 00 D9
			39 00 00 00 00 00 11 B5 00 E5 01 0E 01 30 01 68 01 94 01 DA 02 12 02 14
			39 00 00 00 00 00 11 B6 02 4E 02 92 02 BE 02 F3 03 15 03 46 03 53 03 62
			39 00 00 00 00 00 0D B7 03 72 03 84 03 9B 03 B7 03 D2 03 D7
			39 00 00 00 00 00 11 B8 00 0B 00 1B 00 39 00 54 00 6C 00 81 00 95 00 A6
			39 00 00 00 00 00 11 B9 00 B6 00 EC 01 16 01 57 01 88 01 D3 02 0D 02 10
			39 00 00 00 00 00 11 BA 02 4A 02 90 02 BD 02 F4 03 1B 03 53 03 66 03 86
			39 01 00 00 00 00 0D BB 03 9B 03 9D 03 9F 03 B8 03 D2 03 D7
			15 00 00 00 00 00 02 FF 21
			15 00 00 00 00 00 02 FB 01
			39 00 00 00 00 00 11 B0 00 0B 00 1C 00 38 00 50 00 66 00 79 00 8C 00 9D
			39 00 00 00 00 00 11 B1 00 AD 00 E3 01 0E 01 51 01 83 01 D0 02 0B 02 0E
			39 00 00 00 00 00 11 B2 02 49 02 8E 02 BB 02 F0 03 11 03 41 03 4D 03 61
			39 00 00 00 00 00 0D B3 03 71 03 84 03 9A 03 B5 03 D2 03 D7
			39 00 00 00 00 00 11 B4 00 75 00 7F 00 91 00 A1 00 B1 00 BF 00 CC 00 D9
			39 00 00 00 00 00 11 B5 00 E5 01 0E 01 30 01 68 01 94 01 DA 02 12 02 14
			39 00 00 00 00 00 11 B6 02 4E 02 92 02 BE 02 F3 03 15 03 46 03 53 03 62
			39 00 00 00 00 00 0D B7 03 72 03 84 03 9B 03 B7 03 D2 03 D7
			39 00 00 00 00 00 11 B8 00 0B 00 1B 00 39 00 54 00 6C 00 81 00 95 00 A6
			39 00 00 00 00 00 11 B9 00 B6 00 EC 01 16 01 57 01 88 01 D3 02 0D 02 10
			39 00 00 00 00 00 11 BA 02 4A 02 90 02 BD 02 F4 03 1B 03 53 03 66 03 86
			39 00 00 00 00 00 0D BB 03 9B 03 9D 03 9F 03 B8 03 D2 03 D7
			15 01 00 00 00 00 02 FF 10
		];
		qcom,mdss-dsi-gamma4-command = [
			15 00 00 00 00 00 02 FF 20
			15 00 00 00 00 00 02 FB 01
			39 00 00 00 00 00 11 B0 00 09 00 19 00 35 00 4E 00 65 00 79 00 8C 00 9D
			39 00 00 00 00 00 11 B1 00 AD 00 E5 01 11 01 56 01 88 01 D5 02 11 02 12
			39 00 00 00 00 00 11 B2 02 4F 02 93 02 BE 02 F5 03 17 03 42 03 4E 03 61
			39 00 00 00 00 00 0D B3 03 72 03 87 03 9E 03 BA 03 D3 03 D7
			39 00 00 00 00 00 11 B4 00 C6 00 CD 00 D9 00 E5 00 F0 00 FB 01 05 01 0E
			39 00 00 00 00 00 11 B5 01 17 01 38 01 54 01 84 01 AB 01 EA 02 20 02 21
			39 00 00 00 00 00 11 B6 02 5A 02 9C 02 C7 02 FD 03 21 03 4C 03 59 03 67
			39 00 00 00 00 00 0D B7 03 76 03 88 03 9E 03 B8 03 D2 03 D7
			39 00 00 00 00 00 11 B8 00 11 00 23 00 41 00 5B 00 73 00 88 00 9B 00 AC
			39 00 00 00 00 00 11 B9 00 BC 00 F3 01 1D 01 5F 01 8F 01 D9 02 14 02 15
			39 00 00 00 00 00 11 BA 02 51 02 95 02 C1 02 FA 03 23 03 59 03 6D 03 95
			39 01 00 00 00 00 0D BB 03 B8 03 BA 03 BC 03 BE 03 D2 03 D7
			15 00 00 00 00 00 02 FF 21
			15 00 00 00 00 00 02 FB 01
			39 00 00 00 00 00 11 B0 00 09 00 19 00 35 00 4E 00 65 00 79 00 8C 00 9D
			39 00 00 00 00 00 11 B1 00 AD 00 E5 01 11 01 56 01 88 01 D5 02 11 02 12
			39 00 00 00 00 00 11 B2 02 4F 02 93 02 BE 02 F5 03 17 03 42 03 4E 03 61
			39 00 00 00 00 00 0D B3 03 72 03 87 03 9E 03 BA 03 D3 03 D7
			39 00 00 00 00 00 11 B4 00 C6 00 CD 00 D9 00 E5 00 F0 00 FB 01 05 01 0E
			39 00 00 00 00 00 11 B5 01 17 01 38 01 54 01 84 01 AB 01 EA 02 20 02 21
			39 00 00 00 00 00 11 B6 02 5A 02 9C 02 C7 02 FD 03 21 03 4C 03 59 03 67
			39 00 00 00 00 00 0D B7 03 76 03 88 03 9E 03 B8 03 D2 03 D7
			39 00 00 00 00 00 11 B8 00 11 00 23 00 41 00 5B 00 73 00 88 00 9B 00 AC
			39 00 00 00 00 00 11 B9 00 BC 00 F3 01 1D 01 5F 01 8F 01 D9 02 14 02 15
			39 00 00 00 00 00 11 BA 02 51 02 95 02 C1 02 FA 03 23 03 59 03 6D 03 95
			39 00 00 00 00 00 0D BB 03 B8 03 BA 03 BC 03 BE 03 D2 03 D7
			15 01 00 00 00 00 02 FF 10
		];
		qcom,mdss-dsi-gamma5-command = [
			15 00 00 00 00 00 02 FF 20
			15 00 00 00 00 00 02 FB 01
			39 00 00 00 00 00 11 B0 00 0B 00 1C 00 39 00 53 00 6A 00 7E 00 91 00 A3
			39 00 00 00 00 00 11 B1 00 B2 00 E9 01 15 01 57 01 89 01 D6 02 14 02 15
			39 00 00 00 00 00 11 B2 02 51 02 94 02 C0 02 F5 03 15 03 43 03 53 03 62
			39 00 00 00 00 00 0D B3 03 73 03 88 03 9F 03 BB 03 D3 03 D7
			39 00 00 00 00 00 11 B4 00 CF 00 D5 00 E1 00 ED 00 F7 01 02 01 0B 01 15
			39 00 00 00 00 00 11 B5 01 1D 01 3D 01 59 01 88 01 AE 01 ED 02 23 02 25
			39 00 00 00 00 00 11 B6 02 5D 02 9F 02 CA 02 FE 03 22 03 4E 03 5A 03 68
			39 00 00 00 00 00 0D B7 03 77 03 88 03 9C 03 B6 03 D2 03 D7
			39 00 00 00 00 00 11 B8 00 E2 00 E8 00 F3 00 FE 01 08 01 11 01 1A 01 23
			39 00 00 00 00 00 11 B9 01 2B 01 49 01 64 01 90 01 B5 01 F2 02 28 02 29
			39 00 00 00 00 00 11 BA 02 61 02 A3 02 CF 03 04 03 2D 03 64 03 7C 03 8C
			39 01 00 00 00 00 0D BB 03 8E 03 94 03 A0 03 C2 03 D4 03 D7
			15 00 00 00 00 00 02 FF 21
			15 00 00 00 00 00 02 FB 01
			39 00 00 00 00 00 11 B0 00 0B 00 1C 00 39 00 53 00 6A 00 7E 00 91 00 A3
			39 00 00 00 00 00 11 B1 00 B2 00 E9 01 15 01 57 01 89 01 D6 02 14 02 15
			39 00 00 00 00 00 11 B2 02 51 02 94 02 C0 02 F5 03 15 03 43 03 53 03 62
			39 00 00 00 00 00 0D B3 03 73 03 88 03 9F 03 BB 03 D3 03 D7
			39 00 00 00 00 00 11 B4 00 CF 00 D5 00 E1 00 ED 00 F7 01 02 01 0B 01 15
			39 00 00 00 00 00 11 B5 01 1D 01 3D 01 59 01 88 01 AE 01 ED 02 23 02 25
			39 00 00 00 00 00 11 B6 02 5D 02 9F 02 CA 02 FE 03 22 03 4E 03 5A 03 68
			39 00 00 00 00 00 0D B7 03 77 03 88 03 9C 03 B6 03 D2 03 D7
			39 00 00 00 00 00 11 B8 00 E2 00 E8 00 F3 00 FE 01 08 01 11 01 1A 01 23
			39 00 00 00 00 00 11 B9 01 2B 01 49 01 64 01 90 01 B5 01 F2 02 28 02 29
			39 00 00 00 00 00 11 BA 02 61 02 A3 02 CF 03 04 03 2D 03 64 03 7C 03 8C
			39 00 00 00 00 00 0D BB 03 8E 03 94 03 A0 03 C2 03 D4 03 D7
			15 01 00 00 00 00 02 FF 10
		];
		qcom,mdss-dsi-gamma6-command = [
			15 00 00 00 00 00 02 FF 20
			15 00 00 00 00 00 02 FB 01
			39 00 00 00 00 00 11 B0 00 0B 00 1C 00 39 00 53 00 6A 00 7E 00 91 00 A3
			39 00 00 00 00 00 11 B1 00 B2 00 E9 01 15 01 57 01 89 01 D6 02 14 02 15
			39 00 00 00 00 00 11 B2 02 51 02 94 02 C0 02 F5 03 15 03 43 03 53 03 62
			39 00 00 00 00 00 0D B3 03 73 03 88 03 9F 03 BB 03 D3 03 D7
			39 00 00 00 00 00 11 B4 00 CF 00 D5 00 E1 00 ED 00 F7 01 02 01 0B 01 15
			39 00 00 00 00 00 11 B5 01 1D 01 3D 01 59 01 88 01 AE 01 ED 02 23 02 25
			39 00 00 00 00 00 11 B6 02 5D 02 9F 02 CA 02 FE 03 22 03 4E 03 5A 03 68
			39 00 00 00 00 00 0D B7 03 77 03 88 03 9C 03 B6 03 D2 03 D7
			39 00 00 00 00 00 11 B8 00 E2 00 E8 00 F3 00 FE 01 08 01 11 01 1A 01 23
			39 00 00 00 00 00 11 B9 01 2B 01 49 01 64 01 90 01 B5 01 F2 02 28 02 29
			39 00 00 00 00 00 11 BA 02 61 02 A3 02 CF 03 04 03 2D 03 64 03 7C 03 8C
			39 01 00 00 00 00 0D BB 03 8E 03 94 03 A0 03 C2 03 D4 03 D7
			15 00 00 00 00 00 02 FF 21
			15 00 00 00 00 00 02 FB 01
			39 00 00 00 00 00 11 B0 00 0B 00 1C 00 39 00 53 00 6A 00 7E 00 91 00 A3
			39 00 00 00 00 00 11 B1 00 B2 00 E9 01 15 01 57 01 89 01 D6 02 14 02 15
			39 00 00 00 00 00 11 B2 02 51 02 94 02 C0 02 F5 03 15 03 43 03 53 03 62
			39 00 00 00 00 00 0D B3 03 73 03 88 03 9F 03 BB 03 D3 03 D7
			39 00 00 00 00 00 11 B4 00 CF 00 D5 00 E1 00 ED 00 F7 01 02 01 0B 01 15
			39 00 00 00 00 00 11 B5 01 1D 01 3D 01 59 01 88 01 AE 01 ED 02 23 02 25
			39 00 00 00 00 00 11 B6 02 5D 02 9F 02 CA 02 FE 03 22 03 4E 03 5A 03 68
			39 00 00 00 00 00 0D B7 03 77 03 88 03 9C 03 B6 03 D2 03 D7
			39 00 00 00 00 00 11 B8 00 E2 00 E8 00 F3 00 FE 01 08 01 11 01 1A 01 23
			39 00 00 00 00 00 11 B9 01 2B 01 49 01 64 01 90 01 B5 01 F2 02 28 02 29
			39 00 00 00 00 00 11 BA 02 61 02 A3 02 CF 03 04 03 2D 03 64 03 7C 03 8C
			39 00 00 00 00 00 0D BB 03 8E 03 94 03 A0 03 C2 03 D4 03 D7
			15 01 00 00 00 00 02 FF 10
		];
		qcom,mdss-dsi-gamma7-command = [
			15 00 00 00 00 00 02 FF 20
			15 00 00 00 00 00 02 FB 01
			39 00 00 00 00 00 11 B0 00 91 00 99 00 A9 00 B7 00 C5 00 D2 00 DE 00 E9
			39 00 00 00 00 00 11 B1 00 F4 01 1A 01 3B 01 6F 01 9A 01 DE 02 16 02 18
			39 00 00 00 00 00 11 B2 02 51 02 95 02 C1 02 F7 03 1A 03 48 03 55 03 64
			39 00 00 00 00 00 0D B3 03 74 03 87 03 9D 03 B9 03 D3 03 D7
			39 00 00 00 00 00 11 B4 00 09 00 19 00 35 00 4E 00 65 00 79 00 8B 00 9B
			39 00 00 00 00 00 11 B5 00 AA 00 DF 01 09 01 4B 01 7E 01 CB 02 07 02 09
			39 00 00 00 00 00 11 B6 02 46 02 8A 02 B7 02 EE 03 11 03 42 03 4F 03 5E
			39 00 00 00 00 00 0D B7 03 6E 03 81 03 98 03 B4 03 D2 03 D7
			39 00 00 00 00 00 11 B8 00 09 00 1A 00 37 00 51 00 68 00 7D 00 90 00 A1
			39 00 00 00 00 00 11 B9 00 B1 00 E7 01 11 01 52 01 84 01 D0 02 0B 02 0D
			39 00 00 00 00 00 11 BA 02 49 02 8E 02 BB 02 F4 03 1B 03 53 03 66 03 7D
			39 01 00 00 00 00 0D BB 03 8F 03 97 03 9C 03 B7 03 D2 03 D7
			15 00 00 00 00 00 02 FF 21
			15 00 00 00 00 00 02 FB 01
			39 00 00 00 00 00 11 B0 00 91 00 99 00 A9 00 B7 00 C5 00 D2 00 DE 00 E9
			39 00 00 00 00 00 11 B1 00 F4 01 1A 01 3B 01 6F 01 9A 01 DE 02 16 02 18
			39 00 00 00 00 00 11 B2 02 51 02 95 02 C1 02 F7 03 1A 03 48 03 55 03 64
			39 00 00 00 00 00 0D B3 03 74 03 87 03 9D 03 B9 03 D3 03 D7
			39 00 00 00 00 00 11 B4 00 09 00 19 00 35 00 4E 00 65 00 79 00 8B 00 9B
			39 00 00 00 00 00 11 B5 00 AA 00 DF 01 09 01 4B 01 7E 01 CB 02 07 02 09
			39 00 00 00 00 00 11 B6 02 46 02 8A 02 B7 02 EE 03 11 03 42 03 4F 03 5E
			39 00 00 00 00 00 0D B7 03 6E 03 81 03 98 03 B4 03 D2 03 D7
			39 00 00 00 00 00 11 B8 00 09 00 1A 00 37 00 51 00 68 00 7D 00 90 00 A1
			39 00 00 00 00 00 11 B9 00 B1 00 E7 01 11 01 52 01 84 01 D0 02 0B 02 0D
			39 00 00 00 00 00 11 BA 02 49 02 8E 02 BB 02 F4 03 1B 03 53 03 66 03 7D
			39 00 00 00 00 00 0D BB 03 8F 03 97 03 9C 03 B7 03 D2 03 D7
			15 01 00 00 00 00 02 FF 10
		];
		qcom,mdss-dsi-gamma8-command = [
			15 00 00 00 00 00 02 FF 20
			15 00 00 00 00 00 02 FB 01
			39 00 00 00 00 00 11 B0 01 03 01 08 01 10 01 19 01 21 01 28 01 30 01 37
			39 00 00 00 00 00 11 B1 01 3E 01 58 01 6E 01 96 01 B9 01 F2 02 26 02 28
			39 00 00 00 00 00 11 B2 02 5E 02 A0 02 CB 02 FF 03 25 03 50 03 5D 03 6A
			39 00 00 00 00 00 0D B3 03 7A 03 8C 03 A2 03 BC 03 D3 03 D7
			39 00 00 00 00 00 11 B4 00 09 00 19 00 35 00 4B 00 61 00 74 00 87 00 97
			39 00 00 00 00 00 11 B5 00 A7 00 DD 01 07 01 4A 01 7D 01 CB 02 08 02 0A
			39 00 00 00 00 00 11 B6 02 45 02 8A 02 B7 02 ED 03 10 03 41 03 4F 03 5E
			39 00 00 00 00 00 0D B7 03 6E 03 81 03 98 03 B4 03 D2 03 D7
			39 00 00 00 00 00 11 B8 00 09 00 1A 00 38 00 51 00 68 00 7D 00 90 00 A1
			39 00 00 00 00 00 11 B9 00 B1 00 E7 01 11 01 52 01 84 01 D0 02 0C 02 0E
			39 00 00 00 00 00 11 BA 02 49 02 8E 02 BB 02 F3 03 1A 03 52 03 66 03 7D
			39 01 00 00 00 00 0D BB 03 8F 03 97 03 9C 03 B7 03 D2 03 D7
			15 00 00 00 00 00 02 FF 21
			15 00 00 00 00 00 02 FB 01
			39 00 00 00 00 00 11 B0 01 03 01 08 01 10 01 19 01 21 01 28 01 30 01 37
			39 00 00 00 00 00 11 B1 01 3E 01 58 01 6E 01 96 01 B9 01 F2 02 26 02 28
			39 00 00 00 00 00 11 B2 02 5E 02 A0 02 CB 02 FF 03 25 03 50 03 5D 03 6A
			39 00 00 00 00 00 0D B3 03 7A 03 8C 03 A2 03 BC 03 D3 03 D7
			39 00 00 00 00 00 11 B4 00 09 00 19 00 35 00 4B 00 61 00 74 00 87 00 97
			39 00 00 00 00 00 11 B5 00 A7 00 DD 01 07 01 4A 01 7D 01 CB 02 08 02 0A
			39 00 00 00 00 00 11 B6 02 45 02 8A 02 B7 02 ED 03 10 03 41 03 4F 03 5E
			39 00 00 00 00 00 0D B7 03 6E 03 81 03 98 03 B4 03 D2 03 D7
			39 00 00 00 00 00 11 B8 00 09 00 1A 00 38 00 51 00 68 00 7D 00 90 00 A1
			39 00 00 00 00 00 11 B9 00 B1 00 E7 01 11 01 52 01 84 01 D0 02 0C 02 0E
			39 00 00 00 00 00 11 BA 02 49 02 8E 02 BB 02 F3 03 1A 03 52 03 66 03 7D
			39 00 00 00 00 00 0D BB 03 8F 03 97 03 9C 03 B7 03 D2 03 D7
			15 01 00 00 00 00 02 FF 10
		];
		qcom,mdss-dsi-gamma9-command = [
			15 00 00 00 00 00 02 FF 20
			15 00 00 00 00 00 02 FB 01
			39 00 00 00 00 00 11 B0 00 0A 00 1B 00 37 00 50 00 66 00 7A 00 8C 00 9E
			39 00 00 00 00 00 11 B1 00 AE 00 E3 01 0E 01 4E 01 82 01 CE 02 0A 02 0C
			39 00 00 00 00 00 11 B2 02 48 02 8C 02 B9 02 EE 03 11 03 3F 03 51 03 5F
			39 00 00 00 00 00 0D B3 03 70 03 82 03 98 03 B4 03 D2 03 D7
			39 00 00 00 00 00 11 B4 00 91 00 99 00 A9 00 B7 00 C5 00 D2 00 DE 00 E9
			39 00 00 00 00 00 11 B5 00 F4 01 1A 01 39 01 6E 01 98 01 DC 02 14 02 15
			39 00 00 00 00 00 11 B6 02 4F 02 92 02 BE 02 F4 03 16 03 46 03 53 03 62
			39 00 00 00 00 00 0D B7 03 72 03 85 03 9C 03 B7 03 D2 03 D7
			39 00 00 00 00 00 11 B8 01 12 01 16 01 1E 01 26 01 2D 01 35 01 3B 01 42
			39 00 00 00 00 00 11 B9 01 49 01 61 01 77 01 9C 01 BE 01 F4 02 28 02 29
			39 00 00 00 00 00 11 BA 02 60 02 A1 02 CE 03 03 03 2F 03 69 03 89 03 98
			39 01 00 00 00 00 0D BB 03 9A 03 9C 03 A4 03 BF 03 D4 03 D7
			15 00 00 00 00 00 02 FF 21
			15 00 00 00 00 00 02 FB 01
			39 00 00 00 00 00 11B0 00 0A 00 1B 00 37 00 50 00 66 00 7A 00 8C 00 9E
			39 00 00 00 00 00 11B1 00 AE 00 E3 01 0E 01 4E 01 82 01 CE 02 0A 02 0C
			39 00 00 00 00 00 11B2 02 48 02 8C 02 B9 02 EE 03 11 03 3F 03 51 03 5F
			39 00 00 00 00 00 0DB3 03 70 03 82 03 98 03 B4 03 D2 03 D7
			39 00 00 00 00 00 11B4 00 91 00 99 00 A9 00 B7 00 C5 00 D2 00 DE 00 E9
			39 00 00 00 00 00 11B5 00 F4 01 1A 01 39 01 6E 01 98 01 DC 02 14 02 15
			39 00 00 00 00 00 11B6 02 4F 02 92 02 BE 02 F4 03 16 03 46 03 53 03 62
			39 00 00 00 00 00 0DB7 03 72 03 85 03 9C 03 B7 03 D2 03 D7
			39 00 00 00 00 00 11B8 01 12 01 16 01 1E 01 26 01 2D 01 35 01 3B 01 42
			39 00 00 00 00 00 11B9 01 49 01 61 01 77 01 9C 01 BE 01 F4 02 28 02 29
			39 00 00 00 00 00 11BA 02 60 02 A1 02 CE 03 03 03 2F 03 69 03 89 03 98
			39 00 00 00 00 00 0DBB 03 9A 03 9C 03 A4 03 BF 03 D4 03 D7
			15 01 00 00 00 00 02 FF 10
		];
		qcom,mdss-dsi-gamma10-command = [
			15 00 00 00 00 00 02 FF 20
			15 00 00 00 00 00 02 FB 01
			39 00 00 00 00 00 11 B0 00 0C 00 1C 00 3A 00 54 00 6A 00 7E 00 92 00 A2
			39 00 00 00 00 00 11 B1 00 B3 00 EB 01 15 01 58 01 8A 01 D6 02 13 02 14
			39 00 00 00 00 00 11 B2 02 4E 02 91 02 BE 02 F3 03 15 03 42 03 54 03 62
			39 00 00 00 00 00 0D B3 03 73 03 85 03 9C 03 B7 03 D2 03 D7
			39 00 00 00 00 00 11 B4 00 70 00 7A 00 8D 00 9F 00 AF 00 BE 00 CD 00 DA
			39 00 00 00 00 00 11 B5 00 E6 01 11 01 34 01 6C 01 99 01 DF 02 18 02 19
			39 00 00 00 00 00 11 B6 02 52 02 95 02 C1 02 F6 03 18 03 47 03 54 03 62
			39 00 00 00 00 00 0D B7 03 72 03 85 03 9A 03 B6 03 D2 03 D7
			39 00 00 00 00 00 11 B8 00 CF 00 D5 00 E2 00 EE 00 F9 01 03 01 0D 01 16
			39 00 00 00 00 00 11 B9 01 1F 01 40 01 5B 01 8A 01 B0 01 EE 02 24 02 25
			39 00 00 00 00 00 11 BA 02 5C 02 9E 02 CB 03 01 03 2B 03 65 03 83 03 90
			39 01 00 00 00 00 0D BB 03 92 03 94 03 A1 03 C2 03 D4 03 D7

			15 00 00 00 00 00 02 FF 21
			15 00 00 00 00 00 02 FB 01
			39 00 00 00 00 00 11 B0 00 0C 00 1C 00 3A 00 54 00 6A 00 7E 00 92 00 A2
			39 00 00 00 00 00 11 B1 00 B3 00 EB 01 15 01 58 01 8A 01 D6 02 13 02 14
			39 00 00 00 00 00 11 B2 02 4E 02 91 02 BE 02 F3 03 15 03 42 03 54 03 62
			39 00 00 00 00 00 0D B3 03 73 03 85 03 9C 03 B7 03 D2 03 D7
			39 00 00 00 00 00 11 B4 00 70 00 7A 00 8D 00 9F 00 AF 00 BE 00 CD 00 DA
			39 00 00 00 00 00 11 B5 00 E6 01 11 01 34 01 6C 01 99 01 DF 02 18 02 19
			39 00 00 00 00 00 11 B6 02 52 02 95 02 C1 02 F6 03 18 03 47 03 54 03 62
			39 00 00 00 00 00 0D B7 03 72 03 85 03 9A 03 B6 03 D2 03 D7
			39 00 00 00 00 00 11 B8 00 CF 00 D5 00 E2 00 EE 00 F9 01 03 01 0D 01 16
			39 00 00 00 00 00 11 B9 01 1F 01 40 01 5B 01 8A 01 B0 01 EE 02 24 02 25
			39 00 00 00 00 00 11 BA 02 5C 02 9E 02 CB 03 01 03 2B 03 65 03 83 03 90
			39 00 00 00 00 00 0D BB 03 92 03 94 03 A1 03 C2 03 D4 03 D7
			15 01 00 00 00 00 02 FF 10
		];
		qcom,mdss-dsi-gamma11-command = [
			15 00 00 00 00 00 02 FF 20
			15 00 00 00 00 00 02 FB 01
			39 00 00 00 00 00 11 B0 00 0B 00 1C 00 36 00 4F 00 66 00 79 00 8C 00 9E
			39 00 00 00 00 00 11 B1 00 AD 00 E3 01 0E 01 52 01 83 01 D0 02 0B 02 0D
			39 00 00 00 00 00 11 B2 02 49 02 8E 02 BA 02 EF 03 0F 03 3F 03 4C 03 5E
			39 00 00 00 00 00 0D B3 03 6C 03 81 03 9A 03 B5 03 D2 03 D7
			39 00 00 00 00 00 11 B4 00 F0 00 F5 00 FF 01 08 01 11 01 19 01 21 01 29
			39 00 00 00 00 00 11 B5 01 31 01 4C 01 65 01 8F 01 B2 01 EE 02 21 02 23
			39 00 00 00 00 00 11 B6 02 5A 02 9C 02 C7 02 FB 03 21 03 4D 03 5A 03 68
			39 00 00 00 00 00 0D B7 03 77 03 89 03 9F 03 BA 03 D3 03 D7
			39 00 00 00 00 00 11 B8 00 C6 00 CD 00 D9 00 E5 00 F0 00 FA 01 04 01 0E
			39 00 00 00 00 00 11 B9 01 16 01 36 01 52 01 82 01 A8 01 E7 02 1C 02 1E
			39 00 00 00 00 00 11 BA 02 56 02 9A 02 C6 02 FC 03 26 03 5C 03 72 03 99
			39 01 00 00 00 00 0D BB 03 AD 03 B3 03 B5 03 BF 03 D4 03 D7
			15 00 00 00 00 00 02 FF 21
			15 00 00 00 00 00 02 FB 01
			39 00 00 00 00 00 11 B0 00 0B 00 1C 00 36 00 4F 00 66 00 79 00 8C 00 9E
			39 00 00 00 00 00 11 B1 00 AD 00 E3 01 0E 01 52 01 83 01 D0 02 0B 02 0D
			39 00 00 00 00 00 11 B2 02 49 02 8E 02 BA 02 EF 03 0F 03 3F 03 4C 03 5E
			39 00 00 00 00 00 0D B3 03 6C 03 81 03 9A 03 B5 03 D2 03 D7
			39 00 00 00 00 00 11 B4 00 F0 00 F5 00 FF 01 08 01 11 01 19 01 21 01 29
			39 00 00 00 00 00 11 B5 01 31 01 4C 01 65 01 8F 01 B2 01 EE 02 21 02 23
			39 00 00 00 00 00 11 B6 02 5A 02 9C 02 C7 02 FB 03 21 03 4D 03 5A 03 68
			39 00 00 00 00 00 0D B7 03 77 03 89 03 9F 03 BA 03 D3 03 D7
			39 00 00 00 00 00 11 B8 00 C6 00 CD 00 D9 00 E5 00 F0 00 FA 01 04 01 0E
			39 00 00 00 00 00 11 B9 01 16 01 36 01 52 01 82 01 A8 01 E7 02 1C 02 1E
			39 00 00 00 00 00 11 BA 02 56 02 9A 02 C6 02 FC 03 26 03 5C 03 72 03 99
			39 00 00 00 00 00 0D BB 03 AD 03 B3 03 B5 03 BF 03 D4 03 D7
			15 01 00 00 00 00 02 FF 10
		];
		qcom,mdss-dsi-gamma12-command = [
			15 00 00 00 00 00 02 FF 20
			15 00 00 00 00 00 02 FB 01
			39 00 00 00 00 00 11 B0 00 0B 00 1C 00 36 00 4F 00 66 00 79 00 8C 00 9E
			39 00 00 00 00 00 11 B1 00 AD 00 E3 01 0E 01 52 01 83 01 D0 02 0B 02 0D
			39 00 00 00 00 00 11 B2 02 49 02 8E 02 BA 02 EF 03 0F 03 3F 03 4C 03 5E
			39 00 00 00 00 00 0D B3 03 6C 03 81 03 9A 03 B5 03 D2 03 D7
			39 00 00 00 00 00 11 B4 00 F0 00 F5 00 FF 01 08 01 11 01 19 01 21 01 29
			39 00 00 00 00 00 11 B5 01 31 01 4C 01 65 01 8F 01 B2 01 EE 02 21 02 23
			39 00 00 00 00 00 11 B6 02 5A 02 9C 02 C7 02 FB 03 21 03 4D 03 5A 03 68
			39 00 00 00 00 00 0D B7 03 77 03 89 03 9F 03 BA 03 D3 03 D7
			39 00 00 00 00 00 11 B8 00 C6 00 CD 00 D9 00 E5 00 F0 00 FA 01 04 01 0E
			39 00 00 00 00 00 11 B9 01 16 01 36 01 52 01 82 01 A8 01 E7 02 1C 02 1E
			39 00 00 00 00 00 11 BA 02 56 02 9A 02 C6 02 FC 03 26 03 5C 03 72 03 99
			39 01 00 00 00 00 0D BB 03 AD 03 B3 03 B5 03 BF 03 D4 03 D7
			15 00 00 00 00 00 02 FF 21
			15 00 00 00 00 00 02 FB 01
			39 00 00 00 00 00 11 B0 00 0B 00 1C 00 36 00 4F 00 66 00 79 00 8C 00 9E
			39 00 00 00 00 00 11 B1 00 AD 00 E3 01 0E 01 52 01 83 01 D0 02 0B 02 0D
			39 00 00 00 00 00 11 B2 02 49 02 8E 02 BA 02 EF 03 0F 03 3F 03 4C 03 5E
			39 00 00 00 00 00 0D B3 03 6C 03 81 03 9A 03 B5 03 D2 03 D7
			39 00 00 00 00 00 11 B4 00 F0 00 F5 00 FF 01 08 01 11 01 19 01 21 01 29
			39 00 00 00 00 00 11 B5 01 31 01 4C 01 65 01 8F 01 B2 01 EE 02 21 02 23
			39 00 00 00 00 00 11 B6 02 5A 02 9C 02 C7 02 FB 03 21 03 4D 03 5A 03 68
			39 00 00 00 00 00 0D B7 03 77 03 89 03 9F 03 BA 03 D3 03 D7
			39 00 00 00 00 00 11 B8 00 C6 00 CD 00 D9 00 E5 00 F0 00 FA 01 04 01 0E
			39 00 00 00 00 00 11 B9 01 16 01 36 01 52 01 82 01 A8 01 E7 02 1C 02 1E
			39 00 00 00 00 00 11 BA 02 56 02 9A 02 C6 02 FC 03 26 03 5C 03 72 03 99
			39 00 00 00 00 00 0D BB 03 AD 03 B3 03 B5 03 BF 03 D4 03 D7
			15 01 00 00 00 00 02 FF 10
		];
		qcom,mdss-dsi-gamma13-command = [
			15 00 00 00 00 00 02 FF 20
			15 00 00 00 00 00 02 FB 01
			39 00 00 00 00 00 11 B0 00 0C 00 1D 00 3A 00 54 00 6B 00 80 00 93 00 A5
			39 00 00 00 00 00 11 B1 00 B5 00 EC 01 17 01 5A 01 8C 01 D8 02 13 02 15
			39 00 00 00 00 00 11 B2 02 50 02 93 02 BF 02 F5 03 16 03 45 03 52 03 61
			39 00 00 00 00 00 0D B3 03 6D 03 84 03 9B 03 B7 03 D2 03 D7
			39 00 00 00 00 00 11 B4 00 0C 00 1C 00 39 00 54 00 6A 00 80 00 92 00 A5
			39 00 00 00 00 00 11 B5 00 B4 00 EA 01 16 01 57 01 89 01 D4 02 10 02 12
			39 00 00 00 00 00 11 B6 02 4D 02 90 02 BC 02 F3 03 14 03 45 03 52 03 60
			39 00 00 00 00 00 0D B7 03 6B 03 80 03 98 03 B4 03 D2 03 D7
			39 00 00 00 00 00 11 B8 00 D7 00 DD 00 E9 00 F5 00 FF 01 0A 01 13 01 1D
			39 00 00 00 00 00 11 B9 01 25 01 44 01 60 01 8D 01 B3 01 F0 02 25 02 27
			39 00 00 00 00 00 11 BA 02 5E 02 A0 02 CC 03 03 03 2D 03 6A 03 87 03 C9
			39 01 00 00 00 00 0D BB 03 CB 03 CD 03 CF 03 D1 03 D4 03 D7
			15 00 00 00 00 00 02 FF 21
			15 00 00 00 00 00 02 FB 01
			39 00 00 00 00 00 11 B0 00 0C 00 1D 00 3A 00 54 00 6B 00 80 00 93 00 A5
			39 00 00 00 00 00 11 B1 00 B5 00 EC 01 17 01 5A 01 8C 01 D8 02 13 02 15
			39 00 00 00 00 00 11 B2 02 50 02 93 02 BF 02 F5 03 16 03 45 03 52 03 61
			39 00 00 00 00 00 0D B3 03 6D 03 84 03 9B 03 B7 03 D2 03 D7
			39 00 00 00 00 00 11 B4 00 0C 00 1C 00 39 00 54 00 6A 00 80 00 92 00 A5
			39 00 00 00 00 00 11 B5 00 B4 00 EA 01 16 01 57 01 89 01 D4 02 10 02 12
			39 00 00 00 00 00 11 B6 02 4D 02 90 02 BC 02 F3 03 14 03 45 03 52 03 60
			39 00 00 00 00 00 0D B7 03 6B 03 80 03 98 03 B4 03 D2 03 D7
			39 00 00 00 00 00 11 B8 00 D7 00 DD 00 E9 00 F5 00 FF 01 0A 01 13 01 1D
			39 00 00 00 00 00 11 B9 01 25 01 44 01 60 01 8D 01 B3 01 F0 02 25 02 27
			39 00 00 00 00 00 11 BA 02 5E 02 A0 02 CC 03 03 03 2D 03 6A 03 87 03 C9
			39 00 00 00 00 00 0D BB 03 CB 03 CD 03 CF 03 D1 03 D4 03 D7
			15 01 00 00 00 00 02 FF 10
		];
		qcom,mdss-dsi-gamma14-command = [
			15 00 00 00 00 00 02 FF 20
			15 00 00 00 00 00 02 FB 01
			39 00 00 00 00 00 11 B0 00 0C 00 1C 00 3A 00 54 00 6A 00 7E 00 92 00 A2
			39 00 00 00 00 00 11 B1 00 B3 00 EB 01 15 01 58 01 8A 01 D6 02 13 02 14
			39 00 00 00 00 00 11 B2 02 4E 02 91 02 BE 02 F3 03 15 03 42 03 54 03 62
			39 00 00 00 00 00 0D B3 03 73 03 85 03 9C 03 B7 03 D2 03 D7
			39 00 00 00 00 00 11 B4 00 70 00 7A 00 8D 00 9F 00 AF 00 BE 00 CD 00 DA
			39 00 00 00 00 00 11 B5 00 E6 01 11 01 34 01 6C 01 99 01 DF 02 18 02 19
			39 00 00 00 00 00 11 B6 02 52 02 95 02 C1 02 F6 03 18 03 47 03 54 03 62
			39 00 00 00 00 00 0D B7 03 72 03 85 03 9A 03 B6 03 D2 03 D7
			39 00 00 00 00 00 11 B8 00 CF 00 D5 00 E2 00 EE 00 F9 01 03 01 0D 01 16
			39 00 00 00 00 00 11 B9 01 1F 01 40 01 5B 01 8A 01 B0 01 EE 02 24 02 25
			39 00 00 00 00 00 11 BA 02 5C 02 9E 02 CB 03 01 03 2B 03 65 03 83 03 90
			39 01 00 00 00 00 0D BB 03 92 03 94 03 A1 03 C2 03 D4 03 D7

			15 00 00 00 00 00 02 FF 21
			15 00 00 00 00 00 02 FB 01
			39 00 00 00 00 00 11 B0 00 0C 00 1C 00 3A 00 54 00 6A 00 7E 00 92 00 A2
			39 00 00 00 00 00 11 B1 00 B3 00 EB 01 15 01 58 01 8A 01 D6 02 13 02 14
			39 00 00 00 00 00 11 B2 02 4E 02 91 02 BE 02 F3 03 15 03 42 03 54 03 62
			39 00 00 00 00 00 0D B3 03 73 03 85 03 9C 03 B7 03 D2 03 D7
			39 00 00 00 00 00 11 B4 00 70 00 7A 00 8D 00 9F 00 AF 00 BE 00 CD 00 DA
			39 00 00 00 00 00 11 B5 00 E6 01 11 01 34 01 6C 01 99 01 DF 02 18 02 19
			39 00 00 00 00 00 11 B6 02 52 02 95 02 C1 02 F6 03 18 03 47 03 54 03 62
			39 00 00 00 00 00 0D B7 03 72 03 85 03 9A 03 B6 03 D2 03 D7
			39 00 00 00 00 00 11 B8 00 CF 00 D5 00 E2 00 EE 00 F9 01 03 01 0D 01 16
			39 00 00 00 00 00 11 B9 01 1F 01 40 01 5B 01 8A 01 B0 01 EE 02 24 02 25
			39 00 00 00 00 00 11 BA 02 5C 02 9E 02 CB 03 01 03 2B 03 65 03 83 03 90
			39 00 00 00 00 00 0D BB 03 92 03 94 03 A1 03 C2 03 D4 03 D7
			15 01 00 00 00 00 02 FF 10
		];
		qcom,mdss-dsi-gamma15-command = [
			15 00 00 00 00 00 02 FF 20
			15 00 00 00 00 00 02 FB 01
			39 00 00 00 00 00 11 B0 00 0B 00 1C 00 36 00 4F 00 66 00 79 00 8C 00 9E
			39 00 00 00 00 00 11 B1 00 AD 00 E3 01 0E 01 52 01 83 01 D0 02 0B 02 0D
			39 00 00 00 00 00 11 B2 02 49 02 8E 02 BA 02 EF 03 0F 03 3F 03 4C 03 5E
			39 00 00 00 00 00 0D B3 03 6C 03 81 03 9A 03 B5 03 D2 03 D7
			39 00 00 00 00 00 11 B4 00 F0 00 F5 00 FF 01 08 01 11 01 19 01 21 01 29
			39 00 00 00 00 00 11 B5 01 31 01 4C 01 65 01 8F 01 B2 01 EE 02 21 02 23
			39 00 00 00 00 00 11 B6 02 5A 02 9C 02 C7 02 FB 03 21 03 4D 03 5A 03 68
			39 00 00 00 00 00 0D B7 03 77 03 89 03 9F 03 BA 03 D3 03 D7
			39 00 00 00 00 00 11 B8 00 C6 00 CD 00 D9 00 E5 00 F0 00 FA 01 04 01 0E
			39 00 00 00 00 00 11 B9 01 16 01 36 01 52 01 82 01 A8 01 E7 02 1C 02 1E
			39 00 00 00 00 00 11 BA 02 56 02 9A 02 C6 02 FC 03 26 03 5C 03 72 03 99
			39 01 00 00 00 00 0D BB 03 AD 03 B3 03 B5 03 BF 03 D4 03 D7
			15 00 00 00 00 00 02 FF 21
			15 00 00 00 00 00 02 FB 01
			39 00 00 00 00 00 11 B0 00 0B 00 1C 00 36 00 4F 00 66 00 79 00 8C 00 9E
			39 00 00 00 00 00 11 B1 00 AD 00 E3 01 0E 01 52 01 83 01 D0 02 0B 02 0D
			39 00 00 00 00 00 11 B2 02 49 02 8E 02 BA 02 EF 03 0F 03 3F 03 4C 03 5E
			39 00 00 00 00 00 0D B3 03 6C 03 81 03 9A 03 B5 03 D2 03 D7
			39 00 00 00 00 00 11 B4 00 F0 00 F5 00 FF 01 08 01 11 01 19 01 21 01 29
			39 00 00 00 00 00 11 B5 01 31 01 4C 01 65 01 8F 01 B2 01 EE 02 21 02 23
			39 00 00 00 00 00 11 B6 02 5A 02 9C 02 C7 02 FB 03 21 03 4D 03 5A 03 68
			39 00 00 00 00 00 0D B7 03 77 03 89 03 9F 03 BA 03 D3 03 D7
			39 00 00 00 00 00 11 B8 00 C6 00 CD 00 D9 00 E5 00 F0 00 FA 01 04 01 0E
			39 00 00 00 00 00 11 B9 01 16 01 36 01 52 01 82 01 A8 01 E7 02 1C 02 1E
			39 00 00 00 00 00 11 BA 02 56 02 9A 02 C6 02 FC 03 26 03 5C 03 72 03 99
			39 00 00 00 00 00 0D BB 03 AD 03 B3 03 B5 03 BF 03 D4 03 D7
			15 01 00 00 00 00 02 FF 10
		];
		qcom,mdss-dsi-gamma16-command = [
			15 00 00 00 00 00 02 FF 20
			15 00 00 00 00 00 02 FB 01
			39 00 00 00 00 00 11 B0 00 0B 00 1C 00 36 00 4F 00 66 00 79 00 8C 00 9E
			39 00 00 00 00 00 11 B1 00 AD 00 E3 01 0E 01 52 01 83 01 D0 02 0B 02 0D
			39 00 00 00 00 00 11 B2 02 49 02 8E 02 BA 02 EF 03 0F 03 3F 03 4C 03 5E
			39 00 00 00 00 00 0D B3 03 6C 03 81 03 9A 03 B5 03 D2 03 D7
			39 00 00 00 00 00 11 B4 00 F0 00 F5 00 FF 01 08 01 11 01 19 01 21 01 29
			39 00 00 00 00 00 11 B5 01 31 01 4C 01 65 01 8F 01 B2 01 EE 02 21 02 23
			39 00 00 00 00 00 11 B6 02 5A 02 9C 02 C7 02 FB 03 21 03 4D 03 5A 03 68
			39 00 00 00 00 00 0D B7 03 77 03 89 03 9F 03 BA 03 D3 03 D7
			39 00 00 00 00 00 11 B8 00 C6 00 CD 00 D9 00 E5 00 F0 00 FA 01 04 01 0E
			39 00 00 00 00 00 11 B9 01 16 01 36 01 52 01 82 01 A8 01 E7 02 1C 02 1E
			39 00 00 00 00 00 11 BA 02 56 02 9A 02 C6 02 FC 03 26 03 5C 03 72 03 99
			39 01 00 00 00 00 0D BB 03 AD 03 B3 03 B5 03 BF 03 D4 03 D7
			15 00 00 00 00 00 02 FF 21
			15 00 00 00 00 00 02 FB 01
			39 00 00 00 00 00 11 B0 00 0B 00 1C 00 36 00 4F 00 66 00 79 00 8C 00 9E
			39 00 00 00 00 00 11 B1 00 AD 00 E3 01 0E 01 52 01 83 01 D0 02 0B 02 0D
			39 00 00 00 00 00 11 B2 02 49 02 8E 02 BA 02 EF 03 0F 03 3F 03 4C 03 5E
			39 00 00 00 00 00 0D B3 03 6C 03 81 03 9A 03 B5 03 D2 03 D7
			39 00 00 00 00 00 11 B4 00 F0 00 F5 00 FF 01 08 01 11 01 19 01 21 01 29
			39 00 00 00 00 00 11 B5 01 31 01 4C 01 65 01 8F 01 B2 01 EE 02 21 02 23
			39 00 00 00 00 00 11 B6 02 5A 02 9C 02 C7 02 FB 03 21 03 4D 03 5A 03 68
			39 00 00 00 00 00 0D B7 03 77 03 89 03 9F 03 BA 03 D3 03 D7
			39 00 00 00 00 00 11 B8 00 C6 00 CD 00 D9 00 E5 00 F0 00 FA 01 04 01 0E
			39 00 00 00 00 00 11 B9 01 16 01 36 01 52 01 82 01 A8 01 E7 02 1C 02 1E
			39 00 00 00 00 00 11 BA 02 56 02 9A 02 C6 02 FC 03 26 03 5C 03 72 03 99
			39 00 00 00 00 00 0D BB 03 AD 03 B3 03 B5 03 BF 03 D4 03 D7
			15 01 00 00 00 00 02 FF 10
		];
		qcom,mdss-dsi-gamma17-command = [
			15 00 00 00 00 00 02 FF 20
			15 00 00 00 00 00 02 FB 01
			39 00 00 00 00 00 11 B0 01 14 01 18 01 20 01 27 01 2F 01 36 01 3D 01 43
			39 00 00 00 00 00 11 B1 01 4A 01 62 01 78 01 9E 01 BF 01 F5 02 29 02 2B
			39 00 00 00 00 00 11 B2 02 61 02 A3 02 CE 03 01 03 27 03 54 03 5E 03 6B
			39 00 00 00 00 00 0D B3 03 7A 03 8B 03 A0 03 B9 03 D3 03 D7
			39 00 00 00 00 00 11 B4 00 09 00 19 00 35 00 4D 00 63 00 77 00 89 00 99
			39 00 00 00 00 00 11 B5 00 AB 00 E0 01 09 01 4A 01 7C 01 CA 02 06 02 08
			39 00 00 00 00 00 11 B6 02 45 02 8A 02 B6 02 EE 03 10 03 42 03 4F 03 5E
			39 00 00 00 00 00 0D B7 03 6E 03 81 03 97 03 B2 03 D1 03 D7
			39 00 00 00 00 00 11 B8 00 DB 00 E1 00 EC 00 F6 01 00 01 09 01 12 01 1A
			39 00 00 00 00 00 11 B9 01 23 01 41 01 5A 01 86 01 AB 01 E9 02 1E 02 20
			39 00 00 00 00 00 11 BA 02 58 02 9C 02 C8 02 FF 03 2A 03 65 03 79 03 89
			39 01 00 00 00 00 0D BB 03 8B 03 8F 03 A4 03 BC 03 D2 03 D7
			15 00 00 00 00 00 02 FF 21
			15 00 00 00 00 00 02 FB 01
			39 00 00 00 00 00 11 B0 01 14 01 18 01 20 01 27 01 2F 01 36 01 3D 01 43
			39 00 00 00 00 00 11 B1 01 4A 01 62 01 78 01 9E 01 BF 01 F5 02 29 02 2B
			39 00 00 00 00 00 11 B2 02 61 02 A3 02 CE 03 01 03 27 03 54 03 5E 03 6B
			39 00 00 00 00 00 0D B3 03 7A 03 8B 03 A0 03 B9 03 D3 03 D7
			39 00 00 00 00 00 11 B4 00 09 00 19 00 35 00 4D 00 63 00 77 00 89 00 99
			39 00 00 00 00 00 11 B5 00 AB 00 E0 01 09 01 4A 01 7C 01 CA 02 06 02 08
			39 00 00 00 00 00 11 B6 02 45 02 8A 02 B6 02 EE 03 10 03 42 03 4F 03 5E
			39 00 00 00 00 00 0D B7 03 6E 03 81 03 97 03 B2 03 D1 03 D7
			39 00 00 00 00 00 11 B8 00 DB 00 E1 00 EC 00 F6 01 00 01 09 01 12 01 1A
			39 00 00 00 00 00 11 B9 01 23 01 41 01 5A 01 86 01 AB 01 E9 02 1E 02 20
			39 00 00 00 00 00 11 BA 02 58 02 9C 02 C8 02 FF 03 2A 03 65 03 79 03 89
			39 00 00 00 00 00 0D BB 03 8B 03 8F 03 A4 03 BC 03 D2 03 D7
			15 01 00 00 00 00 02 FF 10
		];
		qcom,mdss-dsi-gamma18-command = [
			15 00 00 00 00 00 02 FF 20
			15 00 00 00 00 00 02 FB 01
			39 00 00 00 00 00 11 B0 00 DC 00 E2 00 EC 00 F7 01 00 01 0A 01 12 01 1B
			39 00 00 00 00 00 11 B1 01 23 01 41 01 5B 01 87 01 AD 01 EA 02 20 02 22
			39 00 00 00 00 00 11 B2 02 59 02 9B 02 C7 02 FC 03 21 03 4D 03 59 03 67
			39 00 00 00 00 00 0D B3 03 77 03 8A 03 A0 03 BB 03 D3 03 D7
			39 00 00 00 00 00 11 B4 00 09 00 18 00 35 00 4C 00 61 00 77 00 8A 00 9B
			39 00 00 00 00 00 11 B5 00 A9 00 E1 01 09 01 4B 01 80 01 CA 02 07 02 0A
			39 00 00 00 00 00 11 B6 02 45 02 8A 02 B7 02 EE 03 10 03 42 03 4F 03 5E
			39 00 00 00 00 00 0D B7 03 6E 03 81 03 98 03 B4 03 D2 03 D7
			39 00 00 00 00 00 11 B8 00 84 00 8D 00 9F 00 AE 00 BC 00 CB 00 D8 00 E4
			39 00 00 00 00 00 11 B9 00 EE 01 17 01 36 01 6C 01 99 01 DB 02 14 02 17
			39 00 00 00 00 00 11 BA 02 50 02 94 02 C1 02 F9 03 22 03 5A 03 6E 03 89
			39 01 00 00 00 00 0D BB 03 A6 03 AE 03 B0 03 B9 03 D3 03 D7
			15 00 00 00 00 00 02 FF 21
			15 00 00 00 00 00 02 FB 01
			39 00 00 00 00 00 11 B0 00 DC 00 E2 00 EC 00 F7 01 00 01 0A 01 12 01 1B
			39 00 00 00 00 00 11 B1 01 23 01 41 01 5B 01 87 01 AD 01 EA 02 20 02 22
			39 00 00 00 00 00 11 B2 02 59 02 9B 02 C7 02 FC 03 21 03 4D 03 59 03 67
			39 00 00 00 00 00 0D B3 03 77 03 8A 03 A0 03 BB 03 D3 03 D7
			39 00 00 00 00 00 11 B4 00 09 00 18 00 35 00 4C 00 61 00 77 00 8A 00 9B
			39 00 00 00 00 00 11 B5 00 A9 00 E1 01 09 01 4B 01 80 01 CA 02 07 02 0A
			39 00 00 00 00 00 11 B6 02 45 02 8A 02 B7 02 EE 03 10 03 42 03 4F 03 5E
			39 00 00 00 00 00 0D B7 03 6E 03 81 03 98 03 B4 03 D2 03 D7
			39 00 00 00 00 00 11 B8 00 84 00 8D 00 9F 00 AE 00 BC 00 CB 00 D8 00 E4
			39 00 00 00 00 00 11 B9 00 EE 01 17 01 36 01 6C 01 99 01 DB 02 14 02 17
			39 00 00 00 00 00 11 BA 02 50 02 94 02 C1 02 F9 03 22 03 5A 03 6E 03 89
			39 00 00 00 00 00 0D BB 03 A6 03 AE 03 B0 03 B9 03 D3 03 D7
			15 01 00 00 00 00 02 FF 10
		];
		qcom,mdss-dsi-gamma19-command = [
			15 00 00 00 00 00 02 FF 20
			15 00 00 00 00 00 02 FB 01
			39 00 00 00 00 00 11 B0 00 AA 00 B1 00 BF 00 CC 00 D8 00 E4 00 EF 00 F9
			39 00 00 00 00 00 11 B1 01 03 01 27 01 45 01 77 01 9F 01 E1 02 19 02 1B
			39 00 00 00 00 00 11 B2 02 54 02 97 02 C3 02 F8 03 1B 03 49 03 56 03 64
			39 00 00 00 00 00 0D B3 03 74 03 86 03 9B 03 B6 03 D3 03 D8
			39 00 00 00 00 00 11 B4 00 71 00 7B 00 8D 00 9D 00 AD 00 BB 00 C9 00 D5
			39 00 00 00 00 00 11 B5 00 E1 01 0B 01 2D 01 65 01 91 01 D7 02 10 02 12
			39 00 00 00 00 00 11 B6 02 4C 02 90 02 BC 02 F3 03 15 03 45 03 52 03 61
			39 00 00 00 00 00 0D B7 03 71 03 84 03 9A 03 B6 03 D3 03 D8
			39 00 00 00 00 00 11 B8 00 0A 00 1B 00 38 00 52 00 69 00 7E 00 92 00 A3
			39 00 00 00 00 00 11 B9 00 B3 00 E9 01 13 01 54 01 86 01 D1 02 0D 02 0F
			39 00 00 00 00 00 11 BA 02 4A 02 8F 02 BC 02 F6 03 1D 03 58 03 6F 03 8B
			39 01 00 00 00 00 0D BB 03 A4 03 A6 03 A8 03 BB 03 D4 03 D8
			15 00 00 00 00 00 02 FF 21
			15 00 00 00 00 00 02 FB 01
			39 00 00 00 00 00 11 B0 00 AA 00 B1 00 BF 00 CC 00 D8 00 E4 00 EF 00 F9
			39 00 00 00 00 00 11 B1 01 03 01 27 01 45 01 77 01 9F 01 E1 02 19 02 1B
			39 00 00 00 00 00 11 B2 02 54 02 97 02 C3 02 F8 03 1B 03 49 03 56 03 64
			39 00 00 00 00 00 0D B3 03 74 03 86 03 9B 03 B6 03 D3 03 D8
			39 00 00 00 00 00 11 B4 00 71 00 7B 00 8D 00 9D 00 AD 00 BB 00 C9 00 D5
			39 00 00 00 00 00 11 B5 00 E1 01 0B 01 2D 01 65 01 91 01 D7 02 10 02 12
			39 00 00 00 00 00 11 B6 02 4C 02 90 02 BC 02 F3 03 15 03 45 03 52 03 61
			39 00 00 00 00 00 0D B7 03 71 03 84 03 9A 03 B6 03 D3 03 D8
			39 00 00 00 00 00 11 B8 00 0A 00 1B 00 38 00 52 00 69 00 7E 00 92 00 A3
			39 00 00 00 00 00 11 B9 00 B3 00 E9 01 13 01 54 01 86 01 D1 02 0D 02 0F
			39 00 00 00 00 00 11 BA 02 4A 02 8F 02 BC 02 F6 03 1D 03 58 03 6F 03 8B
			39 00 00 00 00 00 0D BB 03 A4 03 A6 03 A8 03 BB 03 D4 03 D8
			15 01 00 00 00 00 02 FF 10
		];
		qcom,mdss-dsi-gamma20-command = [
			15 00 00 00 00 00 02 FF 20
			15 00 00 00 00 00 02 FB 01
			39 00 00 00 00 00 11 B0 00 AA 00 B1 00 BF 00 CC 00 D8 00 E4 00 EF 00 F9
			39 00 00 00 00 00 11 B1 01 03 01 27 01 45 01 77 01 9F 01 E1 02 19 02 1B
			39 00 00 00 00 00 11 B2 02 54 02 97 02 C3 02 F8 03 1B 03 49 03 56 03 64
			39 00 00 00 00 00 0D B3 03 74 03 86 03 9B 03 B6 03 D3 03 D8
			39 00 00 00 00 00 11 B4 00 71 00 7B 00 8D 00 9D 00 AD 00 BB 00 C9 00 D5
			39 00 00 00 00 00 11 B5 00 E1 01 0B 01 2D 01 65 01 91 01 D7 02 10 02 12
			39 00 00 00 00 00 11 B6 02 4C 02 90 02 BC 02 F3 03 15 03 45 03 52 03 61
			39 00 00 00 00 00 0D B7 03 71 03 84 03 9A 03 B6 03 D3 03 D8
			39 00 00 00 00 00 11 B8 00 0A 00 1B 00 38 00 52 00 69 00 7E 00 92 00 A3
			39 00 00 00 00 00 11 B9 00 B3 00 E9 01 13 01 54 01 86 01 D1 02 0D 02 0F
			39 00 00 00 00 00 11 BA 02 4A 02 8F 02 BC 02 F6 03 1D 03 58 03 6F 03 8B
			39 01 00 00 00 00 0D BB 03 A4 03 A6 03 A8 03 BB 03 D4 03 D8
			15 00 00 00 00 00 02 FF 21
			15 00 00 00 00 00 02 FB 01
			39 00 00 00 00 00 11 B0 00 AA 00 B1 00 BF 00 CC 00 D8 00 E4 00 EF 00 F9
			39 00 00 00 00 00 11 B1 01 03 01 27 01 45 01 77 01 9F 01 E1 02 19 02 1B
			39 00 00 00 00 00 11 B2 02 54 02 97 02 C3 02 F8 03 1B 03 49 03 56 03 64
			39 00 00 00 00 00 0D B3 03 74 03 86 03 9B 03 B6 03 D3 03 D8
			39 00 00 00 00 00 11 B4 00 71 00 7B 00 8D 00 9D 00 AD 00 BB 00 C9 00 D5
			39 00 00 00 00 00 11 B5 00 E1 01 0B 01 2D 01 65 01 91 01 D7 02 10 02 12
			39 00 00 00 00 00 11 B6 02 4C 02 90 02 BC 02 F3 03 15 03 45 03 52 03 61
			39 00 00 00 00 00 0D B7 03 71 03 84 03 9A 03 B6 03 D3 03 D8
			39 00 00 00 00 00 11 B8 00 0A 00 1B 00 38 00 52 00 69 00 7E 00 92 00 A3
			39 00 00 00 00 00 11 B9 00 B3 00 E9 01 13 01 54 01 86 01 D1 02 0D 02 0F
			39 00 00 00 00 00 11 BA 02 4A 02 8F 02 BC 02 F6 03 1D 03 58 03 6F 03 8B
			39 00 00 00 00 00 0D BB 03 A4 03 A6 03 A8 03 BB 03 D4 03 D8
			15 01 00 00 00 00 02 FF 10
		];
		qcom,mdss-dsi-gamma21-command = [
			15 00 00 00 00 00 02 FF 20
			15 00 00 00 00 00 02 FB 01
			39 00 00 00 00 00 11 B0 01 57 01 5A 01 5F 01 64 01 6A 01 6F 01 74 01 78
			39 00 00 00 00 00 11 B1 01 7D 01 8F 01 A0 01 BE 01 D9 02 09 02 39 02 3A
			39 00 00 00 00 00 11 B2 02 6E 02 AF 02 D9 03 0A 03 2F 03 5E 03 6B 03 74
			39 00 00 00 00 00 0D B3 03 80 03 90 03 A4 03 BC 03 D3 03 D7
			39 00 00 00 00 00 11 B4 00 09 00 19 00 33 00 4C 00 63 00 77 00 8A 00 9A
			39 00 00 00 00 00 11 B5 00 AA 00 DF 01 0A 01 4A 01 7D 01 CA 02 07 02 08
			39 00 00 00 00 00 11 B6 02 44 02 8A 02 B7 02 EE 03 0E 03 42 03 4F 03 5E
			39 00 00 00 00 00 0D B7 03 6B 03 7F 03 97 03 B2 03 D1 03 D7
			39 00 00 00 00 00 11 B8 00 E0 00 E6 00 F0 00 FA 01 04 01 0D 01 16 01 1E
			39 00 00 00 00 00 11 B9 01 26 01 43 01 5D 01 88 01 AD 01 EA 02 1F 02 20
			39 00 00 00 00 00 11 BA 02 58 02 9C 02 C9 02 FF 03 28 03 66 03 7E 03 AC
			39 01 00 00 00 00 0D BB 03 C7 03 CA 03 CC 03 CE 03 D3 03 D7
			15 00 00 00 00 00 02 FF 21
			15 00 00 00 00 00 02 FB 01
			39 00 00 00 00 00 11 B0 01 57 01 5A 01 5F 01 64 01 6A 01 6F 01 74 01 78
			39 00 00 00 00 00 11 B1 01 7D 01 8F 01 A0 01 BE 01 D9 02 09 02 39 02 3A
			39 00 00 00 00 00 11 B2 02 6E 02 AF 02 D9 03 0A 03 2F 03 5E 03 6B 03 74
			39 00 00 00 00 00 0D B3 03 80 03 90 03 A4 03 BC 03 D3 03 D7
			39 00 00 00 00 00 11 B4 00 09 00 19 00 33 00 4C 00 63 00 77 00 8A 00 9A
			39 00 00 00 00 00 11 B5 00 AA 00 DF 01 0A 01 4A 01 7D 01 CA 02 07 02 08
			39 00 00 00 00 00 11 B6 02 44 02 8A 02 B7 02 EE 03 0E 03 42 03 4F 03 5E
			39 00 00 00 00 00 0D B7 03 6B 03 7F 03 97 03 B2 03 D1 03 D7
			39 00 00 00 00 00 11 B8 00 E0 00 E6 00 F0 00 FA 01 04 01 0D 01 16 01 1E
			39 00 00 00 00 00 11 B9 01 26 01 43 01 5D 01 88 01 AD 01 EA 02 1F 02 20
			39 00 00 00 00 00 11 BA 02 58 02 9C 02 C9 02 FF 03 28 03 66 03 7E 03 AC
			39 00 00 00 00 00 0D BB 03 C7 03 CA 03 CC 03 CE 03 D3 03 D7
			15 01 00 00 00 00 02 FF 10
		];
		qcom,mdss-dsi-gamma22-command = [
			15 00 00 00 00 00 02 FF 20
			15 00 00 00 00 00 02 FB 01
			39 00 00 00 00 00 11 B0 01 3E 01 41 01 48 01 4E 01 54 01 5A 01 60 01 66
			39 00 00 00 00 00 11 B1 01 6B 01 80 01 93 01 B4 01 D2 02 05 02 36 02 38
			39 00 00 00 00 00 11 B2 02 6C 02 AC 02 D6 03 06 03 2C 03 58 03 65 03 6F
			39 00 00 00 00 00 0D B3 03 7E 03 8F 03 A3 03 BB 03 D3 03 D7
			39 00 00 00 00 00 11 B4 00 09 00 19 00 37 00 4F 00 65 00 7A 00 8C 00 9F
			39 00 00 00 00 00 11 B5 00 AF 00 E5 01 0F 01 51 01 84 01 D0 02 0C 02 10
			39 00 00 00 00 00 11 B6 02 4A 02 8D 02 BA 02 F0 03 10 03 43 03 51 03 5F
			39 00 00 00 00 00 0D B7 03 6F 03 82 03 98 03 B3 03 D1 03 D7
			39 00 00 00 00 00 11 B8 00 8F 00 97 00 A9 00 B8 00 C6 00 D4 00 E0 00 ED
			39 00 00 00 00 00 11 B9 00 F8 01 1F 01 3F 01 74 01 9F 01 E2 02 1A 02 1D
			39 00 00 00 00 00 11 BA 02 55 02 98 02 C5 02 FB 03 25 03 60 03 79 03 9D
			39 01 00 00 00 00 0D BB 03 CC 03 CE 03 D0 03 D2 03 D4 03 D7
			15 00 00 00 00 00 02 FF 21
			15 00 00 00 00 00 02 FB 01
			39 00 00 00 00 00 11 B0 01 3E 01 41 01 48 01 4E 01 54 01 5A 01 60 01 66
			39 00 00 00 00 00 11 B1 01 6B 01 80 01 93 01 B4 01 D2 02 05 02 36 02 38
			39 00 00 00 00 00 11 B2 02 6C 02 AC 02 D6 03 06 03 2C 03 58 03 65 03 6F
			39 00 00 00 00 00 0D B3 03 7E 03 8F 03 A3 03 BB 03 D3 03 D7
			39 00 00 00 00 00 11 B4 00 09 00 19 00 37 00 4F 00 65 00 7A 00 8C 00 9F
			39 00 00 00 00 00 11 B5 00 AF 00 E5 01 0F 01 51 01 84 01 D0 02 0C 02 10
			39 00 00 00 00 00 11 B6 02 4A 02 8D 02 BA 02 F0 03 10 03 43 03 51 03 5F
			39 00 00 00 00 00 0D B7 03 6F 03 82 03 98 03 B3 03 D1 03 D7
			39 00 00 00 00 00 11 B8 00 8F 00 97 00 A9 00 B8 00 C6 00 D4 00 E0 00 ED
			39 00 00 00 00 00 11 B9 00 F8 01 1F 01 3F 01 74 01 9F 01 E2 02 1A 02 1D
			39 00 00 00 00 00 11 BA 02 55 02 98 02 C5 02 FB 03 25 03 60 03 79 03 9D
			39 00 00 00 00 00 0D BB 03 CC 03 CE 03 D0 03 D2 03 D4 03 D7
			15 01 00 00 00 00 02 FF 10
		];
		qcom,mdss-dsi-gamma23-command = [
			15 00 00 00 00 00 02 FF 20
			15 00 00 00 00 00 02 FB 01
			39 00 00 00 00 00 11 B0 00 FD 01 02 01 0B 01 14 01 1D 01 25 01 2D 01 35
			39 00 00 00 00 00 11 B1 01 3C 01 57 01 6F 01 98 01 BB 01 F5 02 2A 02 2C
			39 00 00 00 00 00 11 B2 02 63 02 A4 02 CF 03 03 03 27 03 52 03 5E 03 6C
			39 00 00 00 00 00 0D B3 03 7B 03 8B 03 9F 03 B7 03 D2 03 D7
			39 00 00 00 00 00 11 B4 00 65 00 6F 00 83 00 95 00 A5 00 B5 00 C3 00 D0
			39 00 00 00 00 00 11 B5 00 DD 01 09 01 2D 01 67 01 94 01 DB 02 15 02 17
			39 00 00 00 00 00 11 B6 02 51 02 94 02 C0 02 F7 03 19 03 48 03 55 03 63
			39 00 00 00 00 00 0D B7 03 73 03 85 03 9A 03 B5 03 D1 03 D7
			39 00 00 00 00 00 11 B8 00 0B 00 1E 00 3C 00 55 00 6B 00 80 00 93 00 A4
			39 00 00 00 00 00 11 B9 00 B4 00 EB 01 16 01 59 01 8A 01 D6 02 12 02 14
			39 00 00 00 00 00 11 BA 02 4F 02 93 02 C0 02 FA 03 21 03 59 03 6D 03 84
			39 01 00 00 00 00 0D BB 03 99 03 9E 03 A0 03 B9 03 D3 03 D7
			15 00 00 00 00 00 02 FF 21
			15 00 00 00 00 00 02 FB 01
			39 00 00 00 00 00 11 B0 00 FD 01 02 01 0B 01 14 01 1D 01 25 01 2D 01 35
			39 00 00 00 00 00 11 B1 01 3C 01 57 01 6F 01 98 01 BB 01 F5 02 2A 02 2C
			39 00 00 00 00 00 11 B2 02 63 02 A4 02 CF 03 03 03 27 03 52 03 5E 03 6C
			39 00 00 00 00 00 0D B3 03 7B 03 8B 03 9F 03 B7 03 D2 03 D7
			39 00 00 00 00 00 11 B4 00 65 00 6F 00 83 00 95 00 A5 00 B5 00 C3 00 D0
			39 00 00 00 00 00 11 B5 00 DD 01 09 01 2D 01 67 01 94 01 DB 02 15 02 17
			39 00 00 00 00 00 11 B6 02 51 02 94 02 C0 02 F7 03 19 03 48 03 55 03 63
			39 00 00 00 00 00 0D B7 03 73 03 85 03 9A 03 B5 03 D1 03 D7
			39 00 00 00 00 00 11 B8 00 0B 00 1E 00 3C 00 55 00 6B 00 80 00 93 00 A4
			39 00 00 00 00 00 11 B9 00 B4 00 EB 01 16 01 59 01 8A 01 D6 02 12 02 14
			39 00 00 00 00 00 11 BA 02 4F 02 93 02 C0 02 FA 03 21 03 59 03 6D 03 84
			39 00 00 00 00 00 0D BB 03 99 03 9E 03 A0 03 B9 03 D3 03 D7
			15 01 00 00 00 00 02 FF 10
		];
		qcom,mdss-dsi-gamma24-command = [
			15 00 00 00 00 00 02 FF 20
			15 00 00 00 00 00 02 FB 01
			39 00 00 00 00 00 11 B0 00 FD 01 02 01 0B 01 14 01 1D 01 25 01 2D 01 35
			39 00 00 00 00 00 11 B1 01 3C 01 57 01 6F 01 98 01 BB 01 F5 02 2A 02 2C
			39 00 00 00 00 00 11 B2 02 63 02 A4 02 CF 03 03 03 27 03 52 03 5E 03 6C
			39 00 00 00 00 00 0D B3 03 7B 03 8B 03 9F 03 B7 03 D2 03 D7
			39 00 00 00 00 00 11 B4 00 65 00 6F 00 83 00 95 00 A5 00 B5 00 C3 00 D0
			39 00 00 00 00 00 11 B5 00 DD 01 09 01 2D 01 67 01 94 01 DB 02 15 02 17
			39 00 00 00 00 00 11 B6 02 51 02 94 02 C0 02 F7 03 19 03 48 03 55 03 63
			39 00 00 00 00 00 0D B7 03 73 03 85 03 9A 03 B5 03 D1 03 D7
			39 00 00 00 00 00 11 B8 00 0B 00 1E 00 3C 00 55 00 6B 00 80 00 93 00 A4
			39 00 00 00 00 00 11 B9 00 B4 00 EB 01 16 01 59 01 8A 01 D6 02 12 02 14
			39 00 00 00 00 00 11 BA 02 4F 02 93 02 C0 02 FA 03 21 03 59 03 6D 03 84
			39 01 00 00 00 00 0D BB 03 99 03 9E 03 A0 03 B9 03 D3 03 D7
			15 00 00 00 00 00 02 FF 21
			15 00 00 00 00 00 02 FB 01
			39 00 00 00 00 00 11 B0 00 FD 01 02 01 0B 01 14 01 1D 01 25 01 2D 01 35
			39 00 00 00 00 00 11 B1 01 3C 01 57 01 6F 01 98 01 BB 01 F5 02 2A 02 2C
			39 00 00 00 00 00 11 B2 02 63 02 A4 02 CF 03 03 03 27 03 52 03 5E 03 6C
			39 00 00 00 00 00 0D B3 03 7B 03 8B 03 9F 03 B7 03 D2 03 D7
			39 00 00 00 00 00 11 B4 00 65 00 6F 00 83 00 95 00 A5 00 B5 00 C3 00 D0
			39 00 00 00 00 00 11 B5 00 DD 01 09 01 2D 01 67 01 94 01 DB 02 15 02 17
			39 00 00 00 00 00 11 B6 02 51 02 94 02 C0 02 F7 03 19 03 48 03 55 03 63
			39 00 00 00 00 00 0D B7 03 73 03 85 03 9A 03 B5 03 D1 03 D7
			39 00 00 00 00 00 11 B8 00 0B 00 1E 00 3C 00 55 00 6B 00 80 00 93 00 A4
			39 00 00 00 00 00 11 B9 00 B4 00 EB 01 16 01 59 01 8A 01 D6 02 12 02 14
			39 00 00 00 00 00 11 BA 02 4F 02 93 02 C0 02 FA 03 21 03 59 03 6D 03 84
			39 00 00 00 00 00 0D BB 03 99 03 9E 03 A0 03 B9 03 D3 03 D7
			15 01 00 00 00 00 02 FF 10
		];


		qcom,mdss-dsi-on-command-state = "dsi_lp_mode";
		qcom,mdss-dsi-off-command-state = "dsi_hs_mode";
		qcom,mdss-dsi-ce-on-command-state = "dsi_hs_mode";
		qcom,mdss-dsi-ce-off-command-state = "dsi_hs_mode";
		qcom,mdss-dsi-srgb-on-command-state = "dsi_hs_mode";
		qcom,mdss-dsi-srgb-off-command-state = "dsi_hs_mode";
		qcom,mdss-dsi-cabc-on-command-state = "dsi_hs_mode";
		qcom,mdss-dsi-cabc-off-command-state = "dsi_hs_mode";
		qcom,mdss-dsi-gamma-command-state = "dsi_hs_mode";
		qcom,mdss-dsi-bl-pmic-control-type = "bl_ctrl_wled";
		qcom,mdss-dsi-reset-sequence = <1 1>, <0 5>, <1 15>;
		qcom,mdss-dsi-tx-eot-append;
		qcom,mdss-dsi-post-init-delay = <1>;

		qcom,esd-check-enabled;
		qcom,mdss-dsi-panel-status-command = [06 01 00 01 05 00 01 0A];
		qcom,mdss-dsi-panel-status-command-state = "dsi_hs_mode";
		qcom,mdss-dsi-panel-status-check-mode = "reg_read";
		qcom,mdss-dsi-panel-status-read-length = <1>;
		qcom,mdss-dsi-panel-status-value = <0x9c>;
		qcom,mdss-dsi-panel-max-error-count = <3>;
	};
};
