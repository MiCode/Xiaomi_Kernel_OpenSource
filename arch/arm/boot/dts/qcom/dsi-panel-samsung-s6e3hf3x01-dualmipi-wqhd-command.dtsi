/* Copyright (c) 2014-2015, The Linux Foundation. All rights reserved.
 *
 * This program is free software; you can redistribute it and/or modify
 * it under the terms of the GNU General Public License version 2 and
 * only version 2 as published by the Free Software Foundation.
 *
 * This program is distributed in the hope that it will be useful,
 * but WITHOUT ANY WARRANTY; without even the implied warranty of
 * MERCHANTABILITY or FITNESS FOR A PARTICULAR PURPOSE.  See the
 * GNU General Public License for more details.
 */

&mdss_mdp {
	dsi_dual_samsung_s6e3hf3x01_command: qcom,mdss_dsi_samsung_Qhd_command {
		qcom,mdss-dsi-panel-name = "dual samsung Qhd command mode dsi panel";
		qcom,mdss-dsi-panel-id = <10>;
		qcom,mdss-dsi-panel-sleepwrmod = <0>;
		qcom,mdss-dsi-panel-type = "dsi_cmd_mode";
		qcom,mdss-dsi-panel-framerate = <60>;
		qcom,mdss-dsi-virtual-channel-id = <0>;
		qcom,mdss-dsi-stream = <0>;
		qcom,mdss-dsi-panel-width = <720>;
		qcom,mdss-dsi-panel-height = <2560>;
		qcom,mdss-dsi-h-front-porch = <120>;
		qcom,mdss-dsi-h-back-porch = <32>;
		qcom,mdss-dsi-h-pulse-width = <16>;
		qcom,mdss-dsi-h-sync-skew = <0>;
		qcom,mdss-dsi-v-back-porch = <11>;
		qcom,mdss-dsi-v-front-porch = <8>;
		qcom,mdss-dsi-v-pulse-width = <1>;
		qcom,mdss-dsi-h-left-border = <0>;
		qcom,mdss-dsi-h-right-border = <0>;
		qcom,mdss-dsi-v-top-border = <0>;
		qcom,mdss-dsi-v-bottom-border = <0>;
		qcom,mdss-dsi-bpp = <24>;
		qcom,mdss-dsi-underflow-color = <0xff>;
		qcom,mdss-dsi-border-color = <0>;
		qcom,mdss-dsi-on-command = [
			05 01 00 00 05 00 02 11 00
			29 00 00 00 00 00 03 F0 5A 5A
			23 00 00 00 00 00 02 C4 03
			23 01 00 00 00 00 02 F9 03
			29 01 00 00 00 00 14 C2 00 00 D8 D8 00 80 2B 05 08 0E 07 0B 05 0D 0A 15 13 20 1E
			29 01 00 00 78 00 03 F0 A5 A5
			05 00 00 00 00 00 02 35 00
			29 00 00 00 00 00 03 F0 5A 5A
			23 00 00 00 00 00 02 ED 44
			29 00 00 00 00 00 03 F0 A5 A5
			23 00 00 00 00 00 02 53 28
			23 00 00 00 00 00 02 51 64
			23 00 00 00 00 00 02 55 02
			05 01 00 00 14 00 02 29 00];
		qcom,mdss-dsi-off-command = [
			05 01 00 00 14 00 02 28 00
			05 01 00 00 78 00 02 10 00];
		qcom,mdss-dsi-on-command-state = "dsi_lp_mode";
		qcom,mdss-dsi-off-command-state = "dsi_hs_mode";
		qcom,mdss-dsi-h-sync-pulse = <0>;
		qcom,mdss-dsi-traffic-mode = "non_burst_sync_event";
		qcom,mdss-dsi-bllp-eof-power-mode;
		qcom,mdss-dsi-bllp-power-mode;
		qcom,mdss-dsi-lane-0-state;
		qcom,mdss-dsi-lane-1-state;
		qcom,mdss-dsi-lane-2-state;
		qcom,mdss-dsi-lane-3-state;
		qcom,cmd-sync-wait-broadcast;
		qcom,mdss-dsi-panel-timings = [D6 46 30 00 A4 A3 2D 49 36 03 04 00];
		qcom,mdss-dsi-t-clk-post = <0x2C>;
		qcom,mdss-dsi-t-clk-pre = <0x1C>;
		qcom,mdss-dsi-bl-min-level = <1>;
		qcom,mdss-dsi-bl-max-level = <255>;
		qcom,mdss-dsi-dma-trigger = "trigger_sw";
		qcom,mdss-dsi-mdp-trigger = "none";
		qcom,mdss-dsi-bl-pmic-control-type = "bl_ctrl_dcs";
		qcom,mdss-dsi-bl-pmic-pwm-frequency = <50>;
		qcom,mdss-dsi-bl-pmic-bank-select = <2>;
		qcom,mdss-dsi-reset-sequence = <1 2>, <0 5>, <1 10>;
		qcom,mdss-pan-physical-width-dimension = <83>;
		qcom,mdss-pan-physical-height-dimension = <133>;
		qcom,mdss-dsi-te-pin-select = <1>;
		qcom,mdss-dsi-wr-mem-start = <0x2c>;
		qcom,mdss-dsi-wr-mem-continue = <0x3c>;
		qcom,mdss-dsi-te-dcs-command = <1>;
		qcom,mdss-dsi-te-check-enable;
		qcom,mdss-dsi-te-using-te-pin;
		qcom,ulps-enabled;
		qcom,dispparam-enabled;
		qcom,mdss-dsi-min-refresh-rate = <50>;
		qcom,mdss-dsi-max-refresh-rate = <60>;
		qcom,mdss-dsi-panel-status-check-mode = "bta_check";
		qcom,mdss-dsi-tx-eot-append;
		qcom,mdss-dsi-lp11-init;
		qcom,panel-supply-entries = <&dsi_panel_pwr_supply_amoled>;

		qcom,mdss-dsi-panel-timings-8996 = [
			23 20 06 09 05 03 04 a0
			23 20 06 09 05 03 04 a0
			23 20 06 09 05 03 04 a0
			23 20 06 09 05 03 04 a0
			23 2e 06 08 05 03 04 a0];

		qcom,config-select = <&dsi_dual_samsung_command_config0>;

		dsi_dual_samsung_command_config0: config0 {
			qcom,split-mode = "dualctl-split";
		};

		dsi_dual_samsung_command_config1: config1 {
			qcom,split-mode = "pingpong-split";
		};

	};
};
