/* Copyright (c) 2017, The Linux Foundation. All rights reserved.
 * Copyright (C) 2019 XiaoMi, Inc.
 *
 * This program is free software; you can redistribute it and/or modify
 * it under the terms of the GNU General Public License version 2 and
 * only version 2 as published by the Free Software Foundation.
 *
 * This program is distributed in the hope that it will be useful,
 * but WITHOUT ANY WARRANTY; without even the implied warranty of
 * MERCHANTABILITY or FITNESS FOR A PARTICULAR PURPOSE.  See the
 * GNU General Public License for more details.
 */

&mdss_mdp {
	dsi_nt36672a_e7t_tianma_fhdplus_video: qcom,mdss_dsi_nt36672a_e7t_tianma_fhdplus_video {
		qcom,mdss-dsi-panel-name = "tianma nt36672a fhdplus video mode dsi panel";
		qcom,mdss-dsi-panel-controller = <&mdss_dsi0>;
		qcom,mdss-dsi-panel-type = "dsi_video_mode";
		qcom,mdss-dsi-panel-framerate = <60>;
		qcom,mdss-dsi-virtual-channel-id = <0>;
		qcom,mdss-dsi-stream = <0>;
		qcom,mdss-dsi-panel-width = <1080>;
		qcom,mdss-dsi-panel-height = <2280>;
		qcom,mdss-pan-physical-width-dimension = <68>;
		qcom,mdss-pan-physical-height-dimension = <143>;
		qcom,mdss-dsi-h-front-porch = <100>;
		qcom,mdss-dsi-h-back-porch = <120>;
		qcom,mdss-dsi-h-pulse-width = <28>;
		qcom,mdss-dsi-h-sync-skew = <0>;
		qcom,mdss-dsi-v-back-porch = <8>;
		qcom,mdss-dsi-v-front-porch = <10>;
		qcom,mdss-dsi-v-pulse-width = <3>;
		qcom,mdss-dsi-h-left-border = <0>;
		qcom,mdss-dsi-h-right-border = <0>;
		qcom,mdss-dsi-v-top-border = <0>;
		qcom,mdss-dsi-v-bottom-border = <0>;
		qcom,mdss-dsi-bpp = <24>;
		qcom,mdss-dsi-underflow-color = <0xff>;
		qcom,mdss-dsi-border-color = <0>;
		qcom,mdss-dsi-h-sync-pulse = <0>;
		qcom,mdss-dsi-traffic-mode = "burst_mode";
		qcom,mdss-dsi-bllp-eof-power-mode;
		qcom,mdss-dsi-bllp-power-mode;
		qcom,mdss-dsi-lane-0-state;
		qcom,mdss-dsi-lane-1-state;
		qcom,mdss-dsi-lane-2-state;
		qcom,mdss-dsi-lane-3-state;
		qcom,mdss-dsi-panel-timings = [fe 3c 2a 00 70 74 2e
				40 30 03 04 00];
		qcom,mdss-dsi-t-clk-post = <0x0f>;
		qcom,mdss-dsi-t-clk-pre = <0x37>;
		qcom,mdss-dsi-bl-min-level = <1>;
		qcom,mdss-dsi-bl-max-level = <4095>;
		qcom,mdss-brightness-max-level = <4095>;
		qcom,mdss-dsi-dma-trigger = "trigger_sw";
		qcom,mdss-dsi-mdp-trigger = "none";
	/*
	 * reg35: enable te output,te signal polarity,te signal active lines within a frame
	 * regff: page select
	 * reg51: bl set(8 or 12 bits)
	 * reg53: bl pwm duty, dimming, bl work
	 * reg55: image enhancement select,cabc mode
	 */
		qcom,mdss-dsi-on-command = [
				15 01 00 00 00 00 02 ff 25
				15 01 00 00 00 00 02 fb 01
				15 01 00 00 00 00 02 18 96
				15 01 00 00 00 00 02 05 04
				15 01 00 00 00 00 02 ff 20
				15 01 00 00 00 00 02 fb 01
				15 01 00 00 00 00 02 78 01
				15 01 00 00 00 00 02 ff 24
				15 01 00 00 00 00 02 fb 01
				15 01 00 00 00 00 02 82 13
				15 01 00 00 00 00 02 84 31
				15 01 00 00 00 00 02 88 13
				15 01 00 00 00 00 02 8a 31
				15 01 00 00 00 00 02 8e e4
				15 01 00 00 00 00 02 8f 01
				15 01 00 00 00 00 02 90 80
				15 01 00 00 00 00 02 ff 26
				15 01 00 00 00 00 02 fb 01
				15 01 00 00 00 00 02 a9 12
				15 01 00 00 00 00 02 aa 10
				15 01 00 00 00 00 02 ae 8a
				15 01 00 00 00 00 02 ff 10
				15 01 00 00 50 00 02 11 00
				15 01 00 00 00 00 02 b0 01
				15 01 00 00 00 00 02 35 00
				15 01 00 00 00 00 02 51 ff
				15 01 00 00 00 00 02 53 2c
				15 01 00 00 00 00 02 55 00
				15 01 00 00 00 00 02 29 00
				];
				qcom,mdss-dsi-off-command = [
				15 01 00 00 14 00 02 28 00
				15 01 00 00 78 00 02 10 00
				];
		qcom,mdss-dsi-ce-on-command = [
				15 01 00 00 00 00 02 FF 22
				15 00 00 00 00 00 02 FB 01
				15 00 00 00 00 00 02 00 40
				15 00 00 00 00 00 02 01 40
				15 00 00 00 00 00 02 02 40
				15 00 00 00 00 00 02 03 40
				15 00 00 00 00 00 02 04 40
				15 00 00 00 00 00 02 05 40
				15 00 00 00 00 00 02 06 40
				15 00 00 00 00 00 02 07 40
				15 00 00 00 00 00 02 08 40
				15 00 00 00 00 00 02 09 40
				15 00 00 00 00 00 02 0A 40
				15 00 00 00 00 00 02 0B 40
				15 00 00 00 00 00 02 0C 40
				15 00 00 00 00 00 02 0D 40
				15 00 00 00 00 00 02 0E 40
				15 00 00 00 00 00 02 0F 40
				15 00 00 00 00 00 02 10 40
				15 00 00 00 00 00 02 11 50
				15 00 00 00 00 00 02 12 60
				15 00 00 00 00 00 02 13 70
				15 01 00 00 00 00 02 14 58
				15 00 00 00 00 00 02 15 68
				15 00 00 00 00 00 02 16 78
				15 00 00 00 00 00 02 17 77
				15 00 00 00 00 00 02 18 3E
				15 00 00 00 00 00 02 19 36
				15 00 00 00 00 00 02 1A 30
				15 00 00 00 00 00 02 1B 28
				15 00 00 00 00 00 02 1C 25
				15 00 00 00 00 00 02 1D 23
				15 00 00 00 00 00 02 1E 26
				15 00 00 00 00 00 02 1F 2A
				15 00 00 00 00 00 02 20 30
				15 00 00 00 00 00 02 21 36
				15 00 00 00 00 00 02 22 3C
				15 00 00 00 00 00 02 23 40
				15 00 00 00 00 00 02 24 40
				15 00 00 00 00 00 02 25 40
				15 00 00 00 00 00 02 26 40
				15 00 00 00 00 00 02 27 40
				15 01 00 00 00 00 02 28 40
				15 00 00 00 00 00 02 2D 00
				15 00 00 00 00 00 02 2F 40
				15 00 00 00 00 00 02 30 40
				15 00 00 00 00 00 02 31 40
				15 00 00 00 00 00 02 32 40
				15 00 00 00 00 00 02 33 40
				15 00 00 00 00 00 02 34 40
				15 00 00 00 00 00 02 35 40
				15 00 00 00 00 00 02 36 40
				15 00 00 00 00 00 02 37 40
				15 00 00 00 00 00 02 38 40
				15 00 00 00 00 00 02 39 40
				15 00 00 00 00 00 02 3A 40
				15 00 00 00 00 00 02 3B 40
				15 00 00 00 00 00 02 3D 40
				15 00 00 00 00 00 02 3F 40
				15 01 00 00 00 00 02 40 40
				15 00 00 00 00 00 02 41 40
				15 00 00 00 00 00 02 42 40
				15 00 00 00 00 00 02 43 40
				15 00 00 00 00 00 02 44 40
				15 00 00 00 00 00 02 45 40
				15 00 00 00 00 00 02 46 40
				15 00 00 00 00 00 02 47 40
				15 00 00 00 00 00 02 48 40
				15 00 00 00 00 00 02 49 40
				15 00 00 00 00 00 02 4A 40
				15 00 00 00 00 00 02 4B 40
				15 00 00 00 00 00 02 4C 40
				15 00 00 00 00 00 02 4D 40
				15 00 00 00 00 00 02 4E 40
				15 00 00 00 00 00 02 4F 40
				15 00 00 00 00 00 02 50 40
				15 00 00 00 00 00 02 51 40
				15 01 00 00 00 00 02 52 40
				15 00 00 00 00 00 02 53 01
				15 00 00 00 00 00 02 54 01
				15 00 00 00 00 00 02 55 FF
				15 00 00 00 00 00 02 56 76
				15 00 00 00 00 00 02 58 C8
				15 00 00 00 00 00 02 59 CA
				15 00 00 00 00 00 02 5A 48
				15 00 00 00 00 00 02 5B 48
				15 00 00 00 00 00 02 5C 48
				15 00 00 00 00 00 02 5D 48
				15 00 00 00 00 00 02 5E 48
				15 00 00 00 00 00 02 5F 48
				15 00 00 00 00 00 02 60 48
				15 00 00 00 00 00 02 61 48
				15 00 00 00 00 00 02 62 48
				15 00 00 00 00 00 02 63 48
				15 00 00 00 00 00 02 64 48
				15 01 00 00 00 00 02 65 48
				15 00 00 00 00 00 02 66 48
				15 00 00 00 00 00 02 67 48
				15 00 00 00 00 00 02 68 48
				15 00 00 00 00 00 02 69 48
				15 00 00 00 00 00 02 6A 48
				15 00 00 00 00 00 02 6B 48
				15 00 00 00 00 00 02 6C 48
				15 00 00 00 00 00 02 6D 48
				15 00 00 00 00 00 02 6E 48
				15 00 00 00 00 00 02 6F C8
				15 00 00 00 00 00 02 70 03
				15 00 00 00 00 00 02 71 00
				15 00 00 00 00 00 02 72 80
				15 00 00 00 00 00 02 73 00
				15 00 00 00 00 00 02 74 06
				15 00 00 00 00 00 02 75 0C
				15 00 00 00 00 00 02 76 03
				15 00 00 00 00 00 02 77 09
				15 01 00 00 00 00 02 78 0F
				15 00 00 00 00 00 02 79 68
				15 00 00 00 00 00 02 7A 8B
				15 00 00 00 00 00 02 7C 80
				15 00 00 00 00 00 02 7D 80
				15 00 00 00 00 00 02 7E 80
				15 00 00 00 00 00 02 7F 00
				15 00 00 00 00 00 02 80 00
				15 00 00 00 00 00 02 81 00
				15 00 00 00 00 00 02 83 01
				15 00 00 00 00 00 02 84 00
				15 00 00 00 00 00 02 85 80
				15 00 00 00 00 00 02 86 80
				15 00 00 00 00 00 02 87 80
				15 00 00 00 00 00 02 88 40
				15 00 00 00 00 00 02 89 83
				15 00 00 00 00 00 02 8A 86
				15 00 00 00 00 00 02 8B 80
				15 01 00 00 00 00 02 8C 80
				15 00 00 00 00 00 02 8D 80
				15 00 00 00 00 00 02 8E 80
				15 00 00 00 00 00 02 8F 80
				15 00 00 00 00 00 02 90 80
				15 00 00 00 00 00 02 91 80
				15 00 00 00 00 00 02 92 80
				15 00 00 00 00 00 02 93 80
				15 00 00 00 00 00 02 94 80
				15 00 00 00 00 00 02 95 80
				15 00 00 00 00 00 02 96 80
				15 00 00 00 00 00 02 97 80
				15 00 00 00 00 00 02 98 80
				15 00 00 00 00 00 02 99 80
				15 00 00 00 00 00 02 9A 80
				15 00 00 00 00 00 02 9B 80
				15 00 00 00 00 00 02 9C 80
				15 00 00 00 00 00 02 9D 80
				15 00 00 00 00 00 02 9E 80
				15 00 00 00 00 00 02 9F 80
				15 01 00 00 00 00 02 A0 80
				15 00 00 00 00 00 02 A2 80
				15 00 00 00 00 00 02 A6 80
				15 00 00 00 00 00 02 A7 80
				15 00 00 00 00 00 02 A9 80
				15 00 00 00 00 00 02 AA 80
				15 00 00 00 00 00 02 AB 80
				15 00 00 00 00 00 02 AC 80
				15 00 00 00 00 00 02 AD 80
				15 00 00 00 00 00 02 AE 80
				15 00 00 00 00 00 02 AF 80
				15 00 00 00 00 00 02 B7 76
				15 00 00 00 00 00 02 B8 76
				15 00 00 00 00 00 02 B9 01
				15 00 00 00 00 00 02 BA 0D
				15 00 00 00 00 00 02 BB 14
				15 00 00 00 00 00 02 BC 0F
				15 00 00 00 00 00 02 BD 18
				15 00 00 00 00 00 02 BE 1F
				15 01 00 00 00 00 02 BF 02
				15 00 00 00 00 00 02 C0 0D
				15 00 00 00 00 00 02 C1 14
				15 00 00 00 00 00 02 C2 03
				15 00 00 00 00 00 02 C3 07
				15 00 00 00 00 00 02 C4 0A
				15 00 00 00 00 00 02 C5 A0
				15 00 00 00 00 00 02 C6 55
				15 00 00 00 00 00 02 C7 3A
				15 00 00 00 00 00 02 C8 01
				15 00 00 00 00 00 02 C9 02
				15 00 00 00 00 00 02 CA 12
				15 00 00 00 00 00 02 CD 80
				15 00 00 00 00 00 02 DB 80
				15 00 00 00 00 00 02 DC 80
				15 00 00 00 00 00 02 DD 80
				15 00 00 00 00 00 02 E0 80
				15 01 00 00 00 00 02 E1 80
				15 00 00 00 00 00 02 E2 80
				15 00 00 00 00 00 02 E3 80
				15 00 00 00 00 00 02 E4 80
				15 00 00 00 00 00 02 E5 40
				15 00 00 00 00 00 02 E6 40
				15 00 00 00 00 00 02 E7 40
				15 00 00 00 00 00 02 E8 40
				15 00 00 00 00 00 02 E9 40
				15 00 00 00 00 00 02 EA 40
				15 00 00 00 00 00 02 EB 40
				15 00 00 00 00 00 02 EC 40
				15 00 00 00 00 00 02 ED 40
				15 00 00 00 00 00 02 EE 40
				15 00 00 00 00 00 02 EF 40
				15 01 00 00 00 00 02 F0 40
				15 00 00 00 00 00 02 F1 40
				15 00 00 00 00 00 02 F2 40
				15 00 00 00 00 00 02 F3 40
				15 00 00 00 00 00 02 F4 40
				15 00 00 00 00 00 02 F5 40
				15 00 00 00 00 00 02 F6 40

				15 01 00 00 00 00 02 FF 10
				15 01 00 00 00 00 02 55 80
				];
		qcom,mdss-dsi-ce-off-command = [
				15 01 00 00 00 00 02 FF 10
				15 01 00 00 00 00 02 55 00
				];
		qcom,mdss-dsi-srgb-on-command = [
				15 01 00 00 00 00 02 FF 22
				15 00 00 00 00 00 02 FB 01
				15 00 00 00 00 00 02 00 35
				15 00 00 00 00 00 02 01 35
				15 00 00 00 00 00 02 02 35
				15 00 00 00 00 00 02 03 35
				15 00 00 00 00 00 02 04 34
				15 00 00 00 00 00 02 05 34
				15 00 00 00 00 00 02 06 34
				15 00 00 00 00 00 02 07 34
				15 00 00 00 00 00 02 08 33
				15 00 00 00 00 00 02 09 33
				15 00 00 00 00 00 02 0A 33
				15 00 00 00 00 00 02 0B 33
				15 00 00 00 00 00 02 0C 33
				15 00 00 00 00 00 02 0D 33
				15 00 00 00 00 00 02 0E 33
				15 00 00 00 00 00 02 0F 33
				15 00 00 00 00 00 02 10 32
				15 00 00 00 00 00 02 11 50
				15 00 00 00 00 00 02 12 60
				15 00 00 00 00 00 02 13 70
				15 00 00 00 00 00 02 14 58
				15 00 00 00 00 00 02 15 68
				15 01 00 00 00 00 02 16 78
				15 00 00 00 00 00 02 17 77
				15 00 00 00 00 00 02 18 40
				15 00 00 00 00 00 02 19 40
				15 00 00 00 00 00 02 1A 40
				15 00 00 00 00 00 02 1B 40
				15 00 00 00 00 00 02 1C 40
				15 00 00 00 00 00 02 1D 40
				15 00 00 00 00 00 02 1E 40
				15 00 00 00 00 00 02 1F 40
				15 00 00 00 00 00 02 20 40
				15 00 00 00 00 00 02 21 45
				15 00 00 00 00 00 02 22 49
				15 00 00 00 00 00 02 23 4C
				15 00 00 00 00 00 02 24 4B
				15 00 00 00 00 00 02 25 48
				15 00 00 00 00 00 02 26 44
				15 00 00 00 00 00 02 27 41
				15 00 00 00 00 00 02 28 40
				15 01 00 00 00 00 02 2D 00
				15 00 00 00 00 00 02 2F 37
				15 00 00 00 00 00 02 30 36
				15 00 00 00 00 00 02 31 36
				15 00 00 00 00 00 02 32 36
				15 00 00 00 00 00 02 33 38
				15 00 00 00 00 00 02 34 38
				15 00 00 00 00 00 02 35 36
				15 00 00 00 00 00 02 36 37
				15 00 00 00 00 00 02 37 36
				15 00 00 00 00 00 02 38 37
				15 00 00 00 00 00 02 39 34
				15 00 00 00 00 00 02 3A 34
				15 00 00 00 00 00 02 3B 32
				15 00 00 00 00 00 02 3D 32
				15 00 00 00 00 00 02 3F 30
				15 00 00 00 00 00 02 40 2F
				15 00 00 00 00 00 02 41 2C
				15 00 00 00 00 00 02 42 36
				15 00 00 00 00 00 02 43 36
				15 00 00 00 00 00 02 44 36
				15 00 00 00 00 00 02 45 36
				15 00 00 00 00 00 02 46 35
				15 01 00 00 00 00 02 47 35
				15 00 00 00 00 00 02 48 35
				15 00 00 00 00 00 02 49 35
				15 00 00 00 00 00 02 4A 35
				15 00 00 00 00 00 02 4B 35
				15 00 00 00 00 00 02 4C 35
				15 00 00 00 00 00 02 4D 34
				15 00 00 00 00 00 02 4E 33
				15 00 00 00 00 00 02 4F 33
				15 00 00 00 00 00 02 50 32
				15 00 00 00 00 00 02 51 31
				15 00 00 00 00 00 02 52 30
				15 00 00 00 00 00 02 53 01
				15 00 00 00 00 00 02 54 00
				15 00 00 00 00 00 02 55 FE
				15 00 00 00 00 00 02 56 77
				15 00 00 00 00 00 02 58 41
				15 00 00 00 00 00 02 59 42
				15 00 00 00 00 00 02 5A 43
				15 01 00 00 00 00 02 5B 44
				15 00 00 00 00 00 02 5C 44
				15 00 00 00 00 00 02 5D 45
				15 00 00 00 00 00 02 5E 45
				15 00 00 00 00 00 02 5F 44
				15 00 00 00 00 00 02 60 C3
				15 00 00 00 00 00 02 61 44
				15 00 00 00 00 00 02 62 46
				15 00 00 00 00 00 02 63 47
				15 00 00 00 00 00 02 64 47
				15 00 00 00 00 00 02 65 48
				15 00 00 00 00 00 02 66 4A
				15 00 00 00 00 00 02 67 4C
				15 00 00 00 00 00 02 68 50
				15 00 00 00 00 00 02 69 4D
				15 00 00 00 00 00 02 6A 49
				15 00 00 00 00 00 02 6B 47
				15 00 00 00 00 00 02 6C 47
				15 01 00 00 00 00 02 6D 47
				15 00 00 00 00 00 02 6E 45
				15 00 00 00 00 00 02 6F 44
				15 00 00 00 00 00 02 70 00
				15 00 00 00 00 00 02 71 00
				15 00 00 00 00 00 02 72 01
				15 00 00 00 00 00 02 73 00
				15 00 00 00 00 00 02 74 06
				15 00 00 00 00 00 02 75 0C
				15 00 00 00 00 00 02 76 03
				15 00 00 00 00 00 02 77 09
				15 00 00 00 00 00 02 78 0F
				15 00 00 00 00 00 02 79 68
				15 00 00 00 00 00 02 7A 88
				15 00 00 00 00 00 02 7C 80
				15 00 00 00 00 00 02 7D 80
				15 00 00 00 00 00 02 7E 80
				15 00 00 00 00 00 02 7F 80
				15 01 00 00 00 00 02 80 06
				15 00 00 00 00 00 02 81 00
				15 00 00 00 00 00 02 83 01
				15 00 00 00 00 00 02 84 04
				15 00 00 00 00 00 02 85 5D
				15 00 00 00 00 00 02 86 59
				15 00 00 00 00 00 02 87 63
				15 00 00 00 00 00 02 88 40
				15 00 00 00 00 00 02 89 80
				15 00 00 00 00 00 02 8A 80
				15 00 00 00 00 00 02 8B 80
				15 00 00 00 00 00 02 8C 80
				15 00 00 00 00 00 02 8D 80
				15 00 00 00 00 00 02 8E 80
				15 00 00 00 00 00 02 8F 80
				15 00 00 00 00 00 02 90 80
				15 00 00 00 00 00 02 91 80
				15 00 00 00 00 00 02 92 80
				15 01 00 00 00 00 02 93 80
				15 00 00 00 00 00 02 94 80
				15 00 00 00 00 00 02 95 80
				15 00 00 00 00 00 02 96 80
				15 00 00 00 00 00 02 97 80
				15 00 00 00 00 00 02 98 80
				15 00 00 00 00 00 02 99 80
				15 00 00 00 00 00 02 9A 80
				15 00 00 00 00 00 02 9B 80
				15 00 00 00 00 00 02 9C 80
				15 00 00 00 00 00 02 9D 80
				15 00 00 00 00 00 02 9E 80
				15 00 00 00 00 00 02 9F 80
				15 00 00 00 00 00 02 A0 80
				15 00 00 00 00 00 02 A2 7C
				15 00 00 00 00 00 02 A6 80
				15 00 00 00 00 00 02 A7 80
				15 00 00 00 00 00 02 A9 80
				15 01 00 00 00 00 02 AA 80
				15 00 00 00 00 00 02 AB 80
				15 00 00 00 00 00 02 AC 80
				15 00 00 00 00 00 02 AD 80
				15 00 00 00 00 00 02 AE 80
				15 00 00 00 00 00 02 AF 6F
				15 00 00 00 00 00 02 B7 76
				15 00 00 00 00 00 02 B8 76
				15 00 00 00 00 00 02 B9 05
				15 00 00 00 00 00 02 BA 0D
				15 00 00 00 00 00 02 BB 14
				15 00 00 00 00 00 02 BC 0F
				15 00 00 00 00 00 02 BD 18
				15 00 00 00 00 00 02 BE 1F
				15 00 00 00 00 00 02 BF 05
				15 00 00 00 00 00 02 C0 0D
				15 00 00 00 00 00 02 C1 14
				15 00 00 00 00 00 02 C2 03
				15 00 00 00 00 00 02 C3 07
				15 00 00 00 00 00 02 C4 0A
				15 01 00 00 00 00 02 C5 A0
				15 00 00 00 00 00 02 C6 55
				15 00 00 00 00 00 02 C7 FF
				15 00 00 00 00 00 02 C8 39
				15 00 00 00 00 00 02 C9 44
				15 00 00 00 00 00 02 CA 12
				15 00 00 00 00 00 02 CD 80
				15 00 00 00 00 00 02 DB 70
				15 00 00 00 00 00 02 DC 80
				15 00 00 00 00 00 02 DD 80
				15 00 00 00 00 00 02 E0 7A
				15 00 00 00 00 00 02 E1 7F
				15 00 00 00 00 00 02 E2 80
				15 00 00 00 00 00 02 E3 80
				15 00 00 00 00 00 02 E4 80
				15 00 00 00 00 00 02 E5 40
				15 00 00 00 00 00 02 E6 40
				15 00 00 00 00 00 02 E7 40
				15 01 00 00 00 00 02 E8 40
				15 00 00 00 00 00 02 E9 40
				15 00 00 00 00 00 02 EA 40
				15 00 00 00 00 00 02 EB 40
				15 00 00 00 00 00 02 EC 40
				15 00 00 00 00 00 02 ED 40
				15 00 00 00 00 00 02 EE 40
				15 00 00 00 00 00 02 EF 40
				15 00 00 00 00 00 02 F0 40
				15 00 00 00 00 00 02 F1 40
				15 00 00 00 00 00 02 F2 40
				15 00 00 00 00 00 02 F3 40
				15 00 00 00 00 00 02 F4 40
				15 00 00 00 00 00 02 F5 40
				15 00 00 00 00 00 02 F6 40
				15 01 00 00 00 00 02 FF 10
				15 01 00 00 00 00 02 55 80
				];
		qcom,mdss-dsi-srgb-off-command = [
				15 01 00 00 00 00 02 FF 10
				15 01 00 00 00 00 02 55 00
				];
		qcom,mdss-dsi-cabc-on-command = [
				15 01 00 00 00 00 02 FF 23
				15 01 00 00 00 00 02 FB 01
				15 01 00 00 00 00 02 01 84
				15 01 00 00 00 00 02 04 08
				15 01 00 00 00 00 02 05 2D
				15 01 00 00 00 00 02 06 00
				15 01 00 00 00 00 02 11 01
				15 01 00 00 00 00 02 12 80
				15 01 00 00 00 00 02 15 6D
				15 01 00 00 00 00 02 16 0B
				15 01 00 00 00 00 02 29 0A
				15 01 00 00 00 00 02 30 FF
				15 01 00 00 00 00 02 31 FF
				15 01 00 00 00 00 02 32 FF
				15 01 00 00 00 00 02 33 FF
				15 01 00 00 00 00 02 34 FF
				15 01 00 00 00 00 02 35 FF
				15 01 00 00 00 00 02 36 FF
				15 01 00 00 00 00 02 37 FF
				15 01 00 00 00 00 02 38 FC
				15 01 00 00 00 00 02 39 F8
				15 01 00 00 00 00 02 3A F4
				15 01 00 00 00 00 02 3B F1
				15 01 00 00 00 00 02 3D EE
				15 01 00 00 00 00 02 3F EB
				15 01 00 00 00 00 02 40 E8
				15 01 00 00 00 00 02 41 E5

				15 01 00 00 00 00 02 FF 10
				15 01 00 00 00 00 02 FB 01
				15 01 00 00 00 00 02 51 FF
				15 01 00 00 00 00 02 53 2C
				15 01 00 00 00 00 02 55 01
		];
		qcom,mdss-dsi-cabc-off-command = [
				15 01 00 00 00 00 02 FF 10
				15 01 00 00 00 00 02 FB 01
				15 01 00 00 00 00 02 55 00
		];
		qcom,mdss-dsi-gamma0-command = [
		];
		qcom,mdss-dsi-gamma1-command = [

		];
		qcom,mdss-dsi-gamma2-command = [
		];
		qcom,mdss-dsi-gamma3-command = [

		];
		qcom,mdss-dsi-gamma4-command = [
		];
		qcom,mdss-dsi-gamma5-command = [

		];
		qcom,mdss-dsi-gamma6-command = [

		];
		qcom,mdss-dsi-gamma7-command = [

		];
		qcom,mdss-dsi-gamma8-command = [
		];
		qcom,mdss-dsi-gamma9-command = [

		];
		qcom,mdss-dsi-gamma10-command = [

		];
		qcom,mdss-dsi-gamma11-command = [

		];
		qcom,mdss-dsi-gamma12-command = [

		];
		qcom,mdss-dsi-gamma13-command = [

		];
		qcom,mdss-dsi-gamma14-command = [

		];
		qcom,mdss-dsi-gamma15-command = [

		];
		qcom,mdss-dsi-gamma16-command = [

		];
		qcom,mdss-dsi-gamma17-command = [

		];
		qcom,mdss-dsi-gamma18-command = [

		];
		qcom,mdss-dsi-gamma19-command = [

		];
		qcom,mdss-dsi-gamma20-command = [

		];
		qcom,mdss-dsi-gamma21-command = [

		];
		qcom,mdss-dsi-gamma22-command = [

		];
		qcom,mdss-dsi-gamma23-command = [

		];
		qcom,mdss-dsi-gamma24-command = [

		];


		qcom,mdss-dsi-on-command-state = "dsi_lp_mode";
		qcom,mdss-dsi-off-command-state = "dsi_hs_mode";
		qcom,mdss-dsi-ce-on-command-state = "dsi_hs_mode";
		qcom,mdss-dsi-ce-off-command-state = "dsi_hs_mode";
		qcom,mdss-dsi-srgb-on-command-state = "dsi_hs_mode";
		qcom,mdss-dsi-srgb-off-command-state = "dsi_hs_mode";
		qcom,mdss-dsi-cabc-on-command-state = "dsi_hs_mode";
		qcom,mdss-dsi-cabc-off-command-state = "dsi_hs_mode";
		qcom,mdss-dsi-gamma-command-state = "dsi_hs_mode";
		qcom,mdss-dsi-bl-pmic-control-type = "bl_ctrl_wled";
		qcom,mdss-dsi-reset-sequence = <1 1>, <0 5>, <1 15>;
		qcom,mdss-dsi-tx-eot-append;
		qcom,mdss-dsi-post-init-delay = <1>;

		qcom,esd-check-enabled;
		qcom,mdss-dsi-panel-status-command = [06 01 00 01 05 00 01 0A];
		qcom,mdss-dsi-panel-status-command-state = "dsi_hs_mode";
		qcom,mdss-dsi-panel-status-check-mode = "reg_read";
		qcom,mdss-dsi-panel-status-read-length = <1>;
		qcom,mdss-dsi-panel-status-value = <0x9c>;
		qcom,mdss-dsi-panel-max-error-count = <3>;
	};
};
