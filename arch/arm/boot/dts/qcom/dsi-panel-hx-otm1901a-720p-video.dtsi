/*
 * Copyright (c) 2015, The Linux Foundation. All rights reserved.
 * Copyright (C) 2019 XiaoMi, Inc.
 *
 * This program is free software; you can redistribute it and/or modify
 * it under the terms of the GNU General Public License version 2 and
 * only version 2 as published by the Free Software Foundation.
 *
 * This program is distributed in the hope that it will be useful,
 * but WITHOUT ANY WARRANTY; without even the implied warranty of
 * MERCHANTABILITY or FITNESS FOR A PARTICULAR PURPOSE.  See the
 * GNU General Public License for more details.
 */

/*---------------------------------------------------------------------------
 * This file is autogenerated file using gcdb parser. Please do not edit it.
 * Update input XML file to add a new entry or update variable in this file
 * VERSION = "1.0"
 *---------------------------------------------------------------------------*/
&mdss_mdp {
	dsi_hx_otm1901a_720p_video: qcom,mdss_dsi_hx_otm1901a_720p_video {
		qcom,mdss-dsi-panel-name = "hx otm1901a 720p video mode dsi panel";
		qcom,mdss-dsi-panel-controller = <&mdss_dsi0>;
		qcom,mdss-dsi-panel-type = "dsi_video_mode";
		qcom,mdss-dsi-panel-destination = "display_1";
		qcom,mdss-dsi-panel-framerate = <60>;
		qcom,mdss-dsi-virtual-channel-id = <0>;
		qcom,mdss-dsi-stream = <0>;
		qcom,mdss-dsi-panel-width = <720>;
		qcom,mdss-dsi-panel-height = <1280>;
		qcom,mdss-dsi-h-front-porch = <96>;
		qcom,mdss-dsi-h-back-porch = <96>;
		qcom,mdss-dsi-h-pulse-width = <4>;
		qcom,mdss-dsi-h-sync-skew = <0>;
		qcom,mdss-dsi-v-back-porch = <9>;
		qcom,mdss-dsi-v-front-porch = <14>;
		qcom,mdss-dsi-v-pulse-width = <1>;
		qcom,mdss-dsi-h-left-border = <0>;
		qcom,mdss-dsi-h-right-border = <0>;
		qcom,mdss-dsi-v-top-border = <0>;
		qcom,mdss-dsi-v-bottom-border = <0>;
		qcom,mdss-dsi-bpp = <24>;
		qcom,mdss-dsi-underflow-color = <0xff>;
		qcom,mdss-dsi-border-color = <0>;
		qcom,mdss-dsi-on-command = [
			39 01 00 00 00 00 02 00 00
			39 01 00 00 00 00 04 FF 19 01 01
			39 01 00 00 00 00 02 00 80
			39 01 00 00 00 00 03 FF 19 01
			39 01 00 00 00 00 02 00 00
			39 01 00 00 00 00 02 1C 33
			39 01 00 00 00 00 02 00 A0
			39 01 00 00 00 00 02 C1 E8
			39 01 00 00 00 00 02 00 A7
			39 01 00 00 00 00 02 C1 00
			39 01 00 00 00 00 02 00 90
			39 01 00 00 00 00 07 C0 00 2F 00 00 00 01
			39 01 00 00 00 00 02 00 C0
			39 01 00 00 00 00 07 C0 00 2F 00 00 00 01
			39 01 00 00 00 00 02 00 9A
			39 01 00 00 00 00 02 C0 1E
			39 01 00 00 00 00 02 00 AC
			39 01 00 00 00 00 02 C0 06
			39 01 00 00 00 00 02 00 DC
			39 01 00 00 00 00 02 C0 06
			39 01 00 00 00 00 02 00 92
			39 01 00 00 00 00 02 E9 00
			39 01 00 00 00 00 02 00 90
			39 01 00 00 00 00 02 F3 01
			39 01 00 00 00 00 02 00 93
			39 01 00 00 00 00 02 C5 23
			39 01 00 00 00 00 02 00 95
			39 01 00 00 00 00 02 C5 23
			39 01 00 00 00 00 02 00 97
			39 01 00 00 00 00 02 C5 1E
			39 01 00 00 00 00 02 00 99
			39 01 00 00 00 00 02 C5 1E
			39 01 00 00 00 00 02 00 9B
			39 01 00 00 00 00 04 C5 22 20 88
			39 01 00 00 00 00 02 00 00
			39 01 00 00 00 00 02 00 84
			39 01 00 00 00 00 03 C5 13 13
			39 01 00 00 00 00 02 00 00
			39 01 00 00 00 00 03 D8 2F 2F
			39 01 00 00 00 00 02 00 B3
			39 01 00 00 00 00 02 C0 CC
			39 01 00 00 00 00 02 00 BC
			39 01 00 00 00 00 02 C0 00
			39 01 00 00 00 00 02 00 84
			39 01 00 00 00 00 02 C4 22
			39 01 00 00 00 00 02 00 80
			39 01 00 00 00 00 02 C4 14
			39 01 00 00 00 00 02 00 80
			39 01 00 00 00 00 0f C0 00 7C 00 08 08 00 7C 08 08 00 7C 00 08 08
			39 01 00 00 00 00 02 00 F0
			39 01 00 00 00 00 07 C3 22 00 00 00 00 0C
			39 01 00 00 00 00 02 00 A0
			39 01 00 00 00 00 08 C0 00 00 1E 00 00 17 06
			39 01 00 00 00 00 02 00 D0
			39 01 00 00 00 00 08 C0 00 00 1E 00 00 17 06
			39 01 00 00 00 00 02 00 90
			39 01 00 00 00 00 09 C2 83 01 74 36 82 01 74 36
			39 01 00 00 00 00 02 00 A0
			39 01 00 00 00 00 05 C2 83 00 00 D0
			39 01 00 00 00 00 02 00 80
			39 01 00 00 00 00 0d C3 82 02 03 00 13 04 81 02 03 00 13 04
			39 01 00 00 00 00 02 00 90
			39 01 00 00 00 00 0d C3 80 02 03 00 13 04 01 02 03 00 13 04
			39 01 00 00 00 00 02 00 80
			39 01 00 00 00 00 10 CC 09 0A 11 12 13 14 15 16 17 18 0B 28 28 28 28
			39 01 00 00 00 00 02 00 90
			39 01 00 00 00 00 10 CC 0A 09 14 13 12 11 15 16 17 18 0B 28 28 28 28
			39 01 00 00 00 00 02 00 A0
			39 01 00 00 00 00 10 CC 1D 1E 1F 19 1A 1B 1C 20 21 22 23 24 25 26 27
			39 01 00 00 00 00 02 00 B0
			39 01 00 00 00 00 09 CC 01 02 03 05 06 07 04 08
			39 01 00 00 00 00 02 00 C0
			39 01 00 00 00 00 0d CC 00 00 00 00 00 00 00 00 00 00 00 77
			39 01 00 00 00 00 02 00 D0
			39 01 00 00 00 00 0d CC FF 0F 30 00 05 00 00 00 33 03 00 77
			39 01 00 00 00 00 02 00 80
			39 01 00 00 00 00 10 CB 00 00 00 00 00 00 00 00 00 00 CF 00 00 00 00
			39 01 00 00 00 00 02 00 90
			39 01 00 00 00 00 10 CB 00 00 FF 00 00 00 00 00 00 00 00 00 00 00 00
			39 01 00 00 00 00 02 00 A0
			39 01 00 00 00 00 10 CB 15 15 15 15 15 15 00 00 00 00 EA 00 00 00 00
			39 01 00 00 00 00 02 00 B0
			39 01 00 00 00 00 10 CB 00 15 D5 00 00 00 00 00 00 00 00 00 00 00 00
			39 01 00 00 00 00 02 00 C0
			39 01 00 00 00 00 09 CB 00 00 00 00 00 00 77 77
			39 01 00 00 00 00 02 00 D0
			39 01 00 00 00 00 09 CB 00 00 00 00 00 00 77 77
			39 01 00 00 00 00 02 00 E0
			39 01 00 00 00 00 09 CB 00 00 00 00 00 00 77 77
			39 01 00 00 00 00 02 00 F0
			39 01 00 00 00 00 09 CB 11 11 11 00 00 00 77 77
			39 01 00 00 00 00 02 00 80
			39 01 00 00 00 00 10 CD 3F 3F 3F 3F 3F 3F 3F 3F 3F 06 04 0B 11 12 02
			39 01 00 00 00 00 02 00 90
			39 01 00 00 00 00 0c CD 3F 3F 3F 25 25 25 21 20 1F 25 25
			39 01 00 00 00 00 02 00 A0
			39 01 00 00 00 00 10 CD 3F 3F 3F 3F 3F 3F 3F 3F 3F 05 03 0B 11 12 01
			39 01 00 00 00 00 02 00 B0
			39 01 00 00 00 00 0c CD 3F 3F 3F 25 25 25 21 20 1F 25 25
			39 01 00 00 00 00 02 00 00
			39 01 00 00 00 00 19 E1 00 06 0B 16 22 29 36 49 55 69 73 79 82 7D 79 65 51 3E 31 29 1E 13 0B 09
			39 01 00 00 00 00 02 00 00
			39 01 00 00 00 00 19 E2 00 06 0B 16 22 29 36 49 55 69 73 79 82 7D 79 65 51 3E 31 29 1E 13 0B 09
			39 01 00 00 00 00 02 00 00
			39 01 00 00 00 00 19 E3 00 06 0B 16 22 29 36 49 55 69 73 79 82 7D 79 65 51 3E 31 29 1E 13 0B 09
			39 01 00 00 00 00 02 00 00
			39 01 00 00 00 00 19 E4 00 06 0B 16 22 29 36 49 55 69 73 79 82 7D 79 65 51 3E 31 29 1E 13 0B 09
			39 01 00 00 00 00 02 00 00
			39 01 00 00 00 00 19 E5 00 06 0B 16 22 29 36 49 55 69 73 79 82 7D 79 65 51 3E 31 29 1E 13 0B 09
			39 01 00 00 00 00 02 00 00
			39 01 00 00 00 00 19 E6 00 06 0B 16 22 29 36 49 55 69 73 79 82 79 76 65 51 3E 31 29 1E 13 0B 09
			39 01 00 00 00 00 02 00 D4
			39 01 00 00 00 00 05 C3 01 01 01 01
			39 01 00 00 00 00 02 00 F7
			39 01 00 00 00 00 05 C3 04 16 00 00
			39 01 00 00 00 00 02 00 D0
			39 01 00 00 00 00 05 F5 06 11 06 11
			39 01 00 00 00 00 02 00 81
			39 01 00 00 00 00 02 A5 06
			39 01 00 00 00 00 02 00 82
			39 01 00 00 00 00 02 C4 f0
			39 01 00 00 00 00 02 00 84
			39 01 00 00 00 00 02 C4 22
			39 01 00 00 00 00 02 00 92
			39 01 00 00 00 00 02 C5 A0
			39 01 00 00 00 00 02 00 94
			39 01 00 00 00 00 02 C5 90
			39 01 00 00 00 00 02 00 c1
			39 01 00 00 00 00 02 C5 66
			39 01 00 00 00 00 02 00 89
			39 01 00 00 00 00 02 F3 5A
			39 01 00 00 00 00 02 00 90
			39 01 00 00 00 00 02 F3 01
			39 01 00 00 00 00 02 00 82
			39 01 00 00 00 00 02 A5 1F
			39 01 00 00 00 00 02 00 00
			39 01 00 00 00 00 02 1C 05
			39 01 00 00 00 00 05 2A 00 00 02 CF
			39 01 00 00 00 00 05 2B 00 00 04 FF
			39 01 00 00 00 00 02 00 90
			39 01 00 00 00 00 02 D7 00
			39 01 00 00 00 00 02 00 91
			39 01 00 00 00 00 02 D7 C8
			39 01 00 00 00 00 02 00 ba
			39 01 00 00 00 00 03 c0 C2 01
			39 01 00 00 00 00 02 35 00
			39 01 00 00 00 00 02 00 94
			39 01 00 00 00 00 02 C1 84
			39 01 00 00 00 00 02 00 98
			39 01 00 00 00 00 02 C1 74
			39 01 00 00 00 00 02 00 CD
			39 01 00 00 00 00 02 F5 19
			39 01 00 00 00 00 02 00 DB
			39 01 00 00 00 00 02 F5 19
			39 01 00 00 00 00 02 00 F5
			39 01 00 00 00 00 02 C1 40
			39 01 00 00 00 00 02 00 B9
			39 01 00 00 00 00 02 C0 13
			39 01 00 00 00 00 02 00 8D
			39 01 00 00 00 00 02 F5 20
			39 01 00 00 00 00 02 00 D0
			39 01 00 00 00 00 05 F5 06 10 06 10
			39 01 00 00 00 00 02 00 C0
			39 01 00 00 00 00 02 C4 E8
			39 01 00 00 00 00 02 00 E0
			39 01 00 00 00 00 09 CB 01 01 01 00 00 00 77 77
			39 01 00 00 00 00 02 00 B0
			39 01 00 00 00 00 02 CA 02
			39 01 00 00 00 00 02 00 80
			39 01 00 00 00 00 02 CA 80
			39 01 00 00 00 00 02 00 86
			39 01 00 00 00 00 02 f3 e0
			39 01 00 00 00 00 02 35 00
39 01 00 00 00 00 02 00 00
39 01 00 00 00 00 91 D4 fc 3d fc 3d fc 3d fc 3d fc 3e fc 3e fc 3e fd 3e fd 3e fd 3f fd 3f fd 3f fd 3f fd 3f fd 40 fd 40 fd 40 fd 40 fd 40 fd 40 fd 40 fd 40 fd 40 fe 40 fe 40 fe 40 fe 40 fe 40 fe 40 fe 40 fe 40 fe 40 fe 40 fe 40 ff 40 ff 40 ff 40 ff 40 ff 40 ff 40 ff 40 ff 40 00 40 00 40 00 40 00 40 00 40 00 40 00 40 00 40 00 40 00 40 00 40 00 40 00 40 00 40 00 40 00 40 00 40 00 40 00 40 00 40 00 40 00 40 00 40 00 40 00 40 00 40 00 40 00 40 00 40 00 40
39 01 00 00 00 00 91 D4 00 3f 00 3f 00 3f 00 3f 00 3f 00 3f 00 3f 00 3f 00 3f 00 3f 00 3f 00 3f 00 3f 00 3f 00 3f 00 3f 00 3f 00 3f 00 3f 00 3f 00 3f 00 3f ff 3f ff 3f ff 3f ff 3f ff 3f ff 3f ff 3f fe 3f fe 3f fe 3f fe 3f fe 3f fe 3f fe 3f fe 3f ff 40 ff 40 ff 40 ff 40 ff 40 ff 40 ff 40 ff 40 00 40 00 40 00 40 00 40 00 40 ff 40 ff 40 ff 40 ff 40 fe 40 fe 40 fe 40 fe 40 fd 40 fd 40 fd 40 fc 40 fc 40 fc 40 fc 40 fd 40 fd 40 fd 40 fd 40 fd 40 fe 40 fe 40
39 01 00 00 00 00 91 D4 fe 40 fe 40 fe 40 ff 40 ff 40 ff 40 ff 40 ff 40 ff 40 ff 40 ff 40 ff 40 ff 40 ff 40 ff 40 ff 40 ff 40 ff 40 ff 40 ff 40 ff 40 ff 40 ff 40 ff 40 ff 3f fe 3f fe 3f fe 3f fe 3e fe 3e fd 3e fd 3e fd 3e fd 3d fc 3d fc 3d fa 4c fb 4c fb 4b fb 4b fb 4b fb 4a fc 4a fc 4a fc 49 fc 49 fc 49 fc 48 fd 48 fd 48 fe 47 fe 47 fe 48 fd 48 fd 48 fd 49 fd 49 fd 4a fd 4a fd 4b fd 4b fd 4c fd 4c fd 4d fd 4d fd 4d fe 4e ff 4e ff 4f 00 4f 01 4f 01 50
39 01 00 00 00 00 91 D4 03 50 03 50 04 50 04 51 06 51 06 51 07 52 07 52 09 52 09 52 09 52 0a 51 0a 50 0a 50 0a 4f 0b 4e 0b 4e 0b 4d 0b 4d 0c 4c 0c 4b 0c 4b 0c 4a 0d 4a 0d 49 0d 48 0d 47 0c 46 0c 45 0c 44 0c 43 0c 42 0c 41 0b 40 0b 3f 0b 3f 0b 3e 0b 3d 0b 3c 0a 3b 0a 3a 0a 3a 0a 39 0a 39 0a 38 0a 38 0a 37 0a 36 09 36 08 36 08 35 08 34 08 34 08 33 08 33 08 33 07 33 06 33 06 33 05 33 05 34 04 34 04 34 03 34 02 34 02 34 01 34 00 34 00 34 ff 34 ff 35 ff 36
39 01 00 00 00 00 91 D4 ff 37 ff 38 ff 39 fe 3a fe 3a fe 3b fe 3c fe 3d fe 3e fd 3f fd 40 fd 41 fd 42 fd 42 fd 43 fb 43 fb 43 fb 44 fb 44 fb 45 fa 45 fa 46 fa 46 fa 47 f9 47 f8 48 f8 48 f8 49 f8 49 f9 49 fa 49 fa 49 fa 4a fb 4a fb 4a fb 4a fb 4a fc 4b fc 4b fc 4b fd 4b fd 4b fd 4b fd 4b fd 4a fd 4a fd 49 fd 49 fd 48 fd 48 fe 48 fe 47 fe 47 fe 46 fe 46 fe 45 fe 45 fd 45 fe 45 fd 46 fc 46 fc 47 fc 47 fc 48 fc 48 fc 49 fb 49 fb 4a fb 4a fb 4b fb 4b fb 4c


39 01 00 00 00 00 02 00 00
39 01 00 00 00 00 91 D5 fc 48 fc 48 fc 48 fc 48 fc 49 fc 49 fc 49 fc 49 fc 49 fc 49 fc 49 fc 49 fc 49 fc 49 fc 49 fc 49 fc 4a fc 4a fd 4a fd 4a fd 4a fd 4a fd 4a fd 4a fe 4b ff 4b ff 4b ff 4b ff 4b ff 4b 00 4b 00 4b 00 4b 00 4b 01 4b 01 4b 01 4a 01 4a 03 4a 03 4a 03 4a 03 4a 04 49 04 49 04 49 05 49 05 47 06 46 06 45 07 44 07 42 07 41 08 40 08 3f 09 3d 09 3c 09 3b 0a 3a 0a 38 0a 37 0a 36 0a 36 0a 35 0a 35 09 35 09 35 09 34 09 34 09 34 09 33 09 33 09 33
39 01 00 00 00 00 91 D5 08 33 08 32 08 32 08 32 08 31 07 31 07 30 07 30 07 2f 07 2f 06 2e 06 2e 06 2d 05 2d 05 2c 05 2b 05 2b 04 2a 04 2a 04 2b 03 2c 03 2c 02 2d 02 2e 01 2e 00 2f 00 30 ff 31 fe 31 fe 32 fd 33 fc 33 fb 34 fb 35 fb 36 fc 37 fd 39 fd 3a fe 3b fe 3d ff 3e 00 40 01 41 01 42 02 43 02 45 04 46 04 47 05 49 04 49 03 4a 03 4b 01 4b 01 4c 00 4c ff 4d ff 4e fd 4e fd 4f fc 4f fa 50 fa 51 f9 51 f8 52 f9 52 f9 52 f9 52 f9 53 f9 53 fa 53 fa 53 fa 53
39 01 00 00 00 00 91 D5 fa 54 fb 54 fc 54 fc 54 fc 55 fc 55 fd 55 fd 55 fd 55 fd 55 fd 55 fe 55 ff 55 ff 55 ff 55 ff 55 ff 55 00 55 00 55 00 55 00 55 00 55 00 54 00 53 00 52 ff 51 ff 51 ff 50 ff 4f fe 4e fd 4d fd 4c fd 4b fd 4b fc 4a fc 49 f3 4f f3 50 f3 51 f4 52 f4 53 f4 54 f5 55 f5 56 f5 57 f5 58 f7 59 f7 5a f6 5b f7 5c f8 5d f8 5e f8 5e f8 5e f9 5e f9 5e f9 5d f9 5d f9 5d f9 5d fa 5d fb 5d fb 5d fb 5d fb 5d fb 5d fc 5d fe 5d fe 5e 00 5e 02 5f 02 5f
39 01 00 00 00 00 91 D5 04 60 05 60 07 61 08 61 09 61 0b 62 0c 62 0e 62 0f 63 10 63 11 62 11 61 11 61 11 60 13 5f 12 5f 12 5e 12 5e 14 5d 14 5c 14 5c 13 5b 15 5b 15 5a 15 59 14 58 14 56 14 55 13 53 13 52 12 50 12 4e 12 4d 11 4b 11 4a 11 48 10 47 10 45 10 44 0f 42 0f 42 0f 41 0f 40 0f 40 0f 3f 0e 3e 0e 3d 0e 3d 0e 3c 0e 3b 0e 3b 0d 3a 0d 39 0d 39 0d 38 0c 38 0c 37 0b 37 0a 37 0a 37 09 36 08 36 08 36 07 36 07 35 06 35 05 34 05 34 04 34 03 34 03 34 02 34
39 01 00 00 00 00 91 D5 01 35 01 35 00 36 00 36 ff 36 fe 37 fe 37 fd 37 fd 38 fc 38 fb 38 fb 38 fa 39 fa 39 fa 3a fa 3a fa 3a fa 3b fa 3b fa 3b fb 3c fb 3c fb 3d fb 3d fb 3e fb 3e fb 3e fb 3f fb 3f fb 3f fb 3f fb 3f fb 3f fb 3f f9 3f f9 3f f9 3f f9 3f f9 3f f9 3f f9 3f f9 3f f9 3f f9 40 f9 41 f8 42 f8 43 f8 45 f7 46 f7 47 f7 48 f7 49 f7 4a f7 4c f7 4d f5 4e f5 4f f5 50 f5 50 f5 50 f5 50 f5 4f f5 4f f5 4f f4 4f f3 4f f3 4f f4 4f f4 4f f4 4f f4 4f f4 4f
			39 01 00 00 78 00 02 11 00
			39 01 00 00 15 00 02 29 00
//			39 01 00 00 00 00 02 51 66
			39 01 00 00 00 00 02 53 24];

		qcom,mdss-dsi-india-on-command = [
			39 01 00 00 00 00 02 00 00
			39 01 00 00 00 00 04 FF 19 01 01
			39 01 00 00 00 00 02 00 80
			39 01 00 00 00 00 03 FF 19 01
			39 01 00 00 00 00 02 00 00
			39 01 00 00 00 00 02 1C 33
			39 01 00 00 00 00 02 00 A0
			39 01 00 00 00 00 02 C1 E8
			39 01 00 00 00 00 02 00 A7
			39 01 00 00 00 00 02 C1 00
			39 01 00 00 00 00 02 00 90
			39 01 00 00 00 00 07 C0 00 2F 00 00 00 01
			39 01 00 00 00 00 02 00 C0
			39 01 00 00 00 00 07 C0 00 2F 00 00 00 01
			39 01 00 00 00 00 02 00 9A
			39 01 00 00 00 00 02 C0 1E
			39 01 00 00 00 00 02 00 AC
			39 01 00 00 00 00 02 C0 06
			39 01 00 00 00 00 02 00 DC
			39 01 00 00 00 00 02 C0 06
			39 01 00 00 00 00 02 00 92
			39 01 00 00 00 00 02 E9 00
			39 01 00 00 00 00 02 00 90
			39 01 00 00 00 00 02 F3 01
			39 01 00 00 00 00 02 00 93
			39 01 00 00 00 00 02 C5 23
			39 01 00 00 00 00 02 00 95
			39 01 00 00 00 00 02 C5 23
			39 01 00 00 00 00 02 00 97
			39 01 00 00 00 00 02 C5 1E
			39 01 00 00 00 00 02 00 99
			39 01 00 00 00 00 02 C5 1E
			39 01 00 00 00 00 02 00 9B
			39 01 00 00 00 00 04 C5 22 20 88
			39 01 00 00 00 00 02 00 00
			39 01 00 00 00 00 02 00 84
			39 01 00 00 00 00 03 C5 13 13
			39 01 00 00 00 00 02 00 00
			39 01 00 00 00 00 03 D8 2F 2F
			39 01 00 00 00 00 02 00 B3
			39 01 00 00 00 00 02 C0 CC
			39 01 00 00 00 00 02 00 BC
			39 01 00 00 00 00 02 C0 00
			39 01 00 00 00 00 02 00 84
			39 01 00 00 00 00 02 C4 22
			39 01 00 00 00 00 02 00 80
			39 01 00 00 00 00 02 C4 14
			39 01 00 00 00 00 02 00 80
			39 01 00 00 00 00 0f C0 00 7C 00 08 08 00 7C 08 08 00 7C 00 08 08
			39 01 00 00 00 00 02 00 F0
			39 01 00 00 00 00 07 C3 22 00 00 00 00 0C
			39 01 00 00 00 00 02 00 A0
			39 01 00 00 00 00 08 C0 00 00 1E 00 00 17 06
			39 01 00 00 00 00 02 00 D0
			39 01 00 00 00 00 08 C0 00 00 1E 00 00 17 06
			39 01 00 00 00 00 02 00 90
			39 01 00 00 00 00 09 C2 83 01 74 36 82 01 74 36
			39 01 00 00 00 00 02 00 A0
			39 01 00 00 00 00 05 C2 83 00 00 D0
			39 01 00 00 00 00 02 00 80
			39 01 00 00 00 00 0d C3 82 02 03 00 13 04 81 02 03 00 13 04
			39 01 00 00 00 00 02 00 90
			39 01 00 00 00 00 0d C3 80 02 03 00 13 04 01 02 03 00 13 04
			39 01 00 00 00 00 02 00 80
			39 01 00 00 00 00 10 CC 09 0A 11 12 13 14 15 16 17 18 0B 28 28 28 28
			39 01 00 00 00 00 02 00 90
			39 01 00 00 00 00 10 CC 0A 09 14 13 12 11 15 16 17 18 0B 28 28 28 28
			39 01 00 00 00 00 02 00 A0
			39 01 00 00 00 00 10 CC 1D 1E 1F 19 1A 1B 1C 20 21 22 23 24 25 26 27
			39 01 00 00 00 00 02 00 B0
			39 01 00 00 00 00 09 CC 01 02 03 05 06 07 04 08
			39 01 00 00 00 00 02 00 C0
			39 01 00 00 00 00 0d CC 00 00 00 00 00 00 00 00 00 00 00 77
			39 01 00 00 00 00 02 00 D0
			39 01 00 00 00 00 0d CC FF 0F 30 00 05 00 00 00 33 03 00 77
			39 01 00 00 00 00 02 00 80
			39 01 00 00 00 00 10 CB 00 00 00 00 00 00 00 00 00 00 CF 00 00 00 00
			39 01 00 00 00 00 02 00 90
			39 01 00 00 00 00 10 CB 00 00 FF 00 00 00 00 00 00 00 00 00 00 00 00
			39 01 00 00 00 00 02 00 A0
			39 01 00 00 00 00 10 CB 15 15 15 15 15 15 00 00 00 00 EA 00 00 00 00
			39 01 00 00 00 00 02 00 B0
			39 01 00 00 00 00 10 CB 00 15 D5 00 00 00 00 00 00 00 00 00 00 00 00
			39 01 00 00 00 00 02 00 C0
			39 01 00 00 00 00 09 CB 00 00 00 00 00 00 77 77

			39 01 00 00 00 00 02 00 D0
			39 01 00 00 00 00 09 CB 00 00 00 00 00 00 77 77
			39 01 00 00 00 00 02 00 E0
			39 01 00 00 00 00 09 CB 00 00 00 00 00 00 77 77
			39 01 00 00 00 00 02 00 F0
			39 01 00 00 00 00 09 CB 11 11 11 00 00 00 77 77
			39 01 00 00 00 00 02 00 80
			39 01 00 00 00 00 10 CD 3F 3F 3F 3F 3F 3F 3F 3F 3F 06 04 0B 11 12 02
			39 01 00 00 00 00 02 00 90
			39 01 00 00 00 00 0c CD 3F 3F 3F 25 25 25 21 20 1F 25 25
			39 01 00 00 00 00 02 00 A0
			39 01 00 00 00 00 10 CD 3F 3F 3F 3F 3F 3F 3F 3F 3F 05 03 0B 11 12 01
			39 01 00 00 00 00 02 00 B0
			39 01 00 00 00 00 0c CD 3F 3F 3F 25 25 25 21 20 1F 25 25
			39 01 00 00 00 00 02 00 00
			39 01 00 00 00 00 19 E1 00 06 0B 16 22 29 36 49 55 69 73 79 82 7D 79 65 51 3E 31 29 1E 13 0B 09
			39 01 00 00 00 00 02 00 00
			39 01 00 00 00 00 19 E2 00 06 0B 16 22 29 36 49 55 69 73 79 82 7D 79 65 51 3E 31 29 1E 13 0B 09
			39 01 00 00 00 00 02 00 00
			39 01 00 00 00 00 19 E3 00 06 0B 16 22 29 36 49 55 69 73 79 82 7D 79 65 51 3E 31 29 1E 13 0B 09
			39 01 00 00 00 00 02 00 00
			39 01 00 00 00 00 19 E4 00 06 0B 16 22 29 36 49 55 69 73 79 82 7D 79 65 51 3E 31 29 1E 13 0B 09
			39 01 00 00 00 00 02 00 00
			39 01 00 00 00 00 19 E5 00 06 0B 16 22 29 36 49 55 69 73 79 82 7D 79 65 51 3E 31 29 1E 13 0B 09
			39 01 00 00 00 00 02 00 00
			39 01 00 00 00 00 19 E6 00 06 0B 16 22 29 36 49 55 69 73 79 82 79 76 65 51 3E 31 29 1E 13 0B 09
			39 01 00 00 00 00 02 00 D4
			39 01 00 00 00 00 05 C3 01 01 01 01
			39 01 00 00 00 00 02 00 F7
			39 01 00 00 00 00 05 C3 04 16 00 00
			39 01 00 00 00 00 02 00 D0
			39 01 00 00 00 00 05 F5 06 11 06 11
			39 01 00 00 00 00 02 00 81
			39 01 00 00 00 00 02 A5 06
			39 01 00 00 00 00 02 00 82
			39 01 00 00 00 00 02 C4 f0
			39 01 00 00 00 00 02 00 84
			39 01 00 00 00 00 02 C4 22
			39 01 00 00 00 00 02 00 92
			39 01 00 00 00 00 02 C5 A0
			39 01 00 00 00 00 02 00 94
			39 01 00 00 00 00 02 C5 90
			39 01 00 00 00 00 02 00 c1
			39 01 00 00 00 00 02 C5 66
			39 01 00 00 00 00 02 00 89
			39 01 00 00 00 00 02 F3 5A
			39 01 00 00 00 00 02 00 90
			39 01 00 00 00 00 02 F3 01
			39 01 00 00 00 00 02 00 82
			39 01 00 00 00 00 02 A5 1F
			39 01 00 00 00 00 02 00 00
			39 01 00 00 00 00 02 1C 05
			39 01 00 00 00 00 05 2A 00 00 02 CF
			39 01 00 00 00 00 05 2B 00 00 04 FF
			39 01 00 00 00 00 02 00 90
			39 01 00 00 00 00 02 D7 00
			39 01 00 00 00 00 02 00 91
			39 01 00 00 00 00 02 D7 C8
			39 01 00 00 00 00 02 00 ba
			39 01 00 00 00 00 03 c0 C2 01
			39 01 00 00 00 00 02 35 00
			39 01 00 00 00 00 02 00 94
			39 01 00 00 00 00 02 C1 84
			39 01 00 00 00 00 02 00 98
			39 01 00 00 00 00 02 C1 74
			39 01 00 00 00 00 02 00 CD
			39 01 00 00 00 00 02 F5 19
			39 01 00 00 00 00 02 00 DB
			39 01 00 00 00 00 02 F5 19
			39 01 00 00 00 00 02 00 F5
			39 01 00 00 00 00 02 C1 40
			39 01 00 00 00 00 02 00 B9
			39 01 00 00 00 00 02 C0 13
			39 01 00 00 00 00 02 00 8D
			39 01 00 00 00 00 02 F5 20
			39 01 00 00 00 00 02 00 D0
			39 01 00 00 00 00 05 F5 06 10 06 10
			39 01 00 00 00 00 02 00 C0
			39 01 00 00 00 00 02 C4 E8
			39 01 00 00 00 00 02 00 E0
			39 01 00 00 00 00 09 CB 01 01 01 00 00 00 77 77
			39 01 00 00 00 00 02 00 B0
			39 01 00 00 00 00 02 CA 02
			39 01 00 00 00 00 02 00 80
			39 01 00 00 00 00 02 CA 80
			39 01 00 00 00 00 02 00 86
			39 01 00 00 00 00 02 f3 e0
			39 01 00 00 00 00 02 35 00
39 01 00 00 00 00 02 00 00
39 01 00 00 00 00 91 D4 fc 3b fc 3c fc 3c fc 3c fc 3d fc 3d fc 3d fc 3d fc 3e fc 3e fd 3e fd 3f fd 3f fd 3f fd 40 fd 40 fd 40 fd 40 fd 40 fd 40 fd 40 fd 40 fe 40 fe 40 fe 40 fe 40 fe 40 fe 40 fe 40 fe 40 fe 40 ff 40 ff 40 ff 40 00 40 00 40 00 40 01 40 01 40 01 40 02 40 02 40 03 40 03 40 03 40 04 40 04 40 04 40 04 40 06 3f 06 3f 06 3f 07 3f 07 3f 07 3f 07 3f 08 3f 08 3e 08 3e 09 3e 09 3e 09 3e 09 3e 09 3e 09 3e 09 3e 09 3e 09 3e 09 3e 09 3e 09 3e 09 3e
39 01 00 00 00 00 91 D4 09 3e 09 3e 09 3e 09 3e 08 3e 08 3e 08 3e 07 3e 07 3e 06 3e 05 3e 05 3e 04 3f 04 3f 04 3f 03 3f 03 3f 02 3f 02 3f 01 3f 01 3f 00 3f ff 3f fe 3f fe 3f fd 3f fc 3f fc 3f fb 3e fa 3e f9 3e f8 3e f8 3e f8 3e f8 3e f9 3e fb 3e fc 3f fd 3f fe 3f ff 3f 00 3f 01 3f 02 3f 03 3f 04 3f 05 3f 06 3e 07 3e 05 3f 05 3f 04 3f 04 3f 03 3f 03 3f 02 3f 02 3f 01 3f 00 40 00 40 ff 40 fe 40 fe 40 fe 40 fe 40 fe 40 fe 40 fe 40 fe 40 fe 40 ff 40 ff 40
39 01 00 00 00 00 91 D4 ff 40 ff 40 ff 40 ff 40 ff 40 ff 40 00 40 00 40 00 40 00 40 00 40 00 40 00 40 00 40 00 40 ff 40 ff 40 ff 40 ff 40 ff 40 ff 40 ff 40 ff 40 ff 3f ff 3f fe 3f fe 3e fe 3e fe 3e fd 3d fd 3d fd 3d fd 3d fc 3c fc 3c fc 3c f8 4d f8 4d f8 4d f8 4c f8 4c f8 4c f7 4c f7 4b f7 4b f7 4b f7 4b f7 4a f6 4a f6 4a f6 4a f6 49 f6 49 f7 49 f7 49 f8 49 f8 49 f8 49 fa 49 fa 49 fa 49 fb 49 fb 49 fc 49 fc 49 fd 49 fd 49 fe 4a ff 4b ff 4c 00 4d 01 4e
39 01 00 00 00 00 91 D4 01 4f 02 50 03 50 04 51 04 52 05 53 06 54 07 55 07 55 09 56 09 55 09 54 09 53 0a 52 0a 51 0a 50 0b 4f 0b 4e 0b 4d 0b 4c 0c 4b 0c 4a 0c 49 0d 48 0c 47 0c 46 0c 45 0c 44 0d 43 0d 42 0d 41 0c 40 0c 3f 0c 3e 0d 3d 0d 3c 0c 3b 0c 3a 0c 39 0c 38 0c 38 0b 38 0b 38 0a 38 0a 38 09 38 09 38 08 37 08 37 08 37 07 37 07 37 06 37 06 37 05 37 05 37 04 38 04 38 03 39 03 39 03 3a 02 3a 02 3b 01 3b 01 3c 01 3c 00 3c ff 3d ff 3d ff 3e fe 3f fe 41
39 01 00 00 00 00 91 D4 fe 42 fc 43 fc 45 fc 46 fb 47 fb 49 fb 4a f9 4b f9 4d f9 4e f8 4f f8 50 f7 51 f7 51 f7 51 f7 51 f7 51 f7 51 f8 51 f8 51 f8 51 f8 51 f8 50 f8 50 f8 50 f8 50 f8 50 f8 50 f8 50 f9 4f f9 4f f9 4f fa 4f fb 4e fb 4e fb 4e fc 4d fc 4d fc 4d fd 4d fd 4c fd 4c fe 4c fd 4b fd 4b fd 4b fd 4b fd 4a fd 4a fd 4a fd 49 fd 49 fd 49 fc 48 fc 48 fc 48 fc 48 fc 48 fc 48 fc 48 fc 49 fb 49 fb 49 fb 4a fb 4a fb 4b fa 4b f9 4b f9 4c f9 4c f9 4d f9 4d

39 01 00 00 00 00 02 00 00
39 01 00 00 00 00 91 D5 fc 4b fb 4a fb 4a fb 4a fb 4a fb 4a fb 4a fb 4a fb 4a fb 4a fb 4a fa 49 fa 49 fa 49 fa 49 fa 49 fa 49 fb 4a fb 4a fb 4a fc 4a fc 4a fc 4a fd 4a fd 4b fd 4b fd 4b ff 4b ff 4b ff 4b ff 4b 00 4b 00 4b 00 4b 00 4b 00 4b 00 4b 01 4b 01 4a 01 4a 01 4a 01 4a 02 4a 03 4a 03 4a 03 49 03 48 04 47 04 46 05 45 05 44 06 43 06 42 07 41 07 40 08 3f 08 3e 09 3c 08 3b 09 3a 09 39 09 38 0a 37 0a 36 09 36 0a 35 0a 34 0a 33 0b 32 0a 31 0a 30 0b 2f
39 01 00 00 00 00 91 D5 0b 2e 0a 2d 0b 2c 0b 2c 0a 2c 0a 2c 09 2d 09 2d 08 2d 08 2e 07 2e 07 2e 06 2f 06 2f 05 2f 05 30 04 30 03 30 03 31 03 31 02 31 01 32 01 32 00 32 00 33 ff 33 ff 33 fe 33 fd 34 fd 34 fc 34 fc 34 fb 35 fb 35 fa 37 fa 39 f9 3a f9 3c f8 3d f8 3f f7 41 f7 42 f6 44 f5 45 f5 47 f5 49 f4 4a f3 4c f2 4d f3 4e f4 4e f4 4f f4 4f f5 50 f5 50 f6 51 f6 51 f7 52 f7 52 f7 53 f8 53 f9 54 f9 54 fa 55 fa 55 fa 55 fa 55 fa 55 fb 55 fc 55 fc 55 fc 55
39 01 00 00 00 00 91 D5 fc 55 fc 55 fc 55 fd 55 fd 55 fd 55 fd 55 fd 55 ff 55 ff 55 ff 55 ff 55 00 55 00 55 00 55 00 55 01 55 01 55 01 55 01 55 03 55 03 55 01 54 01 54 01 53 00 52 00 51 00 51 ff 50 ff 4f fe 4f fd 4e fd 4d fd 4d fc 4c fc 4b f0 55 ef 56 ef 56 ef 57 ef 58 ef 58 ef 59 ef 5a ee 5a ee 5b ee 5c ee 5c ee 5d ee 5e ee 5e ef 5f ef 5f f0 5e f1 5e f3 5e f4 5d f5 5d f6 5d f7 5c f8 5c fa 5c fa 5b fb 5b fc 5a fd 5a fe 5a ff 5a 00 5b 02 5b 02 5c 03 5c
39 01 00 00 00 00 91 D5 05 5d 05 5d 07 5e 07 5e 08 5f 0a 5f 0b 60 0c 60 0e 61 0e 61 0f 60 0f 5f 0f 5f 0f 5e 10 5e 10 5d 10 5c 10 5c 11 5b 12 5a 11 5a 11 59 11 59 13 58 12 57 12 56 12 55 12 53 13 52 13 51 12 4f 12 4e 13 4c 13 4b 12 4a 12 49 12 47 13 46 12 45 12 44 11 43 10 42 10 41 0f 41 0e 40 0d 3f 0d 3e 0c 3e 0c 3d 0b 3c 0a 3b 09 3b 09 3a 08 39 08 38 07 39 07 39 07 39 07 39 06 39 06 39 05 3a 05 3a 05 3a 04 3a 04 3a 04 3b 03 3b 03 3b 02 3c 02 3d 01 3f
39 01 00 00 00 00 91 D5 01 40 00 42 00 44 ff 45 ff 47 fd 48 fd 4a fc 4b fc 4d fb 4f fa 50 f9 52 f9 53 f9 52 f9 51 f9 50 f9 4f f9 4f f9 4e f9 4d f9 4c f9 4b f9 4a fa 4a fa 49 fa 48 fa 47 fa 47 fa 46 fa 46 fa 46 fa 46 fa 46 fa 46 fa 45 fa 45 fa 45 fa 45 fa 45 fa 45 fa 45 fa 44 fa 45 fa 45 f9 46 f9 47 f8 48 f8 48 f8 49 f8 4a f7 4b f7 4b f7 4c f7 4d f6 4e f6 4f f6 4f f5 50 f5 50 f5 51 f5 51 f4 51 f3 52 f3 52 f3 52 f3 53 f2 53 f1 53 f1 54 f1 54 f1 54 f0 55
			39 01 00 00 78 00 02 11 00
			39 01 00 00 15 00 02 29 00
//			39 01 00 00 00 00 02 51 66
			39 01 00 00 00 00 02 53 24];


		qcom,mdss-dsi-off-command = [05 01 00 00 00 00 02 28 00
					05 01 00 00 78 00 02 10 00];
qcom,mdss-dsi-warm-command = [
23 00 00 00 00 00 02 00 00
23 00 00 00 00 00 02 E1 00
23 00 00 00 00 00 02 E1 08
23 00 00 00 00 00 02 E1 0e
23 00 00 00 00 00 02 E1 18
23 00 00 00 00 00 02 E1 21
23 00 00 00 00 00 02 E1 28
23 00 00 00 00 00 02 E1 35
23 00 00 00 00 00 02 E1 49
23 00 00 00 00 00 02 E1 55
23 00 00 00 00 00 02 E1 68
23 00 00 00 00 00 02 E1 73
23 00 00 00 00 00 02 E1 79
23 00 00 00 00 00 02 E1 81
23 00 00 00 00 00 02 E1 7c
23 00 00 00 00 00 02 E1 78
23 00 00 00 00 00 02 E1 67
23 00 00 00 00 00 02 E1 51
23 00 00 00 00 00 02 E1 3e
23 00 00 00 00 00 02 E1 32
23 00 00 00 00 00 02 E1 2a
23 00 00 00 00 00 02 E1 21
23 00 00 00 00 00 02 E1 15
23 00 00 00 00 00 02 E1 0c
23 00 00 00 00 00 02 E1 09
23 00 00 00 00 00 02 00 00
23 00 00 00 00 00 02 E2 00
23 00 00 00 00 00 02 E2 08
23 00 00 00 00 00 02 E2 0e
23 00 00 00 00 00 02 E2 18
23 00 00 00 00 00 02 E2 21
23 00 00 00 00 00 02 E2 28
23 00 00 00 00 00 02 E2 35
23 00 00 00 00 00 02 E2 49
23 00 00 00 00 00 02 E2 55
23 00 00 00 00 00 02 E2 68
23 00 00 00 00 00 02 E2 73
23 00 00 00 00 00 02 E2 79
23 00 00 00 00 00 02 E2 81
23 00 00 00 00 00 02 E2 7c
23 00 00 00 00 00 02 E2 78
23 00 00 00 00 00 02 E2 67
23 00 00 00 00 00 02 E2 51
23 00 00 00 00 00 02 E2 3e
23 00 00 00 00 00 02 E2 32
23 00 00 00 00 00 02 E2 2a
23 00 00 00 00 00 02 E2 21
23 00 00 00 00 00 02 E2 15
23 00 00 00 00 00 02 E2 0c
23 00 00 00 00 00 02 E2 09
23 00 00 00 00 00 02 00 00
23 00 00 00 00 00 02 E3 34
23 00 00 00 00 00 02 E3 37
23 00 00 00 00 00 02 E3 3a
23 00 00 00 00 00 02 E3 3e
23 00 00 00 00 00 02 E3 43
23 00 00 00 00 00 02 E3 48
23 00 00 00 00 00 02 E3 50
23 00 00 00 00 00 02 E3 5d
23 00 00 00 00 00 02 E3 63
23 00 00 00 00 00 02 E3 71
23 00 00 00 00 00 02 E3 79
23 00 00 00 00 00 02 E3 7d
23 00 00 00 00 00 02 E3 7f
23 00 00 00 00 00 02 E3 7a
23 00 00 00 00 00 02 E3 76
23 00 00 00 00 00 02 E3 65
23 00 00 00 00 00 02 E3 50
23 00 00 00 00 00 02 E3 3c
23 00 00 00 00 00 02 E3 31
23 00 00 00 00 00 02 E3 29
23 00 00 00 00 00 02 E3 20
23 00 00 00 00 00 02 E3 15
23 00 00 00 00 00 02 E3 0c
23 00 00 00 00 00 02 E3 09
23 00 00 00 00 00 02 00 00
23 00 00 00 00 00 02 E4 34
23 00 00 00 00 00 02 E4 37
23 00 00 00 00 00 02 E4 3a
23 00 00 00 00 00 02 E4 3e
23 00 00 00 00 00 02 E4 43
23 00 00 00 00 00 02 E4 48
23 00 00 00 00 00 02 E4 50
23 00 00 00 00 00 02 E4 5d
23 00 00 00 00 00 02 E4 63
23 00 00 00 00 00 02 E4 71
23 00 00 00 00 00 02 E4 79
23 00 00 00 00 00 02 E4 7d
23 00 00 00 00 00 02 E4 7f
23 00 00 00 00 00 02 E4 7a
23 00 00 00 00 00 02 E4 76
23 00 00 00 00 00 02 E4 65
23 00 00 00 00 00 02 E4 50
23 00 00 00 00 00 02 E4 3c
23 00 00 00 00 00 02 E4 31
23 00 00 00 00 00 02 E4 29
23 00 00 00 00 00 02 E4 20
23 00 00 00 00 00 02 E4 15
23 00 00 00 00 00 02 E4 0c
23 00 00 00 00 00 02 E4 09
23 00 00 00 00 00 02 00 00
23 00 00 00 00 00 02 E5 5e
23 00 00 00 00 00 02 E5 5e
23 00 00 00 00 00 02 E5 60
23 00 00 00 00 00 02 E5 62
23 00 00 00 00 00 02 E5 65
23 00 00 00 00 00 02 E5 68
23 00 00 00 00 00 02 E5 6c
23 00 00 00 00 00 02 E5 75
23 00 00 00 00 00 02 E5 76
23 00 00 00 00 00 02 E5 7d
23 00 00 00 00 00 02 E5 81
23 00 00 00 00 00 02 E5 84
23 00 00 00 00 00 02 E5 7a
23 00 00 00 00 00 02 E5 76
23 00 00 00 00 00 02 E5 70
23 00 00 00 00 00 02 E5 5f
23 00 00 00 00 00 02 E5 4e
23 00 00 00 00 00 02 E5 3a
23 00 00 00 00 00 02 E5 2f
23 00 00 00 00 00 02 E5 27
23 00 00 00 00 00 02 E5 1f
23 00 00 00 00 00 02 E5 13
23 00 00 00 00 00 02 E5 0c
23 00 00 00 00 00 02 E5 09
23 00 00 00 00 00 02 00 00
23 00 00 00 00 00 02 E6 5e
23 00 00 00 00 00 02 E6 5e
23 00 00 00 00 00 02 E6 60
23 00 00 00 00 00 02 E6 62
23 00 00 00 00 00 02 E6 65
23 00 00 00 00 00 02 E6 68
23 00 00 00 00 00 02 E6 6c
23 00 00 00 00 00 02 E6 75
23 00 00 00 00 00 02 E6 76
23 00 00 00 00 00 02 E6 7d
23 00 00 00 00 00 02 E6 81
23 00 00 00 00 00 02 E6 84
23 00 00 00 00 00 02 E6 7a
23 00 00 00 00 00 02 E6 76
23 00 00 00 00 00 02 E6 70
23 00 00 00 00 00 02 E6 5f
23 00 00 00 00 00 02 E6 4e
23 00 00 00 00 00 02 E6 3a
23 00 00 00 00 00 02 E6 2f
23 00 00 00 00 00 02 E6 27
23 00 00 00 00 00 02 E6 1f
23 00 00 00 00 00 02 E6 13
23 00 00 00 00 00 02 E6 0c
23 01 00 00 00 00 02 E6 09
		];

qcom,mdss-dsi-cold-command = [
23 00 00 00 00 00 02 00 00
23 00 00 00 00 00 02 E1 3f
23 00 00 00 00 00 02 E1 42
23 00 00 00 00 00 02 E1 46
23 00 00 00 00 00 02 E1 49
23 00 00 00 00 00 02 E1 4d
23 00 00 00 00 00 02 E1 4f
23 00 00 00 00 00 02 E1 55
23 00 00 00 00 00 02 E1 60
23 00 00 00 00 00 02 E1 66
23 00 00 00 00 00 02 E1 72
23 00 00 00 00 00 02 E1 79
23 00 00 00 00 00 02 E1 7e
23 00 00 00 00 00 02 E1 7e
23 00 00 00 00 00 02 E1 7a
23 00 00 00 00 00 02 E1 74
23 00 00 00 00 00 02 E1 63
23 00 00 00 00 00 02 E1 4f
23 00 00 00 00 00 02 E1 3d
23 00 00 00 00 00 02 E1 30
23 00 00 00 00 00 02 E1 29
23 00 00 00 00 00 02 E1 20
23 00 00 00 00 00 02 E1 13
23 00 00 00 00 00 02 E1 0c
23 00 00 00 00 00 02 E1 09
23 00 00 00 00 00 02 00 00
23 00 00 00 00 00 02 E2 3f
23 00 00 00 00 00 02 E2 42
23 00 00 00 00 00 02 E2 46
23 00 00 00 00 00 02 E2 49
23 00 00 00 00 00 02 E2 4d
23 00 00 00 00 00 02 E2 4f
23 00 00 00 00 00 02 E2 55
23 00 00 00 00 00 02 E2 60
23 00 00 00 00 00 02 E2 66
23 00 00 00 00 00 02 E2 72
23 00 00 00 00 00 02 E2 79
23 00 00 00 00 00 02 E2 7e
23 00 00 00 00 00 02 E2 7e
23 00 00 00 00 00 02 E2 7a
23 00 00 00 00 00 02 E2 74
23 00 00 00 00 00 02 E2 63
23 00 00 00 00 00 02 E2 4f
23 00 00 00 00 00 02 E2 3d
23 00 00 00 00 00 02 E2 30
23 00 00 00 00 00 02 E2 29
23 00 00 00 00 00 02 E2 20
23 00 00 00 00 00 02 E2 13
23 00 00 00 00 00 02 E2 0c
23 00 00 00 00 00 02 E2 09
23 00 00 00 00 00 02 00 00
23 00 00 00 00 00 02 E3 3b
23 00 00 00 00 00 02 E3 3d
23 00 00 00 00 00 02 E3 3f
23 00 00 00 00 00 02 E3 44
23 00 00 00 00 00 02 E3 48
23 00 00 00 00 00 02 E3 4d
23 00 00 00 00 00 02 E3 54
23 00 00 00 00 00 02 E3 61
23 00 00 00 00 00 02 E3 65
23 00 00 00 00 00 02 E3 73
23 00 00 00 00 00 02 E3 7a
23 00 00 00 00 00 02 E3 7e
23 00 00 00 00 00 02 E3 7e
23 00 00 00 00 00 02 E3 7a
23 00 00 00 00 00 02 E3 74
23 00 00 00 00 00 02 E3 63
23 00 00 00 00 00 02 E3 4f
23 00 00 00 00 00 02 E3 3d
23 00 00 00 00 00 02 E3 30
23 00 00 00 00 00 02 E3 28
23 00 00 00 00 00 02 E3 1f
23 00 00 00 00 00 02 E3 14
23 00 00 00 00 00 02 E3 0c
23 00 00 00 00 00 02 E3 09
23 00 00 00 00 00 02 00 00
23 00 00 00 00 00 02 E4 3b
23 00 00 00 00 00 02 E4 3d
23 00 00 00 00 00 02 E4 3f
23 00 00 00 00 00 02 E4 44
23 00 00 00 00 00 02 E4 48
23 00 00 00 00 00 02 E4 4d
23 00 00 00 00 00 02 E4 54
23 00 00 00 00 00 02 E4 61
23 00 00 00 00 00 02 E4 65
23 00 00 00 00 00 02 E4 73
23 00 00 00 00 00 02 E4 7a
23 00 00 00 00 00 02 E4 7e
23 00 00 00 00 00 02 E4 7e
23 00 00 00 00 00 02 E4 7a
23 00 00 00 00 00 02 E4 74
23 00 00 00 00 00 02 E4 63
23 00 00 00 00 00 02 E4 4f
23 00 00 00 00 00 02 E4 3d
23 00 00 00 00 00 02 E4 30
23 00 00 00 00 00 02 E4 28
23 00 00 00 00 00 02 E4 1f
23 00 00 00 00 00 02 E4 14
23 00 00 00 00 00 02 E4 0c
23 00 00 00 00 00 02 E4 09
23 00 00 00 00 00 02 00 00
23 00 00 00 00 00 02 E5 3b
23 00 00 00 00 00 02 E5 3e
23 00 00 00 00 00 02 E5 41
23 00 00 00 00 00 02 E5 45
23 00 00 00 00 00 02 E5 49
23 00 00 00 00 00 02 E5 4d
23 00 00 00 00 00 02 E5 56
23 00 00 00 00 00 02 E5 63
23 00 00 00 00 00 02 E5 66
23 00 00 00 00 00 02 E5 75
23 00 00 00 00 00 02 E5 7c
23 00 00 00 00 00 02 E5 7f
23 00 00 00 00 00 02 E5 7d
23 00 00 00 00 00 02 E5 79
23 00 00 00 00 00 02 E5 73
23 00 00 00 00 00 02 E5 62
23 00 00 00 00 00 02 E5 50
23 00 00 00 00 00 02 E5 3d
23 00 00 00 00 00 02 E5 31
23 00 00 00 00 00 02 E5 29
23 00 00 00 00 00 02 E5 20
23 00 00 00 00 00 02 E5 13
23 00 00 00 00 00 02 E5 0c
23 00 00 00 00 00 02 E5 09
23 00 00 00 00 00 02 00 00
23 00 00 00 00 00 02 E6 3b
23 00 00 00 00 00 02 E6 3e
23 00 00 00 00 00 02 E6 41
23 00 00 00 00 00 02 E6 45
23 00 00 00 00 00 02 E6 49
23 00 00 00 00 00 02 E6 4d
23 00 00 00 00 00 02 E6 56
23 00 00 00 00 00 02 E6 63
23 00 00 00 00 00 02 E6 66
23 00 00 00 00 00 02 E6 75
23 00 00 00 00 00 02 E6 7c
23 00 00 00 00 00 02 E6 7f
23 00 00 00 00 00 02 E6 7d
23 00 00 00 00 00 02 E6 79
23 00 00 00 00 00 02 E6 73
23 00 00 00 00 00 02 E6 62
23 00 00 00 00 00 02 E6 50
23 00 00 00 00 00 02 E6 3d
23 00 00 00 00 00 02 E6 31
23 00 00 00 00 00 02 E6 29
23 00 00 00 00 00 02 E6 20
23 00 00 00 00 00 02 E6 13
23 00 00 00 00 00 02 E6 0c
23 01 00 00 00 00 02 E6 09
];

qcom,mdss-dsi-default-command = [
23 00 00 00 00 00 02 00 00
23 00 00 00 00 00 02 E1 00
23 00 00 00 00 00 02 E1 05
23 00 00 00 00 00 02 E1 0c
23 00 00 00 00 00 02 E1 17
23 00 00 00 00 00 02 E1 20
23 00 00 00 00 00 02 E1 28
23 00 00 00 00 00 02 E1 36
23 00 00 00 00 00 02 E1 4b
23 00 00 00 00 00 02 E1 55
23 00 00 00 00 00 02 E1 6a
23 00 00 00 00 00 02 E1 74
23 00 00 00 00 00 02 E1 7a
23 00 00 00 00 00 02 E1 81
23 00 00 00 00 00 02 E1 7c
23 00 00 00 00 00 02 E1 76
23 00 00 00 00 00 02 E1 65
23 00 00 00 00 00 02 E1 51
23 00 00 00 00 00 02 E1 3f
23 00 00 00 00 00 02 E1 32
23 00 00 00 00 00 02 E1 2a
23 00 00 00 00 00 02 E1 21
23 00 00 00 00 00 02 E1 15
23 00 00 00 00 00 02 E1 0e
23 00 00 00 00 00 02 E1 09
23 00 00 00 00 00 02 00 00
23 00 00 00 00 00 02 E2 00
23 00 00 00 00 00 02 E2 05
23 00 00 00 00 00 02 E2 0c
23 00 00 00 00 00 02 E2 17
23 00 00 00 00 00 02 E2 20
23 00 00 00 00 00 02 E2 28
23 00 00 00 00 00 02 E2 36
23 00 00 00 00 00 02 E2 4b
23 00 00 00 00 00 02 E2 55
23 00 00 00 00 00 02 E2 6a
23 00 00 00 00 00 02 E2 74
23 00 00 00 00 00 02 E2 7a
23 00 00 00 00 00 02 E2 81
23 00 00 00 00 00 02 E2 7c
23 00 00 00 00 00 02 E2 76
23 00 00 00 00 00 02 E2 65
23 00 00 00 00 00 02 E2 51
23 00 00 00 00 00 02 E2 3f
23 00 00 00 00 00 02 E2 32
23 00 00 00 00 00 02 E2 2a
23 00 00 00 00 00 02 E2 21
23 00 00 00 00 00 02 E2 15
23 00 00 00 00 00 02 E2 0e
23 00 00 00 00 00 02 E2 09
23 00 00 00 00 00 02 00 00
23 00 00 00 00 00 02 E3 25
23 00 00 00 00 00 02 E3 29
23 00 00 00 00 00 02 E3 2c
23 00 00 00 00 00 02 E3 32
23 00 00 00 00 00 02 E3 39
23 00 00 00 00 00 02 E3 3d
23 00 00 00 00 00 02 E3 47
23 00 00 00 00 00 02 E3 56
23 00 00 00 00 00 02 E3 5e
23 00 00 00 00 00 02 E3 6e
23 00 00 00 00 00 02 E3 77
23 00 00 00 00 00 02 E3 7c
23 00 00 00 00 00 02 E3 80
23 00 00 00 00 00 02 E3 7b
23 00 00 00 00 00 02 E3 75
23 00 00 00 00 00 02 E3 64
23 00 00 00 00 00 02 E3 50
23 00 00 00 00 00 02 E3 3e
23 00 00 00 00 00 02 E3 31
23 00 00 00 00 00 02 E3 29
23 00 00 00 00 00 02 E3 20
23 00 00 00 00 00 02 E3 15
23 00 00 00 00 00 02 E3 0e
23 00 00 00 00 00 02 E3 09
23 00 00 00 00 00 02 00 00
23 00 00 00 00 00 02 E4 25
23 00 00 00 00 00 02 E4 29
23 00 00 00 00 00 02 E4 2c
23 00 00 00 00 00 02 E4 32
23 00 00 00 00 00 02 E4 39
23 00 00 00 00 00 02 E4 3d
23 00 00 00 00 00 02 E4 47
23 00 00 00 00 00 02 E4 56
23 00 00 00 00 00 02 E4 5e
23 00 00 00 00 00 02 E4 6e
23 00 00 00 00 00 02 E4 77
23 00 00 00 00 00 02 E4 7c
23 00 00 00 00 00 02 E4 80
23 00 00 00 00 00 02 E4 7b
23 00 00 00 00 00 02 E4 75
23 00 00 00 00 00 02 E4 64
23 00 00 00 00 00 02 E4 50
23 00 00 00 00 00 02 E4 3e
23 00 00 00 00 00 02 E4 31
23 00 00 00 00 00 02 E4 29
23 00 00 00 00 00 02 E4 20
23 00 00 00 00 00 02 E4 15
23 00 00 00 00 00 02 E4 0e
23 00 00 00 00 00 02 E4 09
23 00 00 00 00 00 02 00 00
23 00 00 00 00 00 02 E5 3b
23 00 00 00 00 00 02 E5 3f
23 00 00 00 00 00 02 E5 41
23 00 00 00 00 00 02 E5 46
23 00 00 00 00 00 02 E5 4b
23 00 00 00 00 00 02 E5 4f
23 00 00 00 00 00 02 E5 56
23 00 00 00 00 00 02 E5 62
23 00 00 00 00 00 02 E5 69
23 00 00 00 00 00 02 E5 76
23 00 00 00 00 00 02 E5 7b
23 00 00 00 00 00 02 E5 7f
23 00 00 00 00 00 02 E5 7d
23 00 00 00 00 00 02 E5 7a
23 00 00 00 00 00 02 E5 74
23 00 00 00 00 00 02 E5 60
23 00 00 00 00 00 02 E5 50
23 00 00 00 00 00 02 E5 3d
23 00 00 00 00 00 02 E5 31
23 00 00 00 00 00 02 E5 29
23 00 00 00 00 00 02 E5 20
23 00 00 00 00 00 02 E5 14
23 00 00 00 00 00 02 E5 0e
23 00 00 00 00 00 02 E5 09
23 00 00 00 00 00 02 00 00
23 00 00 00 00 00 02 E6 3b
23 00 00 00 00 00 02 E6 3f
23 00 00 00 00 00 02 E6 41
23 00 00 00 00 00 02 E6 46
23 00 00 00 00 00 02 E6 4b
23 00 00 00 00 00 02 E6 4f
23 00 00 00 00 00 02 E6 56
23 00 00 00 00 00 02 E6 62
23 00 00 00 00 00 02 E6 69
23 00 00 00 00 00 02 E6 76
23 00 00 00 00 00 02 E6 7b
23 00 00 00 00 00 02 E6 7f
23 00 00 00 00 00 02 E6 7d
23 00 00 00 00 00 02 E6 7a
23 00 00 00 00 00 02 E6 74
23 00 00 00 00 00 02 E6 60
23 00 00 00 00 00 02 E6 50
23 00 00 00 00 00 02 E6 3d
23 00 00 00 00 00 02 E6 31
23 00 00 00 00 00 02 E6 29
23 00 00 00 00 00 02 E6 20
23 00 00 00 00 00 02 E6 14
23 00 00 00 00 00 02 E6 0e
23 01 00 00 00 00 02 E6 09
];

qcom,mdss-dsi-level1-command = [
23 00 00 00 00 00 02 00 00
23 00 00 00 00 00 02 E1 00
23 00 00 00 00 00 02 E1 0a
23 00 00 00 00 00 02 E1 10
23 00 00 00 00 00 02 E1 1a
23 00 00 00 00 00 02 E1 22
23 00 00 00 00 00 02 E1 29
23 00 00 00 00 00 02 E1 36
23 00 00 00 00 00 02 E1 4b
23 00 00 00 00 00 02 E1 56
23 00 00 00 00 00 02 E1 6a
23 00 00 00 00 00 02 E1 74
23 00 00 00 00 00 02 E1 7b
23 00 00 00 00 00 02 E1 80
23 00 00 00 00 00 02 E1 7b
23 00 00 00 00 00 02 E1 77
23 00 00 00 00 00 02 E1 65
23 00 00 00 00 00 02 E1 51
23 00 00 00 00 00 02 E1 3e
23 00 00 00 00 00 02 E1 32
23 00 00 00 00 00 02 E1 2a
23 00 00 00 00 00 02 E1 20
23 00 00 00 00 00 02 E1 14
23 00 00 00 00 00 02 E1 0d
23 00 00 00 00 00 02 E1 09
23 00 00 00 00 00 02 00 00
23 00 00 00 00 00 02 E2 00
23 00 00 00 00 00 02 E2 0a
23 00 00 00 00 00 02 E2 10
23 00 00 00 00 00 02 E2 1a
23 00 00 00 00 00 02 E2 22
23 00 00 00 00 00 02 E2 29
23 00 00 00 00 00 02 E2 36
23 00 00 00 00 00 02 E2 4b
23 00 00 00 00 00 02 E2 56
23 00 00 00 00 00 02 E2 6a
23 00 00 00 00 00 02 E2 74
23 00 00 00 00 00 02 E2 7b
23 00 00 00 00 00 02 E2 80
23 00 00 00 00 00 02 E2 7b
23 00 00 00 00 00 02 E2 77
23 00 00 00 00 00 02 E2 65
23 00 00 00 00 00 02 E2 51
23 00 00 00 00 00 02 E2 3e
23 00 00 00 00 00 02 E2 32
23 00 00 00 00 00 02 E2 2a
23 00 00 00 00 00 02 E2 20
23 00 00 00 00 00 02 E2 14
23 00 00 00 00 00 02 E2 0d
23 00 00 00 00 00 02 E2 09
23 00 00 00 00 00 02 00 00
23 00 00 00 00 00 02 E3 3a
23 00 00 00 00 00 02 E3 3d
23 00 00 00 00 00 02 E3 3f
23 00 00 00 00 00 02 E3 44
23 00 00 00 00 00 02 E3 49
23 00 00 00 00 00 02 E3 4c
23 00 00 00 00 00 02 E3 54
23 00 00 00 00 00 02 E3 60
23 00 00 00 00 00 02 E3 65
23 00 00 00 00 00 02 E3 74
23 00 00 00 00 00 02 E3 7b
23 00 00 00 00 00 02 E3 7f
23 00 00 00 00 00 02 E3 7e
23 00 00 00 00 00 02 E3 79
23 00 00 00 00 00 02 E3 74
23 00 00 00 00 00 02 E3 62
23 00 00 00 00 00 02 E3 4f
23 00 00 00 00 00 02 E3 3c
23 00 00 00 00 00 02 E3 30
23 00 00 00 00 00 02 E3 28
23 00 00 00 00 00 02 E3 1f
23 00 00 00 00 00 02 E3 14
23 00 00 00 00 00 02 E3 0d
23 00 00 00 00 00 02 E3 09
23 00 00 00 00 00 02 00 00
23 00 00 00 00 00 02 E4 3a
23 00 00 00 00 00 02 E4 3d
23 00 00 00 00 00 02 E4 3f
23 00 00 00 00 00 02 E4 44
23 00 00 00 00 00 02 E4 49
23 00 00 00 00 00 02 E4 4c
23 00 00 00 00 00 02 E4 54
23 00 00 00 00 00 02 E4 60
23 00 00 00 00 00 02 E4 65
23 00 00 00 00 00 02 E4 74
23 00 00 00 00 00 02 E4 7b
23 00 00 00 00 00 02 E4 7f
23 00 00 00 00 00 02 E4 7e
23 00 00 00 00 00 02 E4 79
23 00 00 00 00 00 02 E4 74
23 00 00 00 00 00 02 E4 62
23 00 00 00 00 00 02 E4 4f
23 00 00 00 00 00 02 E4 3c
23 00 00 00 00 00 02 E4 30
23 00 00 00 00 00 02 E4 28
23 00 00 00 00 00 02 E4 1f
23 00 00 00 00 00 02 E4 14
23 00 00 00 00 00 02 E4 0d
23 00 00 00 00 00 02 E4 09
23 00 00 00 00 00 02 00 00
23 00 00 00 00 00 02 E5 5a
23 00 00 00 00 00 02 E5 5b
23 00 00 00 00 00 02 E5 5d
23 00 00 00 00 00 02 E5 5f
23 00 00 00 00 00 02 E5 61
23 00 00 00 00 00 02 E5 63
23 00 00 00 00 00 02 E5 69
23 00 00 00 00 00 02 E5 73
23 00 00 00 00 00 02 E5 74
23 00 00 00 00 00 02 E5 7d
23 00 00 00 00 00 02 E5 81
23 00 00 00 00 00 02 E5 84
23 00 00 00 00 00 02 E5 79
23 00 00 00 00 00 02 E5 75
23 00 00 00 00 00 02 E5 70
23 00 00 00 00 00 02 E5 5e
23 00 00 00 00 00 02 E5 4e
23 00 00 00 00 00 02 E5 3a
23 00 00 00 00 00 02 E5 2f
23 00 00 00 00 00 02 E5 28
23 00 00 00 00 00 02 E5 1e
23 00 00 00 00 00 02 E5 12
23 00 00 00 00 00 02 E5 0d
23 00 00 00 00 00 02 E5 09
23 00 00 00 00 00 02 00 00
23 00 00 00 00 00 02 E6 5a
23 00 00 00 00 00 02 E6 5b
23 00 00 00 00 00 02 E6 5d
23 00 00 00 00 00 02 E6 5f
23 00 00 00 00 00 02 E6 61
23 00 00 00 00 00 02 E6 63
23 00 00 00 00 00 02 E6 69
23 00 00 00 00 00 02 E6 73
23 00 00 00 00 00 02 E6 74
23 00 00 00 00 00 02 E6 7d
23 00 00 00 00 00 02 E6 81
23 00 00 00 00 00 02 E6 84
23 00 00 00 00 00 02 E6 79
23 00 00 00 00 00 02 E6 75
23 00 00 00 00 00 02 E6 70
23 00 00 00 00 00 02 E6 5e
23 00 00 00 00 00 02 E6 4e
23 00 00 00 00 00 02 E6 3a
23 00 00 00 00 00 02 E6 2f
23 00 00 00 00 00 02 E6 28
23 00 00 00 00 00 02 E6 1e
23 00 00 00 00 00 02 E6 12
23 00 00 00 00 00 02 E6 0d
23 01 00 00 00 00 02 E6 09
];

qcom,mdss-dsi-level2-command = [
23 00 00 00 00 00 02 00 00
23 00 00 00 00 00 02 E1 00
23 00 00 00 00 00 02 E1 08
23 00 00 00 00 00 02 E1 0d
23 00 00 00 00 00 02 E1 18
23 00 00 00 00 00 02 E1 21
23 00 00 00 00 00 02 E1 28
23 00 00 00 00 00 02 E1 35
23 00 00 00 00 00 02 E1 4a
23 00 00 00 00 00 02 E1 55
23 00 00 00 00 00 02 E1 68
23 00 00 00 00 00 02 E1 73
23 00 00 00 00 00 02 E1 79
23 00 00 00 00 00 02 E1 81
23 00 00 00 00 00 02 E1 7c
23 00 00 00 00 00 02 E1 78
23 00 00 00 00 00 02 E1 67
23 00 00 00 00 00 02 E1 51
23 00 00 00 00 00 02 E1 3e
23 00 00 00 00 00 02 E1 32
23 00 00 00 00 00 02 E1 2a
23 00 00 00 00 00 02 E1 21
23 00 00 00 00 00 02 E1 15
23 00 00 00 00 00 02 E1 0c
23 00 00 00 00 00 02 E1 09
23 00 00 00 00 00 02 00 00
23 00 00 00 00 00 02 E2 00
23 00 00 00 00 00 02 E2 08
23 00 00 00 00 00 02 E2 0d
23 00 00 00 00 00 02 E2 18
23 00 00 00 00 00 02 E2 21
23 00 00 00 00 00 02 E2 28
23 00 00 00 00 00 02 E2 35
23 00 00 00 00 00 02 E2 4a
23 00 00 00 00 00 02 E2 55
23 00 00 00 00 00 02 E2 68
23 00 00 00 00 00 02 E2 73
23 00 00 00 00 00 02 E2 79
23 00 00 00 00 00 02 E2 81
23 00 00 00 00 00 02 E2 7c
23 00 00 00 00 00 02 E2 78
23 00 00 00 00 00 02 E2 67
23 00 00 00 00 00 02 E2 51
23 00 00 00 00 00 02 E2 3e
23 00 00 00 00 00 02 E2 32
23 00 00 00 00 00 02 E2 2a
23 00 00 00 00 00 02 E2 21
23 00 00 00 00 00 02 E2 15
23 00 00 00 00 00 02 E2 0c
23 00 00 00 00 00 02 E2 09
23 00 00 00 00 00 02 00 00
23 00 00 00 00 00 02 E3 47
23 00 00 00 00 00 02 E3 49
23 00 00 00 00 00 02 E3 4b
23 00 00 00 00 00 02 E3 4f
23 00 00 00 00 00 02 E3 52
23 00 00 00 00 00 02 E3 56
23 00 00 00 00 00 02 E3 5c
23 00 00 00 00 00 02 E3 65
23 00 00 00 00 00 02 E3 6a
23 00 00 00 00 00 02 E3 76
23 00 00 00 00 00 02 E3 7b
23 00 00 00 00 00 02 E3 7f
23 00 00 00 00 00 02 E3 7d
23 00 00 00 00 00 02 E3 79
23 00 00 00 00 00 02 E3 74
23 00 00 00 00 00 02 E3 63
23 00 00 00 00 00 02 E3 4f
23 00 00 00 00 00 02 E3 3b
23 00 00 00 00 00 02 E3 30
23 00 00 00 00 00 02 E3 28
23 00 00 00 00 00 02 E3 1f
23 00 00 00 00 00 02 E3 14
23 00 00 00 00 00 02 E3 0c
23 00 00 00 00 00 02 E3 09
23 00 00 00 00 00 02 00 00
23 00 00 00 00 00 02 E4 47
23 00 00 00 00 00 02 E4 49
23 00 00 00 00 00 02 E4 4b
23 00 00 00 00 00 02 E4 4f
23 00 00 00 00 00 02 E4 52
23 00 00 00 00 00 02 E4 56
23 00 00 00 00 00 02 E4 5c
23 00 00 00 00 00 02 E4 65
23 00 00 00 00 00 02 E4 6a
23 00 00 00 00 00 02 E4 76
23 00 00 00 00 00 02 E4 7b
23 00 00 00 00 00 02 E4 7f
23 00 00 00 00 00 02 E4 7d
23 00 00 00 00 00 02 E4 79
23 00 00 00 00 00 02 E4 74
23 00 00 00 00 00 02 E4 63
23 00 00 00 00 00 02 E4 4f
23 00 00 00 00 00 02 E4 3b
23 00 00 00 00 00 02 E4 30
23 00 00 00 00 00 02 E4 28
23 00 00 00 00 00 02 E4 1f
23 00 00 00 00 00 02 E4 14
23 00 00 00 00 00 02 E4 0c
23 00 00 00 00 00 02 E4 09
23 00 00 00 00 00 02 00 00
23 00 00 00 00 00 02 E5 69
23 00 00 00 00 00 02 E5 69
23 00 00 00 00 00 02 E5 6b
23 00 00 00 00 00 02 E5 6d
23 00 00 00 00 00 02 E5 6f
23 00 00 00 00 00 02 E5 70
23 00 00 00 00 00 02 E5 75
23 00 00 00 00 00 02 E5 7c
23 00 00 00 00 00 02 E5 7c
23 00 00 00 00 00 02 E5 81
23 00 00 00 00 00 02 E5 84
23 00 00 00 00 00 02 E5 86
23 00 00 00 00 00 02 E5 78
23 00 00 00 00 00 02 E5 74
23 00 00 00 00 00 02 E5 6f
23 00 00 00 00 00 02 E5 5e
23 00 00 00 00 00 02 E5 4d
23 00 00 00 00 00 02 E5 39
23 00 00 00 00 00 02 E5 2e
23 00 00 00 00 00 02 E5 27
23 00 00 00 00 00 02 E5 1e
23 00 00 00 00 00 02 E5 12
23 00 00 00 00 00 02 E5 0c
23 00 00 00 00 00 02 E5 09
23 00 00 00 00 00 02 00 00
23 00 00 00 00 00 02 E6 69
23 00 00 00 00 00 02 E6 69
23 00 00 00 00 00 02 E6 6b
23 00 00 00 00 00 02 E6 6d
23 00 00 00 00 00 02 E6 6f
23 00 00 00 00 00 02 E6 70
23 00 00 00 00 00 02 E6 75
23 00 00 00 00 00 02 E6 7c
23 00 00 00 00 00 02 E6 7c
23 00 00 00 00 00 02 E6 81
23 00 00 00 00 00 02 E6 84
23 00 00 00 00 00 02 E6 86
23 00 00 00 00 00 02 E6 78
23 00 00 00 00 00 02 E6 74
23 00 00 00 00 00 02 E6 6f
23 00 00 00 00 00 02 E6 5e
23 00 00 00 00 00 02 E6 4d
23 00 00 00 00 00 02 E6 39
23 00 00 00 00 00 02 E6 2e
23 00 00 00 00 00 02 E6 27
23 00 00 00 00 00 02 E6 1e
23 00 00 00 00 00 02 E6 12
23 00 00 00 00 00 02 E6 0c
23 01 00 00 00 00 02 E6 09
];

qcom,mdss-dsi-level3-command = [
23 00 00 00 00 00 02 00 00
23 00 00 00 00 00 02 E1 00
23 00 00 00 00 00 02 E1 07
23 00 00 00 00 00 02 E1 0e
23 00 00 00 00 00 02 E1 19
23 00 00 00 00 00 02 E1 23
23 00 00 00 00 00 02 E1 2a
23 00 00 00 00 00 02 E1 38
23 00 00 00 00 00 02 E1 4c
23 00 00 00 00 00 02 E1 55
23 00 00 00 00 00 02 E1 6a
23 00 00 00 00 00 02 E1 75
23 00 00 00 00 00 02 E1 7c
23 00 00 00 00 00 02 E1 80
23 00 00 00 00 00 02 E1 7c
23 00 00 00 00 00 02 E1 77
23 00 00 00 00 00 02 E1 66
23 00 00 00 00 00 02 E1 51
23 00 00 00 00 00 02 E1 3e
23 00 00 00 00 00 02 E1 31
23 00 00 00 00 00 02 E1 2a
23 00 00 00 00 00 02 E1 20
23 00 00 00 00 00 02 E1 14
23 00 00 00 00 00 02 E1 0c
23 00 00 00 00 00 02 E1 09
23 00 00 00 00 00 02 00 00
23 00 00 00 00 00 02 E2 00
23 00 00 00 00 00 02 E2 07
23 00 00 00 00 00 02 E2 0e
23 00 00 00 00 00 02 E2 19
23 00 00 00 00 00 02 E2 23
23 00 00 00 00 00 02 E2 2a
23 00 00 00 00 00 02 E2 38
23 00 00 00 00 00 02 E2 4c
23 00 00 00 00 00 02 E2 55
23 00 00 00 00 00 02 E2 6a
23 00 00 00 00 00 02 E2 75
23 00 00 00 00 00 02 E2 7c
23 00 00 00 00 00 02 E2 80
23 00 00 00 00 00 02 E2 7c
23 00 00 00 00 00 02 E2 77
23 00 00 00 00 00 02 E2 66
23 00 00 00 00 00 02 E2 51
23 00 00 00 00 00 02 E2 3e
23 00 00 00 00 00 02 E2 31
23 00 00 00 00 00 02 E2 2a
23 00 00 00 00 00 02 E2 20
23 00 00 00 00 00 02 E2 14
23 00 00 00 00 00 02 E2 0c
23 00 00 00 00 00 02 E2 09
23 00 00 00 00 00 02 00 00
23 00 00 00 00 00 02 E3 51
23 00 00 00 00 00 02 E3 53
23 00 00 00 00 00 02 E3 54
23 00 00 00 00 00 02 E3 57
23 00 00 00 00 00 02 E3 5b
23 00 00 00 00 00 02 E3 5e
23 00 00 00 00 00 02 E3 63
23 00 00 00 00 00 02 E3 6c
23 00 00 00 00 00 02 E3 6f
23 00 00 00 00 00 02 E3 7a
23 00 00 00 00 00 02 E3 7f
23 00 00 00 00 00 02 E3 82
23 00 00 00 00 00 02 E3 7b
23 00 00 00 00 00 02 E3 78
23 00 00 00 00 00 02 E3 72
23 00 00 00 00 00 02 E3 60
23 00 00 00 00 00 02 E3 4e
23 00 00 00 00 00 02 E3 3b
23 00 00 00 00 00 02 E3 2e
23 00 00 00 00 00 02 E3 27
23 00 00 00 00 00 02 E3 1e
23 00 00 00 00 00 02 E3 13
23 00 00 00 00 00 02 E3 0c
23 00 00 00 00 00 02 E3 09
23 00 00 00 00 00 02 00 00
23 00 00 00 00 00 02 E4 51
23 00 00 00 00 00 02 E4 53
23 00 00 00 00 00 02 E4 54
23 00 00 00 00 00 02 E4 57
23 00 00 00 00 00 02 E4 5b
23 00 00 00 00 00 02 E4 5e
23 00 00 00 00 00 02 E4 63
23 00 00 00 00 00 02 E4 6c
23 00 00 00 00 00 02 E4 6f
23 00 00 00 00 00 02 E4 7a
23 00 00 00 00 00 02 E4 7f
23 00 00 00 00 00 02 E4 82
23 00 00 00 00 00 02 E4 7b
23 00 00 00 00 00 02 E4 78
23 00 00 00 00 00 02 E4 72
23 00 00 00 00 00 02 E4 60
23 00 00 00 00 00 02 E4 4e
23 00 00 00 00 00 02 E4 3b
23 00 00 00 00 00 02 E4 2e
23 00 00 00 00 00 02 E4 27
23 00 00 00 00 00 02 E4 1e
23 00 00 00 00 00 02 E4 13
23 00 00 00 00 00 02 E4 0c
23 00 00 00 00 00 02 E4 09
23 00 00 00 00 00 02 00 00
23 00 00 00 00 00 02 E5 76
23 00 00 00 00 00 02 E5 76
23 00 00 00 00 00 02 E5 78
23 00 00 00 00 00 02 E5 79
23 00 00 00 00 00 02 E5 7b
23 00 00 00 00 00 02 E5 7c
23 00 00 00 00 00 02 E5 80
23 00 00 00 00 00 02 E5 86
23 00 00 00 00 00 02 E5 82
23 00 00 00 00 00 02 E5 88
23 00 00 00 00 00 02 E5 89
23 00 00 00 00 00 02 E5 8a
23 00 00 00 00 00 02 E5 75
23 00 00 00 00 00 02 E5 72
23 00 00 00 00 00 02 E5 6b
23 00 00 00 00 00 02 E5 5a
23 00 00 00 00 00 02 E5 4b
23 00 00 00 00 00 02 E5 37
23 00 00 00 00 00 02 E5 2c
23 00 00 00 00 00 02 E5 26
23 00 00 00 00 00 02 E5 1c
23 00 00 00 00 00 02 E5 11
23 00 00 00 00 00 02 E5 0c
23 00 00 00 00 00 02 E5 09
23 00 00 00 00 00 02 00 00
23 00 00 00 00 00 02 E6 76
23 00 00 00 00 00 02 E6 76
23 00 00 00 00 00 02 E6 78
23 00 00 00 00 00 02 E6 79
23 00 00 00 00 00 02 E6 7b
23 00 00 00 00 00 02 E6 7c
23 00 00 00 00 00 02 E6 80
23 00 00 00 00 00 02 E6 86
23 00 00 00 00 00 02 E6 82
23 00 00 00 00 00 02 E6 88
23 00 00 00 00 00 02 E6 89
23 00 00 00 00 00 02 E6 8a
23 00 00 00 00 00 02 E6 75
23 00 00 00 00 00 02 E6 72
23 00 00 00 00 00 02 E6 6b
23 00 00 00 00 00 02 E6 5a
23 00 00 00 00 00 02 E6 4b
23 00 00 00 00 00 02 E6 37
23 00 00 00 00 00 02 E6 2c
23 00 00 00 00 00 02 E6 26
23 00 00 00 00 00 02 E6 1c
23 00 00 00 00 00 02 E6 11
23 00 00 00 00 00 02 E6 0c
23 01 00 00 00 00 02 E6 09
];

qcom,mdss-dsi-level4-command = [
23 00 00 00 00 00 02 00 00
23 00 00 00 00 00 02 E1 00
23 00 00 00 00 00 02 E1 08
23 00 00 00 00 00 02 E1 0a
23 00 00 00 00 00 02 E1 19
23 00 00 00 00 00 02 E1 24
23 00 00 00 00 00 02 E1 2b
23 00 00 00 00 00 02 E1 39
23 00 00 00 00 00 02 E1 4c
23 00 00 00 00 00 02 E1 54
23 00 00 00 00 00 02 E1 6b
23 00 00 00 00 00 02 E1 76
23 00 00 00 00 00 02 E1 7c
23 00 00 00 00 00 02 E1 80
23 00 00 00 00 00 02 E1 7c
23 00 00 00 00 00 02 E1 77
23 00 00 00 00 00 02 E1 66
23 00 00 00 00 00 02 E1 51
23 00 00 00 00 00 02 E1 3e
23 00 00 00 00 00 02 E1 31
23 00 00 00 00 00 02 E1 2a
23 00 00 00 00 00 02 E1 21
23 00 00 00 00 00 02 E1 14
23 00 00 00 00 00 02 E1 0c
23 00 00 00 00 00 02 E1 09
23 00 00 00 00 00 02 00 00
23 00 00 00 00 00 02 E2 00
23 00 00 00 00 00 02 E2 08
23 00 00 00 00 00 02 E2 0a
23 00 00 00 00 00 02 E2 19
23 00 00 00 00 00 02 E2 24
23 00 00 00 00 00 02 E2 2b
23 00 00 00 00 00 02 E2 39
23 00 00 00 00 00 02 E2 4c
23 00 00 00 00 00 02 E2 54
23 00 00 00 00 00 02 E2 6b
23 00 00 00 00 00 02 E2 76
23 00 00 00 00 00 02 E2 7c
23 00 00 00 00 00 02 E2 80
23 00 00 00 00 00 02 E2 7c
23 00 00 00 00 00 02 E2 77
23 00 00 00 00 00 02 E2 66
23 00 00 00 00 00 02 E2 51
23 00 00 00 00 00 02 E2 3e
23 00 00 00 00 00 02 E2 31
23 00 00 00 00 00 02 E2 2a
23 00 00 00 00 00 02 E2 21
23 00 00 00 00 00 02 E2 14
23 00 00 00 00 00 02 E2 0c
23 00 00 00 00 00 02 E2 09
23 00 00 00 00 00 02 00 00
23 00 00 00 00 00 02 E3 5b
23 00 00 00 00 00 02 E3 5c
23 00 00 00 00 00 02 E3 5e
23 00 00 00 00 00 02 E3 60
23 00 00 00 00 00 02 E3 63
23 00 00 00 00 00 02 E3 65
23 00 00 00 00 00 02 E3 6a
23 00 00 00 00 00 02 E3 72
23 00 00 00 00 00 02 E3 74
23 00 00 00 00 00 02 E3 7e
23 00 00 00 00 00 02 E3 81
23 00 00 00 00 00 02 E3 84
23 00 00 00 00 00 02 E3 7a
23 00 00 00 00 00 02 E3 77
23 00 00 00 00 00 02 E3 71
23 00 00 00 00 00 02 E3 5f
23 00 00 00 00 00 02 E3 4d
23 00 00 00 00 00 02 E3 3a
23 00 00 00 00 00 02 E3 2e
23 00 00 00 00 00 02 E3 27
23 00 00 00 00 00 02 E3 1e
23 00 00 00 00 00 02 E3 12
23 00 00 00 00 00 02 E3 0c
23 00 00 00 00 00 02 E3 09
23 00 00 00 00 00 02 00 00
23 00 00 00 00 00 02 E4 5b
23 00 00 00 00 00 02 E4 5c
23 00 00 00 00 00 02 E4 5e
23 00 00 00 00 00 02 E4 60
23 00 00 00 00 00 02 E4 63
23 00 00 00 00 00 02 E4 65
23 00 00 00 00 00 02 E4 6a
23 00 00 00 00 00 02 E4 72
23 00 00 00 00 00 02 E4 74
23 00 00 00 00 00 02 E4 7e
23 00 00 00 00 00 02 E4 81
23 00 00 00 00 00 02 E4 84
23 00 00 00 00 00 02 E4 7a
23 00 00 00 00 00 02 E4 77
23 00 00 00 00 00 02 E4 71
23 00 00 00 00 00 02 E4 5f
23 00 00 00 00 00 02 E4 4d
23 00 00 00 00 00 02 E4 3a
23 00 00 00 00 00 02 E4 2e
23 00 00 00 00 00 02 E4 27
23 00 00 00 00 00 02 E4 1e
23 00 00 00 00 00 02 E4 12
23 00 00 00 00 00 02 E4 0c
23 00 00 00 00 00 02 E4 09
23 00 00 00 00 00 02 00 00
23 00 00 00 00 00 02 E5 7f
23 00 00 00 00 00 02 E5 7f
23 00 00 00 00 00 02 E5 80
23 00 00 00 00 00 02 E5 82
23 00 00 00 00 00 02 E5 83
23 00 00 00 00 00 02 E5 84
23 00 00 00 00 00 02 E5 87
23 00 00 00 00 00 02 E5 8c
23 00 00 00 00 00 02 E5 88
23 00 00 00 00 00 02 E5 8c
23 00 00 00 00 00 02 E5 8d
23 00 00 00 00 00 02 E5 8c
23 00 00 00 00 00 02 E5 73
23 00 00 00 00 00 02 E5 70
23 00 00 00 00 00 02 E5 68
23 00 00 00 00 00 02 E5 59
23 00 00 00 00 00 02 E5 4a
23 00 00 00 00 00 02 E5 36
23 00 00 00 00 00 02 E5 2a
23 00 00 00 00 00 02 E5 25
23 00 00 00 00 00 02 E5 1c
23 00 00 00 00 00 02 E5 10
23 00 00 00 00 00 02 E5 0b
23 00 00 00 00 00 02 E5 09
23 00 00 00 00 00 02 00 00
23 00 00 00 00 00 02 E6 7f
23 00 00 00 00 00 02 E6 7f
23 00 00 00 00 00 02 E6 80
23 00 00 00 00 00 02 E6 82
23 00 00 00 00 00 02 E6 83
23 00 00 00 00 00 02 E6 84
23 00 00 00 00 00 02 E6 87
23 00 00 00 00 00 02 E6 8c
23 00 00 00 00 00 02 E6 88
23 00 00 00 00 00 02 E6 8c
23 00 00 00 00 00 02 E6 8d
23 00 00 00 00 00 02 E6 8c
23 00 00 00 00 00 02 E6 73
23 00 00 00 00 00 02 E6 70
23 00 00 00 00 00 02 E6 68
23 00 00 00 00 00 02 E6 59
23 00 00 00 00 00 02 E6 4a
23 00 00 00 00 00 02 E6 36
23 00 00 00 00 00 02 E6 2a
23 00 00 00 00 00 02 E6 25
23 00 00 00 00 00 02 E6 1c
23 00 00 00 00 00 02 E6 10
23 00 00 00 00 00 02 E6 0b
23 01 00 00 00 00 02 E6 09
];

qcom,mdss-dsi-level5-command = [
23 00 00 00 00 00 02 00 00
23 00 00 00 00 00 02 E1 00
23 00 00 00 00 00 02 E1 05
23 00 00 00 00 00 02 E1 13
23 00 00 00 00 00 02 E1 1c
23 00 00 00 00 00 02 E1 24
23 00 00 00 00 00 02 E1 2a
23 00 00 00 00 00 02 E1 38
23 00 00 00 00 00 02 E1 4c
23 00 00 00 00 00 02 E1 54
23 00 00 00 00 00 02 E1 6a
23 00 00 00 00 00 02 E1 75
23 00 00 00 00 00 02 E1 7b
23 00 00 00 00 00 02 E1 80
23 00 00 00 00 00 02 E1 7c
23 00 00 00 00 00 02 E1 77
23 00 00 00 00 00 02 E1 66
23 00 00 00 00 00 02 E1 50
23 00 00 00 00 00 02 E1 3e
23 00 00 00 00 00 02 E1 31
23 00 00 00 00 00 02 E1 2a
23 00 00 00 00 00 02 E1 20
23 00 00 00 00 00 02 E1 14
23 00 00 00 00 00 02 E1 0d
23 00 00 00 00 00 02 E1 09
23 00 00 00 00 00 02 00 00
23 00 00 00 00 00 02 E2 00
23 00 00 00 00 00 02 E2 05
23 00 00 00 00 00 02 E2 13
23 00 00 00 00 00 02 E2 1c
23 00 00 00 00 00 02 E2 24
23 00 00 00 00 00 02 E2 2a
23 00 00 00 00 00 02 E2 38
23 00 00 00 00 00 02 E2 4c
23 00 00 00 00 00 02 E2 54
23 00 00 00 00 00 02 E2 6a
23 00 00 00 00 00 02 E2 75
23 00 00 00 00 00 02 E2 7b
23 00 00 00 00 00 02 E2 80
23 00 00 00 00 00 02 E2 7c
23 00 00 00 00 00 02 E2 77
23 00 00 00 00 00 02 E2 66
23 00 00 00 00 00 02 E2 50
23 00 00 00 00 00 02 E2 3e
23 00 00 00 00 00 02 E2 31
23 00 00 00 00 00 02 E2 2a
23 00 00 00 00 00 02 E2 20
23 00 00 00 00 00 02 E2 14
23 00 00 00 00 00 02 E2 0d
23 00 00 00 00 00 02 E2 09
23 00 00 00 00 00 02 00 00
23 00 00 00 00 00 02 E3 61
23 00 00 00 00 00 02 E3 62
23 00 00 00 00 00 02 E3 63
23 00 00 00 00 00 02 E3 65
23 00 00 00 00 00 02 E3 68
23 00 00 00 00 00 02 E3 6b
23 00 00 00 00 00 02 E3 6f
23 00 00 00 00 00 02 E3 76
23 00 00 00 00 00 02 E3 77
23 00 00 00 00 00 02 E3 80
23 00 00 00 00 00 02 E3 83
23 00 00 00 00 00 02 E3 85
23 00 00 00 00 00 02 E3 79
23 00 00 00 00 00 02 E3 76
23 00 00 00 00 00 02 E3 70
23 00 00 00 00 00 02 E3 5e
23 00 00 00 00 00 02 E3 4c
23 00 00 00 00 00 02 E3 39
23 00 00 00 00 00 02 E3 2d
23 00 00 00 00 00 02 E3 26
23 00 00 00 00 00 02 E3 1d
23 00 00 00 00 00 02 E3 12
23 00 00 00 00 00 02 E3 0d
23 00 00 00 00 00 02 E3 09
23 00 00 00 00 00 02 00 00
23 00 00 00 00 00 02 E4 61
23 00 00 00 00 00 02 E4 62
23 00 00 00 00 00 02 E4 63
23 00 00 00 00 00 02 E4 65
23 00 00 00 00 00 02 E4 68
23 00 00 00 00 00 02 E4 6b
23 00 00 00 00 00 02 E4 6f
23 00 00 00 00 00 02 E4 76
23 00 00 00 00 00 02 E4 77
23 00 00 00 00 00 02 E4 80
23 00 00 00 00 00 02 E4 83
23 00 00 00 00 00 02 E4 85
23 00 00 00 00 00 02 E4 79
23 00 00 00 00 00 02 E4 76
23 00 00 00 00 00 02 E4 70
23 00 00 00 00 00 02 E4 5e
23 00 00 00 00 00 02 E4 4c
23 00 00 00 00 00 02 E4 39
23 00 00 00 00 00 02 E4 2d
23 00 00 00 00 00 02 E4 26
23 00 00 00 00 00 02 E4 1d
23 00 00 00 00 00 02 E4 12
23 00 00 00 00 00 02 E4 0d
23 00 00 00 00 00 02 E4 09
23 00 00 00 00 00 02 00 00
23 00 00 00 00 00 02 E5 87
23 00 00 00 00 00 02 E5 87
23 00 00 00 00 00 02 E5 87
23 00 00 00 00 00 02 E5 88
23 00 00 00 00 00 02 E5 89
23 00 00 00 00 00 02 E5 8a
23 00 00 00 00 00 02 E5 8d
23 00 00 00 00 00 02 E5 91
23 00 00 00 00 00 02 E5 8d
23 00 00 00 00 00 02 E5 90
23 00 00 00 00 00 02 E5 90
23 00 00 00 00 00 02 E5 8f
23 00 00 00 00 00 02 E5 71
23 00 00 00 00 00 02 E5 6f
23 00 00 00 00 00 02 E5 65
23 00 00 00 00 00 02 E5 57
23 00 00 00 00 00 02 E5 47
23 00 00 00 00 00 02 E5 35
23 00 00 00 00 00 02 E5 29
23 00 00 00 00 00 02 E5 23
23 00 00 00 00 00 02 E5 1a
23 00 00 00 00 00 02 E5 10
23 00 00 00 00 00 02 E5 0c
23 00 00 00 00 00 02 E5 09
23 00 00 00 00 00 02 00 00
23 00 00 00 00 00 02 E6 87
23 00 00 00 00 00 02 E6 87
23 00 00 00 00 00 02 E6 87
23 00 00 00 00 00 02 E6 88
23 00 00 00 00 00 02 E6 89
23 00 00 00 00 00 02 E6 8a
23 00 00 00 00 00 02 E6 8d
23 00 00 00 00 00 02 E6 91
23 00 00 00 00 00 02 E6 8d
23 00 00 00 00 00 02 E6 90
23 00 00 00 00 00 02 E6 90
23 00 00 00 00 00 02 E6 8f
23 00 00 00 00 00 02 E6 71
23 00 00 00 00 00 02 E6 6f
23 00 00 00 00 00 02 E6 65
23 00 00 00 00 00 02 E6 57
23 00 00 00 00 00 02 E6 47
23 00 00 00 00 00 02 E6 35
23 00 00 00 00 00 02 E6 29
23 00 00 00 00 00 02 E6 23
23 00 00 00 00 00 02 E6 1a
23 00 00 00 00 00 02 E6 10
23 00 00 00 00 00 02 E6 0c
23 01 00 00 00 00 02 E6 09
];

qcom,mdss-dsi-level6-command = [
23 00 00 00 00 00 02 00 00
23 00 00 00 00 00 02 E1 00
23 00 00 00 00 00 02 E1 08
23 00 00 00 00 00 02 E1 0f
23 00 00 00 00 00 02 E1 1a
23 00 00 00 00 00 02 E1 28
23 00 00 00 00 00 02 E1 2e
23 00 00 00 00 00 02 E1 39
23 00 00 00 00 00 02 E1 4e
23 00 00 00 00 00 02 E1 57
23 00 00 00 00 00 02 E1 6a
23 00 00 00 00 00 02 E1 74
23 00 00 00 00 00 02 E1 7b
23 00 00 00 00 00 02 E1 80
23 00 00 00 00 00 02 E1 7c
23 00 00 00 00 00 02 E1 76
23 00 00 00 00 00 02 E1 65
23 00 00 00 00 00 02 E1 51
23 00 00 00 00 00 02 E1 3f
23 00 00 00 00 00 02 E1 32
23 00 00 00 00 00 02 E1 2a
23 00 00 00 00 00 02 E1 21
23 00 00 00 00 00 02 E1 15
23 00 00 00 00 00 02 E1 0d
23 00 00 00 00 00 02 E1 09
23 00 00 00 00 00 02 00 00
23 00 00 00 00 00 02 E2 00
23 00 00 00 00 00 02 E2 08
23 00 00 00 00 00 02 E2 0f
23 00 00 00 00 00 02 E2 1a
23 00 00 00 00 00 02 E2 28
23 00 00 00 00 00 02 E2 2e
23 00 00 00 00 00 02 E2 39
23 00 00 00 00 00 02 E2 4e
23 00 00 00 00 00 02 E2 57
23 00 00 00 00 00 02 E2 6a
23 00 00 00 00 00 02 E2 74
23 00 00 00 00 00 02 E2 7b
23 00 00 00 00 00 02 E2 80
23 00 00 00 00 00 02 E2 7c
23 00 00 00 00 00 02 E2 76
23 00 00 00 00 00 02 E2 65
23 00 00 00 00 00 02 E2 51
23 00 00 00 00 00 02 E2 3f
23 00 00 00 00 00 02 E2 32
23 00 00 00 00 00 02 E2 2a
23 00 00 00 00 00 02 E2 21
23 00 00 00 00 00 02 E2 15
23 00 00 00 00 00 02 E2 0d
23 00 00 00 00 00 02 E2 09
23 00 00 00 00 00 02 00 00
23 00 00 00 00 00 02 E3 6e
23 00 00 00 00 00 02 E3 6e
23 00 00 00 00 00 02 E3 6f
23 00 00 00 00 00 02 E3 71
23 00 00 00 00 00 02 E3 72
23 00 00 00 00 00 02 E3 74
23 00 00 00 00 00 02 E3 78
23 00 00 00 00 00 02 E3 7e
23 00 00 00 00 00 02 E3 7d
23 00 00 00 00 00 02 E3 85
23 00 00 00 00 00 02 E3 87
23 00 00 00 00 00 02 E3 88
23 00 00 00 00 00 02 E3 77
23 00 00 00 00 00 02 E3 74
23 00 00 00 00 00 02 E3 6e
23 00 00 00 00 00 02 E3 5d
23 00 00 00 00 00 02 E3 4a
23 00 00 00 00 00 02 E3 38
23 00 00 00 00 00 02 E3 2c
23 00 00 00 00 00 02 E3 25
23 00 00 00 00 00 02 E3 1d
23 00 00 00 00 00 02 E3 13
23 00 00 00 00 00 02 E3 0d
23 00 00 00 00 00 02 E3 09
23 00 00 00 00 00 02 00 00
23 00 00 00 00 00 02 E4 6e
23 00 00 00 00 00 02 E4 6e
23 00 00 00 00 00 02 E4 6f
23 00 00 00 00 00 02 E4 71
23 00 00 00 00 00 02 E4 72
23 00 00 00 00 00 02 E4 74
23 00 00 00 00 00 02 E4 78
23 00 00 00 00 00 02 E4 7e
23 00 00 00 00 00 02 E4 7d
23 00 00 00 00 00 02 E4 85
23 00 00 00 00 00 02 E4 87
23 00 00 00 00 00 02 E4 88
23 00 00 00 00 00 02 E4 77
23 00 00 00 00 00 02 E4 74
23 00 00 00 00 00 02 E4 6e
23 00 00 00 00 00 02 E4 5d
23 00 00 00 00 00 02 E4 4a
23 00 00 00 00 00 02 E4 38
23 00 00 00 00 00 02 E4 2c
23 00 00 00 00 00 02 E4 25
23 00 00 00 00 00 02 E4 1d
23 00 00 00 00 00 02 E4 13
23 00 00 00 00 00 02 E4 0d
23 00 00 00 00 00 02 E4 09
23 00 00 00 00 00 02 00 00
23 00 00 00 00 00 02 E5 8e
23 00 00 00 00 00 02 E5 8e
23 00 00 00 00 00 02 E5 8f
23 00 00 00 00 00 02 E5 90
23 00 00 00 00 00 02 E5 91
23 00 00 00 00 00 02 E5 92
23 00 00 00 00 00 02 E5 94
23 00 00 00 00 00 02 E5 97
23 00 00 00 00 00 02 E5 92
23 00 00 00 00 00 02 E5 96
23 00 00 00 00 00 02 E5 93
23 00 00 00 00 00 02 E5 92
23 00 00 00 00 00 02 E5 6d
23 00 00 00 00 00 02 E5 6b
23 00 00 00 00 00 02 E5 64
23 00 00 00 00 00 02 E5 53
23 00 00 00 00 00 02 E5 46
23 00 00 00 00 00 02 E5 34
23 00 00 00 00 00 02 E5 28
23 00 00 00 00 00 02 E5 22
23 00 00 00 00 00 02 E5 1a
23 00 00 00 00 00 02 E5 10
23 00 00 00 00 00 02 E5 0c
23 00 00 00 00 00 02 E5 09
23 00 00 00 00 00 02 00 00
23 00 00 00 00 00 02 E6 8e
23 00 00 00 00 00 02 E6 8e
23 00 00 00 00 00 02 E6 8f
23 00 00 00 00 00 02 E6 90
23 00 00 00 00 00 02 E6 91
23 00 00 00 00 00 02 E6 92
23 00 00 00 00 00 02 E6 94
23 00 00 00 00 00 02 E6 97
23 00 00 00 00 00 02 E6 92
23 00 00 00 00 00 02 E6 96
23 00 00 00 00 00 02 E6 93
23 00 00 00 00 00 02 E6 92
23 00 00 00 00 00 02 E6 6d
23 00 00 00 00 00 02 E6 6b
23 00 00 00 00 00 02 E6 64
23 00 00 00 00 00 02 E6 53
23 00 00 00 00 00 02 E6 46
23 00 00 00 00 00 02 E6 34
23 00 00 00 00 00 02 E6 28
23 00 00 00 00 00 02 E6 22
23 00 00 00 00 00 02 E6 1a
23 00 00 00 00 00 02 E6 10
23 00 00 00 00 00 02 E6 0c
23 01 00 00 00 00 02 E6 09
];

qcom,mdss-dsi-level7-command = [
23 00 00 00 00 00 02 00 00
23 00 00 00 00 00 02 E1 00
23 00 00 00 00 00 02 E1 04
23 00 00 00 00 00 02 E1 0b
23 00 00 00 00 00 02 E1 19
23 00 00 00 00 00 02 E1 27
23 00 00 00 00 00 02 E1 2d
23 00 00 00 00 00 02 E1 3a
23 00 00 00 00 00 02 E1 4d
23 00 00 00 00 00 02 E1 55
23 00 00 00 00 00 02 E1 6a
23 00 00 00 00 00 02 E1 75
23 00 00 00 00 00 02 E1 7b
23 00 00 00 00 00 02 E1 80
23 00 00 00 00 00 02 E1 7c
23 00 00 00 00 00 02 E1 76
23 00 00 00 00 00 02 E1 64
23 00 00 00 00 00 02 E1 51
23 00 00 00 00 00 02 E1 3e
23 00 00 00 00 00 02 E1 32
23 00 00 00 00 00 02 E1 2b
23 00 00 00 00 00 02 E1 21
23 00 00 00 00 00 02 E1 14
23 00 00 00 00 00 02 E1 0c
23 00 00 00 00 00 02 E1 09
23 00 00 00 00 00 02 00 00
23 00 00 00 00 00 02 E2 00
23 00 00 00 00 00 02 E2 04
23 00 00 00 00 00 02 E2 0b
23 00 00 00 00 00 02 E2 19
23 00 00 00 00 00 02 E2 27
23 00 00 00 00 00 02 E2 2d
23 00 00 00 00 00 02 E2 3a
23 00 00 00 00 00 02 E2 4d
23 00 00 00 00 00 02 E2 55
23 00 00 00 00 00 02 E2 6a
23 00 00 00 00 00 02 E2 75
23 00 00 00 00 00 02 E2 7b
23 00 00 00 00 00 02 E2 80
23 00 00 00 00 00 02 E2 7c
23 00 00 00 00 00 02 E2 76
23 00 00 00 00 00 02 E2 64
23 00 00 00 00 00 02 E2 51
23 00 00 00 00 00 02 E2 3e
23 00 00 00 00 00 02 E2 32
23 00 00 00 00 00 02 E2 2b
23 00 00 00 00 00 02 E2 21
23 00 00 00 00 00 02 E2 14
23 00 00 00 00 00 02 E2 0c
23 00 00 00 00 00 02 E2 09
23 00 00 00 00 00 02 00 00
23 00 00 00 00 00 02 E3 74
23 00 00 00 00 00 02 E3 74
23 00 00 00 00 00 02 E3 75
23 00 00 00 00 00 02 E3 76
23 00 00 00 00 00 02 E3 77
23 00 00 00 00 00 02 E3 79
23 00 00 00 00 00 02 E3 7d
23 00 00 00 00 00 02 E3 82
23 00 00 00 00 00 02 E3 81
23 00 00 00 00 00 02 E3 88
23 00 00 00 00 00 02 E3 88
23 00 00 00 00 00 02 E3 89
23 00 00 00 00 00 02 E3 76
23 00 00 00 00 00 02 E3 73
23 00 00 00 00 00 02 E3 6e
23 00 00 00 00 00 02 E3 5d
23 00 00 00 00 00 02 E3 4a
23 00 00 00 00 00 02 E3 37
23 00 00 00 00 00 02 E3 2c
23 00 00 00 00 00 02 E3 25
23 00 00 00 00 00 02 E3 1c
23 00 00 00 00 00 02 E3 12
23 00 00 00 00 00 02 E3 0c
23 00 00 00 00 00 02 E3 09
23 00 00 00 00 00 02 00 00
23 00 00 00 00 00 02 E4 74
23 00 00 00 00 00 02 E4 74
23 00 00 00 00 00 02 E4 75
23 00 00 00 00 00 02 E4 76
23 00 00 00 00 00 02 E4 77
23 00 00 00 00 00 02 E4 79
23 00 00 00 00 00 02 E4 7d
23 00 00 00 00 00 02 E4 82
23 00 00 00 00 00 02 E4 81
23 00 00 00 00 00 02 E4 88
23 00 00 00 00 00 02 E4 88
23 00 00 00 00 00 02 E4 89
23 00 00 00 00 00 02 E4 76
23 00 00 00 00 00 02 E4 73
23 00 00 00 00 00 02 E4 6e
23 00 00 00 00 00 02 E4 5d
23 00 00 00 00 00 02 E4 4a
23 00 00 00 00 00 02 E4 37
23 00 00 00 00 00 02 E4 2c
23 00 00 00 00 00 02 E4 25
23 00 00 00 00 00 02 E4 1c
23 00 00 00 00 00 02 E4 12
23 00 00 00 00 00 02 E4 0c
23 00 00 00 00 00 02 E4 09
23 00 00 00 00 00 02 00 00
23 00 00 00 00 00 02 E5 95
23 00 00 00 00 00 02 E5 95
23 00 00 00 00 00 02 E5 96
23 00 00 00 00 00 02 E5 96
23 00 00 00 00 00 02 E5 97
23 00 00 00 00 00 02 E5 97
23 00 00 00 00 00 02 E5 99
23 00 00 00 00 00 02 E5 9c
23 00 00 00 00 00 02 E5 97
23 00 00 00 00 00 02 E5 99
23 00 00 00 00 00 02 E5 97
23 00 00 00 00 00 02 E5 94
23 00 00 00 00 00 02 E5 6b
23 00 00 00 00 00 02 E5 67
23 00 00 00 00 00 02 E5 62
23 00 00 00 00 00 02 E5 50
23 00 00 00 00 00 02 E5 43
23 00 00 00 00 00 02 E5 31
23 00 00 00 00 00 02 E5 27
23 00 00 00 00 00 02 E5 20
23 00 00 00 00 00 02 E5 18
23 00 00 00 00 00 02 E5 0f
23 00 00 00 00 00 02 E5 0b
23 00 00 00 00 00 02 E5 09
23 00 00 00 00 00 02 00 00
23 00 00 00 00 00 02 E6 95
23 00 00 00 00 00 02 E6 95
23 00 00 00 00 00 02 E6 96
23 00 00 00 00 00 02 E6 96
23 00 00 00 00 00 02 E6 97
23 00 00 00 00 00 02 E6 97
23 00 00 00 00 00 02 E6 99
23 00 00 00 00 00 02 E6 9c
23 00 00 00 00 00 02 E6 97
23 00 00 00 00 00 02 E6 99
23 00 00 00 00 00 02 E6 97
23 00 00 00 00 00 02 E6 94
23 00 00 00 00 00 02 E6 6b
23 00 00 00 00 00 02 E6 67
23 00 00 00 00 00 02 E6 62
23 00 00 00 00 00 02 E6 50
23 00 00 00 00 00 02 E6 43
23 00 00 00 00 00 02 E6 31
23 00 00 00 00 00 02 E6 27
23 00 00 00 00 00 02 E6 20
23 00 00 00 00 00 02 E6 18
23 00 00 00 00 00 02 E6 0f
23 00 00 00 00 00 02 E6 0b
23 01 00 00 00 00 02 E6 09
];

 qcom,mdss-dsi-level8-command = [
23 00 00 00 00 00 02 00 00
23 00 00 00 00 00 02 E1 00
23 00 00 00 00 00 02 E1 02
23 00 00 00 00 00 02 E1 0d
23 00 00 00 00 00 02 E1 16
23 00 00 00 00 00 02 E1 25
23 00 00 00 00 00 02 E1 2b
23 00 00 00 00 00 02 E1 38
23 00 00 00 00 00 02 E1 4e
23 00 00 00 00 00 02 E1 56
23 00 00 00 00 00 02 E1 69
23 00 00 00 00 00 02 E1 74
23 00 00 00 00 00 02 E1 7b
23 00 00 00 00 00 02 E1 80
23 00 00 00 00 00 02 E1 7c
23 00 00 00 00 00 02 E1 76
23 00 00 00 00 00 02 E1 66
23 00 00 00 00 00 02 E1 51
23 00 00 00 00 00 02 E1 3f
23 00 00 00 00 00 02 E1 32
23 00 00 00 00 00 02 E1 2a
23 00 00 00 00 00 02 E1 21
23 00 00 00 00 00 02 E1 14
23 00 00 00 00 00 02 E1 0d
23 00 00 00 00 00 02 E1 09
23 00 00 00 00 00 02 00 00
23 00 00 00 00 00 02 E2 00
23 00 00 00 00 00 02 E2 02
23 00 00 00 00 00 02 E2 0d
23 00 00 00 00 00 02 E2 16
23 00 00 00 00 00 02 E2 25
23 00 00 00 00 00 02 E2 2b
23 00 00 00 00 00 02 E2 38
23 00 00 00 00 00 02 E2 4e
23 00 00 00 00 00 02 E2 56
23 00 00 00 00 00 02 E2 69
23 00 00 00 00 00 02 E2 74
23 00 00 00 00 00 02 E2 7b
23 00 00 00 00 00 02 E2 80
23 00 00 00 00 00 02 E2 7c
23 00 00 00 00 00 02 E2 76
23 00 00 00 00 00 02 E2 66
23 00 00 00 00 00 02 E2 51
23 00 00 00 00 00 02 E2 3f
23 00 00 00 00 00 02 E2 32
23 00 00 00 00 00 02 E2 2a
23 00 00 00 00 00 02 E2 21
23 00 00 00 00 00 02 E2 14
23 00 00 00 00 00 02 E2 0d
23 00 00 00 00 00 02 E2 09
23 00 00 00 00 00 02 00 00
23 00 00 00 00 00 02 E3 7b
23 00 00 00 00 00 02 E3 7b
23 00 00 00 00 00 02 E3 7b
23 00 00 00 00 00 02 E3 7c
23 00 00 00 00 00 02 E3 7d
23 00 00 00 00 00 02 E3 7f
23 00 00 00 00 00 02 E3 82
23 00 00 00 00 00 02 E3 87
23 00 00 00 00 00 02 E3 84
23 00 00 00 00 00 02 E3 8b
23 00 00 00 00 00 02 E3 8b
23 00 00 00 00 00 02 E3 8b
23 00 00 00 00 00 02 E3 75
23 00 00 00 00 00 02 E3 72
23 00 00 00 00 00 02 E3 6c
23 00 00 00 00 00 02 E3 5b
23 00 00 00 00 00 02 E3 49
23 00 00 00 00 00 02 E3 37
23 00 00 00 00 00 02 E3 2b
23 00 00 00 00 00 02 E3 24
23 00 00 00 00 00 02 E3 1c
23 00 00 00 00 00 02 E3 12
23 00 00 00 00 00 02 E3 0c
23 00 00 00 00 00 02 E3 09
23 00 00 00 00 00 02 00 00
23 00 00 00 00 00 02 E4 7b
23 00 00 00 00 00 02 E4 7b
23 00 00 00 00 00 02 E4 7b
23 00 00 00 00 00 02 E4 7c
23 00 00 00 00 00 02 E4 7d
23 00 00 00 00 00 02 E4 7f
23 00 00 00 00 00 02 E4 82
23 00 00 00 00 00 02 E4 87
23 00 00 00 00 00 02 E4 84
23 00 00 00 00 00 02 E4 8b
23 00 00 00 00 00 02 E4 8b
23 00 00 00 00 00 02 E4 8b
23 00 00 00 00 00 02 E4 75
23 00 00 00 00 00 02 E4 72
23 00 00 00 00 00 02 E4 6c
23 00 00 00 00 00 02 E4 5b
23 00 00 00 00 00 02 E4 49
23 00 00 00 00 00 02 E4 37
23 00 00 00 00 00 02 E4 2b
23 00 00 00 00 00 02 E4 24
23 00 00 00 00 00 02 E4 1c
23 00 00 00 00 00 02 E4 12
23 00 00 00 00 00 02 E4 0c
23 00 00 00 00 00 02 E4 09
23 00 00 00 00 00 02 00 00
23 00 00 00 00 00 02 E5 9a
23 00 00 00 00 00 02 E5 9a
23 00 00 00 00 00 02 E5 9b
23 00 00 00 00 00 02 E5 9c
23 00 00 00 00 00 02 E5 9d
23 00 00 00 00 00 02 E5 9e
23 00 00 00 00 00 02 E5 a0
23 00 00 00 00 00 02 E5 a1
23 00 00 00 00 00 02 E5 9c
23 00 00 00 00 00 02 E5 9d
23 00 00 00 00 00 02 E5 9a
23 00 00 00 00 00 02 E5 97
23 00 00 00 00 00 02 E5 68
23 00 00 00 00 00 02 E5 64
23 00 00 00 00 00 02 E5 5f
23 00 00 00 00 00 02 E5 4e
23 00 00 00 00 00 02 E5 40
23 00 00 00 00 00 02 E5 30
23 00 00 00 00 00 02 E5 25
23 00 00 00 00 00 02 E5 1f
23 00 00 00 00 00 02 E5 17
23 00 00 00 00 00 02 E5 0f
23 00 00 00 00 00 02 E5 0b
23 00 00 00 00 00 02 E5 09
23 00 00 00 00 00 02 00 00
23 00 00 00 00 00 02 E6 9a
23 00 00 00 00 00 02 E6 9a
23 00 00 00 00 00 02 E6 9b
23 00 00 00 00 00 02 E6 9c
23 00 00 00 00 00 02 E6 9d
23 00 00 00 00 00 02 E6 9e
23 00 00 00 00 00 02 E6 a0
23 00 00 00 00 00 02 E6 a1
23 00 00 00 00 00 02 E6 9c
23 00 00 00 00 00 02 E6 9d
23 00 00 00 00 00 02 E6 9a
23 00 00 00 00 00 02 E6 97
23 00 00 00 00 00 02 E6 68
23 00 00 00 00 00 02 E6 64
23 00 00 00 00 00 02 E6 5f
23 00 00 00 00 00 02 E6 4e
23 00 00 00 00 00 02 E6 40
23 00 00 00 00 00 02 E6 30
23 00 00 00 00 00 02 E6 25
23 00 00 00 00 00 02 E6 1f
23 00 00 00 00 00 02 E6 17
23 00 00 00 00 00 02 E6 0f
23 00 00 00 00 00 02 E6 0b
23 01 00 00 00 00 02 E6 09
 ];

qcom,mdss-dsi-india-ce-on-command = [
23 01 00 00 00 00 02 55 00
23 01 00 00 00 00 02 81 80
];
qcom,mdss-dsi-china-ce-on-command = [
23 01 00 00 00 00 02 55 00
23 01 00 00 00 00 02 81 80
];


qcom,mdss-dsi-ce-off-command = [
		39 01 00 00 00 00 02 81 00
];
		qcom,mdss-dsi-on-command-state = "dsi_lp_mode";
		qcom,mdss-dsi-off-command-state = "dsi_hs_mode";
		qcom,mdss-dsi-warm-command-state = "dsi_hs_mode";
		qcom,mdss-dsi-cold-command-state = "dsi_hs_mode";
		qcom,mdss-dsi-default-command-state = "dsi_hs_mode";
		qcom,mdss-dsi-level1-command-state = "dsi_hs_mode";
		qcom,mdss-dsi-level2-command-state = "dsi_hs_mode";
		qcom,mdss-dsi-level3-command-state = "dsi_hs_mode";
		qcom,mdss-dsi-level4-command-state = "dsi_hs_mode";
		qcom,mdss-dsi-level5-command-state = "dsi_hs_mode";
		qcom,mdss-dsi-level6-command-state = "dsi_hs_mode";
		qcom,mdss-dsi-level7-command-state = "dsi_hs_mode";
		qcom,mdss-dsi-level8-command-state = "dsi_hs_mode";
		qcom,mdss-dsi-ce-on-command-state = "dsi_lp_mode";
		qcom,mdss-dsi-ce-off-command-state = "dsi_lp_mode";
		qcom,mdss-dsi-h-sync-pulse = <1>;
		qcom,mdss-dsi-traffic-mode = "burst_mode";
		qcom,mdss-dsi-lane-map = "lane_map_0123";
		qcom,mdss-dsi-bllp-eof-power-mode;
		qcom,mdss-dsi-bllp-power-mode;
       		// qcom,mdss-dsi-hfp-power-mode;
        	qcom,cont-splash-enabled;
        	qcom,mdss-dsi-lane-0-state;
		qcom,mdss-dsi-lane-1-state;
		qcom,mdss-dsi-lane-2-state;
		qcom,mdss-dsi-lane-3-state;
		qcom,mdss-dsi-panel-timings = [6e 18 10 00 38 3e 12 25 1a 03 04 00];
		qcom,mdss-dsi-t-clk-post = <0x05>;
		qcom,mdss-dsi-t-clk-pre = <0x25>;
		qcom,mdss-dsi-dma-trigger = "trigger_sw";
		qcom,mdss-dsi-mdp-trigger = "none";
		qcom,mdss-dsi-bl-pmic-control-type = "bl_ctrl_dcs";
		qcom,mdss-dsi-bl-min-level = <1>;
		qcom,mdss-dsi-bl-max-level = <255>;
                qcom,mdss-pan-physical-width-dimension = <68>;
                qcom,mdss-pan-physical-height-dimension = <121>;
		qcom,mdss-dsi-reset-sequence = <1 20>, <0 20>, <1 20>;
		qcom,mdss-dsi-tx-eot-append;
		qcom,esd-check-enabled;
		qcom,mdss-dsi-panel-status-command = [06 01 00 01 05 00 01 ac];
		qcom,mdss-dsi-panel-status-command-state = "dsi_lp_mode";
		qcom,mdss-dsi-panel-status-check-mode = "reg_read";
		qcom,mdss-dsi-panel-status-read-length = <1>;
		qcom,mdss-dsi-panel-max-error-count = <3>;
		qcom,mdss-dsi-panel-status-value = <0x00>;
	};
};

