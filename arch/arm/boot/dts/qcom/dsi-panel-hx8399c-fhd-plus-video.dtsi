/* Copyright (c) 2018, The Linux Foundation. All rights reserved.
 *
 * This program is free software; you can redistribute it and/or modify
 * it under the terms of the GNU General Public License version 2 and
 * only version 2 as published by the Free Software Foundation.
 *
 * This program is distributed in the hope that it will be useful,
 * but WITHOUT ANY WARRANTY; without even the implied warranty of
 * MERCHANTABILITY or FITNESS FOR A PARTICULAR PURPOSE.  See the
 * GNU General Public License for more details.
 */

&mdss_mdp {
	dsi_hx8399c_truly_vid: qcom,mdss_dsi_hx8399_truly_fhd_video {
		qcom,mdss-dsi-panel-name =
			"hx8399c video mode dsi truly panel";
		qcom,mdss-dsi-panel-type = "dsi_video_mode";
		qcom,mdss-dsi-panel-framerate = <60>;
		qcom,mdss-dsi-virtual-channel-id = <0>;
		qcom,mdss-dsi-stream = <0>;
		qcom,mdss-dsi-panel-width = <1080>;
		qcom,mdss-dsi-panel-height = <2160>;
		qcom,mdss-dsi-h-front-porch = <42>;
		qcom,mdss-dsi-h-back-porch = <42>;
		qcom,mdss-dsi-h-pulse-width = <10>;
		qcom,mdss-dsi-h-sync-skew = <0>;
		qcom,mdss-dsi-v-back-porch = <15>;
		qcom,mdss-dsi-v-front-porch = <10>;
		qcom,mdss-dsi-v-pulse-width = <3>;
		qcom,mdss-dsi-h-left-border = <0>;
		qcom,mdss-dsi-h-right-border = <0>;
		qcom,mdss-dsi-v-top-border = <0>;
		qcom,mdss-dsi-v-bottom-border = <0>;
		qcom,mdss-pan-physical-width-dimension = <65>;
		qcom,mdss-pan-physical-height-dimension = <129>;
		qcom,mdss-dsi-bpp = <24>;
		qcom,mdss-dsi-color-order = "rgb_swap_rgb";
		qcom,mdss-dsi-underflow-color = <0xff>;
		qcom,mdss-dsi-border-color = <0>;
		qcom,mdss-dsi-on-command = [
			39 01 00 00 00 00 04
				b9 ff 83 99
			39 01 00 00 00 00 02
				d2 88
			39 01 00 00 00 00 0c
				b1 02 04 72 92 01
				32 aa 11 11 52 57
			39 01 00 00 00 00 10
				b2 00 80 80 cc 05 07 5a
				11 10 10 00 1e 70 03 d4
			39 01 00 00 00 00 2d
				b4 00 ff 59 59 01 ab 00
				00 09 00 03 05 00 28 03
				0b 0d 21 03 02 00 0c a3
				80 59 59 02 ab 00 00 09
				00 03 05 00 28 03 0b 0d
				02 00 0c a3 01
			39 01 00 00 05 00 22
				d3 00 0c 03 03 00 00 10
				10 00 00 03 00 03 00 08
				78 08 78 00 00 00 00 00
				24 02 05 05 03 00 00 00
				05 40
			39 01 00 00 05 00 21
				d5 20 20 19 19 18 18 02
				03 00 01 24 24 18 18 18
				18 24 24 00 00 00 00 00
				00 00 00 2f 2f 30 30 31
				31
			39 01 00 00 05 00 21
				d6 24 24 18 18 19 19 01
				00 03 02 24 24 18 18 18
				18 20 20 40 40 40 40 40
				40 40 40 2f 2f 30 30 31
				31
			39 01 00 00 00 00 02
				bd 00
			39 01 00 00 00 00 11
				d8 aa aa aa aa aa aa aa
				aa aa ba aa aa aa ba aa
				aa
			39 01 00 00 00 00 02
				bd 01
			39 01 00 00 00 00 11
				d8 00 00 00 00 00 00 00
				00 82 ea aa aa 82 ea aa
				aa
			39 01 00 00 00 00 02
				bd 02
			39 01 00 00 00 00 09
				d8 ff ff c0 3f ff ff c0
				3f
			39 01 00 00 00 00 02
				bd 00
			39 01 00 00 05 00 37
				e0 01 21 31 2d 66 6f 7b
				75 7a 81 86 89 8c 90 95
				97 9a a1 a2 aa 9e ad b0
				5b 57 63 7a 01 21 31 2d
				66 6f 7b 75 7a 81 86 89
				8c 90 95 97 9a a1 a2 aa
				9e ad b0 5b 57 63 7a
			39 01 00 00 00 00 03
				b6 7e 7e
			39 01 00 00 00 00 02
				cc 08
			05 01 00 00 96 00 02 11 00
			05 01 00 00 32 00 02 29 00];
		qcom,mdss-dsi-off-command = [
			05 01 00 00 32 00 02 28 00
			05 01 00 00 96 00 02 10 00];
		qcom,mdss-dsi-on-command-state = "dsi_lp_mode";
		qcom,mdss-dsi-off-command-state = "dsi_hs_mode";
		qcom,mdss-dsi-h-sync-pulse = <0>;
		qcom,mdss-dsi-traffic-mode = "non_burst_sync_event";
		qcom,mdss-dsi-lane-map = "lane_map_0123";
		qcom,mdss-dsi-bllp-eof-power-mode;
		qcom,mdss-dsi-bllp-power-mode;
		qcom,mdss-dsi-tx-eot-append;
		qcom,mdss-dsi-lane-0-state;
		qcom,mdss-dsi-lane-1-state;
		qcom,mdss-dsi-lane-2-state;
		qcom,mdss-dsi-lane-3-state;
		qcom,mdss-dsi-t-clk-post = <0x0e>;
		qcom,mdss-dsi-t-clk-pre = <0x31>;
		qcom,mdss-dsi-dma-trigger = "trigger_sw";
		qcom,mdss-dsi-mdp-trigger = "none";
		qcom,mdss-dsi-lp11-init;
		qcom,mdss-dsi-reset-sequence = <1 10>, <0 10>, <1 10>;
	};
};

