/* Copyright (c) 2015, The Linux Foundation. All rights reserved.
 * Copyright (C) 2020 XiaoMi, Inc.
 *
 * This program is free software; you can redistribute it and/or modify
 * it under the terms of the GNU General Public License version 2 and
 * only version 2 as published by the Free Software Foundation.
 *
 * This program is distributed in the hope that it will be useful,
 * but WITHOUT ANY WARRANTY; without even the implied warranty of
 * MERCHANTABILITY or FITNESS FOR A PARTICULAR PURPOSE.  See the
 * GNU General Public License for more details.
 */

/*---------------------------------------------------------------------------
 * This file is autogenerated file using gcdb parser. Please do not edit it.
 * Update input XML file to add a new entry or update variable in this file
 * VERSION = "1.0"
 *---------------------------------------------------------------------------
 */
&mdss_mdp {
	dsi_tianma_fhd_nt36672a_video: qcom,mdss_dsi_tianma_fhd_nt36672a_video {
		qcom,mdss-dsi-panel-name = "tianma fhd video dsi panel";
		qcom,mdss-dsi-panel-id = <0>;
		qcom,mdss-dsi-panel-model = "TIANMA FHD NT36672A VIDEO PANEL";
		qcom,mdss-dsi-panel-sleepwrmod = <0>;
		qcom,mdss-dsi-panel-type = "dsi_video_mode";
		qcom,mdss-dsi-panel-framerate = <60>;
		qcom,mdss-dsi-virtual-channel-id = <0>;
		qcom,mdss-dsi-stream = <0>;
		qcom,mdss-dsi-panel-width = <1080>;
		qcom,mdss-dsi-panel-height = <2280>;
		qcom,mdss-dsi-h-front-porch = <92>;
		qcom,mdss-dsi-h-back-porch = <140>;
		qcom,mdss-dsi-h-pulse-width = <20>;
		qcom,mdss-dsi-h-sync-skew = <0>;
		qcom,mdss-dsi-v-back-porch = <10>;
		qcom,mdss-dsi-v-front-porch = <16>;
		qcom,mdss-dsi-v-pulse-width = <2>;
		qcom,mdss-dsi-h-left-border = <0>;
		qcom,mdss-dsi-h-right-border = <0>;
		qcom,mdss-dsi-v-top-border = <0>;
		qcom,mdss-dsi-v-bottom-border = <0>;
		qcom,mdss-dsi-bpp = <24>;
		qcom,mdss-dsi-color-order = "0";
		qcom,mdss-dsi-underflow-color = <0x0>;
		qcom,mdss-dsi-border-color = <0>;
		qcom,mdss-dsi-on-command = [
			15 01 00 00 00 00 02 FF 22
			15 00 00 00 00 00 02 FB 01
			/* CE */
			15 00 00 00 00 00 02 00 40
			15 00 00 00 00 00 02 01 40
			15 00 00 00 00 00 02 02 40
			15 00 00 00 00 00 02 03 40
			15 00 00 00 00 00 02 04 40
			15 00 00 00 00 00 02 05 40
			15 00 00 00 00 00 02 06 40
			15 00 00 00 00 00 02 07 40
			15 00 00 00 00 00 02 08 40
			15 00 00 00 00 00 02 09 40
			15 00 00 00 00 00 02 0A 40
			15 00 00 00 00 00 02 0B 40
			15 00 00 00 00 00 02 0C 40
			15 00 00 00 00 00 02 0D 40
			15 00 00 00 00 00 02 0E 40
			15 01 00 00 00 00 02 0F 40
			15 00 00 00 00 00 02 10 40
			15 00 00 00 00 00 02 11 50
			15 00 00 00 00 00 02 12 60
			15 00 00 00 00 00 02 13 70
			15 00 00 00 00 00 02 14 58
			15 00 00 00 00 00 02 15 68
			15 00 00 00 00 00 02 16 78
			15 00 00 00 00 00 02 17 77
			15 00 00 00 00 00 02 18 3E
			15 00 00 00 00 00 02 19 36
			15 00 00 00 00 00 02 1A 30
			15 00 00 00 00 00 02 1B 28
			15 00 00 00 00 00 02 1C 25
			15 00 00 00 00 00 02 1D 23
			15 00 00 00 00 00 02 1E 26
			15 01 00 00 00 00 02 1F 2A
			15 00 00 00 00 00 02 20 30
			15 00 00 00 00 00 02 21 36
			15 00 00 00 00 00 02 22 3C
			15 00 00 00 00 00 02 23 40
			15 00 00 00 00 00 02 24 40
			15 00 00 00 00 00 02 25 40
			15 00 00 00 00 00 02 26 40
			15 00 00 00 00 00 02 27 40
			15 00 00 00 00 00 02 28 40
			15 00 00 00 00 00 02 53 01
			15 00 00 00 00 00 02 54 01
			15 00 00 00 00 00 02 55 FF
			15 00 00 00 00 00 02 56 76
			15 00 00 00 00 00 02 58 C8
			15 00 00 00 00 00 02 59 CA
			15 00 00 00 00 00 02 5A 48
			15 00 00 00 00 00 02 5B 48
			15 00 00 00 00 00 02 5C 48
			15 00 00 00 00 00 02 5D 48
			15 00 00 00 00 00 02 5E 48
			15 01 00 00 00 00 02 5F 48
			15 00 00 00 00 00 02 60 48
			15 00 00 00 00 00 02 61 48
			15 00 00 00 00 00 02 62 48
			15 00 00 00 00 00 02 63 48
			15 00 00 00 00 00 02 64 48
			15 00 00 00 00 00 02 65 48
			15 00 00 00 00 00 02 66 48
			15 00 00 00 00 00 02 67 48
			15 00 00 00 00 00 02 68 48
			15 00 00 00 00 00 02 69 48
			15 00 00 00 00 00 02 6A 48
			15 00 00 00 00 00 02 6B 48
			15 00 00 00 00 00 02 6C 48
			15 00 00 00 00 00 02 6D 48
			15 00 00 00 00 00 02 6E 48
			15 01 00 00 00 00 02 6F C8
			15 00 00 00 00 00 02 70 03
			15 00 00 00 00 00 02 71 00
			15 00 00 00 00 00 02 72 80
			15 00 00 00 00 00 02 73 00
			15 00 00 00 00 00 02 74 06
			15 00 00 00 00 00 02 75 0C
			15 00 00 00 00 00 02 76 03
			15 00 00 00 00 00 02 77 09
			15 00 00 00 00 00 02 78 0F
			15 00 00 00 00 00 02 79 68
			15 00 00 00 00 00 02 7A 8B
			15 00 00 00 00 00 02 7C 80
			15 00 00 00 00 00 02 7D 80
			15 00 00 00 00 00 02 7E 80
			15 01 00 00 00 00 02 7F 00
			15 00 00 00 00 00 02 80 00
			15 00 00 00 00 00 02 81 00
			15 00 00 00 00 00 02 83 01
			15 00 00 00 00 00 02 84 00
			15 00 00 00 00 00 02 85 80
			15 00 00 00 00 00 02 86 80
			15 00 00 00 00 00 02 87 80
			15 00 00 00 00 00 02 88 40
			15 00 00 00 00 00 02 89 83
			15 00 00 00 00 00 02 8A 86
			15 00 00 00 00 00 02 B7 76
			15 01 00 00 00 00 02 B8 76
			15 01 00 00 00 00 02 FF 23
			15 00 00 00 00 00 02 FB 01
			/* set LEDPWM 31KHz */
			15 00 00 00 00 00 02 00 60
			15 00 00 00 00 00 02 07 00
			15 00 00 00 00 00 02 08 01
			15 01 00 00 00 00 02 09 00
			/* resolution 1080*2280 */
			15 00 00 00 00 00 02 11 01
			15 00 00 00 00 00 02 12 80
			15 00 00 00 00 00 02 15 6D
			15 01 00 00 00 00 02 16 0B
			/* UI mode */
			15 00 00 00 00 00 02 29 0A
			15 00 00 00 00 00 02 30 FF
			15 00 00 00 00 00 02 31 FF
			15 00 00 00 00 00 02 32 FF
			15 00 00 00 00 00 02 33 FF
			15 00 00 00 00 00 02 34 FF
			15 00 00 00 00 00 02 35 FF
			15 00 00 00 00 00 02 36 FF
			15 00 00 00 00 00 02 37 FF
			15 00 00 00 00 00 02 38 FC
			15 00 00 00 00 00 02 39 F9
			15 00 00 00 00 00 02 3A F5
			15 00 00 00 00 00 02 3B F1
			15 00 00 00 00 00 02 3D EE
			15 00 00 00 00 00 02 3F EB
			15 00 00 00 00 00 02 40 E9
			15 01 00 00 00 00 02 41 E5
			/* STILL mode */
			15 00 00 00 00 00 02 2A 13
			15 00 00 00 00 00 02 45 FF
			15 00 00 00 00 00 02 46 F5
			15 00 00 00 00 00 02 47 EA
			15 00 00 00 00 00 02 48 DF
			15 00 00 00 00 00 02 49 D5
			15 00 00 00 00 00 02 4A CA
			15 00 00 00 00 00 02 4B C0
			15 00 00 00 00 00 02 4C B6
			15 00 00 00 00 00 02 4D AC
			15 00 00 00 00 00 02 4E A2
			15 00 00 00 00 00 02 4F 98
			15 00 00 00 00 00 02 50 8E
			15 00 00 00 00 00 02 51 84
			15 00 00 00 00 00 02 52 7A
			15 00 00 00 00 00 02 53 70
			15 01 00 00 00 00 02 54 66
			/* MOVING mode */
			15 00 00 00 00 00 02 2B 0E
			15 00 00 00 00 00 02 58 FF
			15 00 00 00 00 00 02 59 FF
			15 00 00 00 00 00 02 5A FF
			15 00 00 00 00 00 02 5B FF
			15 00 00 00 00 00 02 5C FF
			15 00 00 00 00 00 02 5D FF
			15 00 00 00 00 00 02 5E FF
			15 00 00 00 00 00 02 5F FF
			15 00 00 00 00 00 02 60 F6
			15 00 00 00 00 00 02 61 EC
			15 00 00 00 00 00 02 62 E3
			15 00 00 00 00 00 02 63 D9
			15 00 00 00 00 00 02 64 D0
			15 00 00 00 00 00 02 65 C7
			15 00 00 00 00 00 02 66 BD
			15 01 00 00 00 00 02 67 B3
			/* cabc dimming */
			15 00 00 00 00 00 02 01 84
			15 01 00 00 00 00 02 06 01
			15 00 00 00 00 00 02 05 2D
			15 00 00 00 00 00 02 04 05
			15 01 00 00 00 00 02 FF 25
			15 00 00 00 00 00 02 FB 01
			15 01 00 00 00 00 02 05 04
			15 01 00 00 00 00 02 FF 10
			15 00 00 00 00 00 02 FB 01
			15 00 00 00 00 00 02 35 00
			29 00 00 00 00 00 03 51 07 FF
			15 00 00 00 00 00 02 53 24
			15 01 00 00 00 00 02 55 00
			05 01 00 00 00 00 02 29 00
			05 01 00 00 46 00 02 11 00
			15 01 00 00 00 00 02 FF 24
			15 00 00 00 00 00 02 FB 01
			/* esd setting, raising is valid */
			15 00 00 00 00 00 02 C3 01
			15 00 00 00 00 00 02 C4 54
			15 01 00 00 00 00 02 C2 8E
			15 01 00 00 00 00 02 FF 10];
		qcom,mdss-dsi-off-command = [
			15 01 00 00 00 00 02 FF 24
			15 00 00 00 00 00 02 FB 01
			15 01 00 00 00 00 02 C3 00
			15 01 00 00 00 00 02 FF 10
			05 01 00 00 00 00 02 28 00
			05 01 00 00 3C 00 02 10 00];
		qcom,mdss-dsi-on-command-state = "dsi_lp_mode";
		qcom,mdss-dsi-off-command-state = "dsi_hs_mode";
		qcom,mdss-dsi-h-sync-pulse = <1>;
		qcom,mdss-dsi-traffic-mode = "burst_mode";
		qcom,mdss-dsi-bllp-eof-power-mode;
		qcom,mdss-dsi-bllp-power-mode;
		qcom,mdss-dsi-lp11-init;
		qcom,mdss-dsi-lane-0-state;
		qcom,mdss-dsi-lane-1-state;
		qcom,mdss-dsi-lane-2-state;
		qcom,mdss-dsi-lane-3-state;
		qcom,mdss-dsi-t-clk-post = <0x0A>;
		qcom,mdss-dsi-t-clk-pre = <0x35>;
		qcom,mdss-dsi-bl-min-level = <1>;
		qcom,mdss-dsi-bl-max-level = <4095>;
		qcom,mdss-brightness-max-level = <4095>;
		qcom,mdss-dsi-dma-trigger = "trigger_sw";
		qcom,mdss-dsi-mdp-trigger = "none";
		qcom,mdss-dsi-bl-pmic-control-type = "bl_ctrl_wled";
		qcom,mdss-dsi-reset-sequence = <1 1>, <0 1>, <1 10>;
		qcom,mdss-pan-physical-width-dimension = <68>;
		qcom,mdss-pan-physical-height-dimension = <144>;
		qcom,mdss-dsi-tx-eot-append;
		qcom,ulps-enabled;
		qcom,esd-err-irq-gpio = <&tlmm 59 0x2001>;
		qcom,esd-check-enabled;
		qcom,dispparam-enabled;
		qcom,mdss-panel-on-dimming-delay = <120>;
		qcom,mdss-dsi-dispparam-dimmingon-command = [
			15 01 00 00 00 00 02 53 2C];
		qcom,mdss-dsi-dispparam-dimmingon-command-state = "dsi_hs_mode";
		qcom,mdss-dsi-dispparam-cabcon-command = [
			15 01 00 00 00 00 02 55 01
		];
		qcom,mdss-dsi-dispparam-cabcon-command-state = "dsi_hs_mode";
		qcom,mdss-dsi-dispparam-cabcstillon-command = [
			15 01 00 00 00 00 02 55 02
		];
		qcom,mdss-dsi-dispparam-cabcstillon-command-state = "dsi_hs_mode";
		qcom,mdss-dsi-dispparam-cabcmovieon-command = [
			15 01 00 00 00 00 02 55 03
		];
		qcom,mdss-dsi-dispparam-cabcmovieon-command-state = "dsi_hs_mode";
		qcom,mdss-dsi-dispparam-cabcoff-command = [
			15 01 00 00 00 00 02 55 00
		];
		qcom,mdss-dsi-dispparam-cabcoff-command-state = "dsi_hs_mode";
		qcom,mdss-dsi-dispparam-skince-cabcuion-command = [
			15 01 00 00 00 00 02 55 81
		];
		qcom,mdss-dsi-dispparam-skince-cabcuion-command-state = "dsi_hs_mode";
		qcom,mdss-dsi-dispparam-skince-cabcstillon-command = [
			15 01 00 00 00 00 02 55 82
		];
		qcom,mdss-dsi-dispparam-skince-cabcstillon-command-state = "dsi_hs_mode";
		qcom,mdss-dsi-dispparam-skince-cabcmovieon-command = [
			15 01 00 00 00 00 02 55 83
		];
		qcom,mdss-dsi-dispparam-skince-cabcmovieon-command-state = "dsi_hs_mode";
		qcom,mdss-dsi-dispparam-skince-cabcoff-command = [
			15 01 00 00 00 00 02 55 80
		];
		qcom,mdss-dsi-dispparam-skince-cabcoff-command-state = "dsi_hs_mode";
	};
};
