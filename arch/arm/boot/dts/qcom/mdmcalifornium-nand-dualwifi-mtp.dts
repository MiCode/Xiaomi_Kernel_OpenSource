/* Copyright (c) 2016, The Linux Foundation. All rights reserved.
 *
 * This program is free software; you can redistribute it and/or modify
 * it under the terms of the GNU General Public License version 2 and
 * only version 2 as published by the Free Software Foundation.
 *
 * This program is distributed in the hope that it will be useful,
 * but WITHOUT ANY WARRANTY; without even the implied warranty of
 * MERCHANTABILITY or FITNESS FOR A PARTICULAR PURPOSE.  See the
 * GNU General Public License for more details.
 */

/dts-v1/;

#include "mdmcalifornium-mtp.dtsi"

/ {
	model = "Qualcomm Technologies, Inc. MDMCALIFORNIUM MTP - DWIFI(NAND)";
	compatible = "qcom,mdmcalifornium-mtp", "qcom,mdmcalifornium",
		     "qcom,mtp";
	qcom,board-id = <8 3>;
};

&cnss_pcie {
	qcom,is-dual-wifi-enabled;
};

&cnss_sdio {
	status = "ok";
};
