/* Copyright (c) 2013-2015, The Linux Foundation. All rights reserved.
 * Copyright (C) 2018 XiaoMi, Inc.
 *
 * This program is free software; you can redistribute it and/or modify
 * it under the terms of the GNU General Public License version 2 and
 * only version 2 as published by the Free Software Foundation.
 *
 * This program is distributed in the hope that it will be useful,
 * but WITHOUT ANY WARRANTY; without even the implied warranty of
 * MERCHANTABILITY or FITNESS FOR A PARTICULAR PURPOSE.  See the
 * GNU General Public License for more details.
 */

&mdss_mdp {
	dsi_auo_fte716_1080p_video: qcom,mdss_dsi_auo_fte716_1080p_video {
		qcom,mdss-dsi-panel-name = "auo fte716 1080p video mode dsi panel";
		qcom,mdss-dsi-panel-type = "dsi_video_mode";
		qcom,mdss-dsi-panel-id = <5>;
		qcom,mdss-dsi-panel-model = "AUO FHD FTE716 VIDEO PANEL";
		qcom,mdss-dsi-panel-framerate = <60>;
		qcom,mdss-dsi-virtual-channel-id = <0>;
		qcom,mdss-dsi-stream = <0>;
		qcom,mdss-dsi-panel-width = <1080>;
		qcom,mdss-dsi-panel-height = <2040>;
		qcom,mdss-dsi-h-front-porch = <46>;
		qcom,mdss-dsi-h-back-porch = <32>;
		qcom,mdss-dsi-h-pulse-width = <4>;
		qcom,mdss-dsi-h-sync-skew = <0>;
		qcom,mdss-dsi-v-back-porch = <16>;
		qcom,mdss-dsi-v-front-porch = <16>;
		qcom,mdss-dsi-v-pulse-width = <4>;
		qcom,mdss-dsi-h-left-border = <0>;
		qcom,mdss-dsi-h-right-border = <0>;
		qcom,mdss-dsi-v-top-border = <0>;
		qcom,mdss-dsi-v-bottom-border = <0>;
		qcom,mdss-dsi-bpp = <24>;
		qcom,mdss-dsi-underflow-color = <0xff>;
		qcom,mdss-dsi-border-color = <0>;
		qcom,mdss-dsi-on-command = [
				29 00 00 00 00 00 02 00 00
				29 00 00 00 00 00 05 2A 00 00 04 37
				29 00 00 00 00 00 02 00 00
				29 00 00 00 00 00 05 2B 00 00 07 F7
				29 00 00 00 00 00 02 00 00
				29 00 00 00 00 00 04 FF 87 16 01
				29 00 00 00 00 00 02 00 80
				29 01 00 00 00 00 03 FF 87 16
				29 00 00 00 00 00 02 00 A0
				29 00 00 00 00 00 08 C0 00 02 02 09 01 16 07
				29 00 00 00 00 00 02 00 D0
				29 00 00 00 00 00 08 C0 00 02 02 09 01 16 07
				29 00 00 00 00 00 02 00 82
				29 00 00 00 00 00 0A A5 33 02 0C 00 00 22 25 55 77
				29 00 00 00 00 00 02 00 B0
				29 00 00 00 00 00 10 C2 85 02 01 0B 80 84 03 01 0B 80 83 04 01 0B 80
				29 00 00 00 00 00 02 00 C0
				29 00 00 00 00 00 06 C2 82 05 01 0B 80
				29 00 00 00 00 00 02 00 D0
				29 00 00 00 00 00 0E C3 00 0A 0A 00 00 00 00 01 04 00 5A 00 00
				29 00 00 00 00 00 02 00 E0
				29 00 00 00 00 00 0E C3 00 0A 0A 00 00 00 00 01 04 00 5A 00 00
				29 00 00 00 00 00 02 00 80
				29 00 00 00 00 00 07 CE 25 00 90 00 78 FF
				29 00 00 00 00 00 02 00 8D
				29 00 00 00 00 00 02 F5 21
				29 00 00 00 00 00 02 00 90
				29 00 00 00 00 00 0B C5 44 19 23 00 88 01 32 52 55 50
				29 00 00 00 00 00 02 00 98
				29 00 00 00 00 00 03 C3 11 11
				29 00 00 00 00 00 02 00 D1
				29 00 00 00 00 00 02 CF 02
				29 00 00 00 00 00 02 00 D7
				29 00 00 00 00 00 02 CF 02
				29 00 00 00 00 00 02 00 8A
				29 00 00 00 00 00 02 A5 00
				29 00 00 00 00 00 02 00 A1
				29 01 00 00 00 00 08 CE 00 02 02 08 01 16 07
				29 00 00 00 00 00 02 00 90
				29 00 00 00 00 00 09 CE 00 8C 0D 9B 00 5C 00 75
				29 00 00 00 00 00 02 00 80
				29 00 00 00 00 00 09 CB 00 00 00 00 50 00 00 00
				29 00 00 00 00 00 02 00 90
				29 00 00 00 00 00 10 CB 00 00 00 00 00 00 00 00 00 00 00 00 00 00 00
				29 00 00 00 00 00 02 00 A0
				29 00 00 00 00 00 10 CB 00 00 00 00 00 00 00 C0 00 00 00 00 00 00 00
				29 00 00 00 00 00 02 00 C0
				29 00 00 00 00 00 10 CB 15 00 15 00 15 15 15 15 2A 2A 00 00 15 15 15
				29 00 00 00 00 00 02 00 D0
				29 00 00 00 00 00 10 CB 15 15 15 55 55 00 00 2A 00 00 00 00 00 00 00
				29 00 00 00 00 00 02 00 F0
				29 00 00 00 00 00 09 CB 33 FF 00 3F F0 3C 00 00
				29 00 00 00 00 00 02 00 81
				29 00 00 00 00 00 0D F3 FF FF C0 FF FC C0 FF FF C0 FF FC C0
				29 00 00 00 00 00 02 00 90
				29 00 00 00 00 00 02 C5 77
				29 00 00 00 00 00 02 00 94
				29 00 00 00 00 00 05 CF 00 00 10 20
				29 00 00 00 00 00 02 00 A4
				29 00 00 00 00 00 05 CF 00 07 01 80
				29 00 00 00 00 00 02 00 D0
				29 00 00 00 00 00 02 CF 08
				29 00 00 00 00 00 02 00 80
				29 00 00 00 00 00 0B CA 80 BF FF 99 FF 80 FF 00 00 00
				29 00 00 00 00 00 02 00 00
				29 00 00 00 00 00 02 C6 10
				29 00 00 00 00 00 02 00 00
				29 01 00 00 00 00 13 C7 90 9A 9A 9A C8 BA 99 AA 8B 98 88 88 88 57 55 55 55 55
				29 00 00 00 00 00 02 00 00
				29 00 00 00 00 00 02 C6 11
				29 00 00 00 00 00 02 00 00
				29 01 00 00 00 00 13 C7 90 8A 8B 8A B9 AA 99 AA AA 87 88 88 88 67 66 56 55 55
				29 00 00 00 00 00 02 00 00
				29 00 00 00 00 00 02 C6 12
				29 00 00 00 00 00 02 00 00
				29 01 00 00 00 00 13 C7 90 99 9A 89 B9 AA 89 AA 9A 88 88 88 88 67 66 66 56 55
				29 00 00 00 00 00 02 00 00
				29 00 00 00 00 00 02 C6 13
				29 00 00 00 00 00 02 00 00
				29 01 00 00 00 00 13 C7 90 99 99 99 B8 A9 99 A9 A9 78 88 88 88 67 66 66 66 66
				29 00 00 00 00 00 02 00 00
				29 00 00 00 00 00 02 C6 14
				29 00 00 00 00 00 02 00 00
				29 01 00 00 00 00 13 C7 80 8A 9A 98 A8 B9 98 A8 A9 88 88 88 88 78 66 66 66 66
				29 00 00 00 00 00 02 00 00
				29 00 00 00 00 00 02 C6 15
				29 00 00 00 00 00 02 00 00
				29 01 00 00 00 00 13 C7 80 99 99 89 A8 A9 89 A9 99 79 88 88 88 78 77 66 66 66
				29 00 00 00 00 00 02 00 00
				29 00 00 00 00 00 02 C6 16
				29 00 00 00 00 00 02 00 00
				29 01 00 00 00 00 13 C7 80 99 99 88 99 A9 98 98 A9 79 88 88 88 78 77 77 66 66
				29 00 00 00 00 00 02 00 00
				29 00 00 00 00 00 02 C6 17
				29 00 00 00 00 00 02 00 00
				29 01 00 00 00 00 13 C7 80 89 99 89 98 A9 88 99 99 79 88 88 88 78 77 77 77 66
				29 00 00 00 00 00 02 00 00
				29 00 00 00 00 00 02 C6 18
				29 00 00 00 00 00 02 00 00
				29 01 00 00 00 00 13 C7 80 98 A8 88 89 A9 88 99 89 79 88 88 88 78 77 77 77 77
				29 00 00 00 00 00 02 00 00
				29 00 00 00 00 00 02 C6 19
				29 00 00 00 00 00 02 00 00
				29 01 00 00 00 00 13 C7 80 98 98 89 88 A9 88 98 99 88 88 88 88 88 77 77 77 77
				29 00 00 00 00 00 02 00 00
				29 00 00 00 00 00 02 C6 1A
				29 00 00 00 00 00 02 00 00
				29 01 00 00 00 00 13 C7 80 98 98 88 98 89 89 98 98 89 88 88 88 88 78 77 77 77
				29 00 00 00 00 00 02 00 00
				29 00 00 00 00 00 02 C6 1B
				29 00 00 00 00 00 02 00 00
				29 01 00 00 00 00 13 C7 80 88 89 88 98 A8 88 98 88 89 88 88 88 88 88 78 77 77
				29 00 00 00 00 00 02 00 00
				29 00 00 00 00 00 02 C6 1C
				29 00 00 00 00 00 02 00 00
				29 01 00 00 00 00 13 C7 80 88 98 88 88 99 88 88 89 98 88 88 88 88 88 88 77 77
				29 00 00 00 00 00 02 00 00
				29 00 00 00 00 00 02 C6 1D
				29 00 00 00 00 00 02 00 00
				29 01 00 00 00 00 13 C7 80 88 98 87 89 98 88 88 98 98 88 88 88 88 88 88 78 77
				29 00 00 00 00 00 02 00 00
				29 00 00 00 00 00 02 C6 1E
				29 00 00 00 00 00 02 00 00
				29 01 00 00 00 00 13 C7 80 88 88 88 88 89 88 88 98 97 88 88 88 88 88 88 88 78
				29 00 00 00 00 00 02 00 00
				29 00 00 00 00 00 02 C6 1F
				29 00 00 00 00 00 02 00 00
				29 01 00 00 00 00 13 C7 80 88 88 88 88 88 88 88 88 98 88 88 88 88 88 88 88 88
				29 00 00 00 00 00 02 00 00
				29 00 00 00 00 00 02 C6 00
				29 00 00 00 00 00 02 00 B0
				29 00 00 00 00 00 04 CA 02 0F 00
				29 00 00 00 00 00 02 00 82
				29 00 00 00 00 00 02 B3 0C
				29 00 00 00 00 00 02 00 00
				29 00 00 00 00 00 04 FF 00 00 00
				29 00 00 00 00 00 02 00 80
				29 01 00 00 00 00 03 FF 00 00
				15 00 00 00 00 00 02 51 FF
				15 00 00 00 00 00 02 53 24
				15 00 00 00 00 00 02 55 00
				15 00 00 00 00 00 02 35 00
				05 01 00 00 78 00 02 11 00
				05 01 00 00 14 00 02 29 00
				];
		qcom,mdss-dsi-off-command = [
				05 01 00 00 78 00 02 10 00
				05 01 00 00 32 00 02 28 00
				];
		qcom,mdss-dsi-on-command-state = "dsi_lp_mode";
		qcom,mdss-dsi-off-command-state = "dsi_hs_mode";
		qcom,mdss-dsi-displayoff-command = [05 01 00 00 20 00 02 28 00];
		qcom,mdss-dsi-displayon-command = [05 01 00 00 20 00 02 29 00];
		qcom,mdss-dsi-displayoff-command-state = "dsi_hs_mode";
		qcom,mdss-dsi-displayon-command-state = "dsi_hs_mode";
		qcom,mdss-dsi-h-sync-pulse = <1>;
		qcom,mdss-dsi-traffic-mode = "burst_mode";
		qcom,mdss-dsi-bllp-eof-power-mode;
		qcom,mdss-dsi-bllp-power-mode;
		qcom,mdss-dsi-lp11-init;
		qcom,mdss-dsi-lane-0-state;
		qcom,mdss-dsi-lane-1-state;
		qcom,mdss-dsi-lane-2-state;
		qcom,mdss-dsi-lane-3-state;
		qcom,mdss-dsi-panel-timings = [f9 3d 34 00 58 4d 36 3f 53 03 04 00];
		qcom,mdss-dsi-panel-timings-phy-v2 = [23 1F 07 09 05 03 04 a0
				23 1F 07 09 05 03 04 a0
				23 1F 07 09 05 03 04 a0
				23 1F 07 09 05 03 04 a0
				23 1A 08 09 05 03 04 a0];
		qcom,mdss-dsi-t-clk-post = <0x0D>;
		qcom,mdss-dsi-t-clk-pre = <0x2F>;
		qcom,mdss-dsi-bl-min-level = <1>;
		qcom,mdss-dsi-bl-max-level = <4095>;
		qcom,mdss-brightness-max-level = <4095>;
		qcom,mdss-dsi-dma-trigger = "trigger_sw";
		qcom,mdss-dsi-mdp-trigger = "none";
		qcom,mdss-dsi-bl-pmic-control-type = "bl_ctrl_wled";
		qcom,mdss-dsi-reset-sequence = <1 10>, <0 1>, <1 10>;
		qcom,mdss-pan-physical-width-dimension = <75>;
		qcom,mdss-pan-physical-height-dimension = <143>;
		qcom,mdss-dsi-min-refresh-rate = <53>;
		qcom,mdss-dsi-max-refresh-rate = <60>;
		qcom,mdss-dsi-tx-eot-append;
		qcom,esd-check-enabled;

		qcom,mdss-dsi-panel-status-check-mode = "te_signal_check";
		qcom,video-panel-esd-te-check;

		qcom,panel-supply-entries = <&dsi_panel_pwr_supply>;
		qcom,cont-splash-enabled;
		qcom,dispparam-enabled;
		qcom,disp-paneloff-disablecabc-enabled;
		qcom,mdss-night-brightness = <7 25 43 61>;
		qcom,mdss-panel-on-dimming-delay = <120>;
		qcom,mdss-dsi-dispparam-cabcon-command = [15 01 00 00 00 00 02 55 02];
		qcom,mdss-dsi-dispparam-cabcguion-command = [15 01 00 00 01 00 02 55 01];
		qcom,mdss-dsi-dispparam-cabcstillon-command = [15 01 00 00 01 00 02 55 02];
		qcom,mdss-dsi-dispparam-cabcmovieon-command = [15 01 00 00 01 00 02 55 03];
		qcom,mdss-dsi-dispparam-cabcoff-command = [15 01 00 00 01 00 02 55 00];
		qcom,mdss-dsi-dispparam-dimmingon-command = [15 01 00 00 01 00 02 53 2C];
		qcom,mdss-dsi-dispparam-idleon-command = [05 01 00 00 01 00 02 39 00];
		qcom,mdss-dsi-dispparam-idleoff-command = [05 01 00 00 01 00 02 38 00];
		qcom,mdss-dsi-dispparam-warm-command = [
				29 00 00 00 00 00 02 00 00
				29 00 00 00 00 00 04 FF 87 16 01
				29 00 00 00 00 00 02 00 80
				29 01 00 00 00 00 03 FF 87 16
				29 00 00 00 00 00 02 00 00
				29 00 00 00 00 00 02 94 C0
				29 00 00 00 00 00 02 00 00
				29 00 00 00 00 00 04 FF 00 00 00
				29 00 00 00 00 00 02 00 80
				29 01 00 00 00 00 03 FF 00 00
				];
		qcom,mdss-dsi-dispparam-warm-command-state = "dsi_lp_mode";
		qcom,mdss-dsi-dispparam-cold-command = [
				29 00 00 00 00 00 02 00 00
				29 00 00 00 00 00 04 FF 87 16 01
				29 00 00 00 00 00 02 00 80
				29 01 00 00 00 00 03 FF 87 16
				29 00 00 00 00 00 02 00 00
				29 00 00 00 00 00 02 94 FF
				29 00 00 00 00 00 02 00 00
				29 00 00 00 00 00 04 FF 00 00 00
				29 00 00 00 00 00 02 00 80
				29 01 00 00 00 00 03 FF 00 00
				];
		qcom,mdss-dsi-dispparam-cold-command-state = "dsi_lp_mode";
		qcom,mdss-dsi-dispparam-papermode1-command = [
				29 00 00 00 00 00 02 00 00
				29 00 00 00 00 00 04 FF 87 16 01
				29 00 00 00 00 00 02 00 80
				29 01 00 00 00 00 03 FF 87 16
				29 00 00 00 00 00 02 00 A0
				29 00 00 00 00 00 02 D7 00 //Digital Gamma enable
				29 00 00 00 00 00 02 00 00
				29 01 00 00 00 00 10 EC 00 04 08 0C 00 10 14 18 1C 55 20 28 30 38 55
				29 00 00 00 00 00 02 00 10
				29 00 00 00 00 00 10 EC 40 48 50 58 05 60 68 70 78 00 80 88 90 98 00
				29 00 00 00 00 00 02 00 20
				29 01 00 00 00 00 10 EC A0 A8 B0 B8 00 C0 C8 D0 D8 00 E0 E8 F0 F8 05
				29 00 00 00 00 00 02 00 30
				29 00 00 00 00 00 05 EC FC FE FF 00
				29 00 00 00 00 00 02 00 00
				29 01 00 00 00 00 10 ED 00 04 08 0C 00 10 14 18 1C 00 20 28 30 38 00
				29 00 00 00 00 00 02 00 10
				29 00 00 00 00 00 10 ED 40 48 50 58 00 60 68 70 78 00 80 88 90 98 00
				29 00 00 00 00 00 02 00 20
				29 01 00 00 00 00 10 ED A0 A8 B0 B8 00 C0 C8 CF D7 F0 DF E7 EF F7 BF
				29 00 00 00 00 00 02 00 30
				29 00 00 00 00 00 05 ED FB FD FE 2A
				29 00 00 00 00 00 02 00 00
				29 01 00 00 00 00 10 EE 00 03 07 0B 6C 0E 12 16 1A 1B 1E 25 2D 34 88
				29 00 00 00 00 00 02 00 10
				29 00 00 00 00 00 10 EE 3C 43 4A 52 74 59 61 68 70 77 77 7F 87 8E 8B
				29 00 00 00 00 00 02 00 20
				29 01 00 00 00 00 10 EE 96 9D A5 AD 2D B4 BC C4 CC 1B D4 DC E3 ED 64
				29 00 00 00 00 00 02 00 30
				29 00 00 00 00 00 05 EE F1 F3 F4 00
				29 00 00 00 00 00 02 00 00
				29 01 00 00 00 00 04 FF 00 00 00
				29 00 00 00 00 00 02 00 80
				29 01 00 00 00 00 03 FF 00 00
				];
		qcom,mdss-dsi-dispparam-papermode1-command-state = "dsi_lp_mode";
		qcom,mdss-dsi-dispparam-papermode2-command = [
				29 00 00 00 00 00 02 00 00
				29 00 00 00 00 00 04 FF 87 16 01
				29 00 00 00 00 00 02 00 80
				29 01 00 00 00 00 03 FF 87 16
				29 00 00 00 00 00 02 00 A0
				29 00 00 00 00 00 02 D7 00
				29 00 00 00 00 00 02 00 00
				29 01 00 00 00 00 10 EC 00 04 08 0C 00 10 14 18 1C 54 20 28 30 38 55
				29 00 00 00 00 00 02 00 10
				29 00 00 00 00 00 10 EC 40 48 50 58 01 60 68 70 78 00 80 88 90 98 00
				29 00 00 00 00 00 02 00 20
				29 01 00 00 00 00 10 EC A0 A8 B0 B8 00 C0 C8 D0 D8 00 E0 E8 F0 F8 04
				29 00 00 00 00 00 02 00 30
				29 00 00 00 00 00 05 EC FC FE FF 00
				29 00 00 00 00 00 02 00 00
				29 01 00 00 00 00 10 ED 00 04 08 0C 00 10 14 18 1B C0 1F 27 2F 38 3F
				29 00 00 00 00 00 02 00 10
				29 00 00 00 00 00 10 ED 40 48 50 58 00 60 68 70 78 00 80 88 90 98 00
				29 00 00 00 00 00 02 00 20
				29 01 00 00 00 00 10 ED A0 A8 B0 B8 00 C0 C8 D0 D8 00 E0 E7 F0 F7 CC
				29 00 00 00 00 00 02 00 30
				29 00 00 00 00 00 05 ED FB FD FE 3F
				29 00 00 00 00 00 02 00 00
				29 01 00 00 00 00 10 EE 00 03 07 0A 88 0E 11 15 19 1D 1C 23 2A 31 FA
				29 00 00 00 00 00 02 00 10
				29 00 00 00 00 00 10 EE 38 3F 46 4E 3F 55 5C 63 6A 50 71 78 80 87 4E
				29 00 00 00 00 00 02 00 20
				29 01 00 00 00 00 10 EE 8E 95 9C A4 39 AB B2 BA C1 8D C9 D1 D7 E1 70
				29 00 00 00 00 00 02 00 30
				29 00 00 00 00 00 05 EE E4 E6 E7 2B
				29 00 00 00 00 00 02 00 00
				29 01 00 00 00 00 04 FF 00 00 00
				29 00 00 00 00 00 02 00 80
				29 01 00 00 00 00 03 FF 00 00
				];
		qcom,mdss-dsi-dispparam-papermode2-command-state = "dsi_lp_mode";
		qcom,mdss-dsi-dispparam-papermode3-command = [
				29 00 00 00 00 00 02 00 00
				29 00 00 00 00 00 04 FF 87 16 01
				29 00 00 00 00 00 02 00 80
				29 01 00 00 00 00 03 FF 87 16
				29 00 00 00 00 00 02 00 A0
				29 00 00 00 00 00 02 D7 00
				29 00 00 00 00 00 02 00 00
				29 01 00 00 00 00 10 EC 00 04 08 0C 00 10 14 18 1C 00 20 28 30 38 00
				29 00 00 00 00 00 02 00 10
				29 00 00 00 00 00 10 EC 3F 47 4F 57 FF 5F 67 6F 77 AA 7F 87 8F 97 55
				29 00 00 00 00 00 02 00 20
				29 01 00 00 00 00 10 EC 9F A7 AF B7 55 BF C7 CF D7 55 DF E7 EF F7 05
				29 00 00 00 00 00 02 00 30
				29 00 00 00 00 00 05 EC FB FD FE 00
				29 00 00 00 00 00 02 00 00
				29 01 00 00 00 00 10 ED 00 04 08 0C 00 10 14 17 1B F0 1F 27 30 38 0F
				29 00 00 00 00 00 02 00 10
				29 00 00 00 00 00 10 ED 40 48 50 58 00 60 68 70 78 50 80 88 90 98 55
				29 00 00 00 00 00 02 00 20
				29 01 00 00 00 00 10 ED A0 A8 B0 B8 55 C0 C8 D0 D8 55 E0 E8 F0 F8 11
				29 00 00 00 00 00 02 00 30
				29 00 00 00 00 00 05 ED FC FE FF 00
				29 00 00 00 00 00 02 00 00
				29 01 00 00 00 00 10 EE 00 03 06 0A 34 0D 10 14 17 9E 1B 21 28 2F 1C
				29 00 00 00 00 00 02 00 10
				29 00 00 00 00 00 10 EE 35 3C 42 49 B6 50 56 5D 64 6C 6B 71 78 7F 6C
				29 00 00 00 00 00 02 00 20
				29 01 00 00 00 00 10 EE 86 8D 93 9A B1 A1 A8 AF B6 AA BD C5 CB D4 92
				29 00 00 00 00 00 02 00 30
				29 00 00 00 00 00 05 EE D8 D9 DA 28
				29 00 00 00 00 00 02 00 00
				29 01 00 00 00 00 04 FF 00 00 00
				29 00 00 00 00 00 02 00 80
				29 01 00 00 00 00 03 FF 00 00
				];
		qcom,mdss-dsi-dispparam-papermode3-command-state = "dsi_lp_mode";
		qcom,mdss-dsi-dispparam-papermode4-command = [
				29 00 00 00 00 00 02 00 00
				29 00 00 00 00 00 04 FF 87 16 01
				29 00 00 00 00 00 02 00 80
				29 01 00 00 00 00 03 FF 87 16
				29 00 00 00 00 00 02 00 A0
				29 00 00 00 00 00 02 D7 00
				29 00 00 00 00 00 02 00 00
				29 01 00 00 00 00 10 EC 00 04 08 0C 00 10 14 18 1C 00 20 28 30 38 00
				29 00 00 00 00 00 02 00 10
				29 00 00 00 00 00 10 EC 3F 47 4F 57 BF 5F 67 6F 77 AA 7F 87 8F 97 55
				29 00 00 00 00 00 02 00 20
				29 01 00 00 00 00 10 EC 9F A7 AF B7 55 BF C7 CF D7 55 DF E7 EF F7 45
				29 00 00 00 00 00 02 00 30
				29 00 00 00 00 00 05 EC FB FD FE 01
				29 00 00 00 00 00 02 00 00
				29 01 00 00 00 00 10 ED 00 04 08 0C 00 10 13 17 1B FC 1F 27 2F 38 3F
				29 00 00 00 00 00 02 00 10
				29 00 00 00 00 00 10 ED 40 48 50 58 00 60 68 70 78 50 80 88 90 98 55
				29 00 00 00 00 00 02 00 20
				29 01 00 00 00 00 10 ED A0 A8 B0 B8 55 C0 C8 D0 D8 55 E0 E8 F0 F8 11
				29 00 00 00 00 00 02 00 30
				29 00 00 00 00 00 05 ED FC FE FF 00
				29 00 00 00 00 00 02 00 00
				29 01 00 00 00 00 10 EE 00 03 06 09 94 0C 10 13 16 43 19 1F 26 2C 4E
				29 00 00 00 00 00 02 00 10
				29 00 00 00 00 00 10 EE 32 38 3E 45 39 4B 51 57 5E 39 64 6A 71 77 9E
				29 00 00 00 00 00 02 00 20
				29 01 00 00 00 00 10 EE 7E 84 8A 91 74 97 9E A4 AB B7 B2 B9 BF C8 04
				29 00 00 00 00 00 02 00 30
				29 00 00 00 00 00 05 EE CB CC CD 2C
				29 00 00 00 00 00 02 00 00
				29 01 00 00 00 00 04 FF 00 00 00
				29 00 00 00 00 00 02 00 80
				29 01 00 00 00 00 03 FF 00 00
				];
		qcom,mdss-dsi-dispparam-papermode4-command-state = "dsi_lp_mode";
		qcom,mdss-dsi-dispparam-papermode5-command = [
				29 00 00 00 00 00 02 00 00
				29 00 00 00 00 00 04 FF 87 16 01
				29 00 00 00 00 00 02 00 80
				29 01 00 00 00 00 03 FF 87 16
				29 00 00 00 00 00 02 00 A0
				29 00 00 00 00 00 02 D7 00
				29 00 00 00 00 00 02 00 00
				29 01 00 00 00 00 10 EC 00 04 08 0C 00 10 14 18 1C 00 20 28 30 38 00
				29 00 00 00 00 00 02 00 10
				29 00 00 00 00 00 10 EC 3F 47 4F 57 BF 5F 67 6F 77 AA 7F 87 8F 97 55
				29 00 00 00 00 00 02 00 20
				29 01 00 00 00 00 10 EC 9F A7 AF B7 55 BF C7 CF D7 55 DF E7 EF F7 55
				29 00 00 00 00 00 02 00 30
				29 00 00 00 00 00 05 EC FB FD FE 15
				29 00 00 00 00 00 02 00 00
				29 01 00 00 00 00 10 ED 00 04 08 0C 00 0F 13 17 1B FF 1F 27 2F 37 FF
				29 00 00 00 00 00 02 00 10
				29 00 00 00 00 00 10 ED 40 48 50 58 00 60 68 70 78 40 80 88 90 98 55
				29 00 00 00 00 00 02 00 20
				29 01 00 00 00 00 10 ED A0 A8 B0 B8 55 C0 C8 D0 D8 55 E0 E8 F0 F8 11
				29 00 00 00 00 00 02 00 30
				29 00 00 00 00 00 05 ED FC FE FF 00
				29 00 00 00 00 00 02 00 00
				29 01 00 00 00 00 10 EE 00 03 06 09 00 0C 0F 12 15 00 18 1D 23 29 6C
				29 00 00 00 00 00 02 00 10
				29 00 00 00 00 00 10 EE 2F 34 3A 40 AC 46 4C 52 57 C1 5D 63 69 6F FF
				29 00 00 00 00 00 02 00 20
				29 01 00 00 00 00 10 EE 75 7B 81 87 AA 8D 93 9A A0 0F A6 AD B2 BB 21
				29 00 00 00 00 00 02 00 30
				29 00 00 00 00 00 05 EE BE BF C0 18
				29 00 00 00 00 00 02 00 00
				29 01 00 00 00 00 04 FF 00 00 00
				29 00 00 00 00 00 02 00 80
				29 01 00 00 00 00 03 FF 00 00
				];
		qcom,mdss-dsi-dispparam-papermode5-command-state = "dsi_lp_mode";
		qcom,mdss-dsi-dispparam-papermode6-command = [
				29 00 00 00 00 00 02 00 00
				29 00 00 00 00 00 04 FF 87 16 01
				29 00 00 00 00 00 02 00 80
				29 01 00 00 00 00 03 FF 87 16
				29 00 00 00 00 00 02 00 A0
				29 00 00 00 00 00 02 D7 00
				29 00 00 00 00 00 02 00 00
				29 01 00 00 00 00 10 EC 00 04 08 0C 00 10 14 18 1C 00 20 28 2F 37 F0
				29 00 00 00 00 00 02 00 10
				29 00 00 00 00 00 10 EC 3F 47 4F 57 AF 5F 67 6F 77 5A 7F 87 8F 97 55
				29 00 00 00 00 00 02 00 20
				29 01 00 00 00 00 10 EC 9F A7 AF B7 01 BF C7 CF D7 00 DF E7 EF F7 05
				29 00 00 00 00 00 02 00 30
				29 00 00 00 00 00 05 EC FB FD FE 00
				29 00 00 00 00 00 02 00 00
				29 01 00 00 00 00 10 ED 00 04 08 0C 00 0F 13 17 1B FF 1F 27 2F 37 FF
				29 00 00 00 00 00 02 00 10
				29 00 00 00 00 00 10 ED 40 48 50 58 00 60 68 70 78 00 80 88 90 98 55
				29 00 00 00 00 00 02 00 20
				29 01 00 00 00 00 10 ED A0 A8 B0 B8 55 C0 C8 D0 D8 55 E0 E8 F0 F8 11
				29 00 00 00 00 00 02 00 30
				29 00 00 00 00 00 05 ED FC FE FF 00
				29 00 00 00 00 00 02 00 00
				29 01 00 00 00 00 10 EE 00 02 05 08 BC 0B 0E 11 13 C6 16 1C 21 26 E2
				29 00 00 00 00 00 02 00 10
				29 00 00 00 00 00 10 EE 2C 31 37 3C 49 41 47 4C 52 77 57 5D 63 68 87
				29 00 00 00 00 00 02 00 20
				29 01 00 00 00 00 10 EE 6E 73 79 7F 1C 84 8A 90 96 17 9B A2 A7 AF 97
				29 00 00 00 00 00 02 00 30
				29 00 00 00 00 00 05 EE B2 B3 B4 2D
				29 00 00 00 00 00 02 00 00
				29 01 00 00 00 00 04 FF 00 00 00
				29 00 00 00 00 00 02 00 80
				29 01 00 00 00 00 03 FF 00 00
				];
		qcom,mdss-dsi-dispparam-papermode6-command-state = "dsi_lp_mode";
		qcom,mdss-dsi-dispparam-papermode7-command = [
				29 00 00 00 00 00 02 00 00
				29 00 00 00 00 00 04 FF 87 16 01
				29 00 00 00 00 00 02 00 80
				29 01 00 00 00 00 03 FF 87 16
				29 00 00 00 00 00 02 00 A0
				29 00 00 00 00 00 02 D7 00
				29 00 00 00 00 00 02 00 00
				29 01 00 00 00 00 10 EC 00 04 08 0C 00 10 14 18 1C 00 20 28 30 37 C0
				29 00 00 00 00 00 02 00 10
				29 00 00 00 00 00 10 EC 3F 47 4F 57 BF 5F 67 6F 77 6A 7F 87 8F 97 55
				29 00 00 00 00 00 02 00 20
				29 01 00 00 00 00 10 EC 9F A7 AF B7 55 BF C7 CF D7 55 DF E7 EF F7 55
				29 00 00 00 00 00 02 00 30
				29 00 00 00 00 00 05 EC FB FD FE 15
				29 00 00 00 00 00 02 00 00
				29 01 00 00 00 00 10 ED 00 04 08 0B C0 0F 13 17 1B FF 1F 27 2F 37 FF
				29 00 00 00 00 00 02 00 10
				29 00 00 00 00 00 10 ED 40 48 50 58 00 60 68 70 78 00 80 88 90 98 55
				29 00 00 00 00 00 02 00 20
				29 01 00 00 00 00 10 ED A0 A8 B0 B8 55 C0 C8 D0 D8 55 E0 E8 F0 F8 11
				29 00 00 00 00 00 02 00 30
				29 00 00 00 00 00 05 ED FC FE FF 00
				29 00 00 00 00 00 02 00 00
				29 01 00 00 00 00 10 EE 00 02 05 08 1C 0A 0D 10 12 8B 15 1A 1F 24 01
				29 00 00 00 00 00 02 00 10
				29 00 00 00 00 00 10 EE 29 2E 33 38 00 3D 42 47 4C 40 51 56 5B 60 E9
				29 00 00 00 00 00 02 00 20
				29 01 00 00 00 00 10 EE 66 6B 70 75 D4 7B 80 85 8B 34 90 96 9B A3 1A
				29 00 00 00 00 00 02 00 30
				29 00 00 00 00 00 05 EE A5 A7 A7 33
				29 00 00 00 00 00 02 00 00
				29 01 00 00 00 00 04 FF 00 00 00
				29 00 00 00 00 00 02 00 80
				29 01 00 00 00 00 03 FF 00 00
				];
		qcom,mdss-dsi-dispparam-papermode7-command-state = "dsi_lp_mode";
		qcom,mdss-dsi-dispparam-papermode-command = [
				29 00 00 00 00 00 02 00 00
				29 00 00 00 00 00 04 FF 87 16 01
				29 00 00 00 00 00 02 00 80
				29 01 00 00 00 00 03 FF 87 16
				29 00 00 00 00 00 02 00 A0
				29 00 00 00 00 00 02 D7 00
				29 00 00 00 00 00 02 00 00
				29 01 00 00 00 00 10 EC 00 04 08 0C 00 0F 13 17 1B FF 1F 27 2F 37 FF
				29 00 00 00 00 00 02 00 10
				29 00 00 00 00 00 10 EC 3F 47 4F 57 6A 5F 67 6F 77 05 7F 87 8F 97 00
				29 00 00 00 00 00 02 00 20
				29 01 00 00 00 00 10 EC 9E A6 AE B6 FF BE C6 CE D6 FF DE E6 EE F6 FF
				29 00 00 00 00 00 02 00 30
				29 00 00 00 00 00 05 EC FA FC FD 3F
				29 00 00 00 00 00 02 00 00
				29 01 00 00 00 00 10 ED 00 04 08 0B C0 0F 13 17 1B FF 1F 27 2F 37 FF
				29 00 00 00 00 00 02 00 10
				29 00 00 00 00 00 10 ED 3F 48 50 58 03 60 68 70 78 00 80 88 90 98 54
				29 00 00 00 00 00 02 00 20
				29 01 00 00 00 00 10 ED A0 A8 B0 B8 55 C0 C8 D0 D8 55 E0 E8 F0 F8 11
				29 00 00 00 00 00 02 00 30
				29 00 00 00 00 00 05 ED FC FE FF 00
				29 00 00 00 00 00 02 00 00
				29 01 00 00 00 00 10 EE 00 02 05 07 88 0A 0C 0F 11 48 13 18 1C 21 22
				29 00 00 00 00 00 02 00 10
				29 00 00 00 00 00 10 EE 25 29 2E 32 DD 37 3C 40 45 62 4A 4E 53 58 18
				29 00 00 00 00 00 02 00 20
				29 01 00 00 00 00 10 EE 5C 61 66 6B 1B 6F 74 79 7E BF 83 89 8D 95 27
				29 00 00 00 00 00 02 00 30
				29 00 00 00 00 00 05 EE 97 98 99 1A
				29 00 00 00 00 00 02 00 00
				29 01 00 00 00 00 04 FF 00 00 00
				29 00 00 00 00 00 02 00 80
				29 01 00 00 00 00 03 FF 00 00
				];
		qcom,mdss-dsi-dispparam-papermode-command-state = "dsi_lp_mode";
	};
};
