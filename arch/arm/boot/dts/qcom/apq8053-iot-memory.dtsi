/*
 * Copyright (c) 2017-2018, The Linux Foundation. All rights reserved.
 *
 * This program is free software; you can redistribute it and/or modify
 * it under the terms of the GNU General Public License version 2 and
 * only version 2 as published by the Free Software Foundation.
 *
 * This program is distributed in the hope that it will be useful,
 * but WITHOUT ANY WARRANTY; without even the implied warranty of
 * MERCHANTABILITY or FITNESS FOR A PARTICULAR PURPOSE.  See the
 * GNU General Public License for more details.
 */

&modem_mem {
	reg = <0x0 0x86c00000 0x0 0x1800000>;
};

&adsp_fw_mem {
	reg = <0x0 0x88400000 0x0 0x1100000>;
};

&wcnss_fw_mem {
	reg = <0x0 0x89500000 0x0 0x700000>;
};

