/* Copyright (c) 2013-2014, The Linux Foundation. All rights reserved.
 * Copyright (C) 2016 XiaoMi, Inc.
 *
 * This program is free software; you can redistribute it and/or modify
 * it under the terms of the GNU General Public License version 2 and
 * only version 2 as published by the Free Software Foundation.
 *
 * This program is distributed in the hope that it will be useful,
 * but WITHOUT ANY WARRANTY; without even the implied warranty of
 * MERCHANTABILITY or FITNESS FOR A PARTICULAR PURPOSE.  See the
 * GNU General Public License for more details.
 */

/*---------------------------------------------------------------------------
 * This file is autogenerated file using gcdb parser. Please do not edit it.
 * Update input XML file to add a new entry or update variable in this file
 * VERSION = "1.0"
 *---------------------------------------------------------------------------*/
&mdss_mdp {
	dsi_jdi_fbc20_wqhd_cmd: qcom,mdss_dsi_jdi_fbc20_wqhd_command {
		qcom,mdss-dsi-panel-name = "jdi fbc20 wqhd cmd mode dsi panel";
		qcom,mdss-dsi-panel-id = <2>;
		qcom,mdss-dsi-panel-controller = <&mdss_dsi0>;
		qcom,mdss-dsi-panel-type = "dsi_cmd_mode";
		qcom,mdss-dsi-panel-destination = "display_1";
		qcom,mdss-dsi-panel-framerate = <60>;

		qcom,mdss-dsi-virtual-channel-id = <0>;
		qcom,mdss-dsi-stream = <0>;
		qcom,mdss-dsi-panel-width = <1440>;
		qcom,mdss-dsi-panel-height = <2560>;
		qcom,mdss-dsi-h-front-porch = <183>;
		qcom,mdss-dsi-h-back-porch = <190>;
		qcom,mdss-dsi-h-pulse-width = <12>;
		qcom,mdss-dsi-h-sync-skew = <0>;
		qcom,mdss-dsi-v-back-porch = <5>;
		qcom,mdss-dsi-v-front-porch = <8>;
		qcom,mdss-dsi-v-pulse-width = <1>;
		qcom,mdss-dsi-h-left-border = <0>;
		qcom,mdss-dsi-h-right-border = <0>;
		qcom,mdss-dsi-v-top-border = <0>;
		qcom,mdss-dsi-v-bottom-border = <0>;
		qcom,mdss-dsi-bpp = <24>;
		qcom,mdss-dsi-underflow-color = <0xff>;
		qcom,mdss-dsi-border-color = <0>;
		qcom,mdss-dsi-on-command = [
			15 01 00 00 00 00 02 ff 28
			15 01 00 00 00 00 02 fb 01
			15 00 00 00 00 00 02 f2 04
			15 00 00 00 00 00 02 f5 84
			15 00 00 00 00 00 02 f6 83
			15 00 00 00 00 00 02 f7 bb
			15 01 00 00 00 00 02 f8 6b

			15 00 00 00 01 00 02 FF 20
			15 00 00 00 01 00 02 FB 01
			15 00 00 00 01 00 02 75 00
			15 00 00 00 01 00 02 76 00
			15 00 00 00 01 00 02 77 00
			15 00 00 00 01 00 02 78 20
			15 00 00 00 01 00 02 79 00
			15 00 00 00 01 00 02 7A 58
			15 00 00 00 01 00 02 7B 00
			15 00 00 00 01 00 02 7C 81
			15 00 00 00 01 00 02 7D 00
			15 00 00 00 01 00 02 7E 9F
			15 00 00 00 01 00 02 7F 00
			15 00 00 00 01 00 02 80 BA
			15 00 00 00 01 00 02 81 00
			15 00 00 00 01 00 02 82 D2
			15 00 00 00 01 00 02 83 00
			15 00 00 00 01 00 02 84 E8
			15 00 00 00 01 00 02 85 00
			15 00 00 00 01 00 02 86 FA
			15 00 00 00 01 00 02 87 01
			15 00 00 00 01 00 02 88 33
			15 00 00 00 01 00 02 89 01
			15 00 00 00 01 00 02 8A 5F
			15 00 00 00 01 00 02 8B 01
			15 00 00 00 01 00 02 8C 9F
			15 00 00 00 01 00 02 8D 01
			15 00 00 00 01 00 02 8E CF
			15 00 00 00 01 00 02 8F 02
			15 00 00 00 01 00 02 90 15
			15 00 00 00 01 00 02 91 02
			15 00 00 00 01 00 02 92 4F
			15 00 00 00 01 00 02 93 02
			15 00 00 00 01 00 02 94 51
			15 00 00 00 01 00 02 95 02
			15 00 00 00 01 00 02 96 84
			15 00 00 00 01 00 02 97 02
			15 00 00 00 01 00 02 98 BD
			15 00 00 00 01 00 02 99 02
			15 00 00 00 01 00 02 9A E0
			15 00 00 00 01 00 02 9B 03
			15 00 00 00 01 00 02 9C 10
			15 00 00 00 01 00 02 9D 03
			15 00 00 00 01 00 02 9E 36
			15 00 00 00 01 00 02 9F 03
			15 00 00 00 01 00 02 A0 67
			15 00 00 00 01 00 02 A2 03
			15 00 00 00 01 00 02 A3 76
			15 00 00 00 01 00 02 A4 03
			15 00 00 00 01 00 02 A5 86
			15 00 00 00 01 00 02 A6 03
			15 00 00 00 01 00 02 A7 98
			15 00 00 00 01 00 02 A9 03
			15 00 00 00 01 00 02 AA AC
			15 00 00 00 01 00 02 AB 03
			15 00 00 00 01 00 02 AC C1
			15 00 00 00 01 00 02 AD 03
			15 00 00 00 01 00 02 AE D8
			15 00 00 00 01 00 02 AF 03
			15 00 00 00 01 00 02 B0 F2
			15 00 00 00 01 00 02 B1 03
			15 00 00 00 01 00 02 B2 FF
			15 00 00 00 01 00 02 B3 00
			15 00 00 00 01 00 02 B4 00
			15 00 00 00 01 00 02 B5 00
			15 00 00 00 01 00 02 B6 20
			15 00 00 00 01 00 02 B7 00
			15 00 00 00 01 00 02 B8 58
			15 00 00 00 01 00 02 B9 00
			15 00 00 00 01 00 02 BA 81
			15 00 00 00 01 00 02 BB 00
			15 00 00 00 01 00 02 BC 9F
			15 00 00 00 01 00 02 BD 00
			15 00 00 00 01 00 02 BE BA
			15 00 00 00 01 00 02 BF 00
			15 00 00 00 01 00 02 C0 D2
			15 00 00 00 01 00 02 C1 00
			15 00 00 00 01 00 02 C2 E8
			15 00 00 00 01 00 02 C3 00
			15 00 00 00 01 00 02 C4 FA
			15 00 00 00 01 00 02 C5 01
			15 00 00 00 01 00 02 C6 33
			15 00 00 00 01 00 02 C7 01
			15 00 00 00 01 00 02 C8 5F
			15 00 00 00 01 00 02 C9 01
			15 00 00 00 01 00 02 CA 9F
			15 00 00 00 01 00 02 CB 01
			15 00 00 00 01 00 02 CC CF
			15 00 00 00 01 00 02 CD 02
			15 00 00 00 01 00 02 CE 15
			15 00 00 00 01 00 02 CF 02
			15 00 00 00 01 00 02 D0 4F
			15 00 00 00 01 00 02 D1 02
			15 00 00 00 01 00 02 D2 51
			15 00 00 00 01 00 02 D3 02
			15 00 00 00 01 00 02 D4 84
			15 00 00 00 01 00 02 D5 02
			15 00 00 00 01 00 02 D6 BD
			15 00 00 00 01 00 02 D7 02
			15 00 00 00 01 00 02 D8 E0
			15 00 00 00 01 00 02 D9 03
			15 00 00 00 01 00 02 DA 10
			15 00 00 00 01 00 02 DB 03
			15 00 00 00 01 00 02 DC 36
			15 00 00 00 01 00 02 DD 03
			15 00 00 00 01 00 02 DE 67
			15 00 00 00 01 00 02 DF 03
			15 00 00 00 01 00 02 E0 76
			15 00 00 00 01 00 02 E1 03
			15 00 00 00 01 00 02 E2 86
			15 00 00 00 01 00 02 E3 03
			15 00 00 00 01 00 02 E4 98
			15 00 00 00 01 00 02 E5 03
			15 00 00 00 01 00 02 E6 AC
			15 00 00 00 01 00 02 E7 03
			15 00 00 00 01 00 02 E8 C1
			15 00 00 00 01 00 02 E9 03
			15 00 00 00 01 00 02 EA D8
			15 00 00 00 01 00 02 EB 03
			15 00 00 00 01 00 02 EC F2
			15 00 00 00 01 00 02 ED 03
			15 00 00 00 01 00 02 EE FF
			15 00 00 00 01 00 02 EF 00
			15 00 00 00 01 00 02 F0 E0
			15 00 00 00 01 00 02 F1 00
			15 00 00 00 01 00 02 F2 E9
			15 00 00 00 01 00 02 F3 00
			15 00 00 00 01 00 02 F4 FB
			15 00 00 00 01 00 02 F5 01
			15 00 00 00 01 00 02 F6 0B
			15 00 00 00 01 00 02 F7 01
			15 00 00 00 01 00 02 F8 1A
			15 00 00 00 01 00 02 F9 01
			15 01 00 00 01 00 02 FA 27
			15 00 00 00 01 00 02 FF 21
			15 00 00 00 01 00 02 FB 01
			15 00 00 00 01 00 02 00 01
			15 00 00 00 01 00 02 01 33
			15 00 00 00 01 00 02 02 01
			15 00 00 00 01 00 02 03 3F
			15 00 00 00 01 00 02 04 01
			15 00 00 00 01 00 02 05 4A
			15 00 00 00 01 00 02 06 01
			15 00 00 00 01 00 02 07 71
			15 00 00 00 01 00 02 08 01
			15 00 00 00 01 00 02 09 8F
			15 00 00 00 01 00 02 0A 01
			15 00 00 00 01 00 02 0B C1
			15 00 00 00 01 00 02 0C 01
			15 00 00 00 01 00 02 0D E9
			15 00 00 00 01 00 02 0E 02
			15 00 00 00 01 00 02 0F 26
			15 00 00 00 01 00 02 10 02
			15 00 00 00 01 00 02 11 5A
			15 00 00 00 01 00 02 12 02
			15 00 00 00 01 00 02 13 5C
			15 00 00 00 01 00 02 14 02
			15 00 00 00 01 00 02 15 8E
			15 00 00 00 01 00 02 16 02
			15 00 00 00 01 00 02 17 C5
			15 00 00 00 01 00 02 18 02
			15 00 00 00 01 00 02 19 E8
			15 00 00 00 01 00 02 1A 03
			15 00 00 00 01 00 02 1B 17
			15 00 00 00 01 00 02 1C 03
			15 00 00 00 01 00 02 1D 39
			15 00 00 00 01 00 02 1E 03
			15 00 00 00 01 00 02 1F 67
			15 00 00 00 01 00 02 20 03
			15 00 00 00 01 00 02 21 76
			15 00 00 00 01 00 02 22 03
			15 00 00 00 01 00 02 23 86
			15 00 00 00 01 00 02 24 03
			15 00 00 00 01 00 02 25 98
			15 00 00 00 01 00 02 26 03
			15 00 00 00 01 00 02 27 AB
			15 00 00 00 01 00 02 28 03
			15 00 00 00 01 00 02 29 C0
			15 00 00 00 01 00 02 2A 03
			15 00 00 00 01 00 02 2B D8
			15 00 00 00 01 00 02 2D 03
			15 00 00 00 01 00 02 2F F2
			15 00 00 00 01 00 02 30 03
			15 00 00 00 01 00 02 31 FF
			15 00 00 00 01 00 02 32 00
			15 00 00 00 01 00 02 33 E0
			15 00 00 00 01 00 02 34 00
			15 00 00 00 01 00 02 35 E9
			15 00 00 00 01 00 02 36 00
			15 00 00 00 01 00 02 37 FB
			15 00 00 00 01 00 02 38 01
			15 00 00 00 01 00 02 39 0B
			15 00 00 00 01 00 02 3A 01
			15 00 00 00 01 00 02 3B 1A
			15 00 00 00 01 00 02 3D 01
			15 00 00 00 01 00 02 3F 27
			15 00 00 00 01 00 02 40 01
			15 00 00 00 01 00 02 41 33
			15 00 00 00 01 00 02 42 01
			15 00 00 00 01 00 02 43 3F
			15 00 00 00 01 00 02 44 01
			15 00 00 00 01 00 02 45 4A
			15 00 00 00 01 00 02 46 01
			15 00 00 00 01 00 02 47 71
			15 00 00 00 01 00 02 48 01
			15 00 00 00 01 00 02 49 8F
			15 00 00 00 01 00 02 4A 01
			15 00 00 00 01 00 02 4B C1
			15 00 00 00 01 00 02 4C 01
			15 00 00 00 01 00 02 4D E9
			15 00 00 00 01 00 02 4E 02
			15 00 00 00 01 00 02 4F 26
			15 00 00 00 01 00 02 50 02
			15 00 00 00 01 00 02 51 5A
			15 00 00 00 01 00 02 52 02
			15 00 00 00 01 00 02 53 5C
			15 00 00 00 01 00 02 54 02
			15 00 00 00 01 00 02 55 8E
			15 00 00 00 01 00 02 56 02
			15 00 00 00 01 00 02 58 C5
			15 00 00 00 01 00 02 59 02
			15 00 00 00 01 00 02 5A E8
			15 00 00 00 01 00 02 5B 03
			15 00 00 00 01 00 02 5C 17
			15 00 00 00 01 00 02 5D 03
			15 00 00 00 01 00 02 5E 39
			15 00 00 00 01 00 02 5F 03
			15 00 00 00 01 00 02 60 67
			15 00 00 00 01 00 02 61 03
			15 00 00 00 01 00 02 62 76
			15 00 00 00 01 00 02 63 03
			15 00 00 00 01 00 02 64 86
			15 00 00 00 01 00 02 65 03
			15 00 00 00 01 00 02 66 98
			15 00 00 00 01 00 02 67 03
			15 00 00 00 01 00 02 68 AB
			15 00 00 00 01 00 02 69 03
			15 00 00 00 01 00 02 6A C0
			15 00 00 00 01 00 02 6B 03
			15 00 00 00 01 00 02 6C D8
			15 00 00 00 01 00 02 6D 03
			15 00 00 00 01 00 02 6E F2
			15 00 00 00 01 00 02 6F 03
			15 00 00 00 01 00 02 70 FF
			15 00 00 00 01 00 02 71 00
			15 00 00 00 01 00 02 72 00
			15 00 00 00 01 00 02 73 00
			15 00 00 00 01 00 02 74 2F
			15 00 00 00 01 00 02 75 00
			15 00 00 00 01 00 02 76 7E
			15 00 00 00 01 00 02 77 00
			15 00 00 00 01 00 02 78 AD
			15 00 00 00 01 00 02 79 00
			15 00 00 00 01 00 02 7A C7
			15 00 00 00 01 00 02 7B 00
			15 00 00 00 01 00 02 7C E0
			15 00 00 00 01 00 02 7D 00
			15 00 00 00 01 00 02 7E F7
			15 00 00 00 01 00 02 7F 01
			15 00 00 00 01 00 02 80 09
			15 00 00 00 01 00 02 81 01
			15 00 00 00 01 00 02 82 19
			15 00 00 00 01 00 02 83 01
			15 00 00 00 01 00 02 84 4F
			15 00 00 00 01 00 02 85 01
			15 00 00 00 01 00 02 86 76
			15 00 00 00 01 00 02 87 01
			15 00 00 00 01 00 02 88 B2
			15 00 00 00 01 00 02 89 01
			15 00 00 00 01 00 02 8A DE
			15 00 00 00 01 00 02 8B 02
			15 00 00 00 01 00 02 8C 20
			15 00 00 00 01 00 02 8D 02
			15 00 00 00 01 00 02 8E 56
			15 00 00 00 01 00 02 8F 02
			15 00 00 00 01 00 02 90 58
			15 00 00 00 01 00 02 91 02
			15 00 00 00 01 00 02 92 8B
			15 00 00 00 01 00 02 93 02
			15 00 00 00 01 00 02 94 C2
			15 00 00 00 01 00 02 95 02
			15 00 00 00 01 00 02 96 E6
			15 00 00 00 01 00 02 97 03
			15 00 00 00 01 00 02 98 15
			15 00 00 00 01 00 02 99 03
			15 00 00 00 01 00 02 9A 35
			15 00 00 00 01 00 02 9B 03
			15 00 00 00 01 00 02 9C 64
			15 00 00 00 01 00 02 9D 03
			15 00 00 00 01 00 02 9E 73
			15 00 00 00 01 00 02 9F 03
			15 00 00 00 01 00 02 A0 83
			15 00 00 00 01 00 02 A2 03
			15 00 00 00 01 00 02 A3 95
			15 00 00 00 01 00 02 A4 03
			15 00 00 00 01 00 02 A5 A9
			15 00 00 00 01 00 02 A6 03
			15 00 00 00 01 00 02 A7 BF
			15 00 00 00 01 00 02 A9 03
			15 00 00 00 01 00 02 AA D7
			15 00 00 00 01 00 02 AB 03
			15 00 00 00 01 00 02 AC F1
			15 00 00 00 01 00 02 AD 03
			15 00 00 00 01 00 02 AE FF
			15 00 00 00 01 00 02 AF 00
			15 00 00 00 01 00 02 B0 00
			15 00 00 00 01 00 02 B1 00
			15 00 00 00 01 00 02 B2 2F
			15 00 00 00 01 00 02 B3 00
			15 00 00 00 01 00 02 B4 7E
			15 00 00 00 01 00 02 B5 00
			15 00 00 00 01 00 02 B6 AD
			15 00 00 00 01 00 02 B7 00
			15 00 00 00 01 00 02 B8 C7
			15 00 00 00 01 00 02 B9 00
			15 00 00 00 01 00 02 BA E0
			15 00 00 00 01 00 02 BB 00
			15 00 00 00 01 00 02 BC F7
			15 00 00 00 01 00 02 BD 01
			15 00 00 00 01 00 02 BE 09
			15 00 00 00 01 00 02 BF 01
			15 00 00 00 01 00 02 C0 19
			15 00 00 00 01 00 02 C1 01
			15 00 00 00 01 00 02 C2 4F
			15 00 00 00 01 00 02 C3 01
			15 00 00 00 01 00 02 C4 76
			15 00 00 00 01 00 02 C5 01
			15 00 00 00 01 00 02 C6 B2
			15 00 00 00 01 00 02 C7 01
			15 00 00 00 01 00 02 C8 DE
			15 00 00 00 01 00 02 C9 02
			15 00 00 00 01 00 02 CA 20
			15 00 00 00 01 00 02 CB 02
			15 00 00 00 01 00 02 CC 56
			15 00 00 00 01 00 02 CD 02
			15 00 00 00 01 00 02 CE 58
			15 00 00 00 01 00 02 CF 02
			15 00 00 00 01 00 02 D0 8B
			15 00 00 00 01 00 02 D1 02
			15 00 00 00 01 00 02 D2 C2
			15 00 00 00 01 00 02 D3 02
			15 00 00 00 01 00 02 D4 E6
			15 00 00 00 01 00 02 D5 03
			15 00 00 00 01 00 02 D6 15
			15 00 00 00 01 00 02 D7 03
			15 00 00 00 01 00 02 D8 35
			15 00 00 00 01 00 02 D9 03
			15 00 00 00 01 00 02 DA 64
			15 00 00 00 01 00 02 DB 03
			15 00 00 00 01 00 02 DC 73
			15 00 00 00 01 00 02 DD 03
			15 00 00 00 01 00 02 DE 83
			15 00 00 00 01 00 02 DF 03
			15 00 00 00 01 00 02 E0 95
			15 00 00 00 01 00 02 E1 03
			15 00 00 00 01 00 02 E2 A9
			15 00 00 00 01 00 02 E3 03
			15 00 00 00 01 00 02 E4 BF
			15 00 00 00 01 00 02 E5 03
			15 00 00 00 01 00 02 E6 D7
			15 00 00 00 01 00 02 E7 03
			15 00 00 00 01 00 02 E8 F1
			15 00 00 00 01 00 02 E9 03
			15 01 00 00 01 00 02 EA FF

			15 00 00 00 00 00 02 ff 23
			15 00 00 00 00 00 02 fb 01
			15 00 00 00 00 00 02 05 24

			15 00 00 00 00 00 02 ff 10
			15 00 00 00 00 00 02 51 ff
			15 00 00 00 00 00 02 53 2c
			15 00 00 00 00 00 02 55 00
			15 00 00 00 00 00 02 35 00
			39 00 00 00 00 00 03 44 09 d9
			15 00 00 00 00 00 02 bb 10
			15 00 00 00 00 00 02 c0 01
			05 01 00 00 78 00 02 11 00
			05 01 00 00 14 00 02 29 00
			];

		qcom,mdss-dsi-on-commandasdf = [
			15 01 00 00 00 00 02 ff 24
			15 01 00 00 00 00 02 ec 01
			];
		qcom,mdss-dsi-off-command = [
			05 01 00 00 02 00 02 28 00
			05 01 00 00 79 00 02 10 00
			];
		qcom,mdss-dsi-on-command-state = "dsi_lp_mode";
		qcom,mdss-dsi-off-command-state = "dsi_hs_mode";
		qcom,mdss-dsi-h-sync-pulse = <0>;
		qcom,mdss-dsi-traffic-mode = "burst_mode";
		qcom,mdss-dsi-bllp-eof-power-mode;
		qcom,mdss-dsi-bllp-power-mode;
		qcom,mdss-dsi-lane-0-state;
		qcom,mdss-dsi-lane-1-state;
		qcom,mdss-dsi-lane-2-state;
		qcom,mdss-dsi-lane-3-state;
		qcom,mdss-dsi-panel-timings = [dc 49 34 00 a7 a2 36 4d 41 03 04 00];
		qcom,mdss-dsi-t-clk-post = <0x19>;
		qcom,mdss-dsi-t-clk-pre = <0x35>;
		qcom,mdss-dsi-bl-min-level = <1>;
		qcom,mdss-dsi-bl-max-level = <4095>;
		qcom,mdss-dsi-dma-trigger = "trigger_sw";
		qcom,mdss-dsi-mdp-trigger = "none";
		qcom,mdss-dsi-bl-pmic-control-type = "bl_ctrl_wled";
		qcom,mdss-dsi-reset-sequence = <1 10>, <0 10>, <1 10>;
		qcom,mdss-pan-physical-width-dimension = <71>;
		qcom,mdss-pan-physical-height-dimension = <126>;

		qcom,mdss-dsi-te-pin-select = <1>;
		qcom,mdss-dsi-wr-mem-start = <0x2c>;
		qcom,mdss-dsi-wr-mem-continue = <0x3c>;
		qcom,mdss-dsi-te-dcs-command = <1>;
		qcom,mdss-dsi-te-check-enable;
		qcom,mdss-dsi-te-using-te-pin;

		qcom,mdss-dsi-fbc-enable;
		qcom,mdss-dsi-fbc-ver2-mode;
		qcom,mdss-dsi-fbc-bpp = <8>;
		qcom,mdss-dsi-fbc-packing = <1>;
		qcom,mdss-dsi-fbc-2d-pred-mode;
		qcom,mdss-dsi-fbc-slice-height = <4>;
		qcom,mdss-dsi-fbc-quant-error;
		qcom,mdss-dsi-fbc-bias = <2>;
		qcom,mdss-dsi-fbc-vlc-mode;
		qcom,mdss-dsi-fbc-bflc-mode;
		qcom,mdss-dsi-fbc-lossy-mode-idx = <3>;
		qcom,mdss-dsi-fbc-pat-mode;
		qcom,mdss-dsi-fbc-budget-ctrl = <5>;
		qcom,mdss-dsi-fbc-block-budget = <59>;
		qcom,mdss-dsi-fbc-h-line-budget = <900>;
		qcom,mdss-dsi-fbc-lossless-threshold = <0x200>;
		qcom,mdss-dsi-fbc-lossy-threshold = <192>;
		qcom,mdss-dsi-fbc-rgb-threshold = <4>;
		qcom,mdss-dsi-fbc-max-pred-err = <2>;
	};
};
