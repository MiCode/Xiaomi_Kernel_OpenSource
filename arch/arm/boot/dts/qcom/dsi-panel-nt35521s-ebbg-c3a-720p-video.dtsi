/* Copyright (c) 2013, The Linux Foundation. All rights reserved.
 * Copyright (C) 2018 XiaoMi, Inc.
 *
 * This program is free software; you can redistribute it and/or modify
 * it under the terms of the GNU General Public License version 2 and
 * only version 2 as published by the Free Software Foundation.
 *
 * This program is distributed in the hope that it will be useful,
 * but WITHOUT ANY WARRANTY; without even the implied warranty of
					See the
 * GNU General Public License for more details.
 */

/*---------------------------------------------------------------------------
 * This file is autogenerated file using gcdb parser. Please do not edit it.
 * Update input XML file to add a new entry or update variable in this file
 * VERSION = "1.0"
 *---------------------------------------------------------------------------*/
&mdss_mdp {
	dsi_nt35521s_ebbg_720_video: qcom,mdss_dsi_nt35521s_ebbg_720p_video {
		qcom,mdss-dsi-panel-name = "nt35521s_HD720p_video_EBBG_c3a";
		qcom,mdss-dsi-panel-controller = <&mdss_dsi0>;
		qcom,mdss-dsi-panel-type = "dsi_video_mode";
		qcom,mdss-dsi-panel-destination = "display_1";
		qcom,mdss-dsi-panel-framerate = <60>;
		qcom,mdss-dsi-virtual-channel-id = <0>;
		qcom,mdss-dsi-stream = <0>;
		qcom,mdss-dsi-panel-width = <720>;
		qcom,mdss-dsi-panel-height = <1280>;
		qcom,mdss-pan-physical-width-dimension = <62>;
		qcom,mdss-pan-physical-height-dimension = <110>;
		qcom,mdss-dsi-h-front-porch = <240>;
		qcom,mdss-dsi-h-back-porch = <241>;
		qcom,mdss-dsi-h-pulse-width = <20>;
		qcom,mdss-dsi-h-sync-skew = <0>;
		qcom,mdss-dsi-v-back-porch = <28>;
		qcom,mdss-dsi-v-front-porch = <35>;
		qcom,mdss-dsi-v-pulse-width = <2>;
		qcom,mdss-dsi-h-left-border = <0>;
		qcom,mdss-dsi-h-right-border = <0>;
		qcom,mdss-dsi-v-top-border = <0>;
		qcom,mdss-dsi-v-bottom-border = <20>;
		qcom,mdss-dsi-bpp = <24>;
		qcom,mdss-dsi-underflow-color = <0x00>;
		qcom,mdss-dsi-border-color = <0>;
		qcom,mdss-dsi-on-command = [29 01 00 00 00 00 06 F0 55 AA 52 08 00
				29 01 00 00 00 00 02 B1 6C
				29 01 00 00 00 00 02 64 07
				29 01 00 00 00 00 03 CC 40 00
				29 01 00 00 00 00 11 D1 00 00 00 01 01 01 01 01 01 01 01 01 02 02 02 02
				29 01 00 00 00 00 0D D7 00 00 00 00 00 00 00 00 00 00 00 00
				29 01 00 00 00 00 0D D8 00 00 00 00 00 00 00 00 00 00 00 00
				29 01 00 00 00 00 06 F0 55 AA 52 00 00
				29 01 00 00 00 00 05 FF AA 55 25 01
				29 01 00 00 00 00 02 6F 1A
				29 01 00 00 00 00 02 F7 05
				29 01 00 00 00 00 02 6F 16
				29 01 00 00 00 00 02 F7 10
				29 01 00 00 00 00 02 6F 10
				29 01 00 00 00 00 02 F7 1D
				29 01 00 00 00 00 05 FF AA 55 25 00
				29 01 00 00 00 00 02 35 00
				05 01 00 00 78 00 02 11 00
				05 01 00 00 00 00 02 29 00
				37 01 00 00 00 00 02 01 00];
		qcom,mdss-dsi-off-command = [05 01 00 00 00 00 02 28 00
				05 01 00 00 78 00 02 10 00];
		qcom,mdss-dsi-on-command-state = "dsi_lp_mode";
		qcom,mdss-dsi-off-command-state = "dsi_hs_mode";
		qcom,mdss-dsi-panel-warm-command = [29 01 00 00 00 00 06 F0 55 AA 52 08 00
				29 01 00 00 00 00 02 26 01
				29 01 00 00 00 00 02 26 02];
		qcom,mdss-dsi-panel-cool-command = [29 01 00 00 00 00 06 F0 55 AA 52 08 00
				29 01 00 00 00 00 02 26 02
				29 01 00 00 00 00 02 26 04];
		qcom,mdss-dsi-panel-nature-command = [29 01 00 00 00 00 06 F0 55 AA 52 08 00
				29 01 00 00 00 00 02 26 02
				29 01 00 00 00 00 02 26 01];
		qcom,mdss-dsi-panel-gamma-command-state = "dsi_lp_mode";
		qcom,mdss-dsi-panel-ce-std-command = [29 00 00 00 00 00 06 F0 55 AA 52 08 00
				29 01 00 00 00 00 02 55 00];
		qcom,mdss-dsi-panel-ce-bright-command = [29 00 00 00 00 00 06 F0 55 AA 52 08 00
				29 01 00 00 00 00 02 55 B0];
		qcom,mdss-dsi-panel-ce-vivid-command = [29 00 00 00 00 00 06 F0 55 AA 52 08 00
				29 01 00 00 00 00 02 55 80];
		qcom,mdss-dsi-panel-ce-command-state = "dsi_lp_mode";
		qcom,mdss-dsi-panel-eye-command01 = [29 00 00 00 00 00 06 F0 55 AA 52 08 02
				29 01 00 00 00 00 02 EE 03
				29 00 00 00 00 00 11 B0 00 14 00 2C 00 51 00 6D 00 85 00 AB 00 CA 00 FC
				29 01 00 00 00 00 11 B1 01 24 01 60 01 8E 01 D7 02 10 02 12 02 47 02 89
				29 00 00 00 00 00 11 B2 02 B4 02 EE 03 14 03 43 03 60 03 86 03 97 03 B0
				29 01 00 00 00 00 05 B3 03 D3 03 D5
				29 00 00 00 00 00 11 B4 01 02 01 06 01 0F 01 18 01 21 01 31 01 40 01 59
				29 01 00 00 00 00 11 B5 01 70 01 98 01 BB 01 F3 02 24 02 26 02 59 02 98
				29 00 00 00 00 00 11 B6 02 C3 02 FB 03 20 03 4E 03 6A 03 8C 03 9E 03 B4
				29 01 00 00 00 00 05 B7 03 D0 03 D5
				29 00 00 00 00 00 11 B8 01 51 01 54 01 59 01 5F 01 64 01 6E 01 77 01 8A
				29 00 00 00 00 00 11 B9 01 9C 01 BC 01 D7 02 08 02 35 02 36 02 67 02 A5
				29 00 00 00 00 00 11 BA 02 CF 03 07 03 29 03 56 03 71 03 8E 03 A2 03 CF
				29 01 00 00 00 00 05 BB 03 D4 03 D5];
		qcom,mdss-dsi-panel-eye-command02 = [29 00 00 00 00 00 06 F0 55 AA 52 08 02
				29 01 00 00 00 00 02 EE 03
				29 00 00 00 00 00 11 B0 00 14 00 2C 00 51 00 6D 00 85 00 AB 00 CA 00 FC
				29 01 00 00 00 00 11 B1 01 24 01 60 01 8E 01 D7 02 10 02 12 02 47 02 89
				29 00 00 00 00 00 11 B2 02 B4 02 EE 03 14 03 43 03 60 03 86 03 97 03 B0
				29 01 00 00 00 00 05 B3 03 D3 03 D5
				29 00 00 00 00 00 11 B4 01 02 01 06 01 0F 01 18 01 21 01 31 01 40 01 59
				29 01 00 00 00 00 11 B5 01 70 01 98 01 BB 01 F3 02 24 02 26 02 59 02 98
				29 00 00 00 00 00 11 B6 02 C3 02 FB 03 20 03 4E 03 6A 03 8C 03 9E 03 B4
				29 01 00 00 00 00 05 B7 03 D0 03 D5
				29 00 00 00 00 00 11 B8 01 75 01 77 01 7B 01 80 01 84 01 8D 01 96 01 A5
				29 00 00 00 00 00 11 B9 01 B4 01 CF 01 E7 02 14 02 3E 02 3F 02 70 02 AD
				29 00 00 00 00 00 11 BA 02 D6 03 0E 03 30 03 5B 03 75 03 90 03 A5 03 D1
				29 01 00 00 00 00 05 BB 03 D4 03 D5];
		qcom,mdss-dsi-panel-eye-command03 = [29 00 00 00 00 00 06 F0 55 AA 52 08 02
				29 01 00 00 00 00 02 EE 03
				29 00 00 00 00 00 11 B0 00 14 00 2C 00 51 00 6D 00 85 00 AB 00 CA 00 FC
				29 01 00 00 00 00 11 B1 01 24 01 60 01 8E 01 D7 02 10 02 12 02 47 02 89
				29 00 00 00 00 00 11 B2 02 B4 02 EE 03 14 03 43 03 60 03 86 03 97 03 B0
				29 01 00 00 00 00 05 B3 03 D3 03 D5
				29 00 00 00 00 00 11 B4 01 02 01 06 01 0F 01 18 01 21 01 31 01 40 01 59
				29 01 00 00 00 00 11 B5 01 70 01 98 01 BB 01 F3 02 24 02 26 02 59 02 98
				29 00 00 00 00 00 11 B6 02 C3 02 FB 03 20 03 4E 03 6A 03 8C 03 9E 03 B4
				29 01 00 00 00 00 05 B7 03 D0 03 D5
				29 00 00 00 00 00 11 B8 01 91 01 93 01 97 01 9B 01 9F 01 A6 01 AD 01 BB
				29 00 00 00 00 00 11 B9 01 C8 01 E0 01 F6 02 1E 02 47 02 49 02 78 02 B5
				29 00 00 00 00 00 11 BA 02 DE 03 14 03 36 03 60 03 79 03 94 03 A8 03 D2
				29 01 00 00 00 00 05 BB 03 D4 03 D5];
		qcom,mdss-dsi-panel-eye-command04 = [29 00 00 00 00 00 06 F0 55 AA 52 08 02
				29 01 00 00 00 00 02 EE 03
				29 00 00 00 00 00 11 B0 00 14 00 2C 00 51 00 6D 00 85 00 AB 00 CA 00 FC
				29 01 00 00 00 00 11 B1 01 24 01 60 01 8E 01 D7 02 10 02 12 02 47 02 89
				29 00 00 00 00 00 11 B2 02 B4 02 EE 03 14 03 43 03 60 03 86 03 97 03 B0
				29 01 00 00 00 00 05 B3 03 D3 03 D5
				29 00 00 00 00 00 11 B4 01 02 01 06 01 0F 01 18 01 21 01 31 01 40 01 59
				29 01 00 00 00 00 11 B5 01 70 01 98 01 BB 01 F3 02 24 02 26 02 59 02 98
				29 00 00 00 00 00 11 B6 02 C3 02 FB 03 20 03 4E 03 6A 03 8C 03 9E 03 B4
				29 01 00 00 00 00 05 B7 03 D0 03 D5
				29 00 00 00 00 00 11 B8 01 B1 01 B2 01 B6 01 B9 01 BC 01 C2 01 C8 01 D3
				29 00 00 00 00 00 11 B9 01 DE 01 F3 02 06 02 2C 02 53 02 54 02 83 02 BE
				29 00 00 00 00 00 11 BA 02 E7 03 1C 03 3D 03 67 03 80 03 99 03 AA 03 D2
				29 01 00 00 00 00 05 BB 03 D4 03 D5];
		qcom,mdss-dsi-panel-eye-command05 = [29 00 00 00 00 00 06 F0 55 AA 52 08 02
				29 01 00 00 00 00 02 EE 03
				29 00 00 00 00 00 11 B0 00 14 00 2C 00 51 00 6D 00 85 00 AB 00 CA 00 FC
				29 01 00 00 00 00 11 B1 01 24 01 60 01 8E 01 D7 02 10 02 12 02 47 02 89
				29 00 00 00 00 00 11 B2 02 B4 02 EE 03 14 03 43 03 60 03 86 03 97 03 B0
				29 01 00 00 00 00 05 B3 03 D3 03 D5
				29 00 00 00 00 00 11 B4 01 02 01 06 01 0F 01 18 01 21 01 31 01 40 01 59
				29 01 00 00 00 00 11 B5 01 70 01 98 01 BB 01 F3 02 24 02 26 02 59 02 98
				29 00 00 00 00 00 11 B6 02 C3 02 FB 03 20 03 4E 03 6A 03 8C 03 9E 03 B4
				29 01 00 00 00 00 05 B7 03 D0 03 D5
				29 00 00 00 00 00 11 B8 01 C8 01 C9 01 CC 01 CF 01 D1 01 D6 01 DB 01 E6
				29 00 00 00 00 00 11 B9 01 EF 02 02 02 14 02 37 02 5D 02 5E 02 8B 02 C7
				29 00 00 00 00 00 11 BA 02 EF 03 23 03 43 03 6C 03 85 03 9D 03 AC 03 D2
				29 01 00 00 00 00 05 BB 03 D4 03 D5];
		qcom,mdss-dsi-panel-eye-command06 = [29 00 00 00 00 00 06 F0 55 AA 52 08 02
				29 01 00 00 00 00 02 EE 03
				29 00 00 00 00 00 11 B0 00 14 00 2C 00 51 00 6D 00 85 00 AB 00 CA 00 FC
				29 01 00 00 00 00 11 B1 01 24 01 60 01 8E 01 D7 02 10 02 12 02 47 02 89
				29 00 00 00 00 00 11 B2 02 B4 02 EE 03 14 03 43 03 60 03 86 03 97 03 B0
				29 01 00 00 00 00 05 B3 03 D3 03 D5
				29 00 00 00 00 00 11 B4 01 02 01 06 01 0F 01 18 01 21 01 31 01 40 01 59
				29 01 00 00 00 00 11 B5 01 70 01 98 01 BB 01 F3 02 24 02 26 02 59 02 98
				29 00 00 00 00 00 11 B6 02 C3 02 FB 03 20 03 4E 03 6A 03 8C 03 9E 03 B4
				29 01 00 00 00 00 05 B7 03 D0 03 D5
				29 00 00 00 00 00 11 B8 01 DE 01 E0 01 E2 01 E5 01 E6 01 EB 01 F0 01 F8
				29 00 00 00 00 00 11 B9 02 01 02 12 02 22 02 44 02 68 02 6A 02 96 02 D1
				29 00 00 00 00 00 11 BA 02 F8 03 2A 03 4A 03 71 03 89 03 A1 03 C6 03 D3
				29 01 00 00 00 00 05 BB 03 D4 03 D5];
		qcom,mdss-dsi-panel-eye-command07 = [29 00 00 00 00 00 06 F0 55 AA 52 08 02
				29 01 00 00 00 00 02 EE 03
				29 00 00 00 00 00 11 B0 00 14 00 2C 00 51 00 6D 00 85 00 AB 00 CA 00 FC
				29 01 00 00 00 00 11 B1 01 24 01 60 01 8E 01 D7 02 10 02 12 02 47 02 89
				29 00 00 00 00 00 11 B2 02 B4 02 EE 03 14 03 43 03 60 03 86 03 97 03 B0
				29 01 00 00 00 00 05 B3 03 D3 03 D5
				29 00 00 00 00 00 11 B4 01 02 01 06 01 0F 01 18 01 21 01 31 01 40 01 59
				29 01 00 00 00 00 11 B5 01 70 01 98 01 BB 01 F3 02 24 02 26 02 59 02 98
				29 00 00 00 00 00 11 B6 02 C3 02 FB 03 20 03 4E 03 6A 03 8C 03 9E 03 B4
				29 01 00 00 00 00 05 B7 03 D0 03 D5
				29 00 00 00 00 00 11 B8 01 F4 01 F5 01 F7 01 F9 01 FB 01 FF 02 02 02 0B
				29 00 00 00 00 00 11 B9 02 12 02 21 02 31 02 50 02 75 02 76 02 A1 02 DC
				29 00 00 00 00 00 11 BA 03 03 03 33 03 52 03 76 03 8C 03 A5 03 CA 03 D3
				29 01 00 00 00 00 05 BB 03 D4 03 D5];
		qcom,mdss-dsi-panel-eye-command08 = [29 00 00 00 00 00 06 F0 55 AA 52 08 02
				29 01 00 00 00 00 02 EE 03
				29 00 00 00 00 00 11 B0 00 14 00 2C 00 51 00 6D 00 85 00 AB 00 CA 00 FC
				29 01 00 00 00 00 11 B1 01 24 01 60 01 8E 01 D7 02 10 02 12 02 47 02 89
				29 00 00 00 00 00 11 B2 02 B4 02 EE 03 14 03 43 03 60 03 86 03 97 03 B0
				29 01 00 00 00 00 05 B3 03 D3 03 D5
				29 00 00 00 00 00 11 B4 01 02 01 06 01 0F 01 18 01 21 01 31 01 40 01 59
				29 01 00 00 00 00 11 B5 01 70 01 98 01 BB 01 F3 02 24 02 26 02 59 02 98
				29 00 00 00 00 00 11 B6 02 C3 02 FB 03 20 03 4E 03 6A 03 8C 03 9E 03 B4
				29 01 00 00 00 00 05 B7 03 D0 03 D5
				29 00 00 00 00 00 11 B8 02 07 02 08 02 0A 02 0B 02 0E 02 11 02 14 02 1B
				29 00 00 00 00 00 11 B9 02 23 02 31 02 3F 02 5E 02 81 02 82 02 AD 02 E7
				29 00 00 00 00 00 11 BA 03 0D 03 3C 03 5A 03 7D 03 8E 03 A8 03 CE 03 D3
				29 01 00 00 00 00 05 BB 03 D4 03 D5];
		qcom,mdss-dsi-panel-eye-command-num = <8>;
		qcom,mdss-dsi-init-last;
		qcom,mdss-dsi-h-sync-pulse = <1>;
		qcom,mdss-dsi-traffic-mode = "non_burst_sync_event";
		qcom,mdss-dsi-bllp-eof-power-mode;
		qcom,mdss-dsi-bllp-power-mode;
		qcom,mdss-dsi-lane-0-state;
		qcom,mdss-dsi-lane-1-state;
		qcom,mdss-dsi-lane-2-state;
		qcom,mdss-dsi-tx-eot-append;
		qcom,mdss-dsi-hbp-power-mode;
		qcom,mdss-dsi-panel-timings = [CF 32 20 00 5E 62 26 34 29 03 04 00];
		qcom,mdss-dsi-t-clk-post = <0x03>;
		qcom,mdss-dsi-t-clk-pre = <0x27>;
		qcom,mdss-dsi-bl-min-level = <4>;
		qcom,mdss-dsi-bl-max-level = <255>;
		qcom,mdss-dsi-bl-pmic-pwm-frequency = <100>;
		qcom,mdss-dsi-bl-pmic-bank-select = <0>;
		qcom,mdss-dsi-dma-trigger = "trigger_sw";
		qcom,mdss-dsi-mdp-trigger = "none";

		qcom,esd-check-enabled;
		qcom,mdss-dsi-panel-status-command = [06 01 00 01 05 00 02 0A 08];
		qcom,mdss-dsi-panel-status-command-state = "dsi_lp_mode";
		qcom,mdss-dsi-panel-status-check-mode = "reg_read";
		qcom,mdss-dsi-panel-status-value = <0x9C>;
		qcom,mdss-dsi-panel-status-read-length = <1>;

		qcom,mdss-dsi-lp11-init;
		qcom,mdss-dsi-init-delay-us = <50000>;
		qcom,mdss-dsi-bl-pmic-control-type = "bl_ctrl_pwm";
		qcom,mdss-dsi-pwm-gpio = <&pm8937_mpps 4 0>;
		qcom,mdss-dsi-reset-sequence = <1 5>, <0 10>, <1 80>;
	};
};
