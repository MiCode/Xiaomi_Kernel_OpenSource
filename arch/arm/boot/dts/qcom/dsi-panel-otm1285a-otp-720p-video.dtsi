/* Copyright (c) 2013, The Linux Foundation. All rights reserved.
 * Copyright (C) 2016 XiaoMi, Inc.
 *
 * This program is free software; you can redistribute it and/or modify
 * it under the terms of the GNU General Public License version 2 and
 * only version 2 as published by the Free Software Foundation.
 *
 * This program is distributed in the hope that it will be useful,
 * but WITHOUT ANY WARRANTY; without even the implied warranty of
 * MERCHANTABILITY or FITNESS FOR A PARTICULAR PURPOSE.  See the
 * GNU General Public License for more details.
 */

/*---------------------------------------------------------------------------
 * This file is autogenerated file using gcdb parser. Please do not edit it.
 * Update input XML file to add a new entry or update variable in this file
 * VERSION = "1.0"
 *---------------------------------------------------------------------------*/
&mdss_mdp {
	dsi_otm1285a_otp_720p_video: qcom,mdss_dsi_otm1285a_otp_720p_video {
		qcom,mdss-dsi-panel-name = "otm1285a_otp_720p_video_EBBG";
		qcom,mdss-dsi-panel-controller = <&mdss_dsi0>;
		qcom,mdss-dsi-panel-type = "dsi_video_mode";
		qcom,mdss-dsi-panel-destination = "display_1";
		qcom,mdss-dsi-panel-framerate = <59>;
		qcom,mdss-dsi-virtual-channel-id = <0>;
		qcom,mdss-dsi-stream = <0>;
		qcom,mdss-dsi-panel-width = <720>;
		qcom,mdss-dsi-panel-height = <1280>;
		qcom,mdss-pan-physical-width-dimension = <58>;
		qcom,mdss-pan-physical-height-dimension = <103>;
		qcom,mdss-dsi-h-front-porch = <28>;
		qcom,mdss-dsi-h-back-porch = <28>;
		qcom,mdss-dsi-h-pulse-width = <2>;
		qcom,mdss-dsi-h-sync-skew = <0>;
		qcom,mdss-dsi-v-back-porch = <30>;
		qcom,mdss-dsi-v-front-porch = <30>;
		qcom,mdss-dsi-v-pulse-width = <2>;
		qcom,mdss-dsi-h-left-border = <0>;
		qcom,mdss-dsi-h-right-border = <0>;
		qcom,mdss-dsi-v-top-border = <0>;
		qcom,mdss-dsi-v-bottom-border = <0>;
		qcom,mdss-dsi-bpp = <24>;

		qcom,mdss-dsi-underflow-color = <0xff>;
		qcom,mdss-dsi-border-color = <0>;
		qcom,mdss-dsi-on-command = [29 01 00 00 00 00 02 00 00
				29 01 00 00 00 00 04 FF 12 85 01
				29 01 00 00 00 00 02 00 80
				29 01 00 00 00 00 03 FF 12 85
				29 01 00 00 00 00 02 00 00
				29 01 00 00 78 00 01 11
				29 01 00 00 00 00 02 00 00
				29 01 00 00 0A 00 01 29];
		qcom,mdss-dsi-off-command = [05 01 00 00 00 00 02 28 00
				05 01 00 00 78 00 02 10 00];
		qcom,mdss-dsi-on-command-state = "dsi_lp_mode";
		qcom,mdss-dsi-off-command-state = "dsi_hs_mode";
		qcom,mdss-dsi-panel-warm-command = [29 00 00 00 00 00 02 00 00
				29 01 00 00 00 00 19 E1 14 18 20 2B 34 3A 46 58 60 73 7E 86 72 6B 65 54 3F 2B 21 19 14 0B 09 08
				29 00 00 00 00 00 02 00 00
				29 01 00 00 00 00 19 E2 0D 18 20 2B 34 3A 46 58 60 73 7E 86 71 6B 64 54 3F 2B 21 19 14 0B 09 08
				29 00 00 00 00 00 02 00 00
				29 01 00 00 00 00 19 E3 50 4F 51 54 58 5B 61 6C 6F 7D 85 8B 6E 68 62 52 3F 2B 21 19 14 0B 09 08
				29 00 00 00 00 00 02 00 00
				29 01 00 00 00 00 19 E4 49 4F 51 54 58 5B 61 6C 6F 7D 85 8B 6D 67 62 52 3F 2B 21 19 14 0B 09 08
				29 00 00 00 00 00 02 00 00
				29 01 00 00 00 00 19 E5 5E 5C 5E 61 63 66 6B 74 75 81 88 8D 6C 66 60 4F 3F 2B 21 19 14 0B 09 08
				29 00 00 00 00 00 02 00 00
				29 01 00 00 00 00 19 E6 57 5C 5E 61 63 66 6B 74 75 81 88 8D 6C 66 60 4F 3F 2B 21 19 14 0B 09 08
				29 00 00 00 00 00 02 00 00
				29 01 00 00 00 00 02 FB 01];
		qcom,mdss-dsi-panel-cool-command = [29 00 00 00 00 00 02 00 00
				29 01 00 00 00 00 19 E1 38 38 3C 42 48 4D 56 64 6A 7B 85 8D 6C 65 5D 4B 38 25 1C 14 0F 0B 09 08
				29 00 00 00 00 00 02 00 00
				29 01 00 00 00 00 19 E2 31 38 3C 42 48 4D 56 64 6A 7B 85 8D 6C 65 5D 4B 38 25 1C 14 0F 0B 09 08
				29 00 00 00 00 00 02 00 00
				29 01 00 00 00 00 19 E3 3F 3F 42 47 4D 51 59 67 6D 7D 86 8D 6B 64 5D 4B 38 25 1C 14 0F 0B 09 08
				29 00 00 00 00 00 02 00 00
				29 01 00 00 00 00 19 E4 38 3F 42 47 4D 51 59 67 6D 7D 86 8E 6C 64 5D 4B 38 25 1C 14 0F 0B 09 08
				29 00 00 00 00 00 02 00 00
				29 01 00 00 00 00 19 E5 12 16 1E 29 32 39 45 58 61 75 81 8A 6E 66 5E 4A 38 25 1C 14 0F 0B 09 08
				29 00 00 00 00 00 02 00 00
				29 01 00 00 00 00 19 E6 0B 16 1E 29 32 39 45 58 61 75 81 8A 6E 66 5E 4A 38 25 1C 14 0F 0B 09 08
				29 00 00 00 00 00 02 00 00
				29 01 00 00 00 00 02 FB 01];
		  qcom,mdss-dsi-panel-nature-command = [29 00 00 00 00 00 02 00 00
				29 01 00 00 00 00 19 E1 11 17 20 2B 35 3C 49 5B 64 76 82 8B 6D 66 5E 4D 37 24 1B 14 0F 0C 0A 08
				29 00 00 00 00 00 02 00 00
				29 01 00 00 00 00 19 E2 0B 17 20 2B 35 3C 49 5B 64 76 82 8B 6D 66 5E 4D 37 24 1B 14 0F 0C 0A 08
				29 00 00 00 00 00 02 00 00
				29 01 00 00 00 00 19 E3 11 18 21 2C 35 3D 49 5B 64 77 82 8B 6D 66 5E 4D 37 24 1B 14 0F 0C 0A 08
				29 00 00 00 00 00 02 00 00
				29 01 00 00 00 00 19 E4 0B 18 21 2C 35 3D 49 5B 64 77 82 8B 6C 66 5E 4D 37 24 1B 14 0F 0C 0A 08
				29 00 00 00 00 00 02 00 00
				29 01 00 00 00 00 19 E5 11 16 1F 29 32 39 46 58 62 75 81 8A 6D 66 5E 4D 37 24 1B 14 0F 0C 0A 08
				29 00 00 00 00 00 02 00 00
				29 01 00 00 00 00 19 E6 0B 16 1F 29 32 39 46 58 62 75 81 8A 6D 66 5E 4D 37 24 1B 14 0F 0C 0A 08
				29 00 00 00 00 00 02 00 00
				29 01 00 00 00 00 02 FB 01];
	  qcom,mdss-dsi-panel-gamma-command-state = "dsi_lp_mode";
	  qcom,mdss-dsi-panel-ce-std-command = [29 00 00 00 00 00 02 00 00
				29 01 00 00 00 00 02 59 03
				29 00 00 00 00 00 02 00 80
				29 01 00 00 00 00 02 D6 88
				29 00 00 00 00 00 02 00 A3
				29 01 00 00 00 00 02 B6 03
				29 00 00 00 00 00 02 00 A0
				29 01 00 00 00 00 0D D6 00 00 00 00 00 00 00 00 00 00 00 00
				29 00 00 00 00 00 02 00 B0
				29 01 00 00 00 00 0D D6 00 00 2e 78 94 78 5c 78 94 78 5c 40
				29 00 00 00 00 00 02 00 C0
				29 01 00 00 00 00 0D D6 0d 00 3d 50 63 50 3d 50 63 50 3d 2b
				29 00 00 00 00 00 02 00 D0
				29 01 00 00 00 00 0D D6 0d 15 1f 28 31 28 1f 28 31 28 1f 15
				29 00 00 00 00 00 02 00 00
				29 01 00 00 00 00 02 FB 01];
	  qcom,mdss-dsi-panel-ce-vivid-command = [29 00 00 00 00 00 02 00 00
				29 01 00 00 00 00 02 59 03
				29 00 00 00 00 00 02 00 80
				29 01 00 00 00 00 02 D6 88
				29 00 00 00 00 00 02 00 A3
				29 01 00 00 00 00 02 B6 03
				29 00 00 00 00 00 02 00 A0
				29 01 00 00 00 00 0D D6 00 00 00 00 00 00 00 00 00 00 00 00
				29 00 00 00 00 00 02 00 B0
				29 01 00 00 00 00 0D D6 00 00 54 c5 e1 c5 a9 c5 e1 c5 a9 8d
				29 00 00 00 00 00 02 00 C0
				29 01 00 00 00 00 0D D6 26 00 71 83 96 83 71 83 96 83 71 5e
				29 00 00 00 00 00 02 00 D0
				29 01 00 00 00 00 0D D6 26 2f 38 42 4b 42 38 42 4b 42 38 2f
				29 00 00 00 00 00 02 00 00
				29 01 00 00 00 00 02 FB 01];
		qcom,mdss-dsi-panel-ce-command-state = "dsi_lp_mode";
		qcom,mdss-dsi-h-sync-pulse = <10>;
		qcom,mdss-dsi-traffic-mode = "non_burst_sync_event";
		qcom,mdss-dsi-bllp-eof-power-mode;
		qcom,mdss-dsi-bllp-power-mode;
		qcom,mdss-dsi-lane-0-state;
		qcom,mdss-dsi-lane-1-state;
		qcom,mdss-dsi-lane-2-state;
		qcom,mdss-dsi-panel-timings = [8b 1e 14 00 44 48 18 22 19 03 04 00];
		qcom,mdss-dsi-t-clk-post = <0x04>;
		qcom,mdss-dsi-t-clk-pre = <0x1c>;
		qcom,mdss-dsi-bl-min-level = <1>;
		qcom,mdss-dsi-bl-max-level = <255>;
		qcom,mdss-dsi-bl-pmic-pwm-frequency = <100>;
		qcom,mdss-dsi-bl-pmic-bank-select = <0>;
		qcom,mdss-dsi-dma-trigger = "trigger_sw";
		qcom,mdss-dsi-mdp-trigger = "none";
		qcom,mdss-dsi-bl-pmic-control-type = "bl_ctrl_pwm";
		qcom,mdss-dsi-reset-sequence = <1 5>, <0 5>, <1 10>;
	};
};
