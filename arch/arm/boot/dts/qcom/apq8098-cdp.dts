/* Copyright (c) 2016-2017, The Linux Foundation. All rights reserved.
 *
 * This program is free software; you can redistribute it and/or modify
 * it under the terms of the GNU General Public License version 2 and
 * only version 2 as published by the Free Software Foundation.
 *
 * This program is distributed in the hope that it will be useful,
 * but WITHOUT ANY WARRANTY; without even the implied warranty of
 * MERCHANTABILITY or FITNESS FOR A PARTICULAR PURPOSE.  See the
 * GNU General Public License for more details.
 */

/dts-v1/;

#include "apq8098.dtsi"
#include "msm8998-mdss-panels.dtsi"
#include "msm8998-cdp.dtsi"

/ {
	model = "Qualcomm Technologies, Inc. APQ 8098 CDP";
	compatible = "qcom,apq8098-cdp", "qcom,apq8098", "qcom,cdp";
	qcom,board-id = <1 0>;
};
