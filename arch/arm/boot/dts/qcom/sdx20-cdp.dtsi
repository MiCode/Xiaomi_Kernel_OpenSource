/* Copyright (c) 2016-2017 The Linux Foundation. All rights reserved.
 *
 * This program is free software; you can redistribute it and/or modify
 * it under the terms of the GNU General Public License version 2 and
 * only version 2 as published by the Free Software Foundation.
 *
 * This program is distributed in the hope that it will be useful,
 * but WITHOUT ANY WARRANTY; without even the implied warranty of
 * MERCHANTABILITY or FITNESS FOR A PARTICULAR PURPOSE.  See the
 * GNU General Public License for more details.
 */

#include <dt-bindings/interrupt-controller/irq.h>
#include "mdm9650-v1.1-cdp.dtsi"
#include "sdx20.dtsi"
#include "sdx20-pinctrl.dtsi"

&soc {
	sound {
		qcom,wsa-devs = <&wsa881x_214>;
		qcom,wsa-aux-dev-prefix = "SpkrRight";
	};
};
