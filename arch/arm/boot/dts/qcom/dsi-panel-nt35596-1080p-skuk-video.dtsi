/* Copyright (c) 2014, The Linux Foundation. All rights reserved.
 *
 * This program is free software; you can redistribute it and/or modify
 * it under the terms of the GNU General Public License version 2 and
 * only version 2 as published by the Free Software Foundation.
 *
 * This program is distributed in the hope that it will be useful,
 * but WITHOUT ANY WARRANTY; without even the implied warranty of
 * MERCHANTABILITY or FITNESS FOR A PARTICULAR PURPOSE.  See the
 * GNU General Public License for more details.
 */

&mdss_mdp {
	dsi_nt35596_1080p_skuk_video: qcom,mdss_dsi_nt35596_1080p_skuk_video {
		qcom,mdss-dsi-panel-name = "nt35596 1080p video mode dsi panel skuk";
		qcom,mdss-dsi-panel-controller = <&mdss_dsi0>;
		qcom,mdss-dsi-panel-type = "dsi_video_mode";
		qcom,mdss-dsi-panel-destination = "display_1";
		qcom,mdss-dsi-panel-framerate = <60>;
		qcom,mdss-dsi-virtual-channel-id = <0>;
		qcom,mdss-dsi-stream = <0>;
		qcom,mdss-dsi-panel-width = <1080>;
		qcom,mdss-dsi-panel-height = <1920>;
		qcom,mdss-dsi-h-front-porch = <100>;
		qcom,mdss-dsi-h-back-porch = <82>;
		qcom,mdss-dsi-h-pulse-width = <8>;
		qcom,mdss-dsi-h-sync-skew = <0>;
		qcom,mdss-dsi-v-back-porch = <7>;
		qcom,mdss-dsi-v-front-porch = <3>;
		qcom,mdss-dsi-v-pulse-width = <2>;
		qcom,mdss-dsi-bpp = <24>;
		qcom,mdss-dsi-color-order = "rgb_swap_rgb";
		qcom,mdss-dsi-underflow-color = <0xff>;
		qcom,mdss-dsi-border-color = <0>;
		qcom,mdss-dsi-on-command = [29 01 00 00 00 00 02 FF EE
		29 01 00 00 00 00 02 FB 01
		29 01 00 00 0A 00 02 18 40
		29 01 00 00 14 00 02 18 00
		29 01 00 00 00 00 02 FF 05
		29 01 00 00 05 00 02 FB 01
		29 01 00 00 00 00 02 90 00
		29 01 00 00 00 00 02 93 04
		29 01 00 00 00 00 02 94 04
		29 01 00 00 00 00 02 9B 0F
		29 01 00 00 00 00 02 91 44
		29 01 00 00 00 00 02 92 79
		29 01 00 00 00 00 02 00 0F
		29 01 00 00 00 00 02 01 00
		29 01 00 00 00 00 02 02 00
		29 01 00 00 00 00 02 03 00
		29 01 00 00 00 00 02 04 0B
		29 01 00 00 00 00 02 05 0C
		29 01 00 00 00 00 02 06 00
		29 01 00 00 00 00 02 07 00
		29 01 00 00 00 00 02 08 00
		29 01 00 00 00 00 02 09 00
		29 01 00 00 00 00 02 0A 03
		29 01 00 00 00 00 02 0B 04
		29 01 00 00 00 00 02 0C 01
		29 01 00 00 00 00 02 0D 13
		29 01 00 00 00 00 02 0E 15
		29 01 00 00 00 00 02 0F 17
		29 01 00 00 00 00 02 10 0F
		29 01 00 00 00 00 02 11 00
		29 01 00 00 00 00 02 12 00
		29 01 00 00 00 00 02 13 00
		29 01 00 00 00 00 02 14 0B
		29 01 00 00 00 00 02 15 0C
		29 01 00 00 00 00 02 16 00
		29 01 00 00 00 00 02 17 00
		29 01 00 00 00 00 02 18 00
		29 01 00 00 00 00 02 19 00
		29 01 00 00 00 00 02 1A 03
		29 01 00 00 00 00 02 1B 04
		29 01 00 00 00 00 02 1C 01
		29 01 00 00 00 00 02 1D 13
		29 01 00 00 00 00 02 1E 15
		29 01 00 00 00 00 02 1F 17
		29 01 00 00 00 00 02 20 09
		29 01 00 00 00 00 02 21 01
		29 01 00 00 00 00 02 22 00
		29 01 00 00 00 00 02 23 00
		29 01 00 00 00 00 02 24 00
		29 01 00 00 00 00 02 25 ED
		29 01 00 00 00 00 02 2F 02
		29 01 00 00 00 00 02 30 04
		29 01 00 00 00 00 02 31 49
		29 01 00 00 00 00 02 32 23
		29 01 00 00 00 00 02 33 01
		29 01 00 00 00 00 02 34 00
		29 01 00 00 00 00 02 35 69
		29 01 00 00 00 00 02 36 00
		29 01 00 00 00 00 02 37 2D
		29 01 00 00 00 00 02 38 18
		29 01 00 00 00 00 02 29 58
		29 01 00 00 00 00 02 2A 16
		29 01 00 00 00 00 02 2B 05
		29 01 00 00 00 00 02 5B 00
		29 01 00 00 00 00 02 5F 75
		29 01 00 00 00 00 02 63 00
		29 01 00 00 00 00 02 67 04
		29 01 00 00 00 00 02 6C 00
		29 01 00 00 00 00 02 7B 80
		29 01 00 00 00 00 02 7C D8
		29 01 00 00 00 00 02 7D 60
		29 01 00 00 00 00 02 7E 0B
		29 01 00 00 00 00 02 7F 17
		29 01 00 00 00 00 02 80 00
		29 01 00 00 00 00 02 81 06
		29 01 00 00 00 00 02 82 03
		29 01 00 00 00 00 02 83 00
		29 01 00 00 00 00 02 84 03
		29 01 00 00 00 00 02 85 07
		29 01 00 00 00 00 02 86 1B
		29 01 00 00 00 00 02 87 39
		29 01 00 00 00 00 02 88 1B
		29 01 00 00 00 00 02 89 39
		29 01 00 00 00 00 02 8A 33
		29 01 00 00 00 00 02 A4 0F
		29 01 00 00 00 00 02 8C 01
		29 01 00 00 00 00 02 99 33
		29 01 00 00 00 00 02 B5 20
		29 01 00 00 00 00 02 FF 01
		29 01 00 00 00 00 02 FB 01
		29 01 00 00 00 00 02 00 01
		29 01 00 00 00 00 02 05 50
		29 01 00 00 00 00 02 06 A0
		29 01 00 00 00 00 02 14 A8
		29 01 00 00 00 00 02 07 B2
		29 01 00 00 00 00 02 0E B5
		29 01 00 00 00 00 02 0F B8
		29 01 00 00 00 00 02 0B 55
		29 01 00 00 00 00 02 0C 55
		29 01 00 00 00 00 02 11 28
		29 01 00 00 00 00 02 12 1F
		29 01 00 00 00 00 02 08 0C
		29 01 00 00 00 00 02 15 15
		29 01 00 00 00 00 02 16 15
		29 01 00 00 00 00 02 FF 01
		29 01 00 00 00 00 02 FB 01
		29 01 00 00 00 00 02 75 00
		29 01 00 00 00 00 02 76 10
		29 01 00 00 00 00 02 77 00
		29 01 00 00 00 00 02 78 1D
		29 01 00 00 00 00 02 79 00
		29 01 00 00 00 00 02 7A 32
		29 01 00 00 00 00 02 7B 00
		29 01 00 00 00 00 02 7C 44
		29 01 00 00 00 00 02 7D 00
		29 01 00 00 00 00 02 7E 54
		29 01 00 00 00 00 02 7F 00
		29 01 00 00 00 00 02 80 63
		29 01 00 00 00 00 02 81 00
		29 01 00 00 00 00 02 82 71
		29 01 00 00 00 00 02 83 00
		29 01 00 00 00 00 02 84 7D
		29 01 00 00 00 00 02 85 00
		29 01 00 00 00 00 02 86 89
		29 01 00 00 00 00 02 87 00
		29 01 00 00 00 00 02 88 B2
		29 01 00 00 00 00 02 89 00
		29 01 00 00 00 00 02 8A D5
		29 01 00 00 00 00 02 8B 01
		29 01 00 00 00 00 02 8C 0D
		29 01 00 00 00 00 02 8D 01
		29 01 00 00 00 00 02 8E 3B
		29 01 00 00 00 00 02 8F 01
		29 01 00 00 00 00 02 90 87
		29 01 00 00 00 00 02 91 01
		29 01 00 00 00 00 02 92 C6
		29 01 00 00 00 00 02 93 01
		29 01 00 00 00 00 02 94 C8
		29 01 00 00 00 00 02 95 02
		29 01 00 00 00 00 02 96 04
		29 01 00 00 00 00 02 97 02
		29 01 00 00 00 00 02 98 47
		29 01 00 00 00 00 02 99 02
		29 01 00 00 00 00 02 9A 72
		29 01 00 00 00 00 02 9B 02
		29 01 00 00 00 00 02 9C AC
		29 01 00 00 00 00 02 9D 02
		29 01 00 00 00 00 02 9E D3
		29 01 00 00 00 00 02 9F 03
		29 01 00 00 00 00 02 A0 07
		29 01 00 00 00 00 02 A2 03
		29 01 00 00 00 00 02 A3 17
		29 01 00 00 00 00 02 A4 03
		29 01 00 00 00 00 02 A5 29
		29 01 00 00 00 00 02 A6 03
		29 01 00 00 00 00 02 A7 3D
		29 01 00 00 00 00 02 A9 03
		29 01 00 00 00 00 02 AA 52
		29 01 00 00 00 00 02 AB 03
		29 01 00 00 00 00 02 AC 6E
		29 01 00 00 00 00 02 AD 03
		29 01 00 00 00 00 02 AE 8D
		29 01 00 00 00 00 02 AF 03
		29 01 00 00 00 00 02 B0 B0
		29 01 00 00 00 00 02 B1 03
		29 01 00 00 00 00 02 B2 BF
		29 01 00 00 00 00 02 B3 00
		29 01 00 00 00 00 02 B4 10
		29 01 00 00 00 00 02 B5 00
		29 01 00 00 00 00 02 B6 1D
		29 01 00 00 00 00 02 B7 00
		29 01 00 00 00 00 02 B8 32
		29 01 00 00 00 00 02 B9 00
		29 01 00 00 00 00 02 BA 44
		29 01 00 00 00 00 02 BB 00
		29 01 00 00 00 00 02 BC 54
		29 01 00 00 00 00 02 BD 00
		29 01 00 00 00 00 02 BE 63
		29 01 00 00 00 00 02 BF 00
		29 01 00 00 00 00 02 C0 71
		29 01 00 00 00 00 02 C1 00
		29 01 00 00 00 00 02 C2 7D
		29 01 00 00 00 00 02 C3 00
		29 01 00 00 00 00 02 C4 89
		29 01 00 00 00 00 02 C5 00
		29 01 00 00 00 00 02 C6 B2
		29 01 00 00 00 00 02 C7 00
		29 01 00 00 00 00 02 C8 D5
		29 01 00 00 00 00 02 C9 01
		29 01 00 00 00 00 02 CA 0D
		29 01 00 00 00 00 02 CB 01
		29 01 00 00 00 00 02 CC 3B
		29 01 00 00 00 00 02 CD 01
		29 01 00 00 00 00 02 CE 87
		29 01 00 00 00 00 02 CF 01
		29 01 00 00 00 00 02 D0 C6
		29 01 00 00 00 00 02 D1 01
		29 01 00 00 00 00 02 D2 C8
		29 01 00 00 00 00 02 D3 02
		29 01 00 00 00 00 02 D4 04
		29 01 00 00 00 00 02 D5 02
		29 01 00 00 00 00 02 D6 47
		29 01 00 00 00 00 02 D7 02
		29 01 00 00 00 00 02 D8 72
		29 01 00 00 00 00 02 D9 02
		29 01 00 00 00 00 02 DA AC
		29 01 00 00 00 00 02 DB 02
		29 01 00 00 00 00 02 DC D3
		29 01 00 00 00 00 02 DD 03
		29 01 00 00 00 00 02 DE 07
		29 01 00 00 00 00 02 DF 03
		29 01 00 00 00 00 02 E0 17
		29 01 00 00 00 00 02 E1 03
		29 01 00 00 00 00 02 E2 29
		29 01 00 00 00 00 02 E3 03
		29 01 00 00 00 00 02 E4 3D
		29 01 00 00 00 00 02 E5 03
		29 01 00 00 00 00 02 E6 52
		29 01 00 00 00 00 02 E7 03
		29 01 00 00 00 00 02 E8 6E
		29 01 00 00 00 00 02 E9 03
		29 01 00 00 00 00 02 EA 8D
		29 01 00 00 00 00 02 EB 03
		29 01 00 00 00 00 02 EC B0
		29 01 00 00 00 00 02 ED 03
		29 01 00 00 00 00 02 EE BF
		29 01 00 00 00 00 02 EF 00
		29 01 00 00 00 00 02 F0 10
		29 01 00 00 00 00 02 F1 00
		29 01 00 00 00 00 02 F2 1D
		29 01 00 00 00 00 02 F3 00
		29 01 00 00 00 00 02 F4 32
		29 01 00 00 00 00 02 F5 00
		29 01 00 00 00 00 02 F6 44
		29 01 00 00 00 00 02 F7 00
		29 01 00 00 00 00 02 F8 54
		29 01 00 00 00 00 02 F9 00
		29 01 00 00 00 00 02 FA 63
		29 01 00 00 00 00 02 FF 02
		29 01 00 00 00 00 02 FB 01
		29 01 00 00 00 00 02 00 00
		29 01 00 00 00 00 02 01 71
		29 01 00 00 00 00 02 02 00
		29 01 00 00 00 00 02 03 7D
		29 01 00 00 00 00 02 04 00
		29 01 00 00 00 00 02 05 89
		29 01 00 00 00 00 02 06 00
		29 01 00 00 00 00 02 07 B2
		29 01 00 00 00 00 02 08 00
		29 01 00 00 00 00 02 09 D5
		29 01 00 00 00 00 02 0A 01
		29 01 00 00 00 00 02 0B 0D
		29 01 00 00 00 00 02 0C 01
		29 01 00 00 00 00 02 0D 3B
		29 01 00 00 00 00 02 0E 01
		29 01 00 00 00 00 02 0F 87
		29 01 00 00 00 00 02 10 01
		29 01 00 00 00 00 02 11 C6
		29 01 00 00 00 00 02 12 01
		29 01 00 00 00 00 02 13 C8
		29 01 00 00 00 00 02 14 02
		29 01 00 00 00 00 02 15 04
		29 01 00 00 00 00 02 16 02
		29 01 00 00 00 00 02 17 47
		29 01 00 00 00 00 02 18 02
		29 01 00 00 00 00 02 19 72
		29 01 00 00 00 00 02 1A 02
		29 01 00 00 00 00 02 1B AC
		29 01 00 00 00 00 02 1C 02
		29 01 00 00 00 00 02 1D D3
		29 01 00 00 00 00 02 1E 03
		29 01 00 00 00 00 02 1F 07
		29 01 00 00 00 00 02 20 03
		29 01 00 00 00 00 02 21 17
		29 01 00 00 00 00 02 22 03
		29 01 00 00 00 00 02 23 29
		29 01 00 00 00 00 02 24 03
		29 01 00 00 00 00 02 25 3D
		29 01 00 00 00 00 02 26 03
		29 01 00 00 00 00 02 27 52
		29 01 00 00 00 00 02 28 03
		29 01 00 00 00 00 02 29 6E
		29 01 00 00 00 00 02 2A 03
		29 01 00 00 00 00 02 2B 8D
		29 01 00 00 00 00 02 2D 03
		29 01 00 00 00 00 02 2F B0
		29 01 00 00 00 00 02 30 03
		29 01 00 00 00 00 02 31 BF
		29 01 00 00 00 00 02 32 00
		29 01 00 00 00 00 02 33 10
		29 01 00 00 00 00 02 34 00
		29 01 00 00 00 00 02 35 1D
		29 01 00 00 00 00 02 36 00
		29 01 00 00 00 00 02 37 32
		29 01 00 00 00 00 02 38 00
		29 01 00 00 00 00 02 39 44
		29 01 00 00 00 00 02 3A 00
		29 01 00 00 00 00 02 3B 54
		29 01 00 00 00 00 02 3D 00
		29 01 00 00 00 00 02 3F 63
		29 01 00 00 00 00 02 40 00
		29 01 00 00 00 00 02 41 71
		29 01 00 00 00 00 02 42 00
		29 01 00 00 00 00 02 43 7D
		29 01 00 00 00 00 02 44 00
		29 01 00 00 00 00 02 45 89
		29 01 00 00 00 00 02 46 00
		29 01 00 00 00 00 02 47 B2
		29 01 00 00 00 00 02 48 00
		29 01 00 00 00 00 02 49 D5
		29 01 00 00 00 00 02 4A 01
		29 01 00 00 00 00 02 4B 0D
		29 01 00 00 00 00 02 4C 01
		29 01 00 00 00 00 02 4D 3B
		29 01 00 00 00 00 02 4E 01
		29 01 00 00 00 00 02 4F 87
		29 01 00 00 00 00 02 50 01
		29 01 00 00 00 00 02 51 C6
		29 01 00 00 00 00 02 52 01
		29 01 00 00 00 00 02 53 C8
		29 01 00 00 00 00 02 54 02
		29 01 00 00 00 00 02 55 04
		29 01 00 00 00 00 02 56 02
		29 01 00 00 00 00 02 58 47
		29 01 00 00 00 00 02 59 02
		29 01 00 00 00 00 02 5A 72
		29 01 00 00 00 00 02 5B 02
		29 01 00 00 00 00 02 5C AC
		29 01 00 00 00 00 02 5D 02
		29 01 00 00 00 00 02 5E D3
		29 01 00 00 00 00 02 5F 03
		29 01 00 00 00 00 02 60 07
		29 01 00 00 00 00 02 61 03
		29 01 00 00 00 00 02 62 17
		29 01 00 00 00 00 02 63 03
		29 01 00 00 00 00 02 64 29
		29 01 00 00 00 00 02 65 03
		29 01 00 00 00 00 02 66 3D
		29 01 00 00 00 00 02 67 03
		29 01 00 00 00 00 02 68 52
		29 01 00 00 00 00 02 69 03
		29 01 00 00 00 00 02 6A 6E
		29 01 00 00 00 00 02 6B 03
		29 01 00 00 00 00 02 6C 8D
		29 01 00 00 00 00 02 6D 03
		29 01 00 00 00 00 02 6E B0
		29 01 00 00 00 00 02 6F 03
		29 01 00 00 00 00 02 70 BF
		29 01 00 00 00 00 02 71 00
		29 01 00 00 00 00 02 72 10
		29 01 00 00 00 00 02 73 00
		29 01 00 00 00 00 02 74 1D
		29 01 00 00 00 00 02 75 00
		29 01 00 00 00 00 02 76 32
		29 01 00 00 00 00 02 77 00
		29 01 00 00 00 00 02 78 44
		29 01 00 00 00 00 02 79 00
		29 01 00 00 00 00 02 7A 54
		29 01 00 00 00 00 02 7B 00
		29 01 00 00 00 00 02 7C 63
		29 01 00 00 00 00 02 7D 00
		29 01 00 00 00 00 02 7E 71
		29 01 00 00 00 00 02 7F 00
		29 01 00 00 00 00 02 80 7D
		29 01 00 00 00 00 02 81 00
		29 01 00 00 00 00 02 82 89
		29 01 00 00 00 00 02 83 00
		29 01 00 00 00 00 02 84 B2
		29 01 00 00 00 00 02 85 00
		29 01 00 00 00 00 02 86 D5
		29 01 00 00 00 00 02 87 01
		29 01 00 00 00 00 02 88 0D
		29 01 00 00 00 00 02 89 01
		29 01 00 00 00 00 02 8A 3B
		29 01 00 00 00 00 02 8B 01
		29 01 00 00 00 00 02 8C 87
		29 01 00 00 00 00 02 8D 01
		29 01 00 00 00 00 02 8E C6
		29 01 00 00 00 00 02 8F 01
		29 01 00 00 00 00 02 90 C8
		29 01 00 00 00 00 02 91 02
		29 01 00 00 00 00 02 92 04
		29 01 00 00 00 00 02 93 02
		29 01 00 00 00 00 02 94 47
		29 01 00 00 00 00 02 95 02
		29 01 00 00 00 00 02 96 72
		29 01 00 00 00 00 02 97 02
		29 01 00 00 00 00 02 98 AC
		29 01 00 00 00 00 02 99 02
		29 01 00 00 00 00 02 9A D3
		29 01 00 00 00 00 02 9B 03
		29 01 00 00 00 00 02 9C 07
		29 01 00 00 00 00 02 9D 03
		29 01 00 00 00 00 02 9E 17
		29 01 00 00 00 00 02 9F 03
		29 01 00 00 00 00 02 A0 29
		29 01 00 00 00 00 02 A2 03
		29 01 00 00 00 00 02 A3 3D
		29 01 00 00 00 00 02 A4 03
		29 01 00 00 00 00 02 A5 52
		29 01 00 00 00 00 02 A6 03
		29 01 00 00 00 00 02 A7 6E
		29 01 00 00 00 00 02 A9 03
		29 01 00 00 00 00 02 AA 8D
		29 01 00 00 00 00 02 AB 03
		29 01 00 00 00 00 02 AC B0
		29 01 00 00 00 00 02 AD 03
		29 01 00 00 00 00 02 AE BF
		29 01 00 00 00 00 02 AF 00
		29 01 00 00 00 00 02 B0 10
		29 01 00 00 00 00 02 B1 00
		29 01 00 00 00 00 02 B2 1D
		29 01 00 00 00 00 02 B3 00
		29 01 00 00 00 00 02 B4 32
		29 01 00 00 00 00 02 B5 00
		29 01 00 00 00 00 02 B6 44
		29 01 00 00 00 00 02 B7 00
		29 01 00 00 00 00 02 B8 54
		29 01 00 00 00 00 02 B9 00
		29 01 00 00 00 00 02 BA 63
		29 01 00 00 00 00 02 BB 00
		29 01 00 00 00 00 02 BC 71
		29 01 00 00 00 00 02 BD 00
		29 01 00 00 00 00 02 BE 7D
		29 01 00 00 00 00 02 BF 00
		29 01 00 00 00 00 02 C0 89
		29 01 00 00 00 00 02 C1 00
		29 01 00 00 00 00 02 C2 B2
		29 01 00 00 00 00 02 C3 00
		29 01 00 00 00 00 02 C4 D5
		29 01 00 00 00 00 02 C5 01
		29 01 00 00 00 00 02 C6 0D
		29 01 00 00 00 00 02 C7 01
		29 01 00 00 00 00 02 C8 3B
		29 01 00 00 00 00 02 C9 01
		29 01 00 00 00 00 02 CA 87
		29 01 00 00 00 00 02 CB 01
		29 01 00 00 00 00 02 CC C6
		29 01 00 00 00 00 02 CD 01
		29 01 00 00 00 00 02 CE C8
		29 01 00 00 00 00 02 CF 02
		29 01 00 00 00 00 02 D0 04
		29 01 00 00 00 00 02 D1 02
		29 01 00 00 00 00 02 D2 47
		29 01 00 00 00 00 02 D3 02
		29 01 00 00 00 00 02 D4 72
		29 01 00 00 00 00 02 D5 02
		29 01 00 00 00 00 02 D6 AC
		29 01 00 00 00 00 02 D7 02
		29 01 00 00 00 00 02 D8 D3
		29 01 00 00 00 00 02 D9 03
		29 01 00 00 00 00 02 DA 07
		29 01 00 00 00 00 02 DB 03
		29 01 00 00 00 00 02 DC 17
		29 01 00 00 00 00 02 DD 03
		29 01 00 00 00 00 02 DE 29
		29 01 00 00 00 00 02 DF 03
		29 01 00 00 00 00 02 E0 3D
		29 01 00 00 00 00 02 E1 03
		29 01 00 00 00 00 02 E2 52
		29 01 00 00 00 00 02 E3 03
		29 01 00 00 00 00 02 E4 6E
		29 01 00 00 00 00 02 E5 03
		29 01 00 00 00 00 02 E6 8D
		29 01 00 00 00 00 02 E7 03
		29 01 00 00 00 00 02 E8 B0
		29 01 00 00 00 00 02 E9 03
		29 01 00 00 00 00 02 EA BF
		29 01 00 00 00 00 02 FF 04
		29 01 00 00 00 00 02 07 00
		29 01 00 00 00 00 02 08 92
		29 01 00 00 00 00 02 FF 00
		29 01 00 00 05 00 02 FB 01
		29 01 00 00 00 00 02 D3 09
		29 01 00 00 00 00 02 D4 04
		29 01 00 00 00 00 02 51 00
		29 01 00 00 00 00 02 53 2C
		29 01 00 00 00 00 02 55 00
		29 01 00 00 78 00 02 11 00
		29 01 00 00 00 00 02 29 00];
		qcom,mdss-dsi-off-command = [05 01 00 00 32 00 02 28 00
					05 01 00 00 78 00 02 10 00];
		qcom,mdss-dsi-on-command-state = "dsi_lp_mode";
		qcom,mdss-dsi-off-command-state = "dsi_hs_mode";
		qcom,mdss-dsi-panel-status-command = [06 01 00 01 05 00 02 0A 08];
		qcom,mdss-dsi-panel-status-command-state = "dsi_lp_mode";
		qcom,mdss-dsi-panel-status-check-mode = "reg_read_nt35596";
		qcom,mdss-dsi-panel-status-value = <0x9c>;
		qcom,mdss-dsi-h-sync-pulse = <1>;
		qcom,mdss-dsi-traffic-mode = "burst_mode";
		qcom,mdss-dsi-lane-map = "lane_map_0123";
		qcom,mdss-dsi-bllp-eof-power-mode;
		qcom,mdss-dsi-bllp-power-mode;
		qcom,mdss-dsi-lane-0-state;
		qcom,mdss-dsi-lane-1-state;
		qcom,mdss-dsi-lane-2-state;
		qcom,mdss-dsi-lane-3-state;
		qcom,mdss-dsi-panel-timings = [9e 43 37 00 60 58 39 45 5b 03 04 00];
		qcom,mdss-dsi-t-clk-post = <0x1e>;
		qcom,mdss-dsi-t-clk-pre = <0x38>;
		qcom,mdss-dsi-bl-min-level = <1>;
		qcom,mdss-dsi-bl-max-level = <255>;
		qcom,mdss-dsi-dma-trigger = "trigger_sw";
		qcom,mdss-dsi-mdp-trigger = "none";
		qcom,mdss-dsi-bl-pmic-control-type = "bl_ctrl_dcs";
		qcom,mdss-dsi-reset-sequence = <1 20>, <0 20>, <1 20>;
	};
};
