/* Copyright (c) 2014, The Linux Foundation. All rights reserved.
 * Copyright (C) 2018 XiaoMi, Inc.
 *
 * This program is free software; you can redistribute it and/or modify
 * it under the terms of the GNU General Public License version 2 and
 * only version 2 as published by the Free Software Foundation.
 *
 * This program is distributed in the hope that it will be useful,
 * but WITHOUT ANY WARRANTY; without even the implied warranty of
 * MERCHANTABILITY or FITNESS FOR A PARTICULAR PURPOSE.  See the
 * GNU General Public License for more details.
 */

/*---------------------------------------------------------------------------
 * This file is autogenerated file using gcdb parser. Please do not edit it.
 * Update input XML file to add a new entry or update variable in this file
 * VERSION = "1.0"
 *---------------------------------------------------------------------------*/
&mdss_mdp {
	dsi_hx8394f_boe_720_vid: qcom,mdss_dsi_hx8394f_boe_c3b_720p_video {
		qcom,mdss-dsi-panel-name = "hx8394F_HD720p_video_BOE_c3b";
		qcom,mdss-dsi-panel-controller = <&mdss_dsi0>;
		qcom,mdss-dsi-panel-type = "dsi_video_mode";
		qcom,mdss-dsi-panel-destination = "display_1";
		qcom,mdss-dsi-panel-model = "BOE HD HX8394F VIDEO PANEL";
		qcom,mdss-dsi-panel-framerate = <60>;
		qcom,mdss-dsi-virtual-channel-id = <0>;
		qcom,mdss-dsi-stream = <0>;
		qcom,mdss-dsi-panel-width = <720>;
		qcom,mdss-dsi-panel-height = <1280>;
		qcom,mdss-dsi-h-front-porch = <160>;
		qcom,mdss-dsi-h-back-porch = <160>;
		qcom,mdss-dsi-h-pulse-width = <24>;
		qcom,mdss-dsi-h-sync-skew = <0>;
		qcom,mdss-dsi-v-back-porch = <12>;
		qcom,mdss-dsi-v-front-porch = <15>;
		qcom,mdss-dsi-v-pulse-width = <4>;
		qcom,mdss-dsi-h-left-border = <0>;
		qcom,mdss-dsi-h-right-border = <0>;
		qcom,mdss-dsi-v-top-border = <0>;
		qcom,mdss-dsi-v-bottom-border = <0>;
		qcom,mdss-dsi-bpp = <24>;
		qcom,mdss-dsi-color-order = "rgb_swap_rgb";
		qcom,mdss-dsi-underflow-color = <0x00>;
		qcom,mdss-dsi-border-color = <0>;
		qcom,mdss-dsi-on-command = [39 01 00 00 00 00 04 B9 FF 83 94
				05 01 00 00 78 00 02 11 00
				05 01 00 00 14 00 02 29 00];
		qcom,mdss-dsi-off-command = [05 01 00 00 32 00 02 28 00
				05 01 00 00 78 00 02 10 00];
		qcom,mdss-dsi-on-command-state = "dsi_lp_mode";
		qcom,mdss-dsi-off-command-state = "dsi_hs_mode";
		qcom,mdss-dsi-panel-warm-command = [39 01 00 00 01 00 3B E0 07 08 09 0D 10 14 16 13 24 36 48 4A 58 6F 76 80 97 A5 A8 B5 C6 62 63 68 6F 72 78 7F 7F 00 02 08 0D 0C 0E 0F 10 24 36 48 4A 58 6F 78 82 99 A4 A0 B1 C0 5E 5E 64 6B 6C 73 7F 7F
				39 01 00 00 01 00 02 BD 00
				39 01 00 00 01 00 2C C1 01 00 0C 18 24 30 3A 43 4A 52 59 5F 66 6D 74 7B 83 8A 91 99 A0 A7 AE B5 BC C3 CA D1 D9 E0 E7 EF F7 FF 15 B3 59 B8 1E 00 AC 63 C0
				39 01 00 00 01 00 02 BD 01
				39 01 00 00 01 00 2B C1 00 0B 16 21 2C 36 3E 46 4D 54 5A 60 66 6C 73 79 7F 86 8D 93 9B A0 A6 AD B3 B9 BF C6 CD D3 DA E0 E6 06 9D 40 21 E3 3C 6E 62 C0
				39 01 00 00 01 00 02 BD 02
				39 01 00 00 01 00 2B C1 00 0A 14 1E 28 32 3B 43 4A 51 57 5D 62 69 6F 75 7B 82 88 8F 95 9C A2 A7 AE B4 BA C0 C6 CD D2 D9 DE 16 BE 95 DB CD E3 01 8C C0
				39 01 00 00 01 00 02 BD 00];
		qcom,mdss-dsi-panel-cool-command = [39 01 00 00 01 00 3B E0 07 08 09 0D 10 14 16 13 24 36 48 4A 58 6F 76 80 97 A5 A8 B5 C6 62 63 68 6F 72 78 7F 7F 00 02 08 0D 0C 0E 11 10 24 36 48 4A 58 6F 78 82 99 A4 A0 B1 C0 5E 5E 64 6B 6C 73 7F 7F
				39 01 00 00 01 00 02 BD 00
				39 01 00 00 01 00 2C C1 01 00 0A 14 1E 28 32 3C 43 4B 52 59 5F 66 6D 74 7B 82 8A 92 9A A0 A8 AF B7 BD C7 CE D5 DD E6 EE F7 FF 16 E3 11 59 A4 8D C3 84 C0
				39 01 00 00 01 00 02 BD 01
				39 01 00 00 01 00 2B C1 00 0A 13 1D 27 31 3B 43 4A 51 57 5E 64 6B 72 79 80 87 8F 97 9E A4 AB B3 BA C1 C9 D0 D7 DF E6 EE F6 0F F0 1D AA B4 7C 01 C8 00
				39 01 00 00 01 00 02 BD 02
				39 01 00 00 01 00 2B C1 00 0A 13 1D 27 32 3C 44 4C 53 5A 60 68 6F 76 7D 85 8C 94 9C A3 AA B2 B9 C0 C8 D0 D8 DF E7 EE F6 FE 0E 56 27 1B 7E B5 F8 8B 00
				39 01 00 00 01 00 02 BD 00];
		qcom,mdss-dsi-panel-nature-command = [39 01 00 00 01 00 3B E0 07 08 09 0D 10 14 16 13 24 36 48 4A 58 6F 76 80 97 A5 A8 B5 C6 62 63 68 6F 72 78 7F 7F 00 02 08 0D 0C 0E 0F 10 24 36 48 4A 58 6F 78 82 99 A4 A0 B1 C0 5E 5E 64 6B 6C 73 7F 7F
				39 01 00 00 01 00 02 BD 00
				39 01 00 00 01 00 2C C1 01 00 0A 14 1E 28 32 3B 43 4A 52 58 5F 65 6D 74 7B 82 8A 92 99 A1 A8 AE B6 BE C5 CD D6 DC E5 ED F6 FF 15 8F C9 C5 97 4F 3C CB C0
				39 01 00 00 01 00 02 BD 01
				39 01 00 00 01 00 2B C1 00 09 13 1D 26 30 39 41 48 4F 55 5C 62 68 6F 76 7D 84 8B 92 9A A0 A7 AE B5 BC C3 CB D2 D9 E0 E7 EF 24 85 5C 39 07 79 44 1A 80
				39 01 00 00 01 00 02 BD 02
				39 01 00 00 01 00 2B C1 00 09 12 1B 24 2E 38 41 48 4F 56 5C 62 69 70 77 7E 85 8C 93 9B A2 A8 AF B6 BD C4 CC D3 DA E1 E8 F0 15 7C 62 A9 1B 8B 4C 2E 00
				39 01 00 00 01 00 02 BD 00];
		qcom,mdss-dsi-panel-gamma-command-state = "dsi_lp_mode";
		qcom,mdss-dsi-panel-ce-std-command = [39 01 00 00 0A 00 03 E4 00 00];
		qcom,mdss-dsi-panel-ce-vivid-command = [39 01 00 00 14 00 02 E4 00
				39 01 00 00 14 00 20 E5 00 00 0B 08 01 00 00 00 00 00 00 05 1D 19 1F 05 ED 09 20 00 00 04 0B 02 01 08 08 07 02 04 02
				39 01 00 00 14 00 16 E6 00 08 00 05 05 10 10 10 20 20 20 10 10 10 10 10 03 A0 01 0F 11
				39 01 00 00 14 00 03 E4 00 41];
		qcom,mdss-dsi-panel-ce-command-state = "dsi_lp_mode";

		qcom,mdss-dsi-panel-eye-command01 = [39 01 00 00 00 00 3B E0 07 08 09 0D 10 14 16 13 24 36 48 4A 58 6F 76 80 97 A5 A8 B5 C6 62 63 68 6F 72 78 7F 7F 00 02 08 0D 0C 0E 0F 10 24 36 48 4A 58 6F 78 82 99 A4 A0 B1 C0 5E 5E 64 6B 6C 73 7F 7F
				39 01 00 00 00 00 02 BD 00
				39 01 00 00 00 00 2C C1 01 00 0A 14 1E 28 32 3B 43 4A 52 58 5F 65 6D 74 7B 82 8A 92 99 A1 A8 AE B6 BE C5 CD D6 DC E5 ED F6 FF 15 8F C9 C5 97 4F 3C CB C0
				39 01 00 00 00 00 02 BD 01
				39 01 00 00 00 00 2B C1 00 09 12 1C 25 2E 37 3F 46 4D 53 59 5F 66 6C 73 7A 81 88 8F 96 9D A3 AA B1 B7 BE C6 CD D4 DB E2 EA 1D BF 9F DE 01 C9 3D 55 00
				39 01 00 00 00 00 02 BD 02
				39 01 00 00 00 00 2B C1 00 08 11 19 22 2C 36 3E 44 4B 52 58 5D 64 6B 71 78 7F 86 8C 94 9A A0 A7 AD B4 BB C2 C9 D0 D7 DD E4 37 A0 F1 E7 03 6E DA 57 C0
				39 01 00 00 00 00 02 BD 00
			];
		qcom,mdss-dsi-panel-eye-command02 = [39 01 00 00 00 00 3B E0 07 08 09 0D 10 14 16 13 24 36 48 4A 58 6F 76 80 97 A5 A8 B5 C6 62 63 68 6F 72 78 7F 7F 00 02 08 0D 0C 0E 0F 10 24 36 48 4A 58 6F 78 82 99 A4 A0 B1 C0 5E 5E 64 6B 6C 73 7F 7F
				39 01 00 00 00 00 02 BD 00
				39 01 00 00 00 00 2C C1 01 00 0A 14 1E 28 32 3B 43 4A 52 58 5F 65 6D 74 7B 82 8A 92 99 A1 A8 AE B6 BE C5 CD D6 DC E5 ED F6 FF 15 8F C9 C5 97 4F 3C CB C0
				39 01 00 00 00 00 02 BD 01
				39 01 00 00 00 00 2B C1 00 09 12 1B 24 2D 36 3E 44 4B 51 57 5D 63 6A 70 77 7D 84 8C 93 99 9F A6 AC B3 BA C1 C8 CF D6 DC E4 06 B9 EF 77 7C 1C D6 53 40
				39 01 00 00 00 00 02 BD 02
				39 01 00 00 00 00 2B C1 00 08 10 18 21 2A 33 3B 41 48 4E 54 59 60 66 6C 72 79 80 86 8D 93 99 A0 A6 AC B3 B9 C0 C7 CD D3 DA 1B 28 D5 86 D2 A8 03 0B 80
				39 01 00 00 00 00 02 BD 00
			];
		qcom,mdss-dsi-panel-eye-command03 = [39 01 00 00 00 00 3B E0 07 08 09 0D 10 14 16 13 24 36 48 4A 58 6F 76 80 97 A5 A8 B5 C6 62 63 68 6F 72 78 7F 7F 00 02 08 0D 0C 0E 0F 10 24 36 48 4A 58 6F 78 82 99 A4 A0 B1 C0 5E 5E 64 6B 6C 73 7F 7F
				39 01 00 00 00 00 02 BD 00
				39 01 00 00 00 00 2C C1 01 00 0A 14 1E 28 32 3B 43 4A 52 58 5F 65 6D 74 7B 82 8A 92 99 A1 A8 AE B6 BE C5 CD D6 DC E5 ED F6 FF 15 8F C9 C5 97 4F 3C CB C0
				39 01 00 00 00 00 02 BD 01
				39 01 00 00 00 00 2B C1 00 08 11 1B 23 2C 35 3C 43 4A 50 55 5B 61 68 6E 74 7B 82 89 90 96 9C A2 A9 AF B6 BD C4 CB D1 D8 DF 3C FB 83 B2 D0 0B 66 0D C0
				39 01 00 00 00 00 02 BD 02
				39 01 00 00 00 00 2B C1 00 08 0F 17 1F 28 31 38 3E 45 4A 50 55 5B 61 67 6D 73 79 80 86 8C 92 98 9E A4 AA B1 B7 BD C3 C9 D0 0E 65 89 AA 6D E6 0C 2F 40
				39 01 00 00 00 00 02 BD 00
			];
		qcom,mdss-dsi-panel-eye-command04 = [39 01 00 00 00 00 3B E0 07 08 09 0D 10 14 16 13 24 36 48 4A 58 6F 76 80 97 A5 A8 B5 C6 62 63 68 6F 72 78 7F 7F 00 02 08 0D 0C 0E 0F 10 24 36 48 4A 58 6F 78 82 99 A4 A0 B1 C0 5E 5E 64 6B 6C 73 7F 7F
				39 01 00 00 00 00 02 BD 00
				39 01 00 00 00 00 2C C1 01 00 0A 14 1E 28 32 3B 43 4A 52 58 5F 65 6D 74 7B 82 8A 92 99 A1 A8 AE B6 BE C5 CD D6 DC E5 ED F6 FF 15 8F C9 C5 97 4F 3C CB C0
				39 01 00 00 00 00 02 BD 01
				39 01 00 00 00 00 2B C1 00 08 11 1A 23 2B 34 3B 41 48 4E 53 59 5F 65 6B 71 78 7E 85 8C 92 98 9E A5 AB B1 B8 BF C5 CC D2 DA 29 21 C3 5A DE 9A 1F 7B 00
				39 01 00 00 00 00 02 BD 02
				39 01 00 00 00 00 2B C1 00 07 0F 16 1D 26 2E 35 3B 41 46 4C 51 57 5C 62 67 6D 73 79 80 85 8B 90 96 9B A2 A8 AE B4 BA BF C6 21 EE AD 4D FF 63 75 13 00
				39 01 00 00 00 00 02 BD 00
			];
		qcom,mdss-dsi-panel-eye-command05 = [39 01 00 00 00 00 3B E0 07 08 09 0D 10 14 16 13 24 36 48 4A 58 6F 76 80 97 A5 A8 B5 C6 62 63 68 6F 72 78 7F 7F 00 02 08 0D 0C 0E 0F 10 24 36 48 4A 58 6F 78 82 99 A4 A0 B1 C0 5E 5E 64 6B 6C 73 7F 7F
				39 01 00 00 00 00 02 BD 00
				39 01 00 00 00 00 2C C1 01 00 0A 14 1E 28 32 3B 43 4A 52 58 5F 65 6D 74 7B 82 8A 92 99 A1 A8 AE B6 BE C5 CD D6 DC E5 ED F6 FF 15 8F C9 C5 97 4F 3C CB C0
				39 01 00 00 00 00 02 BD 01
				39 01 00 00 00 00 2B C1 00 08 11 19 22 2A 33 3A 40 46 4C 52 57 5D 63 69 6F 75 7C 82 89 8F 95 9B A1 A7 AE B4 BB C1 C8 CE D5 13 70 64 55 63 95 A3 21 80
				39 01 00 00 00 00 02 BD 02
				39 01 00 00 00 00 2B C1 00 07 0E 15 1C 24 2C 32 38 3E 43 48 4D 52 57 5D 62 68 6D 73 79 7E 83 89 8E 93 99 9F A5 AA B0 B5 BB 05 67 85 2D 8E AD BE 3B 80
				39 01 00 00 00 00 02 BD 00
			];
		qcom,mdss-dsi-panel-eye-command06 = [39 01 00 00 00 00 3B E0 07 08 09 0D 10 14 16 13 24 36 48 4A 58 6F 76 80 97 A5 A8 B5 C6 62 63 68 6F 72 78 7F 7F 00 02 08 0D 0C 0E 0F 10 24 36 48 4A 58 6F 78 82 99 A4 A0 B1 C0 5E 5E 64 6B 6C 73 7F 7F
				39 01 00 00 00 00 02 BD 00
				39 01 00 00 00 00 2C C1 01 00 0A 14 1E 28 32 3B 43 4A 52 58 5F 65 6D 74 7B 82 8A 92 99 A1 A8 AE B6 BE C5 CD D6 DC E5 ED F6 FF 15 8F C9 C5 97 4F 3C CB C0
				39 01 00 00 00 00 02 BD 01
				39 01 00 00 00 00 2B C1 00 08 10 19 21 29 31 38 3E 44 4A 4F 55 5A 60 66 6C 72 78 7F 85 8B 91 97 9D A3 A9 B0 B6 BC C2 C8 CF 08 6A B7 3E AD E5 44 6F C0
				39 01 00 00 00 00 02 BD 02
				39 01 00 00 00 00 2B C1 00 06 0D 14 1A 22 29 30 35 3A 3F 44 48 4D 53 58 5D 62 67 6D 72 77 7C 81 86 8B 91 96 9B A1 A6 AB B1 34 EC 79 F0 1C EB A7 DF 40
				39 01 00 00 00 00 02 BD 00
			];
		qcom,mdss-dsi-panel-eye-command07 = [39 01 00 00 00 00 3B E0 07 08 09 0D 10 14 16 13 24 36 48 4A 58 6F 76 80 97 A5 A8 B5 C6 62 63 68 6F 72 78 7F 7F 00 02 08 0D 0C 0E 0F 10 24 36 48 4A 58 6F 78 82 99 A4 A0 B1 C0 5E 5E 64 6B 6C 73 7F 7F
				39 01 00 00 00 00 02 BD 00
				39 01 00 00 00 00 2C C1 01 00 0A 14 1E 28 32 3B 43 4A 52 58 5F 65 6D 74 7B 82 8A 92 99 A1 A8 AE B6 BE C5 CD D6 DC E5 ED F6 FF 15 8F C9 C5 97 4F 3C CB C0
				39 01 00 00 00 00 02 BD 01
				39 01 00 00 00 00 2B C1 00 07 10 18 20 28 30 36 3C 42 48 4D 52 58 5D 63 69 6E 75 7B 81 87 8C 92 98 9E A4 AA B0 B6 BC C2 C9 31 53 A1 49 31 8D 42 AA 40
				39 01 00 00 00 00 02 BD 02
				39 01 00 00 00 00 2B C1 00 06 0C 13 19 21 28 2E 33 38 3C 41 45 4A 4F 54 59 5E 63 68 6E 72 77 7C 80 85 8B 90 95 9A 9F A4 A9 2D 80 1D A9 16 25 F1 6E C0
				39 01 00 00 00 00 02 BD 00
			];
		qcom,mdss-dsi-panel-eye-command08 = [39 01 00 00 00 00 3B E0 07 08 09 0D 10 14 16 13 24 36 48 4A 58 6F 76 80 97 A5 A8 B5 C6 62 63 68 6F 72 78 7F 7F 00 02 08 0D 0C 0E 0F 10 24 36 48 4A 58 6F 78 82 99 A4 A0 B1 C0 5E 5E 64 6B 6C 73 7F 7F
				39 01 00 00 00 00 02 BD 00
				39 01 00 00 00 00 2C C1 01 00 0A 14 1E 28 32 3B 43 4A 52 58 5F 65 6D 74 7B 82 8A 92 99 A1 A8 AE B6 BE C5 CD D6 DC E5 ED F6 FF 15 8F C9 C5 97 4F 3C CB C0
				39 01 00 00 00 00 02 BD 01
				39 01 00 00 00 00 2B C1 00 07 0F 17 1F 27 2E 35 3B 40 46 4B 50 55 5B 60 66 6B 71 77 7E 83 88 8E 94 99 9F A5 AB B1 B7 BD C3 3A 4D 30 22 3F 1D 2B A4 80
				39 01 00 00 00 00 02 BD 02
				39 01 00 00 00 00 2B C1 00 06 0C 12 18 1F 25 2B 30 35 39 3D 41 46 4B 4F 54 59 5D 62 67 6C 70 75 79 7E 83 88 8D 92 96 9B A0 00 1D 4B E2 0F DA D9 0D 40
				39 01 00 00 00 00 02 BD 00
			];
		qcom,mdss-dsi-panel-eye-command-num = <8>;
		qcom,mdss-dsi-h-sync-pulse = <1>;
		qcom,mdss-dsi-traffic-mode = "burst_mode";
		qcom,mdss-dsi-lane-map = "lane_map_0123";
		qcom,mdss-dsi-bllp-eof-power-mode;
		qcom,mdss-dsi-bllp-power-mode;
		qcom,mdss-dsi-lane-0-state;
		qcom,mdss-dsi-lane-1-state;
		qcom,mdss-dsi-lane-2-state;
		qcom,mdss-dsi-lane-3-state;
		qcom,mdss-dsi-panel-timings = [8C 20 14 00 46 48 1A 22 18 03 04 00];
		qcom,mdss-dsi-t-clk-post = <0x04>;
		qcom,mdss-dsi-t-clk-pre = <0x1C>;
		qcom,mdss-dsi-bl-min-level = <4>;
		qcom,mdss-dsi-bl-max-level = <255>;
		qcom,mdss-dsi-bl-pmic-pwm-frequency = <100>;
		qcom,mdss-dsi-bl-pmic-bank-select = <0>;
		qcom,mdss-dsi-dma-trigger = "trigger_sw";
		qcom,mdss-dsi-mdp-trigger = "none";
		qcom,mdss-dsi-bl-pmic-control-type = "bl_ctrl_pwm";
		qcom,mdss-dsi-reset-sequence = <1 50>, <0 20>, <1 5>;
		qcom,mdss-pan-physical-width-dimension = <62>;
		qcom,mdss-pan-physical-height-dimension = <110>;
		qcom,mdss-dsi-lp11-init;
		qcom,mdss-dsi-init-delay-us = <50000>;
		qcom,mdss-dsi-tx-eot-append;

		qcom,esd-check-enabled;
		qcom,mdss-dsi-panel-status-command = [06 01 00 01 05 00 01 D9
			06 01 00 01 05 00 01 09
			];
		qcom,mdss-dsi-panel-status-command-num = <2>;
		qcom,mdss-dsi-panel-status-command-state = "dsi_hs_mode";
		qcom,mdss-dsi-panel-status-check-mode = "reg_read";
		qcom,mdss-dsi-panel-status-read-length = <4 4>;
		qcom,mdss-dsi-panel-status-valid-params = <1 3>;
		qcom,mdss-dsi-panel-status-value =
			<0x80 0x80 0x73 0x04 >,
			<0x80 0x80 0x73 0x04 >;
	};
};
