/* Copyright (c) 2013, The Linux Foundation. All rights reserved.
 * Copyright (C) 2016 XiaoMi, Inc.
 *
 * This program is free software; you can redistribute it and/or modify
 * it under the terms of the GNU General Public License version 2 and
 * only version 2 as published by the Free Software Foundation.
 *
 * This program is distributed in the hope that it will be useful,
 * but WITHOUT ANY WARRANTY; without even the implied warranty of
 * MERCHANTABILITY or FITNESS FOR A PARTICULAR PURPOSE.  See the
 * GNU General Public License for more details.
 */

/*---------------------------------------------------------------------------
 * This file is autogenerated file using gcdb parser. Please do not edit it.
 * Update input XML file to add a new entry or update variable in this file
 * VERSION = "1.0"
 *---------------------------------------------------------------------------*/
&mdss_mdp {
	dsi_r69431_hd720_video: qcom,mdss_dsi_r69431_720p_video {
		qcom,mdss-dsi-panel-name = "r69431_HD720p_video_sharp";
		qcom,mdss-dsi-panel-controller = <&mdss_dsi0>;
		qcom,mdss-dsi-panel-type = "dsi_video_mode";
		qcom,mdss-dsi-panel-destination = "display_1";
		qcom,mdss-dsi-panel-framerate = <60>;
		qcom,mdss-dsi-virtual-channel-id = <0>;
		qcom,mdss-dsi-stream = <0>;
		qcom,mdss-dsi-panel-width = <720>;
		qcom,mdss-dsi-panel-height = <1280>;
		qcom,mdss-pan-physical-width-dimension = <58>;
		qcom,mdss-pan-physical-height-dimension = <103>;
		qcom,mdss-dsi-h-front-porch = <120>;
		qcom,mdss-dsi-h-back-porch = <20>;
		qcom,mdss-dsi-h-pulse-width = <10>;
		qcom,mdss-dsi-h-sync-skew = <0>;
		qcom,mdss-dsi-v-back-porch = <11>;
		qcom,mdss-dsi-v-front-porch = <13>;
		qcom,mdss-dsi-v-pulse-width = <1>;
		qcom,mdss-dsi-h-left-border = <0>;
		qcom,mdss-dsi-h-right-border = <0>;
		qcom,mdss-dsi-v-top-border = <0>;
		qcom,mdss-dsi-v-bottom-border = <0>;
		qcom,mdss-dsi-bpp = <24>;
		qcom,mdss-dsi-underflow-color = <0xff>;
		qcom,mdss-dsi-border-color = <0>;
		qcom,mdss-dsi-on-command = [29 01 00 00 00 00 02 B0 00
				29 01 00 00 00 00 02 D6 01
				29 01 00 00 00 00 02 B3 1C
				29 01 00 00 00 00 02 B0 03
				05 01 00 00 00 00 02 29 00
				05 01 00 00 78 00 02 11 00];
		qcom,mdss-dsi-off-command = [05 01 00 00 14 00 02 28 00
				05 01 00 00 DC 00 02 10 00];
		qcom,mdss-dsi-on-command-state = "dsi_lp_mode";
		qcom,mdss-dsi-off-command-state = "dsi_hs_mode";
		qcom,mdss-dsi-h-sync-pulse = <10>;
		qcom,mdss-dsi-traffic-mode = "non_burst_sync_pulse";
		qcom,mdss-dsi-bllp-eof-power-mode;
		qcom,mdss-dsi-bllp-power-mode;
		qcom,mdss-dsi-lane-0-state;
		qcom,mdss-dsi-lane-1-state;
		qcom,mdss-dsi-lane-2-state;
		qcom,mdss-dsi-panel-timings = [98 22 16 00 4a 4c 1a 26 1a 03 04 00];
		qcom,mdss-dsi-t-clk-post = <0x04>;
		qcom,mdss-dsi-t-clk-pre = <0x1e>;
		qcom,mdss-dsi-init-last;
		qcom,mdss-dsi-panel-warm-command = [29 01 00 00 00 00 02 B0 00
				29 01 00 00 00 00 06 B3 1C 00 00 00 00
				29 01 00 00 00 00 27 C7 12 1F 2E 3B 47 51 67 77 84 90 42 4C 59 6B 73 7F 8F 9D A6 00 19 28 33 3F 4B 63 73 82 90 42 4E 5B 6F 79 87 93 9D AF
				29 01 00 00 00 00 27 C8 42 48 4C 54 5B 62 72 7F 8B 94 46 4F 5B 6D 76 81 92 9F A6 3C 40 46 4E 55 5C 6E 7D 89 94 46 51 5F 73 7C 89 96 9F AF
				29 01 00 00 00 00 27 C9 4A 4C 51 58 5F 66 74 80 8C 95 47 51 5C 6D 76 82 92 A0 A6 44 48 4B 52 59 60 70 7E 8A 95 47 51 5E 73 7C 8A 96 A0 AF
				29 01 00 00 00 00 02 D6 01
				29 01 00 00 00 00 02 B0 03];
		qcom,mdss-dsi-panel-cool-command = [29 01 00 00 00 00 02 B0 00
				29 01 00 00 00 00 06 B3 1C 00 00 00 00
				29 01 00 00 00 00 27 C7 31 38 40 4A 52 5B 6E 7E 8A 95 47 51 5D 71 7B 84 99 A3 A6 23 30 38 42 4C 55 6A 7A 88 95 47 53 61 77 81 8C 99 A3 AF
				29 01 00 00 00 00 27 C8 39 3D 43 4C 56 5E 71 7F 8B 96 48 52 5E 72 7B 86 97 A3 A6 2B 35 3B 46 50 58 6D 7D 8B 96 48 54 62 78 81 8E 9B A3 AF
				29 01 00 00 00 00 27 C9 12 21 2E 3D 49 53 69 7A 87 93 45 50 5D 70 78 83 97 9E A6 00 19 24 35 41 4D 65 76 85 93 45 52 5F 74 7E 89 99 A8 AF
				29 01 00 00 00 00 02 D6 01
				29 01 00 00 00 00 02 B0 03];
		qcom,mdss-dsi-panel-nature-command = [29 01 00 00 00 00 02 B0 00
				29 01 00 00 00 00 06 B3 1C 00 00 00 00
				29 01 00 00 00 00 27 C7 12 21 2E 3D 4A 54 6B 7B 88 93 46 50 5D 70 79 83 98 9E A6 00 19 24 35 42 4E 65 77 86 93 44 52 5F 74 7D 89 98 A8 AF
				29 01 00 00 00 00 27 C8 35 3A 42 4D 56 5F 71 80 8C 96 48 52 5E 71 7B 84 99 A3 A6 27 32 3A 45 50 59 6D 7C 8A 96 48 54 62 77 81 8C 99 A3 AF
				29 01 00 00 00 00 27 C9 12 21 2E 3D 4A 54 6B 7B 88 93 46 50 5D 70 79 83 98 9E A6 00 19 24 35 42 4E 65 77 86 93 44 52 5F 74 7D 89 98 A8 AF
				29 01 00 00 00 00 02 D6 01
				29 01 00 00 00 00 02 B0 03];
				/*CE off*/
		qcom,mdss-dsi-panel-ce-std-command = [29 01 00 00 00 00 02 B0 00
				29 01 00 00 00 00 06 B3 1C 00 00 00 00
				29 01 00 00 00 00 21 CA 00 80 80 80 80 80 80 80 08 20 80 80 0A 4A 37 A0 55 F8 0C 0C 20 10 3F 3F 00 00 10 10 3F 3F 3F 3F
				29 01 00 00 00 00 02 D6 01
				29 01 00 00 00 00 02 B0 03];
		qcom,mdss-dsi-panel-ce-vivid-command = [29 01 00 00 00 00 02 B0 00
				29 01 00 00 00 00 06 B3 1C 00 00 00 00
				29 01 00 00 00 00 21 CA 01 80 85 80 B0 A0 B0 85 0A 20 80 80 10 4A 00 FF 00 FF 10 06 20 10 3F 3F 00 00 10 10 3F 3F 3F 3F
				29 01 00 00 00 00 02 D6 01
				29 01 00 00 00 00 02 B0 03];
		qcom,mdss-dsi-panel-gamma-command-state = "dsi_hs_mode";
		qcom,mdss-dsi-panel-ce-command-state = "dsi_hs_mode";
		qcom,mdss-dsi-bl-min-level = <10>;
		qcom,mdss-dsi-bl-max-level = <255>;
		qcom,mdss-dsi-bl-pmic-pwm-frequency = <100>;
		qcom,mdss-dsi-bl-pmic-bank-select = <0>;
		qcom,mdss-dsi-dma-trigger = "trigger_sw";
		qcom,mdss-dsi-mdp-trigger = "none";
		qcom,mdss-dsi-bl-pmic-control-type = "bl_ctrl_pwm";
		qcom,mdss-dsi-reset-sequence = <1 5>, <0 5>, <1 10>;

	};
};
