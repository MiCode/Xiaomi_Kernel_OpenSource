
qcom,d5_cos_3400mah {
	qcom,max-voltage-uv = <4400000>;
	qcom,nom-batt-capacity-mah = <3400>;
	qcom,fg-cc-cv-threshold-mv = <4390>;
	qcom,batt-id-kohm = <100>;
	qcom,battery-beta = <3380>;
	qcom,battery-type = "d5_cos";
	qcom,checksum = <0x5B7D>;
	qcom,gui-version = "PMI8998GUI - 2.0.0.58";
	qcom,fg-profile-data = [
			80 1F 9B 05
			7F 0A 89 FC
			69 1D 47 EC
			F8 0B 8B 14
			95 19 17 22
			FE 3C E7 4A
			57 00 00 00
			17 00 00 00
			00 00 E8 C4
			AC C5 06 BB
			1F 00 08 00
			1C DA 06 E5
			BD F5 22 E3
			A7 F2 E9 03
			0C 04 38 1D
			19 06 09 20
			27 00 14 00
			14 1E 37 F5
			95 02 7F F5
			EF 1C 5A 02
			4B 0D 98 0A
			1C 1A 71 1B
			B7 3D 06 4A
			70 00 00 00
			11 00 00 00
			00 00 A9 CC
			89 BB 9D BA
			1A 00 00 00
			73 EA 06 E5
			BA EC 2C 00
			5D FA 47 0A
			81 EA A4 1A
			A1 33 CC FF
			07 10 00 00
			34 0D 66 46
			1A 00 40 00
			49 01 0A FA
			FF 00 00 00
			00 00 00 00
			00 00 00 00
			00 00 00 00
			00 00 00 00
			00 00 00 00
			00 00 00 00
			00 00 00 00
			00 00 00 00
			00 00 00 00
			00 00 00 00
			00 00 00 00
			00 00 00 00
			00 00 00 00
			00 00 00 00
			00 00 00 00
			00 00 00 00
			00 00 00 00
			00 00 00 00
	];
};
