/* Copyright (c) 2013, The Linux Foundation. All rights reserved.
 *
 * This program is free software; you can redistribute it and/or modify
 * it under the terms of the GNU General Public License version 2 and
 * only version 2 as published by the Free Software Foundation.
 *
 * This program is distributed in the hope that it will be useful,
 * but WITHOUT ANY WARRANTY; without even the implied warranty of
 * MERCHANTABILITY or FITNESS FOR A PARTICULAR PURPOSE.  See the
 * GNU General Public License for more details.
 */

/*---------------------------------------------------------------------------
 * This file is autogenerated file using gcdb parser. Please do not edit it.
 * Update input XML file to add a new entry or update variable in this file
 * VERSION = "1.0"
 *---------------------------------------------------------------------------*/
&mdss_mdp {
	dsi_ft8613_csot_5p7_720p_video: qcom,mdss_dsi_ft8613_csot_5p7_720p_video {
		qcom,mdss-dsi-panel-name = "ft8613_csot_5p7_720p_video";
		qcom,mdss-dsi-panel-controller = <&mdss_dsi0>;
		qcom,mdss-dsi-panel-type = "dsi_video_mode";
		qcom,mdss-dsi-panel-destination = "display_1";
		qcom,mdss-dsi-panel-framerate = <60>;
		qcom,mdss-dsi-pan-fps-update = "dfps_immediate_porch_mode_vfp";
		qcom,min-refresh-rate = <48>;
		qcom,max-refresh-rate = <60>;
		qcom,mdss-dsi-virtual-channel-id = <0>;
		qcom,mdss-dsi-stream = <0>;
		qcom,mdss-dsi-panel-width = <720>;
		qcom,mdss-dsi-panel-height = <1440>;
		qcom,mdss-pan-physical-width-dimension = <65>;
		qcom,mdss-pan-physical-height-dimension = <129>;
		qcom,mdss-dsi-h-front-porch = <32>;
		qcom,mdss-dsi-h-back-porch = <32>;
		qcom,mdss-dsi-h-pulse-width = <2>;
		qcom,mdss-dsi-h-sync-skew = <0>;
		qcom,mdss-dsi-v-back-porch = <16>;
		qcom,mdss-dsi-v-front-porch = <16>;
		qcom,mdss-dsi-v-pulse-width = <2>;
		qcom,mdss-dsi-h-left-border = <0>;
		qcom,mdss-dsi-h-right-border = <0>;
		qcom,mdss-dsi-v-top-border = <0>;
		qcom,mdss-dsi-v-bottom-border = <0>;
		qcom,mdss-dsi-bpp = <24>;
		qcom,mdss-dsi-underflow-color = <0x00>;
		qcom,mdss-dsi-border-color = <0>;
		qcom,mdss-dsi-on-command = [
				39 01 00 00 00 00 02 00 00
				39 01 00 00 00 00 04 FF 87 16 01
				39 01 00 00 00 00 02 00 80
				39 01 00 00 00 00 03 FF 87 16
				39 01 00 00 00 00 02 00 00
				39 01 00 00 00 00 19 E1 00 06 18 2B 36 42 55 64 6B 74 7D 87 70 68 65 5E 50 45 37 2D 25 16 09 07
				39 01 00 00 00 00 02 00 00
				39 01 00 00 00 00 19 E2 00 06 18 2B 36 42 55 64 6B 74 7D 87 70 68 65 5E 50 45 37 2D 25 16 09 07
				39 01 00 00 00 00 02 00 81
				39 01 00 00 00 00 0D F3 40 89 C0 40 89 C0 40 81 C0 40 81 C0
				39 00 00 00 00 00 02 00 00
				39 00 00 00 00 00 05 2A 00 00 02 CF
				39 00 00 00 00 00 02 00 00
				39 00 00 00 00 00 05 2B 00 00 05 9F
				39 01 00 00 00 00 02 00 81
				39 01 00 00 00 00 0a CA b9 ff b9 ff b9 ff 00 00 00
				39 01 00 00 00 00 02 00 00
				39 01 00 00 00 00 02 C6 10
				39 01 00 00 00 00 02 00 00
				39 01 00 00 00 00 13 C7 a0 bb bc aa cd 9a bb 8c 88 88 78 66 56 55 55 55 55 55
				39 01 00 00 00 00 02 00 00
				39 01 00 00 00 00 02 C6 11
				39 01 00 00 00 00 02 00 00
				39 01 00 00 00 00 13 C7 a0 ab ac aa cc 9a ba 8b 88 88 78 66 66 66 66 55 55 55
				39 01 00 00 00 00 02 00 00
				39 01 00 00 00 00 02 C6 12
				39 01 00 00 00 00 02 00 00
				39 01 00 00 00 00 13 C7 a0 aa 9c 9b cc 99 ba 8a 88 88 78 66 66 66 66 66 66 55
				39 01 00 00 00 00 02 00 00
				39 01 00 00 00 00 02 C6 13
				39 01 00 00 00 00 02 00 00
				39 01 00 00 00 00 13 C7 90 9b 9c 9a bc 9a a9 8b 88 88 88 66 66 66 66 66 66 66
				39 01 00 00 00 00 02 00 00
				39 01 00 00 00 00 02 C6 14
				39 01 00 00 00 00 02 00 00
				39 01 00 00 00 00 13 C7 90 9a 9c 9a ca 99 a9 8b 88 88 88 77 67 66 66 66 66 66
				39 01 00 00 00 00 02 00 00
				39 01 00 00 00 00 02 C6 15
				39 01 00 00 00 00 02 00 00
				39 01 00 00 00 00 13 C7 90 9a 9b 9a c9 99 99 8a 88 88 88 77 77 77 67 66 66 66
				39 01 00 00 00 00 02 00 00
				39 01 00 00 00 00 02 C6 16
				39 01 00 00 00 00 02 00 00
				39 01 00 00 00 00 13 C7 90 9a 9a 8a c9 99 99 8a 88 88 88 77 77 77 77 67 66 66
				39 01 00 00 00 00 02 00 00
				39 01 00 00 00 00 02 C6 17
				39 01 00 00 00 00 02 00 00
				39 01 00 00 00 00 13 C7 90 99 9a 8a b9 99 99 89 88 88 88 77 77 77 77 77 77 66
				39 01 00 00 00 00 02 00 00
				39 01 00 00 00 00 02 C6 18
				39 01 00 00 00 00 02 00 00
				39 01 00 00 00 00 13 C7 80 9a 8a 99 a9 99 98 89 88 88 88 78 77 77 77 77 77 77
				39 01 00 00 00 00 02 00 00
				39 01 00 00 00 00 02 C6 19
				39 01 00 00 00 00 02 00 00
				39 01 00 00 00 00 13 C7 80 99 99 99 b8 89 89 89 88 88 88 88 78 77 77 77 77 77
				39 01 00 00 00 00 02 00 00
				39 01 00 00 00 00 02 C6 1a
				39 01 00 00 00 00 02 00 00
				39 01 00 00 00 00 13 C7 80 99 99 98 a8 89 89 89 88 88 88 88 88 78 77 77 77 77
				39 01 00 00 00 00 02 00 00
				39 01 00 00 00 00 02 C6 1b
				39 01 00 00 00 00 02 00 00
				39 01 00 00 00 00 13 C7 80 98 99 89 98 99 88 89 88 88 88 88 88 88 78 77 77 77
				39 01 00 00 00 00 02 00 00
				39 01 00 00 00 00 02 C6 1c
				39 01 00 00 00 00 02 00 00
				39 01 00 00 00 00 13 C7 80 98 98 89 98 89 98 88 88 88 88 88 88 88 88 78 77 77
				39 01 00 00 00 00 02 00 00
				39 01 00 00 00 00 02 C6 1d
				39 01 00 00 00 00 02 00 00
				39 01 00 00 00 00 13 C7 80 88 89 89 98 79 89 88 88 88 88 88 88 88 88 88 78 77
				39 01 00 00 00 00 02 00 00
				39 01 00 00 00 00 02 C6 1e
				39 01 00 00 00 00 02 00 00
				39 01 00 00 00 00 13 C7 80 88 98 88 98 88 89 88 88 88 88 88 88 88 88 88 88 77
				39 01 00 00 00 00 02 00 00
				39 01 00 00 00 00 02 C6 1f
				39 01 00 00 00 00 02 00 00
				39 01 00 00 00 00 13 C7 80 88 88 88 88 89 88 88 88 88 88 88 88 88 88 88 88 88
				39 01 00 00 00 00 02 00 00
				39 01 00 00 00 00 02 C6 00
				39 00 00 00 00 00 02 51 FF
				39 00 00 00 00 00 02 53 24
				39 01 00 00 00 00 02 55 00
				39 01 00 00 78 00 02 11 00
				39 01 00 00 02 00 02 29 00
				39 01 00 00 00 00 02 00 00
				39 01 00 00 00 00 03 99 00 00
		];
		qcom,mdss-dsi-off-command = [
				39 01 00 00 00 00 02 00 00
				39 01 00 00 00 00 03 99 95 27
				05 01 00 00 14 00 02 28 00
				05 01 00 00 78 00 02 10 00
				39 01 00 00 00 00 02 00 00
				39 01 00 00 00 00 05 F7 5A A5 87 16
				39 01 00 00 00 00 02 00 00
				39 01 00 00 00 00 03 99 00 00
		];
		qcom,mdss-dsi-on-command-state = "dsi_lp_mode";
		qcom,mdss-dsi-off-command-state = "dsi_lp_mode";

		qcom,mdss-dsi-panel-cabc-off-command = [
				39 01 00 00 00 00 02 00 00
				39 01 00 00 00 00 03 99 95 27
				39 01 00 00 00 00 02 55 00
				39 01 00 00 00 00 02 00 00
				39 01 00 00 00 00 03 99 00 00
		];
		qcom,mdss-dsi-panel-cabc-on-command = [
				39 01 00 00 00 00 02 00 00
				39 01 00 00 00 00 03 99 95 27
				39 01 00 00 00 00 02 55 01
				39 01 00 00 00 00 02 00 00
				39 01 00 00 00 00 03 99 00 00
		];
		qcom,mdss-dsi-panel-cabc-command-state = "dsi_hs_mode";
		qcom,mdss-dsi-h-sync-pulse = <1>;
		qcom,mdss-dsi-traffic-mode = "burst_mode";
		qcom,mdss-dsi-bllp-eof-power-mode;
		qcom,mdss-dsi-bllp-power-mode;
		qcom,mdss-dsi-lane-0-state;
		qcom,mdss-dsi-lane-1-state;
		qcom,mdss-dsi-lane-2-state;
		qcom,mdss-dsi-lane-3-state;

		qcom,mdss-dsi-panel-timings = [8B 1E 14 00 44 48 18 30 19 03 04 00];
		qcom,mdss-dsi-panel-timings-phy-v2 = [1E 1B 04 06 02 03 04 A0
				1E 1B 04 06 02 03 04 A0
				1E 1B 04 06 02 03 04 A0
				1E 1B 04 06 02 03 04 A0
				1E 0E 03 05 02 03 04 A0];
		qcom,mdss-dsi-t-clk-post = <0x04>;
		qcom,mdss-dsi-t-clk-pre = <0x1D>;
		qcom,mdss-dsi-bl-min-level = <8>;
		qcom,mdss-dsi-bl-max-level = <4095>;
		qcom,mdss-brightness-max-level = <4095>;
		qcom,mdss-dsi-dma-trigger = "trigger_sw";
		qcom,mdss-dsi-mdp-trigger = "none";
		qcom,mdss-dsi-bl-pmic-control-type = "bl_ctrl_wled";
		qcom,mdss-dsi-lp11-init;
		qcom,mdss-dsi-init-delay-us = <5000>;
		qcom,mdss-dsi-reset-sequence = <1 10>, <0 5>, <1 30>;

		qcom,esd-check-enabled;
		qcom,mdss-dsi-panel-status-command = [06 01 00 01 05 00 02 AC 00
				06 01 00 01 05 00 02 0A 9C];
		qcom,mdss-dsi-panel-status-command-num = <2>;
		qcom,mdss-dsi-panel-status-command-state = "dsi_hs_mode";
		qcom,mdss-dsi-panel-status-check-mode = "reg_read";
		qcom,mdss-dsi-panel-status-valid-params = <1 1>;
		qcom,mdss-dsi-panel-status-value = <0x00>,<0x9C>;
		qcom,mdss-dsi-panel-status-read-length = <1 1>;
	};
};
