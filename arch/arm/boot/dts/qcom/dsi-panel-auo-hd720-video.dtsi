/* Copyright (c) 2015, The Linux Foundation. All rights reserved.
 * Copyright (C) 2019 XiaoMi, Inc.
 *
 * This program is free software; you can redistribute it and/or modify
 * it under the terms of the GNU General Public License version 2 and
 * only version 2 as published by the Free Software Foundation.
 *
 * This program is distributed in the hope that it will be useful,
 * but WITHOUT ANY WARRANTY; without even the implied warranty of
 * MERCHANTABILITY or FITNESS FOR A PARTICULAR PURPOSE.  See the
 * GNU General Public License for more details.
 */

&mdss_mdp {
	dsi_auo_hd720_vid: qcom,mdss_dsi_auo_hd720_video {
		qcom,mdss-dsi-panel-name = "auo ili7807d hd720 video mode dsi panel";
		qcom,mdss-dsi-panel-type = "dsi_video_mode";
		qcom,mdss-dsi-panel-controller = <&mdss_dsi0>;
		qcom,mdss-dsi-panel-framerate = <60>;
		qcom,mdss-dsi-virtual-channel-id = <0>;
		qcom,mdss-dsi-stream = <0>;
		qcom,mdss-dsi-panel-width = <720>;
		qcom,mdss-dsi-panel-height = <1440>;
		qcom,mdss-dsi-h-front-porch = <60>;
		qcom,mdss-dsi-h-back-porch = <344>;
		qcom,mdss-dsi-h-pulse-width = <8>;
		qcom,mdss-dsi-h-sync-skew = <0>;
		qcom,mdss-dsi-v-back-porch = <14>;
		qcom,mdss-dsi-v-front-porch = <12>;
		qcom,mdss-dsi-v-pulse-width = <2>;
		qcom,mdss-dsi-h-left-border = <0>;
		qcom,mdss-dsi-h-right-border = <0>;
		qcom,mdss-dsi-v-top-border = <0>;
		qcom,mdss-dsi-v-bottom-border = <0>;
		qcom,mdss-dsi-bpp = <24>;
		qcom,mdss-dsi-underflow-color = <0xff>;
		qcom,mdss-dsi-border-color = <0>;
		qcom,mdss-dsi-h-sync-pulse = <0>;
		qcom,mdss-pan-physical-width-dimension = <68>;
		qcom,mdss-pan-physical-height-dimension = <136>;
		qcom,mdss-dsi-traffic-mode = "burst_mode";
		qcom,mdss-dsi-bllp-eof-power-mode;
		qcom,mdss-dsi-bllp-power-mode;
		qcom,mdss-dsi-lane-0-state;
		qcom,mdss-dsi-lane-1-state;
		qcom,mdss-dsi-lane-2-state;
		qcom,mdss-dsi-lane-3-state;
		qcom,mdss-dsi-panel-timings = [79 1A 12 00 3E 42 16 1E 15 03
			04 00];
		qcom,mdss-dsi-t-clk-post = <0x0b>;
		qcom,mdss-dsi-t-clk-pre = <0x24>;
		qcom,mdss-dsi-bl-min-level = <1>;
		qcom,mdss-dsi-bl-max-level = <4095>;
		qcom,mdss-brightness-max-level = <4095>;
		qcom,mdss-dsi-dma-trigger = "trigger_sw";
		qcom,mdss-dsi-mdp-trigger = "none";
		qcom,mdss-dsi-on-command = [
				39 01 00 00 00 00 04 ff 78 07 05
				15 00 00 00 00 00 02 00 15
				15 00 00 00 00 00 02 01 15
				15 00 00 00 00 00 02 02 15
				15 00 00 00 00 00 02 03 50
				15 00 00 00 00 00 02 04 02
				15 00 00 00 00 00 02 10 0e
				15 00 00 00 00 00 02 11 F7
				15 00 00 00 00 00 02 14 06
				15 00 00 00 00 00 02 16 17
				15 00 00 00 00 00 02 18 17
				15 00 00 00 00 00 02 1e 02
				15 00 00 00 00 00 02 20 17
				15 00 00 00 00 00 02 22 17
				39 01 00 00 00 00 04 FF 78 07 00
				39 01 00 00 00 00 03 51 0F FF
				15 01 00 00 00 00 02 53 2C
				15 01 00 00 00 00 02 55 00
				05 01 00 00 78 00 02 11 00
				05 01 00 00 0a 00 02 29 00
				05 01 00 00 00 00 02 35 00];
		qcom,mdss-dsi-off-command = [
				39 01 00 00 00 00 04 FF 78 07 00
				05 01 00 00 0a 00 02 28 00
				05 01 00 00 78 00 02 10 00];
		qcom,mdss-dsi-ce-on-command = [
				39 00 00 00 00 00 04 FF 78 07 05
				15 00 00 00 00 00 02 30 06
				15 00 00 00 00 00 02 31 10
				15 00 00 00 00 00 02 38 07
				15 00 00 00 00 00 02 39 09
				15 00 00 00 00 00 02 3A 0C
				15 00 00 00 00 00 02 40 02
				15 00 00 00 00 00 02 41 02
				15 00 00 00 00 00 02 42 02
				15 00 00 00 00 00 02 43 02
				15 00 00 00 00 00 02 44 02
				15 00 00 00 00 00 02 45 02
				15 00 00 00 00 00 02 46 02
				15 00 00 00 00 00 02 47 02
				15 00 00 00 00 00 02 48 02
				15 00 00 00 00 00 02 49 02
				15 00 00 00 00 00 02 4A 02
				15 00 00 00 00 00 02 4B 02
				15 00 00 00 00 00 02 4C 02
				15 00 00 00 00 00 02 4D 02
				15 00 00 00 00 00 02 4E 02
				15 00 00 00 00 00 02 4F 02
				15 00 00 00 00 00 02 50 02
				15 00 00 00 00 00 02 51 02
				15 00 00 00 00 00 02 52 02
				15 00 00 00 00 00 02 53 02
				15 00 00 00 00 00 02 54 02
				15 00 00 00 00 00 02 55 02
				15 00 00 00 00 00 02 56 02
				15 00 00 00 00 00 02 57 02
				15 00 00 00 00 00 02 33 03
				15 00 00 00 00 00 02 80 13
				15 00 00 00 00 00 02 81 5B
				39 01 00 00 00 00 04 FF 78 07 00];
		qcom,mdss-dsi-ce-off-command = [
				39 00 00 00 00 00 04 FF 78 07 05
				15 00 00 00 00 00 02 31 00
				39 01 00 00 00 00 04 FF 78 07 00
		];
		qcom,mdss-dsi-cabc-on-command = [
				39 01 00 00 00 00 04 ff 78 07 00
				15 00 00 00 00 00 02 55 01
				39 01 00 00 00 00 04 ff 78 07 00
		];
		qcom,mdss-dsi-cabc-off-command = [
				39 00 00 00 00 00 04 FF 78 07 00
				15 01 00 00 00 00 02 55 00
		];
		qcom,mdss-dsi-gamma-on-command = [
				39 00 00 00 00 00 04 ff 78 07 00
				15 01 00 00 00 00 02 11 00
		];
		qcom,mdss-dsi-gamma-off-command = [
				39 00 00 00 00 00 04 FF 78 07 02
				15 00 00 00 00 00 02 00 01
				15 00 00 00 00 00 02 01 08
				15 00 00 00 00 00 02 02 01
				15 00 00 00 00 00 02 03 0E
				15 00 00 00 00 00 02 04 01
				15 00 00 00 00 00 02 05 1B
				15 00 00 00 00 00 02 06 01
				15 00 00 00 00 00 02 07 26
				15 00 00 00 00 00 02 08 01
				15 00 00 00 00 00 02 09 30
				15 00 00 00 00 00 02 0A 01
				15 00 00 00 00 00 02 0B 3A
				15 00 00 00 00 00 02 0C 01
				15 00 00 00 00 00 02 0D 43
				15 00 00 00 00 00 02 0E 01
				15 00 00 00 00 00 02 0F 4C
				15 00 00 00 00 00 02 10 01
				15 00 00 00 00 00 02 11 54
				15 00 00 00 00 00 02 12 01
				15 00 00 00 00 00 02 13 71
				15 00 00 00 00 00 02 14 01
				15 00 00 00 00 00 02 15 89
				15 00 00 00 00 00 02 16 01
				15 00 00 00 00 00 02 17 B0
				15 00 00 00 00 00 02 18 01
				15 00 00 00 00 00 02 19 CF
				15 00 00 00 00 00 02 1A 02
				15 00 00 00 00 00 02 1B 01
				15 00 00 00 00 00 02 1C 02
				15 00 00 00 00 00 02 1D 29
				15 00 00 00 00 00 02 1E 02
				15 00 00 00 00 00 02 1F 2B
				15 00 00 00 00 00 02 20 02
				15 00 00 00 00 00 02 21 52
				15 00 00 00 00 00 02 22 02
				15 00 00 00 00 00 02 23 81
				15 00 00 00 00 00 02 24 02
				15 00 00 00 00 00 02 25 A2
				15 00 00 00 00 00 02 26 02
				15 00 00 00 00 00 02 27 CF
				15 00 00 00 00 00 02 28 02
				15 00 00 00 00 00 02 29 EF
				15 00 00 00 00 00 02 2A 03
				15 00 00 00 00 00 02 2B 1A
				15 00 00 00 00 00 02 2C 03
				15 00 00 00 00 00 02 2D 26
				15 00 00 00 00 00 02 2E 03
				15 00 00 00 00 00 02 2F 35
				15 00 00 00 00 00 02 30 03
				15 00 00 00 00 00 02 31 45
				15 00 00 00 00 00 02 32 03
				15 00 00 00 00 00 02 33 56
				15 00 00 00 00 00 02 34 03
				15 00 00 00 00 00 02 35 6A
				15 00 00 00 00 00 02 36 03
				15 00 00 00 00 00 02 37 83
				15 00 00 00 00 00 02 38 03
				15 00 00 00 00 00 02 39 C0
				15 00 00 00 00 00 02 3A 03
				15 00 00 00 00 00 02 3B E6
				15 01 00 00 00 00 02 3C 01
				15 00 00 00 00 00 02 3D 08
				15 00 00 00 00 00 02 3E 01
				15 00 00 00 00 00 02 3F 0E
				15 00 00 00 00 00 02 40 01
				15 00 00 00 00 00 02 41 1B
				15 00 00 00 00 00 02 42 01
				15 00 00 00 00 00 02 43 26
				15 00 00 00 00 00 02 44 01
				15 00 00 00 00 00 02 45 30
				15 00 00 00 00 00 02 46 01
				15 00 00 00 00 00 02 47 3A
				15 00 00 00 00 00 02 48 01
				15 00 00 00 00 00 02 49 43
				15 00 00 00 00 00 02 4A 01
				15 00 00 00 00 00 02 4B 4C
				15 00 00 00 00 00 02 4C 01
				15 00 00 00 00 00 02 4D 54
				15 00 00 00 00 00 02 4E 01
				15 00 00 00 00 00 02 4F 71
				15 00 00 00 00 00 02 50 01
				15 00 00 00 00 00 02 51 89
				15 00 00 00 00 00 02 52 01
				15 00 00 00 00 00 02 53 B0
				15 00 00 00 00 00 02 54 01
				15 00 00 00 00 00 02 55 CF
				15 00 00 00 00 00 02 56 02
				15 00 00 00 00 00 02 57 01
				15 00 00 00 00 00 02 58 02
				15 00 00 00 00 00 02 59 29
				15 00 00 00 00 00 02 5A 02
				15 00 00 00 00 00 02 5B 2B
				15 00 00 00 00 00 02 5C 02
				15 00 00 00 00 00 02 5D 52
				15 00 00 00 00 00 02 5E 02
				15 00 00 00 00 00 02 5F 81
				15 00 00 00 00 00 02 60 02
				15 00 00 00 00 00 02 61 A2
				15 00 00 00 00 00 02 62 02
				15 00 00 00 00 00 02 63 CF
				15 00 00 00 00 00 02 64 02
				15 00 00 00 00 00 02 65 EF
				15 00 00 00 00 00 02 66 03
				15 00 00 00 00 00 02 67 1A
				15 00 00 00 00 00 02 68 03
				15 00 00 00 00 00 02 69 26
				15 00 00 00 00 00 02 6A 03
				15 00 00 00 00 00 02 6B 35
				15 00 00 00 00 00 02 6C 03
				15 00 00 00 00 00 02 6D 45
				15 00 00 00 00 00 02 6E 03
				15 00 00 00 00 00 02 6F 56
				15 00 00 00 00 00 02 70 03
				15 00 00 00 00 00 02 71 6A
				15 00 00 00 00 00 02 72 03
				15 00 00 00 00 00 02 73 83
				15 00 00 00 00 00 02 74 03
				15 00 00 00 00 00 02 75 C0
				15 00 00 00 00 00 02 76 03
				15 00 00 00 00 00 02 77 E6
				15 00 00 00 00 00 02 78 01
				15 01 00 00 00 00 02 79 01
				39 00 00 00 00 00 04 FF 78 07 03
				15 00 00 00 00 00 02 00 01
				15 00 00 00 00 00 02 01 39
				15 00 00 00 00 00 02 02 01
				15 00 00 00 00 00 02 03 3D
				15 00 00 00 00 00 02 04 01
				15 00 00 00 00 00 02 05 46
				15 00 00 00 00 00 02 06 01
				15 00 00 00 00 00 02 07 4E
				15 00 00 00 00 00 02 08 01
				15 00 00 00 00 00 02 09 56
				15 00 00 00 00 00 02 0A 01
				15 00 00 00 00 00 02 0B 5E
				15 00 00 00 00 00 02 0C 01
				15 00 00 00 00 00 02 0D 65
				15 00 00 00 00 00 02 0E 01
				15 00 00 00 00 00 02 0F 6C
				15 00 00 00 00 00 02 10 01
				15 00 00 00 00 00 02 11 72
				15 00 00 00 00 00 02 12 01
				15 00 00 00 00 00 02 13 89
				15 00 00 00 00 00 02 14 01
				15 00 00 00 00 00 02 15 9E
				15 00 00 00 00 00 02 16 01
				15 00 00 00 00 00 02 17 C0
				15 00 00 00 00 00 02 18 01
				15 00 00 00 00 00 02 19 DC
				15 00 00 00 00 00 02 1A 02
				15 00 00 00 00 00 02 1B 0A
				15 00 00 00 00 00 02 1C 02
				15 00 00 00 00 00 02 1D 31
				15 00 00 00 00 00 02 1E 02
				15 00 00 00 00 00 02 1F 32
				15 00 00 00 00 00 02 20 02
				15 00 00 00 00 00 02 21 58
				15 00 00 00 00 00 02 22 02
				15 00 00 00 00 00 02 23 87
				15 00 00 00 00 00 02 24 02
				15 00 00 00 00 00 02 25 A8
				15 00 00 00 00 00 02 26 02
				15 00 00 00 00 00 02 27 D6
				15 00 00 00 00 00 02 28 02
				15 00 00 00 00 00 02 29 F6
				15 00 00 00 00 00 02 2A 03
				15 00 00 00 00 00 02 2B 21
				15 00 00 00 00 00 02 2C 03
				15 00 00 00 00 00 02 2D 2E
				15 00 00 00 00 00 02 2E 03
				15 00 00 00 00 00 02 2F 3C
				15 00 00 00 00 00 02 30 03
				15 00 00 00 00 00 02 31 4C
				15 00 00 00 00 00 02 32 03
				15 00 00 00 00 00 02 33 5E
				15 00 00 00 00 00 02 34 03
				15 00 00 00 00 00 02 35 73
				15 00 00 00 00 00 02 36 03
				15 00 00 00 00 00 02 37 8C
				15 00 00 00 00 00 02 38 03
				15 00 00 00 00 00 02 39 AD
				15 00 00 00 00 00 02 3A 03
				15 00 00 00 00 00 02 3B E6
				15 01 00 00 00 00 02 3C 01
				15 00 00 00 00 00 02 3D 39
				15 00 00 00 00 00 02 3E 01
				15 00 00 00 00 00 02 3F 3D
				15 00 00 00 00 00 02 40 01
				15 00 00 00 00 00 02 41 46
				15 00 00 00 00 00 02 42 01
				15 00 00 00 00 00 02 43 4E
				15 00 00 00 00 00 02 44 01
				15 00 00 00 00 00 02 45 56
				15 00 00 00 00 00 02 46 01
				15 00 00 00 00 00 02 47 5E
				15 00 00 00 00 00 02 48 01
				15 00 00 00 00 00 02 49 65
				15 00 00 00 00 00 02 4A 01
				15 00 00 00 00 00 02 4B 6C
				15 00 00 00 00 00 02 4C 01
				15 00 00 00 00 00 02 4D 72
				15 00 00 00 00 00 02 4E 01
				15 00 00 00 00 00 02 4F 89
				15 00 00 00 00 00 02 50 01
				15 00 00 00 00 00 02 51 9E
				15 00 00 00 00 00 02 52 01
				15 00 00 00 00 00 02 53 C0
				15 00 00 00 00 00 02 54 01
				15 00 00 00 00 00 02 55 DC
				15 00 00 00 00 00 02 56 02
				15 00 00 00 00 00 02 57 0A
				15 00 00 00 00 00 02 58 02
				15 00 00 00 00 00 02 59 31
				15 00 00 00 00 00 02 5A 02
				15 00 00 00 00 00 02 5B 32
				15 00 00 00 00 00 02 5C 02
				15 00 00 00 00 00 02 5D 58
				15 00 00 00 00 00 02 5E 02
				15 00 00 00 00 00 02 5F 87
				15 00 00 00 00 00 02 60 02
				15 00 00 00 00 00 02 61 A8
				15 00 00 00 00 00 02 62 02
				15 00 00 00 00 00 02 63 D6
				15 00 00 00 00 00 02 64 02
				15 00 00 00 00 00 02 65 F6
				15 00 00 00 00 00 02 66 03
				15 00 00 00 00 00 02 67 21
				15 00 00 00 00 00 02 68 03
				15 00 00 00 00 00 02 69 2E
				15 00 00 00 00 00 02 6A 03
				15 00 00 00 00 00 02 6B 3C
				15 00 00 00 00 00 02 6C 03
				15 00 00 00 00 00 02 6D 4C
				15 00 00 00 00 00 02 6E 03
				15 00 00 00 00 00 02 6F 5E
				15 00 00 00 00 00 02 70 03
				15 00 00 00 00 00 02 71 73
				15 00 00 00 00 00 02 72 03
				15 00 00 00 00 00 02 73 8C
				15 00 00 00 00 00 02 74 03
				15 00 00 00 00 00 02 75 AD
				15 00 00 00 00 00 02 76 03
				15 00 00 00 00 00 02 77 E6
				15 00 00 00 00 00 02 78 01
				15 01 00 00 00 00 02 79 01
				39 00 00 00 00 00 04 FF 78 07 04
				15 00 00 00 00 00 02 00 00
				15 00 00 00 00 00 02 01 8C
				15 00 00 00 00 00 02 02 00
				15 00 00 00 00 00 02 03 9E
				15 00 00 00 00 00 02 04 00
				15 00 00 00 00 00 02 05 BD
				15 00 00 00 00 00 02 06 00
				15 00 00 00 00 00 02 07 D5
				15 00 00 00 00 00 02 08 00
				15 00 00 00 00 00 02 09 EA
				15 00 00 00 00 00 02 0A 00
				15 00 00 00 00 00 02 0B FB
				15 00 00 00 00 00 02 0C 01
				15 00 00 00 00 00 02 0D 0B
				15 00 00 00 00 00 02 0E 01
				15 00 00 00 00 00 02 0F 19
				15 00 00 00 00 00 02 10 01
				15 00 00 00 00 00 02 11 25
				15 00 00 00 00 00 02 12 01
				15 00 00 00 00 00 02 13 4E
				15 00 00 00 00 00 02 14 01
				15 00 00 00 00 00 02 15 6E
				15 00 00 00 00 00 02 16 01
				15 00 00 00 00 00 02 17 9F
				15 00 00 00 00 00 02 18 01
				15 00 00 00 00 00 02 19 C3
				15 00 00 00 00 00 02 1A 01
				15 00 00 00 00 00 02 1B FA
				15 00 00 00 00 00 02 1C 02
				15 00 00 00 00 00 02 1D 25
				15 00 00 00 00 00 02 1E 02
				15 00 00 00 00 00 02 1F 26
				15 00 00 00 00 00 02 20 02
				15 00 00 00 00 00 02 21 4F
				15 00 00 00 00 00 02 22 02
				15 00 00 00 00 00 02 23 7F
				15 00 00 00 00 00 02 24 02
				15 00 00 00 00 00 02 25 9F
				15 00 00 00 00 00 02 26 02
				15 00 00 00 00 00 02 27 CD
				15 00 00 00 00 00 02 28 02
				15 00 00 00 00 00 02 29 EE
				15 00 00 00 00 00 02 2A 03
				15 00 00 00 00 00 02 2B 1A
				15 00 00 00 00 00 02 2C 03
				15 00 00 00 00 00 02 2D 27
				15 00 00 00 00 00 02 2E 03
				15 00 00 00 00 00 02 2F 36
				15 00 00 00 00 00 02 30 03
				15 00 00 00 00 00 02 31 47
				15 00 00 00 00 00 02 32 03
				15 00 00 00 00 00 02 33 5A
				15 00 00 00 00 00 02 34 03
				15 00 00 00 00 00 02 35 70
				15 00 00 00 00 00 02 36 03
				15 00 00 00 00 00 02 37 8B
				15 00 00 00 00 00 02 38 03
				15 00 00 00 00 00 02 39 AF
				15 00 00 00 00 00 02 3A 03
				15 00 00 00 00 00 02 3B E6
				15 01 00 00 00 00 02 3C 00
				15 00 00 00 00 00 02 3D 8C
				15 00 00 00 00 00 02 3E 00
				15 00 00 00 00 00 02 3F 9E
				15 00 00 00 00 00 02 40 00
				15 00 00 00 00 00 02 41 BD
				15 00 00 00 00 00 02 42 00
				15 00 00 00 00 00 02 43 D5
				15 00 00 00 00 00 02 44 00
				15 00 00 00 00 00 02 45 EA
				15 00 00 00 00 00 02 46 00
				15 00 00 00 00 00 02 47 FB
				15 00 00 00 00 00 02 48 01
				15 00 00 00 00 00 02 49 0B
				15 00 00 00 00 00 02 4A 01
				15 00 00 00 00 00 02 4B 19
				15 00 00 00 00 00 02 4C 01
				15 00 00 00 00 00 02 4D 25
				15 00 00 00 00 00 02 4E 01
				15 00 00 00 00 00 02 4F 4E
				15 00 00 00 00 00 02 50 01
				15 00 00 00 00 00 02 51 6E
				15 00 00 00 00 00 02 52 01
				15 00 00 00 00 00 02 53 9F
				15 00 00 00 00 00 02 54 01
				15 00 00 00 00 00 02 55 C3
				15 00 00 00 00 00 02 56 01
				15 00 00 00 00 00 02 57 FA
				15 00 00 00 00 00 02 58 02
				15 00 00 00 00 00 02 59 25
				15 00 00 00 00 00 02 5A 02
				15 00 00 00 00 00 02 5B 26
				15 00 00 00 00 00 02 5C 02
				15 00 00 00 00 00 02 5D 4F
				15 00 00 00 00 00 02 5E 02
				15 00 00 00 00 00 02 5F 7F
				15 00 00 00 00 00 02 60 02
				15 00 00 00 00 00 02 61 9F
				15 00 00 00 00 00 02 62 02
				15 00 00 00 00 00 02 63 CD
				15 00 00 00 00 00 02 64 02
				15 00 00 00 00 00 02 65 EE
				15 00 00 00 00 00 02 66 03
				15 00 00 00 00 00 02 67 1A
				15 00 00 00 00 00 02 68 03
				15 00 00 00 00 00 02 69 27
				15 00 00 00 00 00 02 6A 03
				15 00 00 00 00 00 02 6B 36
				15 00 00 00 00 00 02 6C 03
				15 00 00 00 00 00 02 6D 47
				15 00 00 00 00 00 02 6E 03
				15 00 00 00 00 00 02 6F 5A
				15 00 00 00 00 00 02 70 03
				15 00 00 00 00 00 02 71 70
				15 00 00 00 00 00 02 72 03
				15 00 00 00 00 00 02 73 8B
				15 00 00 00 00 00 02 74 03
				15 00 00 00 00 00 02 75 AF
				15 00 00 00 00 00 02 76 03
				15 00 00 00 00 00 02 77 E6
				15 00 00 00 00 00 02 78 01
				15 00 00 00 00 00 02 79 01
				39 01 00 00 00 00 04 FF 78 07 00
		];
		qcom,mdss-dsi-ce-on-command-state = "dsi_hs_mode";
		qcom,mdss-dsi-ce-off-command-state = "dsi_hs_mode";
		qcom,mdss-dsi-cabc-on-command-state = "dsi_hs_mode";
		qcom,mdss-dsi-cabc-off-command-state = "dsi_hs_mode";
		qcom,mdss-dsi-on-command-state = "dsi_lp_mode";
		qcom,mdss-dsi-off-command-state = "dsi_lp_mode";
		qcom,mdss-dsi-gamma-command-state = "dsi_hs_mode";
		qcom,mdss-dsi-bl-pmic-control-type = "bl_ctrl_wled";
		qcom,mdss-dsi-reset-sequence = <1 10>, <0 10>, <1 10>;
		qcom,mdss-dsi-tx-eot-append;
		qcom,mdss-dsi-lp11-init;
		qcom,mdss-dsi-post-init-delay = <1>;

		qcom,mdss-dsi-hbp-power-mode;
		qcom,esd-check-enabled;
		qcom,mdss-dsi-panel-status-command = [06 01 00 01 05 00 01 0A];
		qcom,mdss-dsi-panel-status-command-state = "dsi_lp_mode";
		qcom,mdss-dsi-panel-status-check-mode = "reg_read";
		qcom,mdss-dsi-panel-status-read-length = <1>;
		qcom,mdss-dsi-panel-status-value = <0x9c>;
	};
};
