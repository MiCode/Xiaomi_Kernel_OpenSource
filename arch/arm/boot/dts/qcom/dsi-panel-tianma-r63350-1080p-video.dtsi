/* Copyright (c) 2015, The Linux Foundation. All rights reserved.
 * Copyright (C) 2017 XiaoMi, Inc.
 *
 * This program is free software; you can redistribute it and/or modify
 * it under the terms of the GNU General Public License version 2 and
 * only version 2 as published by the Free Software Foundation.
 *
 * This program is distributed in the hope that it will be useful,
 * but WITHOUT ANY WARRANTY; without even the implied warranty of
 * MERCHANTABILITY or FITNESS FOR A PARTICULAR PURPOSE.  See the
 * GNU General Public License for more details.
 */
&mdss_mdp {
	dsi_tianma_r63350_1080p_vid: qcom,mdss_dsi_tianma_r63350_1080p_video {
		qcom,mdss-dsi-panel-name = "tianma r63350 1080p video mode dsi panel";
		qcom,mdss-dsi-panel-type = "dsi_video_mode";
		qcom,mdss-dsi-panel-id = <4>;
		qcom,mdss-dsi-panel-framerate = <60>;
		qcom,mdss-dsi-virtual-channel-id = <0>;
		qcom,mdss-dsi-stream = <0>;
		qcom,mdss-dsi-panel-width = <1080>;
		qcom,mdss-dsi-panel-height = <1920>;
		qcom,mdss-dsi-h-front-porch = <150>;
		qcom,mdss-dsi-h-back-porch = <40>;
		qcom,mdss-dsi-h-pulse-width = <10>;
		qcom,mdss-dsi-h-sync-skew = <0>;
		qcom,mdss-dsi-v-back-porch = <21>;
		qcom,mdss-dsi-v-front-porch = <24>;
		qcom,mdss-dsi-v-pulse-width = <2>;
		qcom,mdss-dsi-h-left-border = <0>;
		qcom,mdss-dsi-h-right-border = <0>;
		qcom,mdss-dsi-v-top-border = <0>;
		qcom,mdss-dsi-v-bottom-border = <0>;
		qcom,mdss-dsi-bpp = <24>;
		qcom,mdss-dsi-underflow-color = <0x0>;
		qcom,mdss-dsi-border-color = <0>;
		qcom,mdss-dsi-h-sync-pulse = <0>;
		qcom,mdss-dsi-traffic-mode = "burst_mode";
		qcom,mdss-dsi-bllp-eof-power-mode;
		qcom,mdss-dsi-bllp-power-mode;
		qcom,mdss-dsi-lp11-init;
		qcom,mdss-dsi-lane-0-state;
		qcom,mdss-dsi-lane-1-state;
		qcom,mdss-dsi-lane-2-state;
		qcom,mdss-dsi-lane-3-state;
		qcom,mdss-dsi-panel-timings = [e3 50 36 00 a9 a3 3a 50 3d 03 04 00];
		qcom,mdss-dsi-t-clk-post = <0x0D>;
		qcom,mdss-dsi-t-clk-pre = <0x30>;
		qcom,mdss-dsi-bl-min-level = <1>;
		qcom,mdss-dsi-bl-max-level = <4095>;
		qcom,mdss-brightness-max-level = <4095>;
		qcom,mdss-dsi-dma-trigger = "trigger_sw";
		qcom,mdss-dsi-mdp-trigger = "none";
		qcom,mdss-dsi-on-command = [
			29 00 00 00 00 00 02 B0 00
			29 00 00 00 00 00 02 D6 01
			29 00 00 00 00 00 09 C2 31 F7 80 17 18 00 00 08
			29 00 00 00 00 00 1B D3 1B 33 99 BB B3 33 33 33 11 00 01 00 00 D8 A0 05 3F 3F 33 33 72 12 8A 57 3D BC
			29 00 00 00 00 00 1F C7 00 12 1A 25 33 42 4C 5C 42 4A 55 5F 69 6F 75 00 12 1A 25 33 42 4C 5C 42 4A 55 5F 69 6F 75
			29 00 00 00 00 00 14 C8 01 00 FE 00 FE C8 00 00 02 00 00 FC 00 04 FE 04 0D ED 00
			29 01 00 00 00 00 02 B0 03
			39 00 00 00 00 00 02 51 FF
			39 00 00 00 00 00 02 53 24
			39 00 00 00 00 00 02 55 00
			05 01 00 00 14 00 02 29 00
			05 01 00 00 78 00 02 11 00];
		qcom,mdss-dsi-off-command = [
			05 01 00 00 14 00 02 28 00
			29 00 00 00 00 00 02 B0 00
			29 01 00 00 32 00 1B D3 13 33 99 B3 B3 33 33 33 11 00 01 00 00 D8 A0 05 3F 3F 33 33 72 12 8A 57 3D BC
			29 00 00 00 00 00 02 B0 03
			05 01 00 00 32 00 02 10 00];
		qcom,mdss-dsi-on-command-state = "dsi_hs_mode";
		qcom,mdss-dsi-off-command-state = "dsi_hs_mode";
		qcom,mdss-dsi-bl-pmic-control-type = "bl_ctrl_wled";
		qcom,mdss-dsi-reset-sequence = <0 5>, <1 10>;
		qcom,mdss-dsi-reset-off-delay = <1>;
		qcom,mdss-dsi-tx-eot-append;
		qcom,cont-splash-enabled;
		qcom,mdss-panel-on-dimming-delay = <120>;
		qcom,mdss-dsi-dispparam-dimmingon-command = [39 01 00 00 01 00 02 53 2C];
		qcom,panel-supply-entries = <&dsi_panel_pwr_supply>;
		qcom,mdss-pan-physical-width-dimension = <80>;
		qcom,mdss-pan-physical-height-dimension = <142>;
		qcom,mdss-night-brightness = <9 27 44 62>;
		qcom,mdss-dsi-min-refresh-rate = <55>;
		qcom,mdss-dsi-max-refresh-rate = <60>;
		qcom,mdss-dsi-pan-enable-dynamic-fps;
		qcom,mdss-dsi-pan-fps-update = "dfps_immediate_porch_mode_vfp";
		qcom,dispparam-enabled;
		qcom,mdss-dsi-dispparam-cabcon-command = [
			29 00 00 00 00 00 02 B0 04
			15 00 00 00 00 00 02 55 81
			29 00 00 00 00 00 08 B8 89 51 0D 00 02 00 00
			29 00 00 00 00 00 1A CE 55 40 4C 5A 69 77 84 93 A2 B1 C1 D1 E0 F0 F1 F2 FF 04 00 04 04 42 00 69 5A
			29 00 00 00 00 00 0A F9 66 3F E0 BE 00 8D BF 80 00
			29 01 00 00 00 00 02 B0 03
			];
		qcom,mdss-dsi-dispparam-cabcon-command-state = "dsi_hs_mode";
		qcom,mdss-dsi-dispparam-cabcguion-command = [
			29 00 00 00 00 00 02 B0 04
			15 00 00 00 00 00 02 55 81
			29 00 00 00 00 00 08 B8 89 51 0D 00 02 00 00
			29 00 00 00 00 00 1A CE 55 40 4C 5A 69 77 84 93 A2 B1 C1 D1 E0 F0 F1 F2 FF 04 00 04 04 42 00 69 5A
			29 00 00 00 00 00 0A F9 66 3F E0 BE 00 8D BF 80 00
			29 01 00 00 00 00 02 B0 03
			];
		qcom,mdss-dsi-dispparam-cabcguion-command-state = "dsi_hs_mode";
		qcom,mdss-dsi-dispparam-cabcstillon-command = [
			29 00 00 00 00 00 02 B0 04
			15 00 00 00 00 00 02 55 82
			29 00 00 00 00 00 08 B9 BB 3D 22 00 03 00 00
			29 00 00 00 00 00 1A CE 55 40 4C 5A 69 77 84 93 A2 B1 C1 D1 E0 F0 F1 F2 FF 04 00 04 04 42 00 69 5A
			29 00 00 00 00 00 0A F9 66 3F E0 BE 00 8D BF 80 00
			29 01 00 00 00 00 02 B0 03
			];
		qcom,mdss-dsi-dispparam-cabcstillon-command-state = "dsi_hs_mode";
		qcom,mdss-dsi-dispparam-cabcmovieon-command = [
			29 00 00 00 00 00 02 B0 04
			15 00 00 00 00 00 02 55 83
			29 00 00 00 00 00 08 BA FF 27 37 00 04 00 00
			29 00 00 00 00 00 1A CE 55 40 4C 5A 69 77 84 93 A2 B1 C1 D1 E0 F0 F1 F2 FF 04 00 04 04 42 00 69 5A
			29 00 00 00 00 00 0A F9 66 3F E0 BE 00 8D BF 80 00
			29 01 00 00 00 00 02 B0 03
			];
		qcom,mdss-dsi-dispparam-cabcmovieon-command-state = "dsi_hs_mode";
		qcom,mdss-dsi-dispparam-cabcoff-command = [
			39 01 00 00 01 00 02 55 00
			];
		qcom,mdss-dsi-dispparam-cabcoff-command-state = "dsi_hs_mode";
		qcom,mdss-dsi-dispparam-ceon-command = [
			29 00 00 00 00 00 02 B0 00
			29 00 00 00 00 00 2C CA 1D FC FC FC 00 D8 D8 A6 00 A6 D6 D6 00 82 00 00 00 9E 00 00 00 9C D0 AD 85 D0 AD 85 50 CD 3A 21 CD 3A 21 25 00 00 00 00 00 00 00
			29 01 00 00 00 00 02 B0 03
			];
		qcom,mdss-dsi-dispparam-ceon-command-state = "dsi_hs_mode";
		qcom,mdss-dsi-dispparam-ceoff-command = [
			29 00 00 00 00 00 02 B0 00
			29 00 00 00 00 00 2C CA 1C FC FC FC 00 D8 D8 A6 00 A6 D6 D6 00 82 00 00 00 9E 00 00 00 9C D0 AD 85 D0 AD 85 50 CD 3A 21 CD 3A 21 25 00 00 00 00 00 00 00
			29 01 00 00 00 00 02 B0 03
			];
		qcom,mdss-dsi-dispparam-ceoff-command-state = "dsi_hs_mode";
		qcom,mdss-dsi-dispparam-papermode1-command = [
			29 00 00 00 00 00 02 B0 00
			29 00 00 00 00 00 14 C8 01 00 13 04 F8 FC 00 00 11 05 FC D4 00 00 10 0A FC 79 00
			29 01 00 00 00 00 02 B0 03
			];
		qcom,mdss-dsi-dispparam-papermode1-command-state = "dsi_hs_mode";
		qcom,mdss-dsi-dispparam-papermode2-command = [
			29 00 00 00 00 00 02 B0 00
			29 00 00 00 00 00 14 C8 01 00 13 04 F8 FC 00 00 11 06 FC DD 00 00 10 09 FD 8E 00
			29 01 00 00 00 00 02 B0 03
			];
		qcom,mdss-dsi-dispparam-papermode2-command-state = "dsi_hs_mode";
		qcom,mdss-dsi-dispparam-papermode3-command = [
			29 00 00 00 00 00 02 B0 00
			29 00 00 00 00 00 14 C8 01 00 13 04 F8 FC 00 00 12 05 FC ED 00 00 12 09 FF A9 00
			29 01 00 00 00 00 02 B0 03
			];
		qcom,mdss-dsi-dispparam-papermode3-command-state = "dsi_hs_mode";
		qcom,mdss-dsi-dispparam-default-command = [
			29 00 00 00 00 00 02 B0 00
			29 00 00 00 00 00 14 C8 01 00 FE 00 FE C8 00 00 02 00 00 FC 00 04 FE 04 0D ED 00
			29 01 00 00 00 00 02 B0 03
			];
		qcom,mdss-dsi-dispparam-default-command-state = "dsi_hs_mode";
	};
};
