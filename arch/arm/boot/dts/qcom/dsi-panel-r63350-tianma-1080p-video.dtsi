/* Copyright (c) 2014, The Linux Foundation. All rights reserved.
 * Copyright (C) 2017 XiaoMi, Inc.
 *
 * This program is free software; you can redistribute it and/or modify
 * it under the terms of the GNU General Public License version 2 and
 * only version 2 as published by the Free Software Foundation.
 *
 * This program is distributed in the hope that it will be useful,
 * but WITHOUT ANY WARRANTY; without even the implied warranty of
 * MERCHANTABILITY or FITNESS FOR A PARTICULAR PURPOSE.  See the
 * GNU General Public License for more details.
 */

/*---------------------------------------------------------------------------
 * This file is autogenerated file using gcdb parser. Please do not edit it.
 * Update input XML file to add a new entry or update variable in this file
 * VERSION = "1.0"
 *---------------------------------------------------------------------------*/
&mdss_mdp {
	dsi_r63350_1080p_video: qcom,mdss_dsi_r63350_1080p_video {
		qcom,mdss-dsi-panel-name = "r63350_1080p_video_Tianma";
		qcom,mdss-dsi-panel-controller = <&mdss_dsi0>;
		qcom,mdss-dsi-panel-type = "dsi_video_mode";
		qcom,mdss-dsi-panel-destination = "display_1";
		qcom,mdss-dsi-panel-framerate = <60>;
		qcom,mdss-dsi-virtual-channel-id = <0>;
		qcom,mdss-dsi-stream = <0>;
		qcom,mdss-dsi-panel-width = <1080>;
		qcom,mdss-dsi-panel-height = <1920>;
		qcom,mdss-dsi-h-front-porch = <92>;
		qcom,mdss-dsi-h-back-porch = <50>;
		qcom,mdss-dsi-h-pulse-width = <12>;
		qcom,mdss-dsi-h-sync-skew = <0>;
		qcom,mdss-dsi-v-back-porch = <4>;
		qcom,mdss-dsi-v-front-porch = <4>;
		qcom,mdss-dsi-v-pulse-width = <2>;
		qcom,mdss-dsi-h-left-border = <0>;
		qcom,mdss-dsi-h-right-border = <0>;
		qcom,mdss-dsi-v-top-border = <0>;
		qcom,mdss-dsi-v-bottom-border = <0>;
		qcom,mdss-dsi-bpp = <24>;
		qcom,mdss-dsi-color-order = "rgb_swap_rgb";
		qcom,mdss-dsi-underflow-color = <0xff>;
		qcom,mdss-dsi-border-color = <0>;
		qcom,mdss-dsi-on-command = [29 01 00 00 00 00 02 B0 00
				29 01 00 00 00 00 02 D6 01
				29 01 00 00 00 00 1B D3 1B 33 BB BB B3 33 33 33 33 00 01 00 00 D8 A0 05 2F 2F 33 33 72 12 8A 57 3D BC
				05 01 00 00 10 00 02 29 00
				05 01 00 00 78 00 02 11 00];
		qcom,mdss-dsi-off-command = [29 01 00 00 00 00 02 B0 00
				05 01 00 00 10 00 02 28 00
				29 01 00 00 32 00 1B D3 13 33 BB B3 B3 33 33 33 33 00 01 00 00 D8 A0 05 2F 2F 33 33 72 12 8A 57 3D BC
				05 01 00 00 78 00 02 10 00
				29 01 00 00 00 00 02 B1 01];
		qcom,mdss-dsi-on-command-state = "dsi_lp_mode";
		qcom,mdss-dsi-off-command-state = "dsi_hs_mode";
		qcom,mdss-dsi-panel-warm-command = [29 01 00 00 00 00 02 B0 00
				29 01 00 00 00 00 02 D6 01
				29 01 00 00 00 00 1F C7 00 0B 13 1C 2B 3A 44 56 3C 45 51 5F 68 6E 72 00 0B 13 1C 2B 3A 44 56 3C 45 51 5F 68 6E 72
				29 01 00 00 00 00 14 C8 01 00 01 03 FC FC 00 00 FF 02 FD B9 00 00 FE 08 03 B7 00];
		qcom,mdss-dsi-panel-cool-command = [29 01 00 00 00 00 02 B0 00
				29 01 00 00 00 00 02 D6 01
				29 01 00 00 00 00 1F C7 00 0D 13 1d 2D 3C 46 58 3F 48 55 63 6B 70 72 00 0D 13 1d 2D 3C 46 58 3F 48 55 63 6B 70 72
				29 01 00 00 00 00 14 C8 01 00 03 01 FE DE 00 00 01 01 FC CF 00 00 02 05 09 FC 00];
		qcom,mdss-dsi-panel-nature-command = [29 01 00 00 00 00 02 B0 00
				29 01 00 00 00 00 02 D6 01
				29 01 00 00 00 00 1F C7 00 0D 13 1d 2D 3C 46 58 3F 48 55 63 6B 70 72 00 0D 13 1d 2D 3C 46 58 3F 48 55 63 6B 70 72
				29 01 00 00 00 00 14 C8 01 00 03 01 FE FC 00 00 01 FF FE FC 00 00 01 06 0B FC 00];
		qcom,mdss-dsi-panel-ce-std-command = [29 01 00 00 00 00 02 B0 00
				29 01 00 00 00 00 02 D6 01
				29 01 00 00 00 00 2C CA 1C FC FC FC 00 00 00 00 00 00 00 00 00 00 00 00 00 00 00 00 00 00 00 00 00 00 00 00 00 00 00 00 00 00 00 00 00 00 00 00 00 00 00];
		qcom,mdss-dsi-panel-ce-vivid-command = [29 00 00 00 00 00 02 B0 00
				29 00 00 00 00 00 02 D6 01
				29 01 00 00 00 00 2C CA 1D FC FC FC 00 D0 D0 90 00 90 90 90 00 00 00 00 00 00 00 00 00 00 00  00 00 00 00 00 00 00 00 00 00  00 00 00 00 00 00 00 00 00 00];
		qcom,mdss-dsi-panel-ce-bright-command = [29 00 00 00 00 00 02 B0 00
				29 00 00 00 00 00 02 D6 01
				29 01 00 00 00 00 2C CA 1D FC FC FC 40 C0 C0 7F 80 80 7F 80 80 00 00 00 00 00 00 00 00 00 00 00 00 00 00 00 00 00 00 00 00 00 00 00 00 00 00 00 00 00 00];
		qcom,mdss-dsi-panel-gamma-command-state = "dsi_lp_mode";
		qcom,mdss-dsi-panel-ce-command-state = "dsi_lp_mode";
		qcom,mdss-dsi-init-last;
		qcom,mdss-dsi-h-sync-pulse = <1>;
		qcom,mdss-dsi-traffic-mode = "burst_mode";
		qcom,mdss-dsi-lane-map = "lane_map_0123";
		qcom,mdss-dsi-bllp-eof-power-mode;
		qcom,mdss-dsi-bllp-power-mode;
		qcom,mdss-dsi-lane-0-state;
		qcom,mdss-dsi-lane-1-state;
		qcom,mdss-dsi-lane-2-state;
		qcom,mdss-dsi-lane-3-state;
		qcom,mdss-dsi-panel-timings = [E2 36 24 00 66 6A 28 38 2A 03 04 00];
		qcom,mdss-dsi-panel-timings-8996 =[23 1F 07 09 05 03 04 A0
				23 1F 07 09 05 03 04 A0
				23 1F 07 09 05 03 04 A0
				23 1F 07 09 05 03 04 A0
				23 19 08 08 05 03 04 A0];
		qcom,mdss-dsi-t-clk-post = <0x02>;
		qcom,mdss-dsi-t-clk-pre = <0x2A>;
		qcom,mdss-dsi-bl-min-level = <1>;
		qcom,mdss-dsi-bl-max-level = <4095>;
		qcom,mdss-dsi-dma-trigger = "trigger_sw";
		qcom,mdss-dsi-mdp-trigger = "none";
		qcom,mdss-dsi-bl-pmic-control-type = "bl_ctrl_wled";
		qcom,mdss-dsi-reset-sequence = <1 10>, <0 10>, <1 20>;
		qcom,mdss-dsi-lp11-init;
		qcom,mdss-dsi-init-delay-us = <50000>;
		qcom,mdss-pan-physical-width-dimension = <62>;
		qcom,mdss-pan-physical-height-dimension = <110>;
	};
};
