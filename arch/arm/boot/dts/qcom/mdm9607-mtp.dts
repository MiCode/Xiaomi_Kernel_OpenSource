/*
 * Copyright (c) 2015, The Linux Foundation. All rights reserved.
 *
 * This program is free software; you can redistribute it and/or modify
 * it under the terms of the GNU General Public License version 2 and
 * only version 2 as published by the Free Software Foundation.
 *
 * This program is distributed in the hope that it will be useful,
 * but WITHOUT ANY WARRANTY; without even the implied warranty of
 * MERCHANTABILITY or FITNESS FOR A PARTICULAR PURPOSE.  See the
 * GNU General Public License for more details.
 */

/dts-v1/;

#include "mdm9607-mtp.dtsi"

/ {
	model = "Qualcomm Technologies, Inc. MDM 9607 MTP";
	compatible = "qcom,mdm9607-mtp", "qcom,mdm9607", "qcom,mtp";
	qcom,board-id = <8 0>;
};
