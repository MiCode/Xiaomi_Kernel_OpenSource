/*
 * Copyright (c) 2014, The Linux Foundation. All rights reserved.
 *
 * This program is free software; you can redistribute it and/or modify
 * it under the terms of the GNU General Public License version 2 and
 * only version 2 as published by the Free Software Foundation.
 *
 * This program is distributed in the hope that it will be useful,
 * but WITHOUT ANY WARRANTY; without even the implied warranty of
 * MERCHANTABILITY or FITNESS FOR A PARTICULAR PURPOSE.  See the
 * GNU General Public License for more details.
 */

&vfe0 {
	qos-entries = <8>;
	qos-regs = <0x378 0x37C 0x380 0x384 0x388 0x38C
			0x390 0x394>;
	qos-settings = <0xAAA9AAA9
		0xAAA9AAA9
		0xAAA9AAA9
		0xAAA9AAA9
		0xAAA9AAA9
		0xAAA9AAA9
		0xAAA9AAA9
		0x0001AAA9>;
	vbif-entries = <1>;
	vbif-regs = <0x124>;
	vbif-settings = <0x3>;
	ds-entries = <17>;
	ds-regs = <0xBD8 0xBDC 0xBE0 0xBE4 0xBE8
		0xBEC 0xBF0 0xBF4 0xBF8 0xBFC 0xC00
		0xC04 0xC08 0xC0C 0xC10 0xC14 0xC18>;
	ds-settings = <0xCCCC1111
		0xCCCC1111
		0xCCCC1111
		0xCCCC1111
		0xCCCC1111
		0xCCCC1111
		0xCCCC1111
		0xCCCC1111
		0xCCCC1111
		0xCCCC1111
		0xCCCC1111
		0xCCCC1111
		0xCCCC1111
		0xCCCC1111
		0xCCCC1111
		0xCCCC1111
		0x00000103>;
	max-clk-nominal = <465000000>;
	max-clk-turbo = <600000000>;
};

&vfe1 {
	qos-entries = <8>;
	qos-regs = <0x378 0x37C 0x380 0x384 0x388 0x38C
			0x390 0x394>;
	qos-settings = <0xAAA9AAA9
		0xAAA9AAA9
		0xAAA9AAA9
		0xAAA9AAA9
		0xAAA9AAA9
		0xAAA9AAA9
		0xAAA9AAA9
		0x0001AAA9>;
	vbif-entries = <1>;
	vbif-regs = <0x124>;
	vbif-settings = <0x3>;
	ds-entries = <17>;
	ds-regs = <0xBD8 0xBDC 0xBE0 0xBE4 0xBE8
		0xBEC 0xBF0 0xBF4 0xBF8 0xBFC 0xC00
		0xC04 0xC08 0xC0C 0xC10 0xC14 0xC18>;
	ds-settings = <0xCCCC1111
		0xCCCC1111
		0xCCCC1111
		0xCCCC1111
		0xCCCC1111
		0xCCCC1111
		0xCCCC1111
		0xCCCC1111
		0xCCCC1111
		0xCCCC1111
		0xCCCC1111
		0xCCCC1111
		0xCCCC1111
		0xCCCC1111
		0xCCCC1111
		0xCCCC1111
		0x00000103>;
	max-clk-nominal = <465000000>;
	max-clk-turbo = <600000000>;
};
