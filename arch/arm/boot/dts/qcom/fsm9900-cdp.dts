/* Copyright (c) 2013-2014, The Linux Foundation. All rights reserved.
 *
 * This program is free software; you can redistribute it and/or modify
 * it under the terms of the GNU General Public License version 2 and
 * only version 2 as published by the Free Software Foundation.
 *
 * This program is distributed in the hope that it will be useful,
 * but WITHOUT ANY WARRANTY; without even the implied warranty of
 * MERCHANTABILITY or FITNESS FOR A PARTICULAR PURPOSE.  See the
 * GNU General Public License for more details.
 */

/dts-v1/;

#include "fsm9900-cdp.dtsi"

/ {
	model = "Qualcomm Technologies, Inc. FSM9900 CDP";
	compatible = "qcom,fsm9900-cdp", "qcom,fsm9900", "qcom,cdp";
	qcom,msm-id = <188 0x10000>,
		      <189 0x10000>,
		      <190 0x10000>,
		      <191 0x10000>,
		      <192 0x10000>,
		      <193 0x10000>;
	qcom,board-id = <0x00010001 0>;

};
