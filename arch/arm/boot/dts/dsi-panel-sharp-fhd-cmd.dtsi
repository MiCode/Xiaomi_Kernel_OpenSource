/* Copyright (c) 2012-2013, The Linux Foundation. All rights reserved.
 * Copyright (C) 2017 XiaoMi, Inc.
 * This program is free software; you can redistribute it and/or modify
 * it under the terms of the GNU General Public License version 2 and
 * only version 2 as published by the Free Software Foundation.
 * This program is distributed in the hope that it will be useful,
 * but WITHOUT ANY WARRANTY; without even the implied warranty of
 * MERCHANTABILITY or FITNESS FOR A PARTICULAR PURPOSE.  See the
 * GNU General Public License for more details.
 */

/*---------------------------------------------------------------------------
 * This file is autogenerated file using gcdb parser. Please do not edit it.
 * Update input XML file to add a new entry or update variable in this file
 * VERSION = "1.0"
 *---------------------------------------------------------------------------*/
&soc {
	dsi_sharp_fhd_cmd: qcom,mdss_dsi_sharp_fhd_cmd {
		qcom,mdss-dsi-panel-name = "sharp fhd cmd mode dsi panel";
		qcom,mdss-dsi-panel-id = <3>;
		qcom,mdss-dsi-panel-sleepwrmod = <1>;
		qcom,mdss-dsi-panel-controller = <&mdss_dsi0>;
		qcom,mdss-dsi-panel-type = "dsi_cmd_mode";
		qcom,mdss-dsi-panel-destination = "display_1";
		qcom,mdss-dsi-panel-framerate = <60>;
		qcom,mdss-dsi-virtual-channel-id = <0>;
		qcom,mdss-dsi-stream = <0>;
		qcom,mdss-dsi-panel-width = <1080>;
		qcom,mdss-dsi-panel-height = <1920>;
		qcom,mdss-dsi-h-front-porch = <80>;
		qcom,mdss-dsi-h-back-porch = <40>;
		qcom,mdss-dsi-h-pulse-width = <10>;
		qcom,mdss-dsi-h-sync-skew = <0>;
		qcom,mdss-dsi-v-back-porch = <4>;
		qcom,mdss-dsi-v-front-porch = <4>;
		qcom,mdss-dsi-v-pulse-width = <2>;
		qcom,mdss-dsi-h-left-border = <0>;
		qcom,mdss-dsi-h-right-border = <0>;
		qcom,mdss-dsi-v-top-border = <0>;
		qcom,mdss-dsi-v-bottom-border = <0>;
		qcom,mdss-dsi-bpp = <24>;
		qcom,mdss-dsi-color-order = <0>;
		qcom,mdss-dsi-underflow-color = <0xff>;
		qcom,mdss-dsi-border-color = <0>;
		qcom,mdss-dsi-on-command = [
				15 01 00 00 01 00 02 FF 10
				15 01 00 00 01 00 02 BB 10
				15 01 00 00 01 00 02 B0 03
				15 00 00 00 01 00 02 FF 24
				15 00 00 00 01 00 02 C4 69
				15 00 00 00 01 00 02 C9 00
				15 01 00 00 01 00 02 FB 01
				15 01 00 00 01 00 02 FF 22
				15 01 00 00 01 00 02 FB 01
				15 01 00 00 01 00 02 00 28
				15 01 00 00 01 00 02 01 2C
				15 01 00 00 01 00 02 02 30
				15 01 00 00 01 00 02 03 34
				15 01 00 00 01 00 02 04 38
				15 01 00 00 01 00 02 05 3C
				15 01 00 00 01 00 02 06 40
				15 01 00 00 01 00 02 07 48
				15 01 00 00 01 00 02 08 4C
				15 01 00 00 01 00 02 09 50
				15 01 00 00 01 00 02 0A 58
				15 01 00 00 01 00 02 0B 60
				15 01 00 00 01 00 02 0C 60
				15 01 00 00 01 00 02 0D 58
				15 01 00 00 01 00 02 0E 50
				15 01 00 00 01 00 02 0F 48
				15 01 00 00 01 00 02 10 38
				15 01 00 00 01 00 02 11 28
				15 01 00 00 01 00 02 12 28
				15 01 00 00 01 00 02 13 28
				15 01 00 00 01 00 02 1B 00
				15 01 00 00 01 00 02 1C 00
				15 01 00 00 01 00 02 1D 00
				15 01 00 00 01 00 02 1E 00
				15 01 00 00 01 00 02 1F 00
				15 01 00 00 01 00 02 20 00
				15 01 00 00 01 00 02 21 00
				15 01 00 00 01 00 02 22 00
				15 01 00 00 01 00 02 23 00
				15 01 00 00 01 00 02 24 00
				15 01 00 00 01 00 02 25 00
				15 01 00 00 01 00 02 26 00
				15 01 00 00 01 00 02 27 00
				15 01 00 00 01 00 02 28 00
				15 01 00 00 01 00 02 29 00
				15 01 00 00 01 00 02 2A 00
				15 01 00 00 01 00 02 2B 00
				15 01 00 00 01 00 02 2F 00
				15 01 00 00 01 00 02 30 00
				15 01 00 00 01 00 02 31 00
				15 01 00 00 01 00 02 32 80
				15 01 00 00 01 00 02 33 80
				15 01 00 00 01 00 02 34 80
				15 01 00 00 01 00 02 35 82
				15 01 00 00 01 00 02 36 84
				15 01 00 00 01 00 02 37 86
				15 01 00 00 01 00 02 38 88
				15 01 00 00 01 00 02 39 8A
				15 01 00 00 01 00 02 3A 8C
				15 01 00 00 01 00 02 3B 8E
				15 01 00 00 01 00 02 3F 90
				15 01 00 00 01 00 02 40 92
				15 01 00 00 01 00 02 41 94
				15 01 00 00 01 00 02 42 94
				15 01 00 00 01 00 02 43 92
				15 01 00 00 01 00 02 44 90
				15 01 00 00 01 00 02 45 8E
				15 01 00 00 01 00 02 46 8C
				15 01 00 00 01 00 02 47 8A
				15 01 00 00 01 00 02 48 88
				15 01 00 00 01 00 02 49 86
				15 01 00 00 01 00 02 4A 84
				15 01 00 00 01 00 02 4B 82
				15 01 00 00 01 00 02 4C 80
				15 01 00 00 01 00 02 4D 08
				15 01 00 00 01 00 02 1A 00
				15 01 00 00 01 00 02 53 01
				15 01 00 00 01 00 02 54 01
				15 01 00 00 01 00 02 56 00
				15 01 00 00 01 00 02 64 2F
				15 01 00 00 01 00 02 68 00
				15 01 00 00 01 00 02 FF 10
				15 01 00 00 01 00 02 35 00
				05 01 00 00 78 00 02 11 00
				15 01 00 00 01 00 02 51 ff
				15 01 00 00 01 00 02 53 2c
				15 01 00 00 01 00 02 55 80
				15 01 00 00 01 00 02 FF F0
				15 01 00 00 01 00 02 92 01
				15 01 00 00 01 00 02 13 01
				15 01 00 00 01 00 02 FF 10
				05 01 00 00 28 00 02 29 00
				];
		qcom,mdss-dsi-off-command = [
				15 01 00 00 00 00 02 FF 10
				39 01 00 00 11 00 02 28 00
				39 01 00 00 44 00 02 10 00
				];
		qcom,mdss-dsi-on-command-state = "dsi_lp_mode";
		qcom,mdss-dsi-off-command-state = "dsi_hs_mode";
		qcom,mdss-dsi-h-sync-pulse = <0>;
		qcom,mdss-dsi-traffic-mode = "burst_mode";
		qcom,mdss-dsi-lane-map = "lane_map_0123";
		qcom,mdss-dsi-bllp-eof-power-mode;
		qcom,mdss-dsi-bllp-power-mode;
		qcom,mdss-dsi-lane-0-state;
		qcom,mdss-dsi-lane-1-state;
		qcom,mdss-dsi-lane-2-state;
		qcom,mdss-dsi-lane-3-state;
		qcom,mdss-dsi-te-pin-select = <1>;
		qcom,mdss-dsi-te-v-sync-rd-ptr-irq-line = <0x2c>;
		qcom,mdss-dsi-te-v-sync-continues-lines = <0x3c>;
		qcom,mdss-dsi-te-dcs-command = <1>;
		qcom,mdss-dsi-te-check-enable;
		qcom,mdss-dsi-te-using-te-pin;
		qcom,mdss-dsi-panel-timings = [e3 50 36 00 a9 a3 3a 50 3d 03 04 00];
		qcom,mdss-dsi-t-clk-post = <0x20>;
		qcom,mdss-dsi-t-clk-pre = <0x36>;
		qcom,mdss-dsi-bl-min-level = <8>;
		qcom,mdss-dsi-bl-max-level = <4095>;
		qcom,mdss-dsi-dma-trigger = "trigger_sw";
		qcom,mdss-dsi-mdp-trigger = "none";
		qcom,mdss-dsi-bl-pmic-control-type = "bl_ctrl_wled";
		qcom,mdss-dsi-reset-sequence = <1 20>, <0 20>, <1 20>;
		qcom,mdss-pan-physical-width-dimension = <61>;
		qcom,mdss-pan-physical-height-dimension = <109>;
		qcom,dispparam-enabled;
		qcom,mdss-dsi-dispparam-cabcon-command = [
				15 00 00 00 01 00 02 FF 10
				15 01 00 00 10 00 02 55 82
				];
		qcom,mdss-dsi-dispparam-cabcguion-command = [
				15 00 00 00 01 00 02 FF 10
				15 01 00 00 10 00 02 55 81
				];
		qcom,mdss-dsi-dispparam-cabcstillon-command = [
				15 00 00 00 01 00 02 FF 10
				15 01 00 00 10 00 02 55 82
				];
		qcom,mdss-dsi-dispparam-cabcmovieon-command = [
				15 00 00 00 01 00 02 FF 10
				15 01 00 00 10 00 02 55 83
				];
		qcom,mdss-dsi-dispparam-cabcon-command-state = "dsi_hs_mode";
		qcom,mdss-dsi-dispparam-cabcoff-command = [
				15 00 00 00 01 00 02 FF 10
				15 01 00 00 10 00 02 55 80
				];
		qcom,mdss-dsi-dispparam-cabcoff-command-state = "dsi_hs_mode";
		qcom,mdss-dsi-dispparam-gammareload-command = [
				15 00 00 00 01 00 02 FF 20
				15 00 00 00 01 00 02 FB 00
				15 00 00 00 01 00 02 FF 21
				15 00 00 00 01 00 02 FB 00
				15 00 00 00 01 00 02 FF 10
				05 01 00 00 10 00 02 11 00
				];
		qcom,mdss-dsi-dispparam-gammareload-command-state = "dsi_hs_mode";
		qcom,mdss-dsi-dispparam-warm-command = [
				15 00 00 00 01 00 02 FF 20
				15 00 00 00 01 00 02 75 00
				15 00 00 00 01 00 02 76 9C
				15 00 00 00 01 00 02 77 00
				15 00 00 00 01 00 02 78 A9
				15 00 00 00 01 00 02 79 00
				15 00 00 00 01 00 02 7A C4
				15 00 00 00 01 00 02 7B 00
				15 00 00 00 01 00 02 7C D8
				15 00 00 00 01 00 02 7D 00
				15 00 00 00 01 00 02 7E EB
				15 00 00 00 01 00 02 7F 00
				15 00 00 00 01 00 02 80 FB
				15 00 00 00 01 00 02 81 01
				15 00 00 00 01 00 02 82 09
				15 00 00 00 01 00 02 83 01
				15 00 00 00 01 00 02 84 15
				15 00 00 00 01 00 02 85 01
				15 00 00 00 01 00 02 86 21
				15 00 00 00 01 00 02 87 01
				15 00 00 00 01 00 02 88 4B
				15 00 00 00 01 00 02 89 01
				15 00 00 00 01 00 02 8A 6D
				15 00 00 00 01 00 02 8B 01
				15 00 00 00 01 00 02 8C A6
				15 00 00 00 01 00 02 8D 01
				15 00 00 00 01 00 02 8E D5
				15 00 00 00 01 00 02 8F 02
				15 00 00 00 01 00 02 90 1C
				15 00 00 00 01 00 02 91 02
				15 00 00 00 01 00 02 92 4F
				15 00 00 00 01 00 02 93 02
				15 00 00 00 01 00 02 94 50
				15 00 00 00 01 00 02 95 02
				15 00 00 00 01 00 02 96 7F
				15 00 00 00 01 00 02 97 02
				15 00 00 00 01 00 02 98 B4
				15 00 00 00 01 00 02 99 02
				15 00 00 00 01 00 02 9A D5
				15 00 00 00 01 00 02 9B 03
				15 00 00 00 01 00 02 9C 08
				15 00 00 00 01 00 02 9D 03
				15 00 00 00 01 00 02 9E 27
				15 00 00 00 01 00 02 9F 03
				15 00 00 00 01 00 02 A0 50
				15 00 00 00 01 00 02 A2 03
				15 00 00 00 01 00 02 A3 5C
				15 00 00 00 01 00 02 A4 03
				15 00 00 00 01 00 02 A5 69
				15 00 00 00 01 00 02 A6 03
				15 00 00 00 01 00 02 A7 77
				15 00 00 00 01 00 02 A9 03
				15 00 00 00 01 00 02 AA 88
				15 00 00 00 01 00 02 AB 03
				15 00 00 00 01 00 02 AC 99
				15 00 00 00 01 00 02 AD 03
				15 00 00 00 01 00 02 AE AF
				15 00 00 00 01 00 02 AF 03
				15 00 00 00 01 00 02 B0 C2
				15 00 00 00 01 00 02 B1 03
				15 00 00 00 01 00 02 B2 C6
				15 00 00 00 01 00 02 B3 00
				15 00 00 00 01 00 02 B4 DF
				15 00 00 00 01 00 02 B5 00
				15 00 00 00 01 00 02 B6 EC
				15 00 00 00 01 00 02 B7 01
				15 00 00 00 01 00 02 B8 05
				15 00 00 00 01 00 02 B9 01
				15 00 00 00 01 00 02 BA 17
				15 00 00 00 01 00 02 BB 01
				15 00 00 00 01 00 02 BC 28
				15 00 00 00 01 00 02 BD 01
				15 00 00 00 01 00 02 BE 36
				15 00 00 00 01 00 02 BF 01
				15 00 00 00 01 00 02 C0 42
				15 00 00 00 01 00 02 C1 01
				15 00 00 00 01 00 02 C2 4D
				15 00 00 00 01 00 02 C3 01
				15 00 00 00 01 00 02 C4 58
				15 00 00 00 01 00 02 C5 01
				15 00 00 00 01 00 02 C6 7A
				15 00 00 00 01 00 02 C7 01
				15 00 00 00 01 00 02 C8 96
				15 00 00 00 01 00 02 C9 01
				15 00 00 00 01 00 02 CA C1
				15 00 00 00 01 00 02 CB 01
				15 00 00 00 01 00 02 CC E2
				15 00 00 00 01 00 02 CD 02
				15 00 00 00 01 00 02 CE 17
				15 00 00 00 01 00 02 CF 02
				15 00 00 00 01 00 02 D0 4A
				15 00 00 00 01 00 02 D1 02
				15 00 00 00 01 00 02 D2 4B
				15 00 00 00 01 00 02 D3 02
				15 00 00 00 01 00 02 D4 7A
				15 00 00 00 01 00 02 D5 02
				15 00 00 00 01 00 02 D6 B1
				15 00 00 00 01 00 02 D7 02
				15 00 00 00 01 00 02 D8 D4
				15 00 00 00 01 00 02 D9 03
				15 00 00 00 01 00 02 DA 03
				15 00 00 00 01 00 02 DB 03
				15 00 00 00 01 00 02 DC 23
				15 00 00 00 01 00 02 DD 03
				15 00 00 00 01 00 02 DE 4D
				15 00 00 00 01 00 02 DF 03
				15 00 00 00 01 00 02 E0 5A
				15 00 00 00 01 00 02 E1 03
				15 00 00 00 01 00 02 E2 68
				15 00 00 00 01 00 02 E3 03
				15 00 00 00 01 00 02 E4 76
				15 00 00 00 01 00 02 E5 03
				15 00 00 00 01 00 02 E6 87
				15 00 00 00 01 00 02 E7 03
				15 00 00 00 01 00 02 E8 98
				15 00 00 00 01 00 02 E9 03
				15 00 00 00 01 00 02 EA AE
				15 00 00 00 01 00 02 EB 03
				15 00 00 00 01 00 02 EC C1
				15 00 00 00 01 00 02 ED 03
				15 00 00 00 01 00 02 EE C6
				15 00 00 00 01 00 02 EF 00
				15 00 00 00 01 00 02 F0 37
				15 00 00 00 01 00 02 F1 00
				15 00 00 00 01 00 02 F2 73
				15 00 00 00 01 00 02 F3 00
				15 00 00 00 01 00 02 F4 9D
				15 00 00 00 01 00 02 F5 00
				15 00 00 00 01 00 02 F6 B9
				15 00 00 00 01 00 02 F7 00
				15 00 00 00 01 00 02 F8 CF
				15 00 00 00 01 00 02 F9 00
				15 00 00 00 01 00 02 FA E2
				15 00 00 00 01 00 02 FF 21
				15 00 00 00 01 00 02 00 00
				15 00 00 00 01 00 02 01 F3
				15 00 00 00 01 00 02 02 01
				15 00 00 00 01 00 02 03 02
				15 00 00 00 01 00 02 04 01
				15 00 00 00 01 00 02 05 0F
				15 00 00 00 01 00 02 06 01
				15 00 00 00 01 00 02 07 3D
				15 00 00 00 01 00 02 08 01
				15 00 00 00 01 00 02 09 62
				15 00 00 00 01 00 02 0A 01
				15 00 00 00 01 00 02 0B 9F
				15 00 00 00 01 00 02 0C 01
				15 00 00 00 01 00 02 0D D0
				15 00 00 00 01 00 02 0E 02
				15 00 00 00 01 00 02 0F 1A
				15 00 00 00 01 00 02 10 02
				15 00 00 00 01 00 02 11 4D
				15 00 00 00 01 00 02 12 02
				15 00 00 00 01 00 02 13 4F
				15 00 00 00 01 00 02 14 02
				15 00 00 00 01 00 02 15 7E
				15 00 00 00 01 00 02 16 02
				15 00 00 00 01 00 02 17 B2
				15 00 00 00 01 00 02 18 02
				15 00 00 00 01 00 02 19 D5
				15 00 00 00 01 00 02 1A 03
				15 00 00 00 01 00 02 1B 07
				15 00 00 00 01 00 02 1C 03
				15 00 00 00 01 00 02 1D 2A
				15 00 00 00 01 00 02 1E 03
				15 00 00 00 01 00 02 1F 4F
				15 00 00 00 01 00 02 20 03
				15 00 00 00 01 00 02 21 59
				15 00 00 00 01 00 02 22 03
				15 00 00 00 01 00 02 23 66
				15 00 00 00 01 00 02 24 03
				15 00 00 00 01 00 02 25 74
				15 00 00 00 01 00 02 26 03
				15 00 00 00 01 00 02 27 85
				15 00 00 00 01 00 02 28 03
				15 00 00 00 01 00 02 29 95
				15 00 00 00 01 00 02 2A 03
				15 00 00 00 01 00 02 2B AA
				15 00 00 00 01 00 02 2D 03
				15 00 00 00 01 00 02 2F C1
				15 00 00 00 01 00 02 30 03
				15 00 00 00 01 00 02 31 C6
				15 00 00 00 01 00 02 32 00
				15 00 00 00 01 00 02 33 84
				15 00 00 00 01 00 02 34 00
				15 00 00 00 01 00 02 35 BE
				15 00 00 00 01 00 02 36 00
				15 00 00 00 01 00 02 37 E6
				15 00 00 00 01 00 02 38 01
				15 00 00 00 01 00 02 39 01
				15 00 00 00 01 00 02 3A 01
				15 00 00 00 01 00 02 3B 15
				15 00 00 00 01 00 02 3D 01
				15 00 00 00 01 00 02 3F 26
				15 00 00 00 01 00 02 40 01
				15 00 00 00 01 00 02 41 34
				15 00 00 00 01 00 02 42 01
				15 00 00 00 01 00 02 43 42
				15 00 00 00 01 00 02 44 01
				15 00 00 00 01 00 02 45 4E
				15 00 00 00 01 00 02 46 01
				15 00 00 00 01 00 02 47 74
				15 00 00 00 01 00 02 48 01
				15 00 00 00 01 00 02 49 91
				15 00 00 00 01 00 02 4A 01
				15 00 00 00 01 00 02 4B BE
				15 00 00 00 01 00 02 4C 01
				15 00 00 00 01 00 02 4D DF
				15 00 00 00 01 00 02 4E 02
				15 00 00 00 01 00 02 4F 15
				15 00 00 00 01 00 02 50 02
				15 00 00 00 01 00 02 51 48
				15 00 00 00 01 00 02 52 02
				15 00 00 00 01 00 02 53 4A
				15 00 00 00 01 00 02 54 02
				15 00 00 00 01 00 02 55 79
				15 00 00 00 01 00 02 56 02
				15 00 00 00 01 00 02 58 AF
				15 00 00 00 01 00 02 59 02
				15 00 00 00 01 00 02 5A D4
				15 00 00 00 01 00 02 5B 03
				15 00 00 00 01 00 02 5C 02
				15 00 00 00 01 00 02 5D 03
				15 00 00 00 01 00 02 5E 26
				15 00 00 00 01 00 02 5F 03
				15 00 00 00 01 00 02 60 4C
				15 00 00 00 01 00 02 61 03
				15 00 00 00 01 00 02 62 57
				15 00 00 00 01 00 02 63 03
				15 00 00 00 01 00 02 64 65
				15 00 00 00 01 00 02 65 03
				15 00 00 00 01 00 02 66 73
				15 00 00 00 01 00 02 67 03
				15 00 00 00 01 00 02 68 84
				15 00 00 00 01 00 02 69 03
				15 00 00 00 01 00 02 6A 94
				15 00 00 00 01 00 02 6B 03
				15 00 00 00 01 00 02 6C A9
				15 00 00 00 01 00 02 6D 03
				15 00 00 00 01 00 02 6E C0
				15 00 00 00 01 00 02 6F 03
				15 00 00 00 01 00 02 70 C6
				15 00 00 00 01 00 02 71 01
				15 00 00 00 01 00 02 72 82
				15 00 00 00 01 00 02 73 01
				15 00 00 00 01 00 02 74 84
				15 00 00 00 01 00 02 75 01
				15 00 00 00 01 00 02 76 8A
				15 00 00 00 01 00 02 77 01
				15 00 00 00 01 00 02 78 90
				15 00 00 00 01 00 02 79 01
				15 00 00 00 01 00 02 7A 94
				15 00 00 00 01 00 02 7B 01
				15 00 00 00 01 00 02 7C 9A
				15 00 00 00 01 00 02 7D 01
				15 00 00 00 01 00 02 7E A0
				15 00 00 00 01 00 02 7F 01
				15 00 00 00 01 00 02 80 A6
				15 00 00 00 01 00 02 81 01
				15 00 00 00 01 00 02 82 AA
				15 00 00 00 01 00 02 83 01
				15 00 00 00 01 00 02 84 BD
				15 00 00 00 01 00 02 85 01
				15 00 00 00 01 00 02 86 D0
				15 00 00 00 01 00 02 87 01
				15 00 00 00 01 00 02 88 F1
				15 00 00 00 01 00 02 89 02
				15 00 00 00 01 00 02 8A 10
				15 00 00 00 01 00 02 8B 02
				15 00 00 00 01 00 02 8C 43
				15 00 00 00 01 00 02 8D 02
				15 00 00 00 01 00 02 8E 6B
				15 00 00 00 01 00 02 8F 02
				15 00 00 00 01 00 02 90 6C
				15 00 00 00 01 00 02 91 02
				15 00 00 00 01 00 02 92 97
				15 00 00 00 01 00 02 93 02
				15 00 00 00 01 00 02 94 CA
				15 00 00 00 01 00 02 95 02
				15 00 00 00 01 00 02 96 EC
				15 00 00 00 01 00 02 97 03
				15 00 00 00 01 00 02 98 23
				15 00 00 00 01 00 02 99 03
				15 00 00 00 01 00 02 9A 38
				15 00 00 00 01 00 02 9B 03
				15 00 00 00 01 00 02 9C 5E
				15 00 00 00 01 00 02 9D 03
				15 00 00 00 01 00 02 9E 6A
				15 00 00 00 01 00 02 9F 03
				15 00 00 00 01 00 02 A0 73
				15 00 00 00 01 00 02 A2 03
				15 00 00 00 01 00 02 A3 80
				15 00 00 00 01 00 02 A4 03
				15 00 00 00 01 00 02 A5 8F
				15 00 00 00 01 00 02 A6 03
				15 00 00 00 01 00 02 A7 9E
				15 00 00 00 01 00 02 A9 03
				15 00 00 00 01 00 02 AA AC
				15 00 00 00 01 00 02 AB 03
				15 00 00 00 01 00 02 AC B4
				15 00 00 00 01 00 02 AD 03
				15 00 00 00 01 00 02 AE C6
				15 00 00 00 01 00 02 AF 01
				15 00 00 00 01 00 02 B0 B7
				15 00 00 00 01 00 02 B1 01
				15 00 00 00 01 00 02 B2 B9
				15 00 00 00 01 00 02 B3 01
				15 00 00 00 01 00 02 B4 BD
				15 00 00 00 01 00 02 B5 01
				15 00 00 00 01 00 02 B6 C1
				15 00 00 00 01 00 02 B7 01
				15 00 00 00 01 00 02 B8 C5
				15 00 00 00 01 00 02 B9 01
				15 00 00 00 01 00 02 BA C9
				15 00 00 00 01 00 02 BB 01
				15 00 00 00 01 00 02 BC CD
				15 00 00 00 01 00 02 BD 01
				15 00 00 00 01 00 02 BE D2
				15 00 00 00 01 00 02 BF 01
				15 00 00 00 01 00 02 C0 D5
				15 00 00 00 01 00 02 C1 01
				15 00 00 00 01 00 02 C2 E2
				15 00 00 00 01 00 02 C3 01
				15 00 00 00 01 00 02 C4 EF
				15 00 00 00 01 00 02 C5 02
				15 00 00 00 01 00 02 C6 06
				15 00 00 00 01 00 02 C7 02
				15 00 00 00 01 00 02 C8 19
				15 00 00 00 01 00 02 C9 02
				15 00 00 00 01 00 02 CA 3E
				15 00 00 00 01 00 02 CB 02
				15 00 00 00 01 00 02 CC 66
				15 00 00 00 01 00 02 CD 02
				15 00 00 00 01 00 02 CE 67
				15 00 00 00 01 00 02 CF 02
				15 00 00 00 01 00 02 D0 92
				15 00 00 00 01 00 02 D1 02
				15 00 00 00 01 00 02 D2 C7
				15 00 00 00 01 00 02 D3 02
				15 00 00 00 01 00 02 D4 EB
				15 00 00 00 01 00 02 D5 03
				15 00 00 00 01 00 02 D6 1E
				15 00 00 00 01 00 02 D7 03
				15 00 00 00 01 00 02 D8 34
				15 00 00 00 01 00 02 D9 03
				15 00 00 00 01 00 02 DA 5B
				15 00 00 00 01 00 02 DB 03
				15 00 00 00 01 00 02 DC 67
				15 00 00 00 01 00 02 DD 03
				15 00 00 00 01 00 02 DE 72
				15 00 00 00 01 00 02 DF 03
				15 00 00 00 01 00 02 E0 7F
				15 00 00 00 01 00 02 E1 03
				15 00 00 00 01 00 02 E2 8E
				15 00 00 00 01 00 02 E3 03
				15 00 00 00 01 00 02 E4 9D
				15 00 00 00 01 00 02 E5 03
				15 00 00 00 01 00 02 E6 AB
				15 00 00 00 01 00 02 E7 03
				15 00 00 00 01 00 02 E8 B3
				15 00 00 00 01 00 02 E9 03
				15 00 00 00 01 00 02 EA C6
				15 01 00 00 01 00 02 FF 10
				];
		qcom,mdss-dsi-dispparam-warm-command-state = "dsi_hs_mode";
		qcom,mdss-dsi-dispparam-default-command = [
				15 00 00 00 01 00 02 FF 20
				15 00 00 00 01 00 02 FB 00
				15 00 00 00 01 00 02 FF 21
				15 00 00 00 01 00 02 FB 00
				15 00 00 00 01 00 02 FF 10
				05 01 00 00 10 00 02 11 00
				];
		qcom,mdss-dsi-dispparam-default-command-state = "dsi_hs_mode";
		qcom,mdss-dsi-dispparam-cold-command = [
				15 00 00 00 00 00 02 FF 20
				15 00 00 00 00 00 02 75 00
				15 00 00 00 00 00 02 76 F1
				15 00 00 00 00 00 02 77 00
				15 00 00 00 00 00 02 78 F8
				15 00 00 00 00 00 02 79 01
				15 00 00 00 00 00 02 7A 06
				15 00 00 00 00 00 02 7B 01
				15 00 00 00 00 00 02 7C 13
				15 00 00 00 00 00 02 7D 01
				15 00 00 00 00 00 02 7E 1F
				15 00 00 00 00 00 02 7F 01
				15 00 00 00 00 00 02 80 2A
				15 00 00 00 00 00 02 81 01
				15 00 00 00 00 00 02 82 35
				15 00 00 00 00 00 02 83 01
				15 00 00 00 00 00 02 84 3E
				15 00 00 00 00 00 02 85 01
				15 00 00 00 00 00 02 86 48
				15 00 00 00 00 00 02 87 01
				15 00 00 00 00 00 02 88 69
				15 00 00 00 00 00 02 89 01
				15 00 00 00 00 00 02 8A 87
				15 00 00 00 00 00 02 8B 01
				15 00 00 00 00 00 02 8C B8
				15 00 00 00 00 00 02 8D 01
				15 00 00 00 00 00 02 8E E3
				15 00 00 00 00 00 02 8F 02
				15 00 00 00 00 00 02 90 25
				15 00 00 00 00 00 02 91 02
				15 00 00 00 00 00 02 92 54
				15 00 00 00 00 00 02 93 02
				15 00 00 00 00 00 02 94 56
				15 00 00 00 00 00 02 95 02
				15 00 00 00 00 00 02 96 83
				15 00 00 00 00 00 02 97 02
				15 00 00 00 00 00 02 98 B8
				15 00 00 00 00 00 02 99 02
				15 00 00 00 00 00 02 9A DA
				15 00 00 00 00 00 02 9B 03
				15 00 00 00 00 00 02 9C 0D
				15 00 00 00 00 00 02 9D 03
				15 00 00 00 00 00 02 9E 2B
				15 00 00 00 00 00 02 9F 03
				15 00 00 00 00 00 02 A0 53
				15 00 00 00 00 00 02 A2 03
				15 00 00 00 00 00 02 A3 60
				15 00 00 00 00 00 02 A4 03
				15 00 00 00 00 00 02 A5 6C
				15 00 00 00 00 00 02 A6 03
				15 00 00 00 00 00 02 A7 7A
				15 00 00 00 00 00 02 A9 03
				15 00 00 00 00 00 02 AA 8A
				15 00 00 00 00 00 02 AB 03
				15 00 00 00 00 00 02 AC 9B
				15 00 00 00 00 00 02 AD 03
				15 00 00 00 00 00 02 AE AE
				15 00 00 00 00 00 02 AF 03
				15 00 00 00 00 00 02 B0 C3
				15 00 00 00 00 00 02 B1 03
				15 00 00 00 00 00 02 B2 C6
				15 00 00 00 00 00 02 B3 01
				15 00 00 00 00 00 02 B4 30
				15 00 00 00 00 00 02 B5 01
				15 00 00 00 00 00 02 B6 35
				15 00 00 00 00 00 02 B7 01
				15 00 00 00 00 00 02 B8 41
				15 00 00 00 00 00 02 B9 01
				15 00 00 00 00 00 02 BA 4E
				15 00 00 00 00 00 02 BB 01
				15 00 00 00 00 00 02 BC 58
				15 00 00 00 00 00 02 BD 01
				15 00 00 00 00 00 02 BE 61
				15 00 00 00 00 00 02 BF 01
				15 00 00 00 00 00 02 C0 6A
				15 00 00 00 00 00 02 C1 01
				15 00 00 00 00 00 02 C2 72
				15 00 00 00 00 00 02 C3 01
				15 00 00 00 00 00 02 C4 7B
				15 00 00 00 00 00 02 C5 01
				15 00 00 00 00 00 02 C6 95
				15 00 00 00 00 00 02 C7 01
				15 00 00 00 00 00 02 C8 AC
				15 00 00 00 00 00 02 C9 01
				15 00 00 00 00 00 02 CA D1
				15 00 00 00 00 00 02 CB 01
				15 00 00 00 00 00 02 CC EE
				15 00 00 00 00 00 02 CD 02
				15 00 00 00 00 00 02 CE 20
				15 00 00 00 00 00 02 CF 02
				15 00 00 00 00 00 02 D0 4F
				15 00 00 00 00 00 02 D1 02
				15 00 00 00 00 00 02 D2 51
				15 00 00 00 00 00 02 D3 02
				15 00 00 00 00 00 02 D4 7E
				15 00 00 00 00 00 02 D5 02
				15 00 00 00 00 00 02 D6 B5
				15 00 00 00 00 00 02 D7 02
				15 00 00 00 00 00 02 D8 D9
				15 00 00 00 00 00 02 D9 03
				15 00 00 00 00 00 02 DA 08
				15 00 00 00 00 00 02 DB 03
				15 00 00 00 00 00 02 DC 27
				15 00 00 00 00 00 02 DD 03
				15 00 00 00 00 00 02 DE 50
				15 00 00 00 00 00 02 DF 03
				15 00 00 00 00 00 02 E0 5D
				15 00 00 00 00 00 02 E1 03
				15 00 00 00 00 00 02 E2 6B
				15 00 00 00 00 00 02 E3 03
				15 00 00 00 00 00 02 E4 79
				15 00 00 00 00 00 02 E5 03
				15 00 00 00 00 00 02 E6 89
				15 00 00 00 00 00 02 E7 03
				15 00 00 00 00 00 02 E8 9A
				15 00 00 00 00 00 02 E9 03
				15 00 00 00 00 00 02 EA AD
				15 00 00 00 00 00 02 EB 03
				15 00 00 00 00 00 02 EC C2
				15 00 00 00 00 00 02 ED 03
				15 00 00 00 00 00 02 EE C6
				15 00 00 00 00 00 02 EF 00
				15 00 00 00 00 00 02 F0 37
				15 00 00 00 00 00 02 F1 00
				15 00 00 00 00 00 02 F2 73
				15 00 00 00 00 00 02 F3 00
				15 00 00 00 00 00 02 F4 9D
				15 00 00 00 00 00 02 F5 00
				15 00 00 00 00 00 02 F6 B9
				15 00 00 00 00 00 02 F7 00
				15 00 00 00 00 00 02 F8 CF
				15 00 00 00 00 00 02 F9 00
				15 00 00 00 00 00 02 FA E2
				15 00 00 00 00 00 02 FF 21
				15 00 00 00 00 00 02 00 00
				15 00 00 00 00 00 02 01 F3
				15 00 00 00 00 00 02 02 01
				15 00 00 00 00 00 02 03 02
				15 00 00 00 00 00 02 04 01
				15 00 00 00 00 00 02 05 0F
				15 00 00 00 00 00 02 06 01
				15 00 00 00 00 00 02 07 3D
				15 00 00 00 00 00 02 08 01
				15 00 00 00 00 00 02 09 62
				15 00 00 00 00 00 02 0A 01
				15 00 00 00 00 00 02 0B 9F
				15 00 00 00 00 00 02 0C 01
				15 00 00 00 00 00 02 0D D0
				15 00 00 00 00 00 02 0E 02
				15 00 00 00 00 00 02 0F 1A
				15 00 00 00 00 00 02 10 02
				15 00 00 00 00 00 02 11 4D
				15 00 00 00 00 00 02 12 02
				15 00 00 00 00 00 02 13 4F
				15 00 00 00 00 00 02 14 02
				15 00 00 00 00 00 02 15 7E
				15 00 00 00 00 00 02 16 02
				15 00 00 00 00 00 02 17 B2
				15 00 00 00 00 00 02 18 02
				15 00 00 00 00 00 02 19 D5
				15 00 00 00 00 00 02 1A 03
				15 00 00 00 00 00 02 1B 07
				15 00 00 00 00 00 02 1C 03
				15 00 00 00 00 00 02 1D 2A
				15 00 00 00 00 00 02 1E 03
				15 00 00 00 00 00 02 1F 4F
				15 00 00 00 00 00 02 20 03
				15 00 00 00 00 00 02 21 59
				15 00 00 00 00 00 02 22 03
				15 00 00 00 00 00 02 23 66
				15 00 00 00 00 00 02 24 03
				15 00 00 00 00 00 02 25 74
				15 00 00 00 00 00 02 26 03
				15 00 00 00 00 00 02 27 85
				15 00 00 00 00 00 02 28 03
				15 00 00 00 00 00 02 29 95
				15 00 00 00 00 00 02 2A 03
				15 00 00 00 00 00 02 2B AA
				15 00 00 00 00 00 02 2D 03
				15 00 00 00 00 00 02 2F C1
				15 00 00 00 00 00 02 30 03
				15 00 00 00 00 00 02 31 C6
				15 00 00 00 00 00 02 32 00
				15 00 00 00 00 00 02 33 84
				15 00 00 00 00 00 02 34 00
				15 00 00 00 00 00 02 35 BE
				15 00 00 00 00 00 02 36 00
				15 00 00 00 00 00 02 37 E6
				15 00 00 00 00 00 02 38 01
				15 00 00 00 00 00 02 39 01
				15 00 00 00 00 00 02 3A 01
				15 00 00 00 00 00 02 3B 15
				15 00 00 00 00 00 02 3D 01
				15 00 00 00 00 00 02 3F 26
				15 00 00 00 00 00 02 40 01
				15 00 00 00 00 00 02 41 34
				15 00 00 00 00 00 02 42 01
				15 00 00 00 00 00 02 43 42
				15 00 00 00 00 00 02 44 01
				15 00 00 00 00 00 02 45 4E
				15 00 00 00 00 00 02 46 01
				15 00 00 00 00 00 02 47 74
				15 00 00 00 00 00 02 48 01
				15 00 00 00 00 00 02 49 91
				15 00 00 00 00 00 02 4A 01
				15 00 00 00 00 00 02 4B BE
				15 00 00 00 00 00 02 4C 01
				15 00 00 00 00 00 02 4D DF
				15 00 00 00 00 00 02 4E 02
				15 00 00 00 00 00 02 4F 15
				15 00 00 00 00 00 02 50 02
				15 00 00 00 00 00 02 51 48
				15 00 00 00 00 00 02 52 02
				15 00 00 00 00 00 02 53 4A
				15 00 00 00 00 00 02 54 02
				15 00 00 00 00 00 02 55 79
				15 00 00 00 00 00 02 56 02
				15 00 00 00 00 00 02 58 AF
				15 00 00 00 00 00 02 59 02
				15 00 00 00 00 00 02 5A D4
				15 00 00 00 00 00 02 5B 03
				15 00 00 00 00 00 02 5C 02
				15 00 00 00 00 00 02 5D 03
				15 00 00 00 00 00 02 5E 26
				15 00 00 00 00 00 02 5F 03
				15 00 00 00 00 00 02 60 4C
				15 00 00 00 00 00 02 61 03
				15 00 00 00 00 00 02 62 57
				15 00 00 00 00 00 02 63 03
				15 00 00 00 00 00 02 64 65
				15 00 00 00 00 00 02 65 03
				15 00 00 00 00 00 02 66 73
				15 00 00 00 00 00 02 67 03
				15 00 00 00 00 00 02 68 84
				15 00 00 00 00 00 02 69 03
				15 00 00 00 00 00 02 6A 94
				15 00 00 00 00 00 02 6B 03
				15 00 00 00 00 00 02 6C A9
				15 00 00 00 00 00 02 6D 03
				15 00 00 00 00 00 02 6E C0
				15 00 00 00 00 00 02 6F 03
				15 00 00 00 00 00 02 70 C6
				15 00 00 00 00 00 02 71 01
				15 00 00 00 00 00 02 72 27
				15 00 00 00 00 00 02 73 01
				15 00 00 00 00 00 02 74 2C
				15 00 00 00 00 00 02 75 01
				15 00 00 00 00 00 02 76 35
				15 00 00 00 00 00 02 77 01
				15 00 00 00 00 00 02 78 40
				15 00 00 00 00 00 02 79 01
				15 00 00 00 00 00 02 7A 48
				15 00 00 00 00 00 02 7B 01
				15 00 00 00 00 00 02 7C 51
				15 00 00 00 00 00 02 7D 01
				15 00 00 00 00 00 02 7E 58
				15 00 00 00 00 00 02 7F 01
				15 00 00 00 00 00 02 80 61
				15 00 00 00 00 00 02 81 01
				15 00 00 00 00 00 02 82 69
				15 00 00 00 00 00 02 83 01
				15 00 00 00 00 00 02 84 84
				15 00 00 00 00 00 02 85 01
				15 00 00 00 00 00 02 86 9D
				15 00 00 00 00 00 02 87 01
				15 00 00 00 00 00 02 88 C9
				15 00 00 00 00 00 02 89 01
				15 00 00 00 00 00 02 8A F0
				15 00 00 00 00 00 02 8B 02
				15 00 00 00 00 00 02 8C 2E
				15 00 00 00 00 00 02 8D 02
				15 00 00 00 00 00 02 8E 5B
				15 00 00 00 00 00 02 8F 02
				15 00 00 00 00 00 02 90 5D
				15 00 00 00 00 00 02 91 02
				15 00 00 00 00 00 02 92 8A
				15 00 00 00 00 00 02 93 02
				15 00 00 00 00 00 02 94 BE
				15 00 00 00 00 00 02 95 02
				15 00 00 00 00 00 02 96 E1
				15 00 00 00 00 00 02 97 03
				15 00 00 00 00 00 02 98 17
				15 00 00 00 00 00 02 99 03
				15 00 00 00 00 00 02 9A 2E
				15 00 00 00 00 00 02 9B 03
				15 00 00 00 00 00 02 9C 55
				15 00 00 00 00 00 02 9D 03
				15 00 00 00 00 00 02 9E 62
				15 00 00 00 00 00 02 9F 03
				15 00 00 00 00 00 02 A0 6D
				15 00 00 00 00 00 02 A2 03
				15 00 00 00 00 00 02 A3 7B
				15 00 00 00 00 00 02 A4 03
				15 00 00 00 00 00 02 A5 8A
				15 00 00 00 00 00 02 A6 03
				15 00 00 00 00 00 02 A7 9B
				15 00 00 00 00 00 02 A9 03
				15 00 00 00 00 00 02 AA AA
				15 00 00 00 00 00 02 AB 03
				15 00 00 00 00 00 02 AC BC
				15 00 00 00 00 00 02 AD 03
				15 00 00 00 00 00 02 AE C6
				15 00 00 00 00 00 02 AF 01
				15 00 00 00 00 00 02 B0 62
				15 00 00 00 00 00 02 B1 01
				15 00 00 00 00 00 02 B2 66
				15 00 00 00 00 00 02 B3 01
				15 00 00 00 00 00 02 B4 6E
				15 00 00 00 00 00 02 B5 01
				15 00 00 00 00 00 02 B6 77
				15 00 00 00 00 00 02 B7 01
				15 00 00 00 00 00 02 B8 7D
				15 00 00 00 00 00 02 B9 01
				15 00 00 00 00 00 02 BA 85
				15 00 00 00 00 00 02 BB 01
				15 00 00 00 00 00 02 BC 8B
				15 00 00 00 00 00 02 BD 01
				15 00 00 00 00 00 02 BE 92
				15 00 00 00 00 00 02 BF 01
				15 00 00 00 00 00 02 C0 98
				15 00 00 00 00 00 02 C1 01
				15 00 00 00 00 00 02 C2 AD
				15 00 00 00 00 00 02 C3 01
				15 00 00 00 00 00 02 C4 C0
				15 00 00 00 00 00 02 C5 01
				15 00 00 00 00 00 02 C6 E0
				15 00 00 00 00 00 02 C7 01
				15 00 00 00 00 00 02 C8 FB
				15 00 00 00 00 00 02 C9 02
				15 00 00 00 00 00 02 CA 29
				15 00 00 00 00 00 02 CB 02
				15 00 00 00 00 00 02 CC 56
				15 00 00 00 00 00 02 CD 02
				15 00 00 00 00 00 02 CE 58
				15 00 00 00 00 00 02 CF 02
				15 00 00 00 00 00 02 D0 85
				15 00 00 00 00 00 02 D1 02
				15 00 00 00 00 00 02 D2 BB
				15 00 00 00 00 00 02 D3 02
				15 00 00 00 00 00 02 D4 E0
				15 00 00 00 00 00 02 D5 03
				15 00 00 00 00 00 02 D6 12
				15 00 00 00 00 00 02 D7 03
				15 00 00 00 00 00 02 D8 2A
				15 00 00 00 00 00 02 D9 03
				15 00 00 00 00 00 02 DA 52
				15 00 00 00 00 00 02 DB 03
				15 00 00 00 00 00 02 DC 60
				15 00 00 00 00 00 02 DD 03
				15 00 00 00 00 00 02 DE 6C
				15 00 00 00 00 00 02 DF 03
				15 00 00 00 00 00 02 E0 7A
				15 00 00 00 00 00 02 E1 03
				15 00 00 00 00 00 02 E2 89
				15 00 00 00 00 00 02 E3 03
				15 00 00 00 00 00 02 E4 9A
				15 00 00 00 00 00 02 E5 03
				15 00 00 00 00 00 02 E6 A9
				15 00 00 00 00 00 02 E7 03
				15 00 00 00 00 00 02 E8 BB
				15 00 00 00 00 00 02 E9 03
				15 00 00 00 00 00 02 EA C6
				15 01 00 00 01 00 02 FF 10
				];
		qcom,mdss-dsi-dispparam-cold-command-state = "dsi_hs_mode";
		qcom,mdss-dsi-dispparam-papermode-command = [
				15 01 00 00 78 00 02 FF 20
				15 00 00 00 01 00 02 FB 01
				15 00 00 00 01 00 02 75 00
				15 00 00 00 01 00 02 76 F0
				15 00 00 00 01 00 02 77 00
				15 00 00 00 01 00 02 78 FA
				15 00 00 00 01 00 02 79 01
				15 00 00 00 01 00 02 7A 0C
				15 00 00 00 01 00 02 7B 01
				15 00 00 00 01 00 02 7C 1C
				15 00 00 00 01 00 02 7D 01
				15 00 00 00 01 00 02 7E 2A
				15 00 00 00 01 00 02 7F 01
				15 00 00 00 01 00 02 80 36
				15 00 00 00 01 00 02 81 01
				15 00 00 00 01 00 02 82 42
				15 00 00 00 01 00 02 83 01
				15 00 00 00 01 00 02 84 4D
				15 00 00 00 01 00 02 85 01
				15 00 00 00 01 00 02 86 57
				15 00 00 00 01 00 02 87 01
				15 00 00 00 01 00 02 88 79
				15 00 00 00 01 00 02 89 01
				15 00 00 00 01 00 02 8A 95
				15 00 00 00 01 00 02 8B 01
				15 00 00 00 01 00 02 8C C3
				15 00 00 00 01 00 02 8D 01
				15 00 00 00 01 00 02 8E E8
				15 00 00 00 01 00 02 8F 02
				15 00 00 00 01 00 02 90 21
				15 00 00 00 01 00 02 91 02
				15 00 00 00 01 00 02 92 51
				15 00 00 00 01 00 02 93 02
				15 00 00 00 01 00 02 94 52
				15 00 00 00 01 00 02 95 02
				15 00 00 00 01 00 02 96 7F
				15 00 00 00 01 00 02 97 02
				15 00 00 00 01 00 02 98 B2
				15 00 00 00 01 00 02 99 02
				15 00 00 00 01 00 02 9A D9
				15 00 00 00 01 00 02 9B 03
				15 00 00 00 01 00 02 9C 04
				15 00 00 00 01 00 02 9D 03
				15 00 00 00 01 00 02 9E 26
				15 00 00 00 01 00 02 9F 03
				15 00 00 00 01 00 02 A0 4E
				15 00 00 00 01 00 02 A2 03
				15 00 00 00 01 00 02 A3 59
				15 00 00 00 01 00 02 A4 03
				15 00 00 00 01 00 02 A5 65
				15 00 00 00 01 00 02 A6 03
				15 00 00 00 01 00 02 A7 73
				15 00 00 00 01 00 02 A9 03
				15 00 00 00 01 00 02 AA 81
				15 00 00 00 01 00 02 AB 03
				15 00 00 00 01 00 02 AC 91
				15 00 00 00 01 00 02 AD 03
				15 00 00 00 01 00 02 AE A2
				15 00 00 00 01 00 02 AF 03
				15 00 00 00 01 00 02 B0 AE
				15 00 00 00 01 00 02 B1 03
				15 00 00 00 01 00 02 B2 FD
				15 00 00 00 01 00 02 B3 00
				15 00 00 00 01 00 02 B4 F0
				15 00 00 00 01 00 02 B5 00
				15 00 00 00 01 00 02 B6 FA
				15 00 00 00 01 00 02 B7 01
				15 00 00 00 01 00 02 B8 0C
				15 00 00 00 01 00 02 B9 01
				15 00 00 00 01 00 02 BA 1C
				15 00 00 00 01 00 02 BB 01
				15 00 00 00 01 00 02 BC 2A
				15 00 00 00 01 00 02 BD 01
				15 00 00 00 01 00 02 BE 36
				15 00 00 00 01 00 02 BF 01
				15 00 00 00 01 00 02 C0 42
				15 00 00 00 01 00 02 C1 01
				15 00 00 00 01 00 02 C2 4D
				15 00 00 00 01 00 02 C3 01
				15 00 00 00 01 00 02 C4 57
				15 00 00 00 01 00 02 C5 01
				15 00 00 00 01 00 02 C6 79
				15 00 00 00 01 00 02 C7 01
				15 00 00 00 01 00 02 C8 95
				15 00 00 00 01 00 02 C9 01
				15 00 00 00 01 00 02 CA C3
				15 00 00 00 01 00 02 CB 01
				15 00 00 00 01 00 02 CC E8
				15 00 00 00 01 00 02 CD 02
				15 00 00 00 01 00 02 CE 21
				15 00 00 00 01 00 02 CF 02
				15 00 00 00 01 00 02 D0 51
				15 00 00 00 01 00 02 D1 02
				15 00 00 00 01 00 02 D2 52
				15 00 00 00 01 00 02 D3 02
				15 00 00 00 01 00 02 D4 7F
				15 00 00 00 01 00 02 D5 02
				15 00 00 00 01 00 02 D6 B2
				15 00 00 00 01 00 02 D7 02
				15 00 00 00 01 00 02 D8 D9
				15 00 00 00 01 00 02 D9 03
				15 00 00 00 01 00 02 DA 04
				15 00 00 00 01 00 02 DB 03
				15 00 00 00 01 00 02 DC 26
				15 00 00 00 01 00 02 DD 03
				15 00 00 00 01 00 02 DE 4E
				15 00 00 00 01 00 02 DF 03
				15 00 00 00 01 00 02 E0 59
				15 00 00 00 01 00 02 E1 03
				15 00 00 00 01 00 02 E2 65
				15 00 00 00 01 00 02 E3 03
				15 00 00 00 01 00 02 E4 73
				15 00 00 00 01 00 02 E5 03
				15 00 00 00 01 00 02 E6 81
				15 00 00 00 01 00 02 E7 03
				15 00 00 00 01 00 02 E8 91
				15 00 00 00 01 00 02 E9 03
				15 00 00 00 01 00 02 EA A2
				15 00 00 00 01 00 02 EB 03
				15 00 00 00 01 00 02 EC AE
				15 00 00 00 01 00 02 ED 03
				15 00 00 00 01 00 02 EE FD
				15 00 00 00 01 00 02 EF 00
				15 00 00 00 01 00 02 F0 BD
				15 00 00 00 01 00 02 F1 00
				15 00 00 00 01 00 02 F2 CC
				15 00 00 00 01 00 02 F3 00
				15 00 00 00 01 00 02 F4 E6
				15 00 00 00 01 00 02 F5 00
				15 00 00 00 01 00 02 F6 FA
				15 00 00 00 01 00 02 F7 01
				15 00 00 00 01 00 02 F8 0B
				15 00 00 00 01 00 02 F9 01
				15 00 00 00 01 00 02 FA 1B
				15 00 00 00 01 00 02 FF 21
				15 00 00 00 01 00 02 FB 01
				15 00 00 00 01 00 02 00 01
				15 00 00 00 01 00 02 01 28
				15 00 00 00 01 00 02 02 01
				15 00 00 00 01 00 02 03 35
				15 00 00 00 01 00 02 04 01
				15 00 00 00 01 00 02 05 40
				15 00 00 00 01 00 02 06 01
				15 00 00 00 01 00 02 07 67
				15 00 00 00 01 00 02 08 01
				15 00 00 00 01 00 02 09 87
				15 00 00 00 01 00 02 0A 01
				15 00 00 00 01 00 02 0B B9
				15 00 00 00 01 00 02 0C 01
				15 00 00 00 01 00 02 0D E0
				15 00 00 00 01 00 02 0E 02
				15 00 00 00 01 00 02 0F 1D
				15 00 00 00 01 00 02 10 02
				15 00 00 00 01 00 02 11 4E
				15 00 00 00 01 00 02 12 02
				15 00 00 00 01 00 02 13 4F
				15 00 00 00 01 00 02 14 02
				15 00 00 00 01 00 02 15 7D
				15 00 00 00 01 00 02 16 02
				15 00 00 00 01 00 02 17 B1
				15 00 00 00 01 00 02 18 02
				15 00 00 00 01 00 02 19 DA
				15 00 00 00 01 00 02 1A 03
				15 00 00 00 01 00 02 1B 06
				15 00 00 00 01 00 02 1C 03
				15 00 00 00 01 00 02 1D 25
				15 00 00 00 01 00 02 1E 03
				15 00 00 00 01 00 02 1F 4D
				15 00 00 00 01 00 02 20 03
				15 00 00 00 01 00 02 21 59
				15 00 00 00 01 00 02 22 03
				15 00 00 00 01 00 02 23 68
				15 00 00 00 01 00 02 24 03
				15 00 00 00 01 00 02 25 7A
				15 00 00 00 01 00 02 26 03
				15 00 00 00 01 00 02 27 91
				15 00 00 00 01 00 02 28 03
				15 00 00 00 01 00 02 29 A5
				15 00 00 00 01 00 02 2A 03
				15 00 00 00 01 00 02 2B B1
				15 00 00 00 01 00 02 2D 03
				15 00 00 00 01 00 02 2F B6
				15 00 00 00 01 00 02 30 03
				15 00 00 00 01 00 02 31 FD
				15 00 00 00 01 00 02 32 00
				15 00 00 00 01 00 02 33 BD
				15 00 00 00 01 00 02 34 00
				15 00 00 00 01 00 02 35 CC
				15 00 00 00 01 00 02 36 00
				15 00 00 00 01 00 02 37 E6
				15 00 00 00 01 00 02 38 00
				15 00 00 00 01 00 02 39 FA
				15 00 00 00 01 00 02 3A 01
				15 00 00 00 01 00 02 3B 0B
				15 00 00 00 01 00 02 3D 01
				15 00 00 00 01 00 02 3F 1B
				15 00 00 00 01 00 02 40 01
				15 00 00 00 01 00 02 41 28
				15 00 00 00 01 00 02 42 01
				15 00 00 00 01 00 02 43 35
				15 00 00 00 01 00 02 44 01
				15 00 00 00 01 00 02 45 40
				15 00 00 00 01 00 02 46 01
				15 00 00 00 01 00 02 47 67
				15 00 00 00 01 00 02 48 01
				15 00 00 00 01 00 02 49 87
				15 00 00 00 01 00 02 4A 01
				15 00 00 00 01 00 02 4B B9
				15 00 00 00 01 00 02 4C 01
				15 00 00 00 01 00 02 4D E0
				15 00 00 00 01 00 02 4E 02
				15 00 00 00 01 00 02 4F 1D
				15 00 00 00 01 00 02 50 02
				15 00 00 00 01 00 02 51 4E
				15 00 00 00 01 00 02 52 02
				15 00 00 00 01 00 02 53 4F
				15 00 00 00 01 00 02 54 02
				15 00 00 00 01 00 02 55 7D
				15 00 00 00 01 00 02 56 02
				15 00 00 00 01 00 02 58 B1
				15 00 00 00 01 00 02 59 02
				15 00 00 00 01 00 02 5A DA
				15 00 00 00 01 00 02 5B 03
				15 00 00 00 01 00 02 5C 06
				15 00 00 00 01 00 02 5D 03
				15 00 00 00 01 00 02 5E 25
				15 00 00 00 01 00 02 5F 03
				15 00 00 00 01 00 02 60 4D
				15 00 00 00 01 00 02 61 03
				15 00 00 00 01 00 02 62 59
				15 00 00 00 01 00 02 63 03
				15 00 00 00 01 00 02 64 68
				15 00 00 00 01 00 02 65 03
				15 00 00 00 01 00 02 66 7A
				15 00 00 00 01 00 02 67 03
				15 00 00 00 01 00 02 68 91
				15 00 00 00 01 00 02 69 03
				15 00 00 00 01 00 02 6A A5
				15 00 00 00 01 00 02 6B 03
				15 00 00 00 01 00 02 6C B1
				15 00 00 00 01 00 02 6D 03
				15 00 00 00 01 00 02 6E B6
				15 00 00 00 01 00 02 6F 03
				15 00 00 00 01 00 02 70 FD
				15 00 00 00 01 00 02 71 02
				15 00 00 00 01 00 02 72 5A
				15 00 00 00 01 00 02 73 02
				15 00 00 00 01 00 02 74 5B
				15 00 00 00 01 00 02 75 02
				15 00 00 00 01 00 02 76 5C
				15 00 00 00 01 00 02 77 02
				15 00 00 00 01 00 02 78 5D
				15 00 00 00 01 00 02 79 02
				15 00 00 00 01 00 02 7A 5F
				15 00 00 00 01 00 02 7B 02
				15 00 00 00 01 00 02 7C 60
				15 00 00 00 01 00 02 7D 02
				15 00 00 00 01 00 02 7E 61
				15 00 00 00 01 00 02 7F 02
				15 00 00 00 01 00 02 80 63
				15 00 00 00 01 00 02 81 02
				15 00 00 00 01 00 02 82 64
				15 00 00 00 01 00 02 83 02
				15 00 00 00 01 00 02 84 69
				15 00 00 00 01 00 02 85 02
				15 00 00 00 01 00 02 86 6F
				15 00 00 00 01 00 02 87 02
				15 00 00 00 01 00 02 88 79
				15 00 00 00 01 00 02 89 02
				15 00 00 00 01 00 02 8A 84
				15 00 00 00 01 00 02 8B 02
				15 00 00 00 01 00 02 8C 9B
				15 00 00 00 01 00 02 8D 02
				15 00 00 00 01 00 02 8E B6
				15 00 00 00 01 00 02 8F 02
				15 00 00 00 01 00 02 90 B7
				15 00 00 00 01 00 02 91 02
				15 00 00 00 01 00 02 92 DD
				15 00 00 00 01 00 02 93 03
				15 00 00 00 01 00 02 94 09
				15 00 00 00 01 00 02 95 03
				15 00 00 00 01 00 02 96 27
				15 00 00 00 01 00 02 97 03
				15 00 00 00 01 00 02 98 49
				15 00 00 00 01 00 02 99 03
				15 00 00 00 01 00 02 9A 5E
				15 00 00 00 01 00 02 9B 03
				15 00 00 00 01 00 02 9C 78
				15 00 00 00 01 00 02 9D 03
				15 00 00 00 01 00 02 9E 80
				15 00 00 00 01 00 02 9F 03
				15 00 00 00 01 00 02 A0 89
				15 00 00 00 01 00 02 A2 03
				15 00 00 00 01 00 02 A3 91
				15 00 00 00 01 00 02 A4 03
				15 00 00 00 01 00 02 A5 9A
				15 00 00 00 01 00 02 A6 03
				15 00 00 00 01 00 02 A7 A0
				15 00 00 00 01 00 02 A9 03
				15 00 00 00 01 00 02 AA A5
				15 00 00 00 01 00 02 AB 03
				15 00 00 00 01 00 02 AC A6
				15 00 00 00 01 00 02 AD 03
				15 00 00 00 01 00 02 AE FD
				15 00 00 00 01 00 02 AF 02
				15 00 00 00 01 00 02 B0 5A
				15 00 00 00 01 00 02 B1 02
				15 00 00 00 01 00 02 B2 5B
				15 00 00 00 01 00 02 B3 02
				15 00 00 00 01 00 02 B4 5C
				15 00 00 00 01 00 02 B5 02
				15 00 00 00 01 00 02 B6 5D
				15 00 00 00 01 00 02 B7 02
				15 00 00 00 01 00 02 B8 5F
				15 00 00 00 01 00 02 B9 02
				15 00 00 00 01 00 02 BA 60
				15 00 00 00 01 00 02 BB 02
				15 00 00 00 01 00 02 BC 61
				15 00 00 00 01 00 02 BD 02
				15 00 00 00 01 00 02 BE 63
				15 00 00 00 01 00 02 BF 02
				15 00 00 00 01 00 02 C0 64
				15 00 00 00 01 00 02 C1 02
				15 00 00 00 01 00 02 C2 69
				15 00 00 00 01 00 02 C3 02
				15 00 00 00 01 00 02 C4 6F
				15 00 00 00 01 00 02 C5 02
				15 00 00 00 01 00 02 C6 79
				15 00 00 00 01 00 02 C7 02
				15 00 00 00 01 00 02 C8 84
				15 00 00 00 01 00 02 C9 02
				15 00 00 00 01 00 02 CA 9B
				15 00 00 00 01 00 02 CB 02
				15 00 00 00 01 00 02 CC B6
				15 00 00 00 01 00 02 CD 02
				15 00 00 00 01 00 02 CE B7
				15 00 00 00 01 00 02 CF 02
				15 00 00 00 01 00 02 D0 DD
				15 00 00 00 01 00 02 D1 03
				15 00 00 00 01 00 02 D2 09
				15 00 00 00 01 00 02 D3 03
				15 00 00 00 01 00 02 D4 27
				15 00 00 00 01 00 02 D5 03
				15 00 00 00 01 00 02 D6 49
				15 00 00 00 01 00 02 D7 03
				15 00 00 00 01 00 02 D8 5E
				15 00 00 00 01 00 02 D9 03
				15 00 00 00 01 00 02 DA 78
				15 00 00 00 01 00 02 DB 03
				15 00 00 00 01 00 02 DC 80
				15 00 00 00 01 00 02 DD 03
				15 00 00 00 01 00 02 DE 89
				15 00 00 00 01 00 02 DF 03
				15 00 00 00 01 00 02 E0 91
				15 00 00 00 01 00 02 E1 03
				15 00 00 00 01 00 02 E2 9A
				15 00 00 00 01 00 02 E3 03
				15 00 00 00 01 00 02 E4 A0
				15 00 00 00 01 00 02 E5 03
				15 00 00 00 01 00 02 E6 A5
				15 00 00 00 01 00 02 E7 03
				15 00 00 00 01 00 02 E8 A6
				15 00 00 00 01 00 02 E9 03
				15 00 00 00 01 00 02 EA FD
				15 00 00 00 01 00 02 FB 01
				15 01 00 00 01 00 02 FF 10
				];
		qcom,mdss-dsi-dispparam-papermode-state = "dsi_hs_mode";
		qcom,mdss-dsi-dispparam-papermode1-command = [
				15 01 00 00 78 00 02 FF 20
				15 00 00 00 01 00 02 FB 01
				15 00 00 00 01 00 02 75 00
				15 00 00 00 01 00 02 76 F0
				15 00 00 00 01 00 02 77 00
				15 00 00 00 01 00 02 78 FA
				15 00 00 00 01 00 02 79 01
				15 00 00 00 01 00 02 7A 0C
				15 00 00 00 01 00 02 7B 01
				15 00 00 00 01 00 02 7C 1C
				15 00 00 00 01 00 02 7D 01
				15 00 00 00 01 00 02 7E 2A
				15 00 00 00 01 00 02 7F 01
				15 00 00 00 01 00 02 80 36
				15 00 00 00 01 00 02 81 01
				15 00 00 00 01 00 02 82 42
				15 00 00 00 01 00 02 83 01
				15 00 00 00 01 00 02 84 4D
				15 00 00 00 01 00 02 85 01
				15 00 00 00 01 00 02 86 57
				15 00 00 00 01 00 02 87 01
				15 00 00 00 01 00 02 88 79
				15 00 00 00 01 00 02 89 01
				15 00 00 00 01 00 02 8A 95
				15 00 00 00 01 00 02 8B 01
				15 00 00 00 01 00 02 8C C3
				15 00 00 00 01 00 02 8D 01
				15 00 00 00 01 00 02 8E E8
				15 00 00 00 01 00 02 8F 02
				15 00 00 00 01 00 02 90 21
				15 00 00 00 01 00 02 91 02
				15 00 00 00 01 00 02 92 51
				15 00 00 00 01 00 02 93 02
				15 00 00 00 01 00 02 94 52
				15 00 00 00 01 00 02 95 02
				15 00 00 00 01 00 02 96 7F
				15 00 00 00 01 00 02 97 02
				15 00 00 00 01 00 02 98 B2
				15 00 00 00 01 00 02 99 02
				15 00 00 00 01 00 02 9A D9
				15 00 00 00 01 00 02 9B 03
				15 00 00 00 01 00 02 9C 04
				15 00 00 00 01 00 02 9D 03
				15 00 00 00 01 00 02 9E 26
				15 00 00 00 01 00 02 9F 03
				15 00 00 00 01 00 02 A0 4E
				15 00 00 00 01 00 02 A2 03
				15 00 00 00 01 00 02 A3 59
				15 00 00 00 01 00 02 A4 03
				15 00 00 00 01 00 02 A5 65
				15 00 00 00 01 00 02 A6 03
				15 00 00 00 01 00 02 A7 73
				15 00 00 00 01 00 02 A9 03
				15 00 00 00 01 00 02 AA 81
				15 00 00 00 01 00 02 AB 03
				15 00 00 00 01 00 02 AC 91
				15 00 00 00 01 00 02 AD 03
				15 00 00 00 01 00 02 AE A2
				15 00 00 00 01 00 02 AF 03
				15 00 00 00 01 00 02 B0 AE
				15 00 00 00 01 00 02 B1 03
				15 00 00 00 01 00 02 B2 FD
				15 00 00 00 01 00 02 B3 00
				15 00 00 00 01 00 02 B4 F0
				15 00 00 00 01 00 02 B5 00
				15 00 00 00 01 00 02 B6 FA
				15 00 00 00 01 00 02 B7 01
				15 00 00 00 01 00 02 B8 0C
				15 00 00 00 01 00 02 B9 01
				15 00 00 00 01 00 02 BA 1C
				15 00 00 00 01 00 02 BB 01
				15 00 00 00 01 00 02 BC 2A
				15 00 00 00 01 00 02 BD 01
				15 00 00 00 01 00 02 BE 36
				15 00 00 00 01 00 02 BF 01
				15 00 00 00 01 00 02 C0 42
				15 00 00 00 01 00 02 C1 01
				15 00 00 00 01 00 02 C2 4D
				15 00 00 00 01 00 02 C3 01
				15 00 00 00 01 00 02 C4 57
				15 00 00 00 01 00 02 C5 01
				15 00 00 00 01 00 02 C6 79
				15 00 00 00 01 00 02 C7 01
				15 00 00 00 01 00 02 C8 95
				15 00 00 00 01 00 02 C9 01
				15 00 00 00 01 00 02 CA C3
				15 00 00 00 01 00 02 CB 01
				15 00 00 00 01 00 02 CC E8
				15 00 00 00 01 00 02 CD 02
				15 00 00 00 01 00 02 CE 21
				15 00 00 00 01 00 02 CF 02
				15 00 00 00 01 00 02 D0 51
				15 00 00 00 01 00 02 D1 02
				15 00 00 00 01 00 02 D2 52
				15 00 00 00 01 00 02 D3 02
				15 00 00 00 01 00 02 D4 7F
				15 00 00 00 01 00 02 D5 02
				15 00 00 00 01 00 02 D6 B2
				15 00 00 00 01 00 02 D7 02
				15 00 00 00 01 00 02 D8 D9
				15 00 00 00 01 00 02 D9 03
				15 00 00 00 01 00 02 DA 04
				15 00 00 00 01 00 02 DB 03
				15 00 00 00 01 00 02 DC 26
				15 00 00 00 01 00 02 DD 03
				15 00 00 00 01 00 02 DE 4E
				15 00 00 00 01 00 02 DF 03
				15 00 00 00 01 00 02 E0 59
				15 00 00 00 01 00 02 E1 03
				15 00 00 00 01 00 02 E2 65
				15 00 00 00 01 00 02 E3 03
				15 00 00 00 01 00 02 E4 73
				15 00 00 00 01 00 02 E5 03
				15 00 00 00 01 00 02 E6 81
				15 00 00 00 01 00 02 E7 03
				15 00 00 00 01 00 02 E8 91
				15 00 00 00 01 00 02 E9 03
				15 00 00 00 01 00 02 EA A2
				15 00 00 00 01 00 02 EB 03
				15 00 00 00 01 00 02 EC AE
				15 00 00 00 01 00 02 ED 03
				15 00 00 00 01 00 02 EE FD
				15 00 00 00 01 00 02 EF 00
				15 00 00 00 01 00 02 F0 BD
				15 00 00 00 01 00 02 F1 00
				15 00 00 00 01 00 02 F2 CC
				15 00 00 00 01 00 02 F3 00
				15 00 00 00 01 00 02 F4 E6
				15 00 00 00 01 00 02 F5 00
				15 00 00 00 01 00 02 F6 FA
				15 00 00 00 01 00 02 F7 01
				15 00 00 00 01 00 02 F8 0B
				15 00 00 00 01 00 02 F9 01
				15 00 00 00 01 00 02 FA 1B
				15 00 00 00 01 00 02 FF 21
				15 00 00 00 01 00 02 FB 01
				15 00 00 00 01 00 02 00 01
				15 00 00 00 01 00 02 01 28
				15 00 00 00 01 00 02 02 01
				15 00 00 00 01 00 02 03 35
				15 00 00 00 01 00 02 04 01
				15 00 00 00 01 00 02 05 40
				15 00 00 00 01 00 02 06 01
				15 00 00 00 01 00 02 07 67
				15 00 00 00 01 00 02 08 01
				15 00 00 00 01 00 02 09 87
				15 00 00 00 01 00 02 0A 01
				15 00 00 00 01 00 02 0B B9
				15 00 00 00 01 00 02 0C 01
				15 00 00 00 01 00 02 0D E0
				15 00 00 00 01 00 02 0E 02
				15 00 00 00 01 00 02 0F 1D
				15 00 00 00 01 00 02 10 02
				15 00 00 00 01 00 02 11 4E
				15 00 00 00 01 00 02 12 02
				15 00 00 00 01 00 02 13 4F
				15 00 00 00 01 00 02 14 02
				15 00 00 00 01 00 02 15 7D
				15 00 00 00 01 00 02 16 02
				15 00 00 00 01 00 02 17 B1
				15 00 00 00 01 00 02 18 02
				15 00 00 00 01 00 02 19 DA
				15 00 00 00 01 00 02 1A 03
				15 00 00 00 01 00 02 1B 06
				15 00 00 00 01 00 02 1C 03
				15 00 00 00 01 00 02 1D 25
				15 00 00 00 01 00 02 1E 03
				15 00 00 00 01 00 02 1F 4D
				15 00 00 00 01 00 02 20 03
				15 00 00 00 01 00 02 21 59
				15 00 00 00 01 00 02 22 03
				15 00 00 00 01 00 02 23 68
				15 00 00 00 01 00 02 24 03
				15 00 00 00 01 00 02 25 7A
				15 00 00 00 01 00 02 26 03
				15 00 00 00 01 00 02 27 91
				15 00 00 00 01 00 02 28 03
				15 00 00 00 01 00 02 29 A5
				15 00 00 00 01 00 02 2A 03
				15 00 00 00 01 00 02 2B B1
				15 00 00 00 01 00 02 2D 03
				15 00 00 00 01 00 02 2F B6
				15 00 00 00 01 00 02 30 03
				15 00 00 00 01 00 02 31 FD
				15 00 00 00 01 00 02 32 00
				15 00 00 00 01 00 02 33 BD
				15 00 00 00 01 00 02 34 00
				15 00 00 00 01 00 02 35 CC
				15 00 00 00 01 00 02 36 00
				15 00 00 00 01 00 02 37 E6
				15 00 00 00 01 00 02 38 00
				15 00 00 00 01 00 02 39 FA
				15 00 00 00 01 00 02 3A 01
				15 00 00 00 01 00 02 3B 0B
				15 00 00 00 01 00 02 3D 01
				15 00 00 00 01 00 02 3F 1B
				15 00 00 00 01 00 02 40 01
				15 00 00 00 01 00 02 41 28
				15 00 00 00 01 00 02 42 01
				15 00 00 00 01 00 02 43 35
				15 00 00 00 01 00 02 44 01
				15 00 00 00 01 00 02 45 40
				15 00 00 00 01 00 02 46 01
				15 00 00 00 01 00 02 47 67
				15 00 00 00 01 00 02 48 01
				15 00 00 00 01 00 02 49 87
				15 00 00 00 01 00 02 4A 01
				15 00 00 00 01 00 02 4B B9
				15 00 00 00 01 00 02 4C 01
				15 00 00 00 01 00 02 4D E0
				15 00 00 00 01 00 02 4E 02
				15 00 00 00 01 00 02 4F 1D
				15 00 00 00 01 00 02 50 02
				15 00 00 00 01 00 02 51 4E
				15 00 00 00 01 00 02 52 02
				15 00 00 00 01 00 02 53 4F
				15 00 00 00 01 00 02 54 02
				15 00 00 00 01 00 02 55 7D
				15 00 00 00 01 00 02 56 02
				15 00 00 00 01 00 02 58 B1
				15 00 00 00 01 00 02 59 02
				15 00 00 00 01 00 02 5A DA
				15 00 00 00 01 00 02 5B 03
				15 00 00 00 01 00 02 5C 06
				15 00 00 00 01 00 02 5D 03
				15 00 00 00 01 00 02 5E 25
				15 00 00 00 01 00 02 5F 03
				15 00 00 00 01 00 02 60 4D
				15 00 00 00 01 00 02 61 03
				15 00 00 00 01 00 02 62 59
				15 00 00 00 01 00 02 63 03
				15 00 00 00 01 00 02 64 68
				15 00 00 00 01 00 02 65 03
				15 00 00 00 01 00 02 66 7A
				15 00 00 00 01 00 02 67 03
				15 00 00 00 01 00 02 68 91
				15 00 00 00 01 00 02 69 03
				15 00 00 00 01 00 02 6A A5
				15 00 00 00 01 00 02 6B 03
				15 00 00 00 01 00 02 6C B1
				15 00 00 00 01 00 02 6D 03
				15 00 00 00 01 00 02 6E B6
				15 00 00 00 01 00 02 6F 03
				15 00 00 00 01 00 02 70 FD
				15 00 00 00 01 00 02 71 01
				15 00 00 00 01 00 02 72 BB
				15 00 00 00 01 00 02 73 01
				15 00 00 00 01 00 02 74 BD
				15 00 00 00 01 00 02 75 01
				15 00 00 00 01 00 02 76 C1
				15 00 00 00 01 00 02 77 01
				15 00 00 00 01 00 02 78 C6
				15 00 00 00 01 00 02 79 01
				15 00 00 00 01 00 02 7A CA
				15 00 00 00 01 00 02 7B 01
				15 00 00 00 01 00 02 7C CE
				15 00 00 00 01 00 02 7D 01
				15 00 00 00 01 00 02 7E D2
				15 00 00 00 01 00 02 7F 01
				15 00 00 00 01 00 02 80 D6
				15 00 00 00 01 00 02 81 01
				15 00 00 00 01 00 02 82 D9
				15 00 00 00 01 00 02 83 01
				15 00 00 00 01 00 02 84 E8
				15 00 00 00 01 00 02 85 01
				15 00 00 00 01 00 02 86 F4
				15 00 00 00 01 00 02 87 02
				15 00 00 00 01 00 02 88 0D
				15 00 00 00 01 00 02 89 02
				15 00 00 00 01 00 02 8A 23
				15 00 00 00 01 00 02 8B 02
				15 00 00 00 01 00 02 8C 4B
				15 00 00 00 01 00 02 8D 02
				15 00 00 00 01 00 02 8E 70
				15 00 00 00 01 00 02 8F 02
				15 00 00 00 01 00 02 90 71
				15 00 00 00 01 00 02 91 02
				15 00 00 00 01 00 02 92 98
				15 00 00 00 01 00 02 93 02
				15 00 00 00 01 00 02 94 CB
				15 00 00 00 01 00 02 95 02
				15 00 00 00 01 00 02 96 EC
				15 00 00 00 01 00 02 97 03
				15 00 00 00 01 00 02 98 1A
				15 00 00 00 01 00 02 99 03
				15 00 00 00 01 00 02 9A 35
				15 00 00 00 01 00 02 9B 03
				15 00 00 00 01 00 02 9C 56
				15 00 00 00 01 00 02 9D 03
				15 00 00 00 01 00 02 9E 60
				15 00 00 00 01 00 02 9F 03
				15 00 00 00 01 00 02 A0 6A
				15 00 00 00 01 00 02 A2 03
				15 00 00 00 01 00 02 A3 76
				15 00 00 00 01 00 02 A4 03
				15 00 00 00 01 00 02 A5 84
				15 00 00 00 01 00 02 A6 03
				15 00 00 00 01 00 02 A7 93
				15 00 00 00 01 00 02 A9 03
				15 00 00 00 01 00 02 AA A0
				15 00 00 00 01 00 02 AB 03
				15 00 00 00 01 00 02 AC A6
				15 00 00 00 01 00 02 AD 03
				15 00 00 00 01 00 02 AE FD
				15 00 00 00 01 00 02 AF 01
				15 00 00 00 01 00 02 B0 BB
				15 00 00 00 01 00 02 B1 01
				15 00 00 00 01 00 02 B2 BD
				15 00 00 00 01 00 02 B3 01
				15 00 00 00 01 00 02 B4 C1
				15 00 00 00 01 00 02 B5 01
				15 00 00 00 01 00 02 B6 C6
				15 00 00 00 01 00 02 B7 01
				15 00 00 00 01 00 02 B8 CA
				15 00 00 00 01 00 02 B9 01
				15 00 00 00 01 00 02 BA CE
				15 00 00 00 01 00 02 BB 01
				15 00 00 00 01 00 02 BC D2
				15 00 00 00 01 00 02 BD 01
				15 00 00 00 01 00 02 BE D6
				15 00 00 00 01 00 02 BF 01
				15 00 00 00 01 00 02 C0 D9
				15 00 00 00 01 00 02 C1 01
				15 00 00 00 01 00 02 C2 E8
				15 00 00 00 01 00 02 C3 01
				15 00 00 00 01 00 02 C4 F4
				15 00 00 00 01 00 02 C5 02
				15 00 00 00 01 00 02 C6 0D
				15 00 00 00 01 00 02 C7 02
				15 00 00 00 01 00 02 C8 23
				15 00 00 00 01 00 02 C9 02
				15 00 00 00 01 00 02 CA 4B
				15 00 00 00 01 00 02 CB 02
				15 00 00 00 01 00 02 CC 70
				15 00 00 00 01 00 02 CD 02
				15 00 00 00 01 00 02 CE 71
				15 00 00 00 01 00 02 CF 02
				15 00 00 00 01 00 02 D0 98
				15 00 00 00 01 00 02 D1 02
				15 00 00 00 01 00 02 D2 CB
				15 00 00 00 01 00 02 D3 02
				15 00 00 00 01 00 02 D4 EC
				15 00 00 00 01 00 02 D5 03
				15 00 00 00 01 00 02 D6 1A
				15 00 00 00 01 00 02 D7 03
				15 00 00 00 01 00 02 D8 35
				15 00 00 00 01 00 02 D9 03
				15 00 00 00 01 00 02 DA 56
				15 00 00 00 01 00 02 DB 03
				15 00 00 00 01 00 02 DC 60
				15 00 00 00 01 00 02 DD 03
				15 00 00 00 01 00 02 DE 6A
				15 00 00 00 01 00 02 DF 03
				15 00 00 00 01 00 02 E0 76
				15 00 00 00 01 00 02 E1 03
				15 00 00 00 01 00 02 E2 84
				15 00 00 00 01 00 02 E3 03
				15 00 00 00 01 00 02 E4 93
				15 00 00 00 01 00 02 E5 03
				15 00 00 00 01 00 02 E6 A0
				15 00 00 00 01 00 02 E7 03
				15 00 00 00 01 00 02 E8 A6
				15 00 00 00 01 00 02 E9 03
				15 00 00 00 01 00 02 EA FD
				15 00 00 00 01 00 02 FB 01
				15 01 00 00 01 00 02 FF 10
				];
		qcom,mdss-dsi-dispparam-papermode1-state = "dsi_hs_mode";
		qcom,mdss-dsi-dispparam-papermode2-command = [
				15 01 00 00 78 00 02 FF 20
				15 00 00 00 01 00 02 FB 01
				15 00 00 00 01 00 02 75 00
				15 00 00 00 01 00 02 76 F0
				15 00 00 00 01 00 02 77 00
				15 00 00 00 01 00 02 78 FA
				15 00 00 00 01 00 02 79 01
				15 00 00 00 01 00 02 7A 0C
				15 00 00 00 01 00 02 7B 01
				15 00 00 00 01 00 02 7C 1C
				15 00 00 00 01 00 02 7D 01
				15 00 00 00 01 00 02 7E 2A
				15 00 00 00 01 00 02 7F 01
				15 00 00 00 01 00 02 80 36
				15 00 00 00 01 00 02 81 01
				15 00 00 00 01 00 02 82 42
				15 00 00 00 01 00 02 83 01
				15 00 00 00 01 00 02 84 4D
				15 00 00 00 01 00 02 85 01
				15 00 00 00 01 00 02 86 57
				15 00 00 00 01 00 02 87 01
				15 00 00 00 01 00 02 88 79
				15 00 00 00 01 00 02 89 01
				15 00 00 00 01 00 02 8A 95
				15 00 00 00 01 00 02 8B 01
				15 00 00 00 01 00 02 8C C3
				15 00 00 00 01 00 02 8D 01
				15 00 00 00 01 00 02 8E E8
				15 00 00 00 01 00 02 8F 02
				15 00 00 00 01 00 02 90 21
				15 00 00 00 01 00 02 91 02
				15 00 00 00 01 00 02 92 51
				15 00 00 00 01 00 02 93 02
				15 00 00 00 01 00 02 94 52
				15 00 00 00 01 00 02 95 02
				15 00 00 00 01 00 02 96 7F
				15 00 00 00 01 00 02 97 02
				15 00 00 00 01 00 02 98 B2
				15 00 00 00 01 00 02 99 02
				15 00 00 00 01 00 02 9A D9
				15 00 00 00 01 00 02 9B 03
				15 00 00 00 01 00 02 9C 04
				15 00 00 00 01 00 02 9D 03
				15 00 00 00 01 00 02 9E 26
				15 00 00 00 01 00 02 9F 03
				15 00 00 00 01 00 02 A0 4E
				15 00 00 00 01 00 02 A2 03
				15 00 00 00 01 00 02 A3 59
				15 00 00 00 01 00 02 A4 03
				15 00 00 00 01 00 02 A5 65
				15 00 00 00 01 00 02 A6 03
				15 00 00 00 01 00 02 A7 73
				15 00 00 00 01 00 02 A9 03
				15 00 00 00 01 00 02 AA 81
				15 00 00 00 01 00 02 AB 03
				15 00 00 00 01 00 02 AC 91
				15 00 00 00 01 00 02 AD 03
				15 00 00 00 01 00 02 AE A2
				15 00 00 00 01 00 02 AF 03
				15 00 00 00 01 00 02 B0 AE
				15 00 00 00 01 00 02 B1 03
				15 00 00 00 01 00 02 B2 FD
				15 00 00 00 01 00 02 B3 00
				15 00 00 00 01 00 02 B4 F0
				15 00 00 00 01 00 02 B5 00
				15 00 00 00 01 00 02 B6 FA
				15 00 00 00 01 00 02 B7 01
				15 00 00 00 01 00 02 B8 0C
				15 00 00 00 01 00 02 B9 01
				15 00 00 00 01 00 02 BA 1C
				15 00 00 00 01 00 02 BB 01
				15 00 00 00 01 00 02 BC 2A
				15 00 00 00 01 00 02 BD 01
				15 00 00 00 01 00 02 BE 36
				15 00 00 00 01 00 02 BF 01
				15 00 00 00 01 00 02 C0 42
				15 00 00 00 01 00 02 C1 01
				15 00 00 00 01 00 02 C2 4D
				15 00 00 00 01 00 02 C3 01
				15 00 00 00 01 00 02 C4 57
				15 00 00 00 01 00 02 C5 01
				15 00 00 00 01 00 02 C6 79
				15 00 00 00 01 00 02 C7 01
				15 00 00 00 01 00 02 C8 95
				15 00 00 00 01 00 02 C9 01
				15 00 00 00 01 00 02 CA C3
				15 00 00 00 01 00 02 CB 01
				15 00 00 00 01 00 02 CC E8
				15 00 00 00 01 00 02 CD 02
				15 00 00 00 01 00 02 CE 21
				15 00 00 00 01 00 02 CF 02
				15 00 00 00 01 00 02 D0 51
				15 00 00 00 01 00 02 D1 02
				15 00 00 00 01 00 02 D2 52
				15 00 00 00 01 00 02 D3 02
				15 00 00 00 01 00 02 D4 7F
				15 00 00 00 01 00 02 D5 02
				15 00 00 00 01 00 02 D6 B2
				15 00 00 00 01 00 02 D7 02
				15 00 00 00 01 00 02 D8 D9
				15 00 00 00 01 00 02 D9 03
				15 00 00 00 01 00 02 DA 04
				15 00 00 00 01 00 02 DB 03
				15 00 00 00 01 00 02 DC 26
				15 00 00 00 01 00 02 DD 03
				15 00 00 00 01 00 02 DE 4E
				15 00 00 00 01 00 02 DF 03
				15 00 00 00 01 00 02 E0 59
				15 00 00 00 01 00 02 E1 03
				15 00 00 00 01 00 02 E2 65
				15 00 00 00 01 00 02 E3 03
				15 00 00 00 01 00 02 E4 73
				15 00 00 00 01 00 02 E5 03
				15 00 00 00 01 00 02 E6 81
				15 00 00 00 01 00 02 E7 03
				15 00 00 00 01 00 02 E8 91
				15 00 00 00 01 00 02 E9 03
				15 00 00 00 01 00 02 EA A2
				15 00 00 00 01 00 02 EB 03
				15 00 00 00 01 00 02 EC AE
				15 00 00 00 01 00 02 ED 03
				15 00 00 00 01 00 02 EE FD
				15 00 00 00 01 00 02 EF 00
				15 00 00 00 01 00 02 F0 BD
				15 00 00 00 01 00 02 F1 00
				15 00 00 00 01 00 02 F2 CC
				15 00 00 00 01 00 02 F3 00
				15 00 00 00 01 00 02 F4 E6
				15 00 00 00 01 00 02 F5 00
				15 00 00 00 01 00 02 F6 FA
				15 00 00 00 01 00 02 F7 01
				15 00 00 00 01 00 02 F8 0B
				15 00 00 00 01 00 02 F9 01
				15 00 00 00 01 00 02 FA 1B
				15 00 00 00 01 00 02 FF 21
				15 00 00 00 01 00 02 FB 01
				15 00 00 00 01 00 02 00 01
				15 00 00 00 01 00 02 01 28
				15 00 00 00 01 00 02 02 01
				15 00 00 00 01 00 02 03 35
				15 00 00 00 01 00 02 04 01
				15 00 00 00 01 00 02 05 40
				15 00 00 00 01 00 02 06 01
				15 00 00 00 01 00 02 07 67
				15 00 00 00 01 00 02 08 01
				15 00 00 00 01 00 02 09 87
				15 00 00 00 01 00 02 0A 01
				15 00 00 00 01 00 02 0B B9
				15 00 00 00 01 00 02 0C 01
				15 00 00 00 01 00 02 0D E0
				15 00 00 00 01 00 02 0E 02
				15 00 00 00 01 00 02 0F 1D
				15 00 00 00 01 00 02 10 02
				15 00 00 00 01 00 02 11 4E
				15 00 00 00 01 00 02 12 02
				15 00 00 00 01 00 02 13 4F
				15 00 00 00 01 00 02 14 02
				15 00 00 00 01 00 02 15 7D
				15 00 00 00 01 00 02 16 02
				15 00 00 00 01 00 02 17 B1
				15 00 00 00 01 00 02 18 02
				15 00 00 00 01 00 02 19 DA
				15 00 00 00 01 00 02 1A 03
				15 00 00 00 01 00 02 1B 06
				15 00 00 00 01 00 02 1C 03
				15 00 00 00 01 00 02 1D 25
				15 00 00 00 01 00 02 1E 03
				15 00 00 00 01 00 02 1F 4D
				15 00 00 00 01 00 02 20 03
				15 00 00 00 01 00 02 21 59
				15 00 00 00 01 00 02 22 03
				15 00 00 00 01 00 02 23 68
				15 00 00 00 01 00 02 24 03
				15 00 00 00 01 00 02 25 7A
				15 00 00 00 01 00 02 26 03
				15 00 00 00 01 00 02 27 91
				15 00 00 00 01 00 02 28 03
				15 00 00 00 01 00 02 29 A5
				15 00 00 00 01 00 02 2A 03
				15 00 00 00 01 00 02 2B B1
				15 00 00 00 01 00 02 2D 03
				15 00 00 00 01 00 02 2F B6
				15 00 00 00 01 00 02 30 03
				15 00 00 00 01 00 02 31 FD
				15 00 00 00 01 00 02 32 00
				15 00 00 00 01 00 02 33 BD
				15 00 00 00 01 00 02 34 00
				15 00 00 00 01 00 02 35 CC
				15 00 00 00 01 00 02 36 00
				15 00 00 00 01 00 02 37 E6
				15 00 00 00 01 00 02 38 00
				15 00 00 00 01 00 02 39 FA
				15 00 00 00 01 00 02 3A 01
				15 00 00 00 01 00 02 3B 0B
				15 00 00 00 01 00 02 3D 01
				15 00 00 00 01 00 02 3F 1B
				15 00 00 00 01 00 02 40 01
				15 00 00 00 01 00 02 41 28
				15 00 00 00 01 00 02 42 01
				15 00 00 00 01 00 02 43 35
				15 00 00 00 01 00 02 44 01
				15 00 00 00 01 00 02 45 40
				15 00 00 00 01 00 02 46 01
				15 00 00 00 01 00 02 47 67
				15 00 00 00 01 00 02 48 01
				15 00 00 00 01 00 02 49 87
				15 00 00 00 01 00 02 4A 01
				15 00 00 00 01 00 02 4B B9
				15 00 00 00 01 00 02 4C 01
				15 00 00 00 01 00 02 4D E0
				15 00 00 00 01 00 02 4E 02
				15 00 00 00 01 00 02 4F 1D
				15 00 00 00 01 00 02 50 02
				15 00 00 00 01 00 02 51 4E
				15 00 00 00 01 00 02 52 02
				15 00 00 00 01 00 02 53 4F
				15 00 00 00 01 00 02 54 02
				15 00 00 00 01 00 02 55 7D
				15 00 00 00 01 00 02 56 02
				15 00 00 00 01 00 02 58 B1
				15 00 00 00 01 00 02 59 02
				15 00 00 00 01 00 02 5A DA
				15 00 00 00 01 00 02 5B 03
				15 00 00 00 01 00 02 5C 06
				15 00 00 00 01 00 02 5D 03
				15 00 00 00 01 00 02 5E 25
				15 00 00 00 01 00 02 5F 03
				15 00 00 00 01 00 02 60 4D
				15 00 00 00 01 00 02 61 03
				15 00 00 00 01 00 02 62 59
				15 00 00 00 01 00 02 63 03
				15 00 00 00 01 00 02 64 68
				15 00 00 00 01 00 02 65 03
				15 00 00 00 01 00 02 66 7A
				15 00 00 00 01 00 02 67 03
				15 00 00 00 01 00 02 68 91
				15 00 00 00 01 00 02 69 03
				15 00 00 00 01 00 02 6A A5
				15 00 00 00 01 00 02 6B 03
				15 00 00 00 01 00 02 6C B1
				15 00 00 00 01 00 02 6D 03
				15 00 00 00 01 00 02 6E B6
				15 00 00 00 01 00 02 6F 03
				15 00 00 00 01 00 02 70 FD
				15 00 00 00 01 00 02 71 01
				15 00 00 00 01 00 02 72 D6
				15 00 00 00 01 00 02 73 01
				15 00 00 00 01 00 02 74 D8
				15 00 00 00 01 00 02 75 01
				15 00 00 00 01 00 02 76 DB
				15 00 00 00 01 00 02 77 01
				15 00 00 00 01 00 02 78 DF
				15 00 00 00 01 00 02 79 01
				15 00 00 00 01 00 02 7A E2
				15 00 00 00 01 00 02 7B 01
				15 00 00 00 01 00 02 7C E6
				15 00 00 00 01 00 02 7D 01
				15 00 00 00 01 00 02 7E E9
				15 00 00 00 01 00 02 7F 01
				15 00 00 00 01 00 02 80 EC
				15 00 00 00 01 00 02 81 01
				15 00 00 00 01 00 02 82 F0
				15 00 00 00 01 00 02 83 01
				15 00 00 00 01 00 02 84 FB
				15 00 00 00 01 00 02 85 02
				15 00 00 00 01 00 02 86 07
				15 00 00 00 01 00 02 87 02
				15 00 00 00 01 00 02 88 1C
				15 00 00 00 01 00 02 89 02
				15 00 00 00 01 00 02 8A 30
				15 00 00 00 01 00 02 8B 02
				15 00 00 00 01 00 02 8C 55
				15 00 00 00 01 00 02 8D 02
				15 00 00 00 01 00 02 8E 78
				15 00 00 00 01 00 02 8F 02
				15 00 00 00 01 00 02 90 79
				15 00 00 00 01 00 02 91 02
				15 00 00 00 01 00 02 92 9F
				15 00 00 00 01 00 02 93 02
				15 00 00 00 01 00 02 94 D5
				15 00 00 00 01 00 02 95 02
				15 00 00 00 01 00 02 96 F5
				15 00 00 00 01 00 02 97 03
				15 00 00 00 01 00 02 98 22
				15 00 00 00 01 00 02 99 03
				15 00 00 00 01 00 02 9A 3E
				15 00 00 00 01 00 02 9B 03
				15 00 00 00 01 00 02 9C 64
				15 00 00 00 01 00 02 9D 03
				15 00 00 00 01 00 02 9E 70
				15 00 00 00 01 00 02 9F 03
				15 00 00 00 01 00 02 A0 80
				15 00 00 00 01 00 02 A2 03
				15 00 00 00 01 00 02 A3 92
				15 00 00 00 01 00 02 A4 03
				15 00 00 00 01 00 02 A5 A2
				15 00 00 00 01 00 02 A6 03
				15 00 00 00 01 00 02 A7 AD
				15 00 00 00 01 00 02 A9 03
				15 00 00 00 01 00 02 AA B4
				15 00 00 00 01 00 02 AB 03
				15 00 00 00 01 00 02 AC B6
				15 00 00 00 01 00 02 AD 03
				15 00 00 00 01 00 02 AE FD
				15 00 00 00 01 00 02 AF 01
				15 00 00 00 01 00 02 B0 D6
				15 00 00 00 01 00 02 B1 01
				15 00 00 00 01 00 02 B2 D8
				15 00 00 00 01 00 02 B3 01
				15 00 00 00 01 00 02 B4 DB
				15 00 00 00 01 00 02 B5 01
				15 00 00 00 01 00 02 B6 DF
				15 00 00 00 01 00 02 B7 01
				15 00 00 00 01 00 02 B8 E2
				15 00 00 00 01 00 02 B9 01
				15 00 00 00 01 00 02 BA E6
				15 00 00 00 01 00 02 BB 01
				15 00 00 00 01 00 02 BC E9
				15 00 00 00 01 00 02 BD 01
				15 00 00 00 01 00 02 BE EC
				15 00 00 00 01 00 02 BF 01
				15 00 00 00 01 00 02 C0 F0
				15 00 00 00 01 00 02 C1 01
				15 00 00 00 01 00 02 C2 FB
				15 00 00 00 01 00 02 C3 02
				15 00 00 00 01 00 02 C4 07
				15 00 00 00 01 00 02 C5 02
				15 00 00 00 01 00 02 C6 1C
				15 00 00 00 01 00 02 C7 02
				15 00 00 00 01 00 02 C8 30
				15 00 00 00 01 00 02 C9 02
				15 00 00 00 01 00 02 CA 55
				15 00 00 00 01 00 02 CB 02
				15 00 00 00 01 00 02 CC 78
				15 00 00 00 01 00 02 CD 02
				15 00 00 00 01 00 02 CE 79
				15 00 00 00 01 00 02 CF 02
				15 00 00 00 01 00 02 D0 9F
				15 00 00 00 01 00 02 D1 02
				15 00 00 00 01 00 02 D2 D5
				15 00 00 00 01 00 02 D3 02
				15 00 00 00 01 00 02 D4 F5
				15 00 00 00 01 00 02 D5 03
				15 00 00 00 01 00 02 D6 22
				15 00 00 00 01 00 02 D7 03
				15 00 00 00 01 00 02 D8 3E
				15 00 00 00 01 00 02 D9 03
				15 00 00 00 01 00 02 DA 64
				15 00 00 00 01 00 02 DB 03
				15 00 00 00 01 00 02 DC 70
				15 00 00 00 01 00 02 DD 03
				15 00 00 00 01 00 02 DE 80
				15 00 00 00 01 00 02 DF 03
				15 00 00 00 01 00 02 E0 92
				15 00 00 00 01 00 02 E1 03
				15 00 00 00 01 00 02 E2 A2
				15 00 00 00 01 00 02 E3 03
				15 00 00 00 01 00 02 E4 AD
				15 00 00 00 01 00 02 E5 03
				15 00 00 00 01 00 02 E6 B4
				15 00 00 00 01 00 02 E7 03
				15 00 00 00 01 00 02 E8 B6
				15 00 00 00 01 00 02 E9 03
				15 00 00 00 01 00 02 EA FD
				15 00 00 00 01 00 02 FB 01
				15 01 00 00 01 00 02 FF 10
				];
		qcom,mdss-dsi-dispparam-papermode2-state = "dsi_hs_mode";
		qcom,mdss-dsi-dispparam-papermode3-command = [
				15 01 00 00 78 00 02 FF 20
				15 00 00 00 01 00 02 FB 01
				15 00 00 00 01 00 02 75 00
				15 00 00 00 01 00 02 76 F0
				15 00 00 00 01 00 02 77 00
				15 00 00 00 01 00 02 78 FA
				15 00 00 00 01 00 02 79 01
				15 00 00 00 01 00 02 7A 0C
				15 00 00 00 01 00 02 7B 01
				15 00 00 00 01 00 02 7C 1C
				15 00 00 00 01 00 02 7D 01
				15 00 00 00 01 00 02 7E 2A
				15 00 00 00 01 00 02 7F 01
				15 00 00 00 01 00 02 80 36
				15 00 00 00 01 00 02 81 01
				15 00 00 00 01 00 02 82 42
				15 00 00 00 01 00 02 83 01
				15 00 00 00 01 00 02 84 4D
				15 00 00 00 01 00 02 85 01
				15 00 00 00 01 00 02 86 57
				15 00 00 00 01 00 02 87 01
				15 00 00 00 01 00 02 88 79
				15 00 00 00 01 00 02 89 01
				15 00 00 00 01 00 02 8A 95
				15 00 00 00 01 00 02 8B 01
				15 00 00 00 01 00 02 8C C3
				15 00 00 00 01 00 02 8D 01
				15 00 00 00 01 00 02 8E E8
				15 00 00 00 01 00 02 8F 02
				15 00 00 00 01 00 02 90 21
				15 00 00 00 01 00 02 91 02
				15 00 00 00 01 00 02 92 51
				15 00 00 00 01 00 02 93 02
				15 00 00 00 01 00 02 94 52
				15 00 00 00 01 00 02 95 02
				15 00 00 00 01 00 02 96 7F
				15 00 00 00 01 00 02 97 02
				15 00 00 00 01 00 02 98 B2
				15 00 00 00 01 00 02 99 02
				15 00 00 00 01 00 02 9A D9
				15 00 00 00 01 00 02 9B 03
				15 00 00 00 01 00 02 9C 04
				15 00 00 00 01 00 02 9D 03
				15 00 00 00 01 00 02 9E 26
				15 00 00 00 01 00 02 9F 03
				15 00 00 00 01 00 02 A0 4E
				15 00 00 00 01 00 02 A2 03
				15 00 00 00 01 00 02 A3 59
				15 00 00 00 01 00 02 A4 03
				15 00 00 00 01 00 02 A5 65
				15 00 00 00 01 00 02 A6 03
				15 00 00 00 01 00 02 A7 73
				15 00 00 00 01 00 02 A9 03
				15 00 00 00 01 00 02 AA 81
				15 00 00 00 01 00 02 AB 03
				15 00 00 00 01 00 02 AC 91
				15 00 00 00 01 00 02 AD 03
				15 00 00 00 01 00 02 AE A2
				15 00 00 00 01 00 02 AF 03
				15 00 00 00 01 00 02 B0 AE
				15 00 00 00 01 00 02 B1 03
				15 00 00 00 01 00 02 B2 FD
				15 00 00 00 01 00 02 B3 00
				15 00 00 00 01 00 02 B4 F0
				15 00 00 00 01 00 02 B5 00
				15 00 00 00 01 00 02 B6 FA
				15 00 00 00 01 00 02 B7 01
				15 00 00 00 01 00 02 B8 0C
				15 00 00 00 01 00 02 B9 01
				15 00 00 00 01 00 02 BA 1C
				15 00 00 00 01 00 02 BB 01
				15 00 00 00 01 00 02 BC 2A
				15 00 00 00 01 00 02 BD 01
				15 00 00 00 01 00 02 BE 36
				15 00 00 00 01 00 02 BF 01
				15 00 00 00 01 00 02 C0 42
				15 00 00 00 01 00 02 C1 01
				15 00 00 00 01 00 02 C2 4D
				15 00 00 00 01 00 02 C3 01
				15 00 00 00 01 00 02 C4 57
				15 00 00 00 01 00 02 C5 01
				15 00 00 00 01 00 02 C6 79
				15 00 00 00 01 00 02 C7 01
				15 00 00 00 01 00 02 C8 95
				15 00 00 00 01 00 02 C9 01
				15 00 00 00 01 00 02 CA C3
				15 00 00 00 01 00 02 CB 01
				15 00 00 00 01 00 02 CC E8
				15 00 00 00 01 00 02 CD 02
				15 00 00 00 01 00 02 CE 21
				15 00 00 00 01 00 02 CF 02
				15 00 00 00 01 00 02 D0 51
				15 00 00 00 01 00 02 D1 02
				15 00 00 00 01 00 02 D2 52
				15 00 00 00 01 00 02 D3 02
				15 00 00 00 01 00 02 D4 7F
				15 00 00 00 01 00 02 D5 02
				15 00 00 00 01 00 02 D6 B2
				15 00 00 00 01 00 02 D7 02
				15 00 00 00 01 00 02 D8 D9
				15 00 00 00 01 00 02 D9 03
				15 00 00 00 01 00 02 DA 04
				15 00 00 00 01 00 02 DB 03
				15 00 00 00 01 00 02 DC 26
				15 00 00 00 01 00 02 DD 03
				15 00 00 00 01 00 02 DE 4E
				15 00 00 00 01 00 02 DF 03
				15 00 00 00 01 00 02 E0 59
				15 00 00 00 01 00 02 E1 03
				15 00 00 00 01 00 02 E2 65
				15 00 00 00 01 00 02 E3 03
				15 00 00 00 01 00 02 E4 73
				15 00 00 00 01 00 02 E5 03
				15 00 00 00 01 00 02 E6 81
				15 00 00 00 01 00 02 E7 03
				15 00 00 00 01 00 02 E8 91
				15 00 00 00 01 00 02 E9 03
				15 00 00 00 01 00 02 EA A2
				15 00 00 00 01 00 02 EB 03
				15 00 00 00 01 00 02 EC AE
				15 00 00 00 01 00 02 ED 03
				15 00 00 00 01 00 02 EE FD
				15 00 00 00 01 00 02 EF 00
				15 00 00 00 01 00 02 F0 BD
				15 00 00 00 01 00 02 F1 00
				15 00 00 00 01 00 02 F2 CC
				15 00 00 00 01 00 02 F3 00
				15 00 00 00 01 00 02 F4 E6
				15 00 00 00 01 00 02 F5 00
				15 00 00 00 01 00 02 F6 FA
				15 00 00 00 01 00 02 F7 01
				15 00 00 00 01 00 02 F8 0B
				15 00 00 00 01 00 02 F9 01
				15 00 00 00 01 00 02 FA 1B
				15 00 00 00 01 00 02 FF 21
				15 00 00 00 01 00 02 FB 01
				15 00 00 00 01 00 02 00 01
				15 00 00 00 01 00 02 01 28
				15 00 00 00 01 00 02 02 01
				15 00 00 00 01 00 02 03 35
				15 00 00 00 01 00 02 04 01
				15 00 00 00 01 00 02 05 40
				15 00 00 00 01 00 02 06 01
				15 00 00 00 01 00 02 07 67
				15 00 00 00 01 00 02 08 01
				15 00 00 00 01 00 02 09 87
				15 00 00 00 01 00 02 0A 01
				15 00 00 00 01 00 02 0B B9
				15 00 00 00 01 00 02 0C 01
				15 00 00 00 01 00 02 0D E0
				15 00 00 00 01 00 02 0E 02
				15 00 00 00 01 00 02 0F 1D
				15 00 00 00 01 00 02 10 02
				15 00 00 00 01 00 02 11 4E
				15 00 00 00 01 00 02 12 02
				15 00 00 00 01 00 02 13 4F
				15 00 00 00 01 00 02 14 02
				15 00 00 00 01 00 02 15 7D
				15 00 00 00 01 00 02 16 02
				15 00 00 00 01 00 02 17 B1
				15 00 00 00 01 00 02 18 02
				15 00 00 00 01 00 02 19 DA
				15 00 00 00 01 00 02 1A 03
				15 00 00 00 01 00 02 1B 06
				15 00 00 00 01 00 02 1C 03
				15 00 00 00 01 00 02 1D 25
				15 00 00 00 01 00 02 1E 03
				15 00 00 00 01 00 02 1F 4D
				15 00 00 00 01 00 02 20 03
				15 00 00 00 01 00 02 21 59
				15 00 00 00 01 00 02 22 03
				15 00 00 00 01 00 02 23 68
				15 00 00 00 01 00 02 24 03
				15 00 00 00 01 00 02 25 7A
				15 00 00 00 01 00 02 26 03
				15 00 00 00 01 00 02 27 91
				15 00 00 00 01 00 02 28 03
				15 00 00 00 01 00 02 29 A5
				15 00 00 00 01 00 02 2A 03
				15 00 00 00 01 00 02 2B B1
				15 00 00 00 01 00 02 2D 03
				15 00 00 00 01 00 02 2F B6
				15 00 00 00 01 00 02 30 03
				15 00 00 00 01 00 02 31 FD
				15 00 00 00 01 00 02 32 00
				15 00 00 00 01 00 02 33 BD
				15 00 00 00 01 00 02 34 00
				15 00 00 00 01 00 02 35 CC
				15 00 00 00 01 00 02 36 00
				15 00 00 00 01 00 02 37 E6
				15 00 00 00 01 00 02 38 00
				15 00 00 00 01 00 02 39 FA
				15 00 00 00 01 00 02 3A 01
				15 00 00 00 01 00 02 3B 0B
				15 00 00 00 01 00 02 3D 01
				15 00 00 00 01 00 02 3F 1B
				15 00 00 00 01 00 02 40 01
				15 00 00 00 01 00 02 41 28
				15 00 00 00 01 00 02 42 01
				15 00 00 00 01 00 02 43 35
				15 00 00 00 01 00 02 44 01
				15 00 00 00 01 00 02 45 40
				15 00 00 00 01 00 02 46 01
				15 00 00 00 01 00 02 47 67
				15 00 00 00 01 00 02 48 01
				15 00 00 00 01 00 02 49 87
				15 00 00 00 01 00 02 4A 01
				15 00 00 00 01 00 02 4B B9
				15 00 00 00 01 00 02 4C 01
				15 00 00 00 01 00 02 4D E0
				15 00 00 00 01 00 02 4E 02
				15 00 00 00 01 00 02 4F 1D
				15 00 00 00 01 00 02 50 02
				15 00 00 00 01 00 02 51 4E
				15 00 00 00 01 00 02 52 02
				15 00 00 00 01 00 02 53 4F
				15 00 00 00 01 00 02 54 02
				15 00 00 00 01 00 02 55 7D
				15 00 00 00 01 00 02 56 02
				15 00 00 00 01 00 02 58 B1
				15 00 00 00 01 00 02 59 02
				15 00 00 00 01 00 02 5A DA
				15 00 00 00 01 00 02 5B 03
				15 00 00 00 01 00 02 5C 06
				15 00 00 00 01 00 02 5D 03
				15 00 00 00 01 00 02 5E 25
				15 00 00 00 01 00 02 5F 03
				15 00 00 00 01 00 02 60 4D
				15 00 00 00 01 00 02 61 03
				15 00 00 00 01 00 02 62 59
				15 00 00 00 01 00 02 63 03
				15 00 00 00 01 00 02 64 68
				15 00 00 00 01 00 02 65 03
				15 00 00 00 01 00 02 66 7A
				15 00 00 00 01 00 02 67 03
				15 00 00 00 01 00 02 68 91
				15 00 00 00 01 00 02 69 03
				15 00 00 00 01 00 02 6A A5
				15 00 00 00 01 00 02 6B 03
				15 00 00 00 01 00 02 6C B1
				15 00 00 00 01 00 02 6D 03
				15 00 00 00 01 00 02 6E B6
				15 00 00 00 01 00 02 6F 03
				15 00 00 00 01 00 02 70 FD
				15 00 00 00 01 00 02 71 01
				15 00 00 00 01 00 02 72 F2
				15 00 00 00 01 00 02 73 01
				15 00 00 00 01 00 02 74 F3
				15 00 00 00 01 00 02 75 01
				15 00 00 00 01 00 02 76 F5
				15 00 00 00 01 00 02 77 01
				15 00 00 00 01 00 02 78 F8
				15 00 00 00 01 00 02 79 01
				15 00 00 00 01 00 02 7A FB
				15 00 00 00 01 00 02 7B 01
				15 00 00 00 01 00 02 7C FE
				15 00 00 00 01 00 02 7D 02
				15 00 00 00 01 00 02 7E 01
				15 00 00 00 01 00 02 7F 02
				15 00 00 00 01 00 02 80 03
				15 00 00 00 01 00 02 81 02
				15 00 00 00 01 00 02 82 06
				15 00 00 00 01 00 02 83 02
				15 00 00 00 01 00 02 84 10
				15 00 00 00 01 00 02 85 02
				15 00 00 00 01 00 02 86 1A
				15 00 00 00 01 00 02 87 02
				15 00 00 00 01 00 02 88 2D
				15 00 00 00 01 00 02 89 02
				15 00 00 00 01 00 02 8A 3E
				15 00 00 00 01 00 02 8B 02
				15 00 00 00 01 00 02 8C 5F
				15 00 00 00 01 00 02 8D 02
				15 00 00 00 01 00 02 8E 80
				15 00 00 00 01 00 02 8F 02
				15 00 00 00 01 00 02 90 81
				15 00 00 00 01 00 02 91 02
				15 00 00 00 01 00 02 92 A5
				15 00 00 00 01 00 02 93 02
				15 00 00 00 01 00 02 94 DB
				15 00 00 00 01 00 02 95 02
				15 00 00 00 01 00 02 96 F6
				15 00 00 00 01 00 02 97 03
				15 00 00 00 01 00 02 98 27
				15 00 00 00 01 00 02 99 03
				15 00 00 00 01 00 02 9A 44
				15 00 00 00 01 00 02 9B 03
				15 00 00 00 01 00 02 9C 65
				15 00 00 00 01 00 02 9D 03
				15 00 00 00 01 00 02 9E 6F
				15 00 00 00 01 00 02 9F 03
				15 00 00 00 01 00 02 A0 79
				15 00 00 00 01 00 02 A2 03
				15 00 00 00 01 00 02 A3 84
				15 00 00 00 01 00 02 A4 03
				15 00 00 00 01 00 02 A5 90
				15 00 00 00 01 00 02 A6 03
				15 00 00 00 01 00 02 A7 9C
				15 00 00 00 01 00 02 A9 03
				15 00 00 00 01 00 02 AA A8
				15 00 00 00 01 00 02 AB 03
				15 00 00 00 01 00 02 AC AF
				15 00 00 00 01 00 02 AD 03
				15 00 00 00 01 00 02 AE FD
				15 00 00 00 01 00 02 AF 01
				15 00 00 00 01 00 02 B0 F2
				15 00 00 00 01 00 02 B1 01
				15 00 00 00 01 00 02 B2 F3
				15 00 00 00 01 00 02 B3 01
				15 00 00 00 01 00 02 B4 F5
				15 00 00 00 01 00 02 B5 01
				15 00 00 00 01 00 02 B6 F8
				15 00 00 00 01 00 02 B7 01
				15 00 00 00 01 00 02 B8 FB
				15 00 00 00 01 00 02 B9 01
				15 00 00 00 01 00 02 BA FE
				15 00 00 00 01 00 02 BB 02
				15 00 00 00 01 00 02 BC 01
				15 00 00 00 01 00 02 BD 02
				15 00 00 00 01 00 02 BE 03
				15 00 00 00 01 00 02 BF 02
				15 00 00 00 01 00 02 C0 06
				15 00 00 00 01 00 02 C1 02
				15 00 00 00 01 00 02 C2 10
				15 00 00 00 01 00 02 C3 02
				15 00 00 00 01 00 02 C4 1A
				15 00 00 00 01 00 02 C5 02
				15 00 00 00 01 00 02 C6 2D
				15 00 00 00 01 00 02 C7 02
				15 00 00 00 01 00 02 C8 3E
				15 00 00 00 01 00 02 C9 02
				15 00 00 00 01 00 02 CA 5F
				15 00 00 00 01 00 02 CB 02
				15 00 00 00 01 00 02 CC 80
				15 00 00 00 01 00 02 CD 02
				15 00 00 00 01 00 02 CE 81
				15 00 00 00 01 00 02 CF 02
				15 00 00 00 01 00 02 D0 A5
				15 00 00 00 01 00 02 D1 02
				15 00 00 00 01 00 02 D2 DB
				15 00 00 00 01 00 02 D3 02
				15 00 00 00 01 00 02 D4 F6
				15 00 00 00 01 00 02 D5 03
				15 00 00 00 01 00 02 D6 27
				15 00 00 00 01 00 02 D7 03
				15 00 00 00 01 00 02 D8 44
				15 00 00 00 01 00 02 D9 03
				15 00 00 00 01 00 02 DA 65
				15 00 00 00 01 00 02 DB 03
				15 00 00 00 01 00 02 DC 6F
				15 00 00 00 01 00 02 DD 03
				15 00 00 00 01 00 02 DE 79
				15 00 00 00 01 00 02 DF 03
				15 00 00 00 01 00 02 E0 84
				15 00 00 00 01 00 02 E1 03
				15 00 00 00 01 00 02 E2 90
				15 00 00 00 01 00 02 E3 03
				15 00 00 00 01 00 02 E4 9C
				15 00 00 00 01 00 02 E5 03
				15 00 00 00 01 00 02 E6 A8
				15 00 00 00 01 00 02 E7 03
				15 00 00 00 01 00 02 E8 AF
				15 00 00 00 01 00 02 E9 03
				15 00 00 00 01 00 02 EA FD
				15 00 00 00 01 00 02 FB 01
				15 01 00 00 01 00 02 FF 10
				];
		qcom,mdss-dsi-dispparam-papermode3-state = "dsi_hs_mode";
		qcom,mdss-dsi-dispparam-papermode4-command = [
				15 01 00 00 78 00 02 FF 20
				15 00 00 00 01 00 02 FB 01
				15 00 00 00 01 00 02 75 00
				15 00 00 00 01 00 02 76 F0
				15 00 00 00 01 00 02 77 00
				15 00 00 00 01 00 02 78 FA
				15 00 00 00 01 00 02 79 01
				15 00 00 00 01 00 02 7A 0C
				15 00 00 00 01 00 02 7B 01
				15 00 00 00 01 00 02 7C 1C
				15 00 00 00 01 00 02 7D 01
				15 00 00 00 01 00 02 7E 2A
				15 00 00 00 01 00 02 7F 01
				15 00 00 00 01 00 02 80 36
				15 00 00 00 01 00 02 81 01
				15 00 00 00 01 00 02 82 42
				15 00 00 00 01 00 02 83 01
				15 00 00 00 01 00 02 84 4D
				15 00 00 00 01 00 02 85 01
				15 00 00 00 01 00 02 86 57
				15 00 00 00 01 00 02 87 01
				15 00 00 00 01 00 02 88 79
				15 00 00 00 01 00 02 89 01
				15 00 00 00 01 00 02 8A 95
				15 00 00 00 01 00 02 8B 01
				15 00 00 00 01 00 02 8C C3
				15 00 00 00 01 00 02 8D 01
				15 00 00 00 01 00 02 8E E8
				15 00 00 00 01 00 02 8F 02
				15 00 00 00 01 00 02 90 21
				15 00 00 00 01 00 02 91 02
				15 00 00 00 01 00 02 92 51
				15 00 00 00 01 00 02 93 02
				15 00 00 00 01 00 02 94 52
				15 00 00 00 01 00 02 95 02
				15 00 00 00 01 00 02 96 7F
				15 00 00 00 01 00 02 97 02
				15 00 00 00 01 00 02 98 B2
				15 00 00 00 01 00 02 99 02
				15 00 00 00 01 00 02 9A D9
				15 00 00 00 01 00 02 9B 03
				15 00 00 00 01 00 02 9C 04
				15 00 00 00 01 00 02 9D 03
				15 00 00 00 01 00 02 9E 26
				15 00 00 00 01 00 02 9F 03
				15 00 00 00 01 00 02 A0 4E
				15 00 00 00 01 00 02 A2 03
				15 00 00 00 01 00 02 A3 59
				15 00 00 00 01 00 02 A4 03
				15 00 00 00 01 00 02 A5 65
				15 00 00 00 01 00 02 A6 03
				15 00 00 00 01 00 02 A7 73
				15 00 00 00 01 00 02 A9 03
				15 00 00 00 01 00 02 AA 81
				15 00 00 00 01 00 02 AB 03
				15 00 00 00 01 00 02 AC 91
				15 00 00 00 01 00 02 AD 03
				15 00 00 00 01 00 02 AE A2
				15 00 00 00 01 00 02 AF 03
				15 00 00 00 01 00 02 B0 AE
				15 00 00 00 01 00 02 B1 03
				15 00 00 00 01 00 02 B2 FD
				15 00 00 00 01 00 02 B3 00
				15 00 00 00 01 00 02 B4 F0
				15 00 00 00 01 00 02 B5 00
				15 00 00 00 01 00 02 B6 FA
				15 00 00 00 01 00 02 B7 01
				15 00 00 00 01 00 02 B8 0C
				15 00 00 00 01 00 02 B9 01
				15 00 00 00 01 00 02 BA 1C
				15 00 00 00 01 00 02 BB 01
				15 00 00 00 01 00 02 BC 2A
				15 00 00 00 01 00 02 BD 01
				15 00 00 00 01 00 02 BE 36
				15 00 00 00 01 00 02 BF 01
				15 00 00 00 01 00 02 C0 42
				15 00 00 00 01 00 02 C1 01
				15 00 00 00 01 00 02 C2 4D
				15 00 00 00 01 00 02 C3 01
				15 00 00 00 01 00 02 C4 57
				15 00 00 00 01 00 02 C5 01
				15 00 00 00 01 00 02 C6 79
				15 00 00 00 01 00 02 C7 01
				15 00 00 00 01 00 02 C8 95
				15 00 00 00 01 00 02 C9 01
				15 00 00 00 01 00 02 CA C3
				15 00 00 00 01 00 02 CB 01
				15 00 00 00 01 00 02 CC E8
				15 00 00 00 01 00 02 CD 02
				15 00 00 00 01 00 02 CE 21
				15 00 00 00 01 00 02 CF 02
				15 00 00 00 01 00 02 D0 51
				15 00 00 00 01 00 02 D1 02
				15 00 00 00 01 00 02 D2 52
				15 00 00 00 01 00 02 D3 02
				15 00 00 00 01 00 02 D4 7F
				15 00 00 00 01 00 02 D5 02
				15 00 00 00 01 00 02 D6 B2
				15 00 00 00 01 00 02 D7 02
				15 00 00 00 01 00 02 D8 D9
				15 00 00 00 01 00 02 D9 03
				15 00 00 00 01 00 02 DA 04
				15 00 00 00 01 00 02 DB 03
				15 00 00 00 01 00 02 DC 26
				15 00 00 00 01 00 02 DD 03
				15 00 00 00 01 00 02 DE 4E
				15 00 00 00 01 00 02 DF 03
				15 00 00 00 01 00 02 E0 59
				15 00 00 00 01 00 02 E1 03
				15 00 00 00 01 00 02 E2 65
				15 00 00 00 01 00 02 E3 03
				15 00 00 00 01 00 02 E4 73
				15 00 00 00 01 00 02 E5 03
				15 00 00 00 01 00 02 E6 81
				15 00 00 00 01 00 02 E7 03
				15 00 00 00 01 00 02 E8 91
				15 00 00 00 01 00 02 E9 03
				15 00 00 00 01 00 02 EA A2
				15 00 00 00 01 00 02 EB 03
				15 00 00 00 01 00 02 EC AE
				15 00 00 00 01 00 02 ED 03
				15 00 00 00 01 00 02 EE FD
				15 00 00 00 01 00 02 EF 00
				15 00 00 00 01 00 02 F0 BD
				15 00 00 00 01 00 02 F1 00
				15 00 00 00 01 00 02 F2 CC
				15 00 00 00 01 00 02 F3 00
				15 00 00 00 01 00 02 F4 E6
				15 00 00 00 01 00 02 F5 00
				15 00 00 00 01 00 02 F6 FA
				15 00 00 00 01 00 02 F7 01
				15 00 00 00 01 00 02 F8 0B
				15 00 00 00 01 00 02 F9 01
				15 00 00 00 01 00 02 FA 1B
				15 00 00 00 01 00 02 FF 21
				15 00 00 00 01 00 02 FB 01
				15 00 00 00 01 00 02 00 01
				15 00 00 00 01 00 02 01 28
				15 00 00 00 01 00 02 02 01
				15 00 00 00 01 00 02 03 35
				15 00 00 00 01 00 02 04 01
				15 00 00 00 01 00 02 05 40
				15 00 00 00 01 00 02 06 01
				15 00 00 00 01 00 02 07 67
				15 00 00 00 01 00 02 08 01
				15 00 00 00 01 00 02 09 87
				15 00 00 00 01 00 02 0A 01
				15 00 00 00 01 00 02 0B B9
				15 00 00 00 01 00 02 0C 01
				15 00 00 00 01 00 02 0D E0
				15 00 00 00 01 00 02 0E 02
				15 00 00 00 01 00 02 0F 1D
				15 00 00 00 01 00 02 10 02
				15 00 00 00 01 00 02 11 4E
				15 00 00 00 01 00 02 12 02
				15 00 00 00 01 00 02 13 4F
				15 00 00 00 01 00 02 14 02
				15 00 00 00 01 00 02 15 7D
				15 00 00 00 01 00 02 16 02
				15 00 00 00 01 00 02 17 B1
				15 00 00 00 01 00 02 18 02
				15 00 00 00 01 00 02 19 DA
				15 00 00 00 01 00 02 1A 03
				15 00 00 00 01 00 02 1B 06
				15 00 00 00 01 00 02 1C 03
				15 00 00 00 01 00 02 1D 25
				15 00 00 00 01 00 02 1E 03
				15 00 00 00 01 00 02 1F 4D
				15 00 00 00 01 00 02 20 03
				15 00 00 00 01 00 02 21 59
				15 00 00 00 01 00 02 22 03
				15 00 00 00 01 00 02 23 68
				15 00 00 00 01 00 02 24 03
				15 00 00 00 01 00 02 25 7A
				15 00 00 00 01 00 02 26 03
				15 00 00 00 01 00 02 27 91
				15 00 00 00 01 00 02 28 03
				15 00 00 00 01 00 02 29 A5
				15 00 00 00 01 00 02 2A 03
				15 00 00 00 01 00 02 2B B1
				15 00 00 00 01 00 02 2D 03
				15 00 00 00 01 00 02 2F B6
				15 00 00 00 01 00 02 30 03
				15 00 00 00 01 00 02 31 FD
				15 00 00 00 01 00 02 32 00
				15 00 00 00 01 00 02 33 BD
				15 00 00 00 01 00 02 34 00
				15 00 00 00 01 00 02 35 CC
				15 00 00 00 01 00 02 36 00
				15 00 00 00 01 00 02 37 E6
				15 00 00 00 01 00 02 38 00
				15 00 00 00 01 00 02 39 FA
				15 00 00 00 01 00 02 3A 01
				15 00 00 00 01 00 02 3B 0B
				15 00 00 00 01 00 02 3D 01
				15 00 00 00 01 00 02 3F 1B
				15 00 00 00 01 00 02 40 01
				15 00 00 00 01 00 02 41 28
				15 00 00 00 01 00 02 42 01
				15 00 00 00 01 00 02 43 35
				15 00 00 00 01 00 02 44 01
				15 00 00 00 01 00 02 45 40
				15 00 00 00 01 00 02 46 01
				15 00 00 00 01 00 02 47 67
				15 00 00 00 01 00 02 48 01
				15 00 00 00 01 00 02 49 87
				15 00 00 00 01 00 02 4A 01
				15 00 00 00 01 00 02 4B B9
				15 00 00 00 01 00 02 4C 01
				15 00 00 00 01 00 02 4D E0
				15 00 00 00 01 00 02 4E 02
				15 00 00 00 01 00 02 4F 1D
				15 00 00 00 01 00 02 50 02
				15 00 00 00 01 00 02 51 4E
				15 00 00 00 01 00 02 52 02
				15 00 00 00 01 00 02 53 4F
				15 00 00 00 01 00 02 54 02
				15 00 00 00 01 00 02 55 7D
				15 00 00 00 01 00 02 56 02
				15 00 00 00 01 00 02 58 B1
				15 00 00 00 01 00 02 59 02
				15 00 00 00 01 00 02 5A DA
				15 00 00 00 01 00 02 5B 03
				15 00 00 00 01 00 02 5C 06
				15 00 00 00 01 00 02 5D 03
				15 00 00 00 01 00 02 5E 25
				15 00 00 00 01 00 02 5F 03
				15 00 00 00 01 00 02 60 4D
				15 00 00 00 01 00 02 61 03
				15 00 00 00 01 00 02 62 59
				15 00 00 00 01 00 02 63 03
				15 00 00 00 01 00 02 64 68
				15 00 00 00 01 00 02 65 03
				15 00 00 00 01 00 02 66 7A
				15 00 00 00 01 00 02 67 03
				15 00 00 00 01 00 02 68 91
				15 00 00 00 01 00 02 69 03
				15 00 00 00 01 00 02 6A A5
				15 00 00 00 01 00 02 6B 03
				15 00 00 00 01 00 02 6C B1
				15 00 00 00 01 00 02 6D 03
				15 00 00 00 01 00 02 6E B6
				15 00 00 00 01 00 02 6F 03
				15 00 00 00 01 00 02 70 FD
				15 00 00 00 01 00 02 71 02
				15 00 00 00 01 00 02 72 0C
				15 00 00 00 01 00 02 73 02
				15 00 00 00 01 00 02 74 0D
				15 00 00 00 01 00 02 75 02
				15 00 00 00 01 00 02 76 10
				15 00 00 00 01 00 02 77 02
				15 00 00 00 01 00 02 78 12
				15 00 00 00 01 00 02 79 02
				15 00 00 00 01 00 02 7A 14
				15 00 00 00 01 00 02 7B 02
				15 00 00 00 01 00 02 7C 16
				15 00 00 00 01 00 02 7D 02
				15 00 00 00 01 00 02 7E 19
				15 00 00 00 01 00 02 7F 02
				15 00 00 00 01 00 02 80 1B
				15 00 00 00 01 00 02 81 02
				15 00 00 00 01 00 02 82 1D
				15 00 00 00 01 00 02 83 02
				15 00 00 00 01 00 02 84 26
				15 00 00 00 01 00 02 85 02
				15 00 00 00 01 00 02 86 2E
				15 00 00 00 01 00 02 87 02
				15 00 00 00 01 00 02 88 3F
				15 00 00 00 01 00 02 89 02
				15 00 00 00 01 00 02 8A 4E
				15 00 00 00 01 00 02 8B 02
				15 00 00 00 01 00 02 8C 6D
				15 00 00 00 01 00 02 8D 02
				15 00 00 00 01 00 02 8E 8C
				15 00 00 00 01 00 02 8F 02
				15 00 00 00 01 00 02 90 8D
				15 00 00 00 01 00 02 91 02
				15 00 00 00 01 00 02 92 B0
				15 00 00 00 01 00 02 93 02
				15 00 00 00 01 00 02 94 E4
				15 00 00 00 01 00 02 95 03
				15 00 00 00 01 00 02 96 03
				15 00 00 00 01 00 02 97 03
				15 00 00 00 01 00 02 98 2D
				15 00 00 00 01 00 02 99 03
				15 00 00 00 01 00 02 9A 45
				15 00 00 00 01 00 02 9B 03
				15 00 00 00 01 00 02 9C 63
				15 00 00 00 01 00 02 9D 03
				15 00 00 00 01 00 02 9E 6C
				15 00 00 00 01 00 02 9F 03
				15 00 00 00 01 00 02 A0 76
				15 00 00 00 01 00 02 A2 03
				15 00 00 00 01 00 02 A3 81
				15 00 00 00 01 00 02 A4 03
				15 00 00 00 01 00 02 A5 8D
				15 00 00 00 01 00 02 A6 03
				15 00 00 00 01 00 02 A7 99
				15 00 00 00 01 00 02 A9 03
				15 00 00 00 01 00 02 AA A2
				15 00 00 00 01 00 02 AB 03
				15 00 00 00 01 00 02 AC A6
				15 00 00 00 01 00 02 AD 03
				15 00 00 00 01 00 02 AE FD
				15 00 00 00 01 00 02 AF 02
				15 00 00 00 01 00 02 B0 0C
				15 00 00 00 01 00 02 B1 02
				15 00 00 00 01 00 02 B2 0D
				15 00 00 00 01 00 02 B3 02
				15 00 00 00 01 00 02 B4 10
				15 00 00 00 01 00 02 B5 02
				15 00 00 00 01 00 02 B6 12
				15 00 00 00 01 00 02 B7 02
				15 00 00 00 01 00 02 B8 14
				15 00 00 00 01 00 02 B9 02
				15 00 00 00 01 00 02 BA 16
				15 00 00 00 01 00 02 BB 02
				15 00 00 00 01 00 02 BC 19
				15 00 00 00 01 00 02 BD 02
				15 00 00 00 01 00 02 BE 1B
				15 00 00 00 01 00 02 BF 02
				15 00 00 00 01 00 02 C0 1D
				15 00 00 00 01 00 02 C1 02
				15 00 00 00 01 00 02 C2 26
				15 00 00 00 01 00 02 C3 02
				15 00 00 00 01 00 02 C4 2E
				15 00 00 00 01 00 02 C5 02
				15 00 00 00 01 00 02 C6 3F
				15 00 00 00 01 00 02 C7 02
				15 00 00 00 01 00 02 C8 4E
				15 00 00 00 01 00 02 C9 02
				15 00 00 00 01 00 02 CA 6D
				15 00 00 00 01 00 02 CB 02
				15 00 00 00 01 00 02 CC 8C
				15 00 00 00 01 00 02 CD 02
				15 00 00 00 01 00 02 CE 8D
				15 00 00 00 01 00 02 CF 02
				15 00 00 00 01 00 02 D0 B0
				15 00 00 00 01 00 02 D1 02
				15 00 00 00 01 00 02 D2 E4
				15 00 00 00 01 00 02 D3 03
				15 00 00 00 01 00 02 D4 03
				15 00 00 00 01 00 02 D5 03
				15 00 00 00 01 00 02 D6 2D
				15 00 00 00 01 00 02 D7 03
				15 00 00 00 01 00 02 D8 45
				15 00 00 00 01 00 02 D9 03
				15 00 00 00 01 00 02 DA 63
				15 00 00 00 01 00 02 DB 03
				15 00 00 00 01 00 02 DC 6C
				15 00 00 00 01 00 02 DD 03
				15 00 00 00 01 00 02 DE 76
				15 00 00 00 01 00 02 DF 03
				15 00 00 00 01 00 02 E0 81
				15 00 00 00 01 00 02 E1 03
				15 00 00 00 01 00 02 E2 8D
				15 00 00 00 01 00 02 E3 03
				15 00 00 00 01 00 02 E4 99
				15 00 00 00 01 00 02 E5 03
				15 00 00 00 01 00 02 E6 A2
				15 00 00 00 01 00 02 E7 03
				15 00 00 00 01 00 02 E8 A6
				15 00 00 00 01 00 02 E9 03
				15 00 00 00 01 00 02 EA FD
				15 00 00 00 01 00 02 FB 01
				15 01 00 00 01 00 02 FF 10
				];
		qcom,mdss-dsi-dispparam-papermode4-state = "dsi_hs_mode";
		qcom,mdss-dsi-dispparam-papermode5-command = [
				15 01 00 00 78 00 02 FF 20
				15 00 00 00 01 00 02 FB 01
				15 00 00 00 01 00 02 75 00
				15 00 00 00 01 00 02 76 F0
				15 00 00 00 01 00 02 77 00
				15 00 00 00 01 00 02 78 FA
				15 00 00 00 01 00 02 79 01
				15 00 00 00 01 00 02 7A 0C
				15 00 00 00 01 00 02 7B 01
				15 00 00 00 01 00 02 7C 1C
				15 00 00 00 01 00 02 7D 01
				15 00 00 00 01 00 02 7E 2A
				15 00 00 00 01 00 02 7F 01
				15 00 00 00 01 00 02 80 36
				15 00 00 00 01 00 02 81 01
				15 00 00 00 01 00 02 82 42
				15 00 00 00 01 00 02 83 01
				15 00 00 00 01 00 02 84 4D
				15 00 00 00 01 00 02 85 01
				15 00 00 00 01 00 02 86 57
				15 00 00 00 01 00 02 87 01
				15 00 00 00 01 00 02 88 79
				15 00 00 00 01 00 02 89 01
				15 00 00 00 01 00 02 8A 95
				15 00 00 00 01 00 02 8B 01
				15 00 00 00 01 00 02 8C C3
				15 00 00 00 01 00 02 8D 01
				15 00 00 00 01 00 02 8E E8
				15 00 00 00 01 00 02 8F 02
				15 00 00 00 01 00 02 90 21
				15 00 00 00 01 00 02 91 02
				15 00 00 00 01 00 02 92 51
				15 00 00 00 01 00 02 93 02
				15 00 00 00 01 00 02 94 52
				15 00 00 00 01 00 02 95 02
				15 00 00 00 01 00 02 96 7F
				15 00 00 00 01 00 02 97 02
				15 00 00 00 01 00 02 98 B2
				15 00 00 00 01 00 02 99 02
				15 00 00 00 01 00 02 9A D9
				15 00 00 00 01 00 02 9B 03
				15 00 00 00 01 00 02 9C 04
				15 00 00 00 01 00 02 9D 03
				15 00 00 00 01 00 02 9E 26
				15 00 00 00 01 00 02 9F 03
				15 00 00 00 01 00 02 A0 4E
				15 00 00 00 01 00 02 A2 03
				15 00 00 00 01 00 02 A3 59
				15 00 00 00 01 00 02 A4 03
				15 00 00 00 01 00 02 A5 65
				15 00 00 00 01 00 02 A6 03
				15 00 00 00 01 00 02 A7 73
				15 00 00 00 01 00 02 A9 03
				15 00 00 00 01 00 02 AA 81
				15 00 00 00 01 00 02 AB 03
				15 00 00 00 01 00 02 AC 91
				15 00 00 00 01 00 02 AD 03
				15 00 00 00 01 00 02 AE A2
				15 00 00 00 01 00 02 AF 03
				15 00 00 00 01 00 02 B0 AE
				15 00 00 00 01 00 02 B1 03
				15 00 00 00 01 00 02 B2 FD
				15 00 00 00 01 00 02 B3 00
				15 00 00 00 01 00 02 B4 F0
				15 00 00 00 01 00 02 B5 00
				15 00 00 00 01 00 02 B6 FA
				15 00 00 00 01 00 02 B7 01
				15 00 00 00 01 00 02 B8 0C
				15 00 00 00 01 00 02 B9 01
				15 00 00 00 01 00 02 BA 1C
				15 00 00 00 01 00 02 BB 01
				15 00 00 00 01 00 02 BC 2A
				15 00 00 00 01 00 02 BD 01
				15 00 00 00 01 00 02 BE 36
				15 00 00 00 01 00 02 BF 01
				15 00 00 00 01 00 02 C0 42
				15 00 00 00 01 00 02 C1 01
				15 00 00 00 01 00 02 C2 4D
				15 00 00 00 01 00 02 C3 01
				15 00 00 00 01 00 02 C4 57
				15 00 00 00 01 00 02 C5 01
				15 00 00 00 01 00 02 C6 79
				15 00 00 00 01 00 02 C7 01
				15 00 00 00 01 00 02 C8 95
				15 00 00 00 01 00 02 C9 01
				15 00 00 00 01 00 02 CA C3
				15 00 00 00 01 00 02 CB 01
				15 00 00 00 01 00 02 CC E8
				15 00 00 00 01 00 02 CD 02
				15 00 00 00 01 00 02 CE 21
				15 00 00 00 01 00 02 CF 02
				15 00 00 00 01 00 02 D0 51
				15 00 00 00 01 00 02 D1 02
				15 00 00 00 01 00 02 D2 52
				15 00 00 00 01 00 02 D3 02
				15 00 00 00 01 00 02 D4 7F
				15 00 00 00 01 00 02 D5 02
				15 00 00 00 01 00 02 D6 B2
				15 00 00 00 01 00 02 D7 02
				15 00 00 00 01 00 02 D8 D9
				15 00 00 00 01 00 02 D9 03
				15 00 00 00 01 00 02 DA 04
				15 00 00 00 01 00 02 DB 03
				15 00 00 00 01 00 02 DC 26
				15 00 00 00 01 00 02 DD 03
				15 00 00 00 01 00 02 DE 4E
				15 00 00 00 01 00 02 DF 03
				15 00 00 00 01 00 02 E0 59
				15 00 00 00 01 00 02 E1 03
				15 00 00 00 01 00 02 E2 65
				15 00 00 00 01 00 02 E3 03
				15 00 00 00 01 00 02 E4 73
				15 00 00 00 01 00 02 E5 03
				15 00 00 00 01 00 02 E6 81
				15 00 00 00 01 00 02 E7 03
				15 00 00 00 01 00 02 E8 91
				15 00 00 00 01 00 02 E9 03
				15 00 00 00 01 00 02 EA A2
				15 00 00 00 01 00 02 EB 03
				15 00 00 00 01 00 02 EC AE
				15 00 00 00 01 00 02 ED 03
				15 00 00 00 01 00 02 EE FD
				15 00 00 00 01 00 02 EF 00
				15 00 00 00 01 00 02 F0 BD
				15 00 00 00 01 00 02 F1 00
				15 00 00 00 01 00 02 F2 CC
				15 00 00 00 01 00 02 F3 00
				15 00 00 00 01 00 02 F4 E6
				15 00 00 00 01 00 02 F5 00
				15 00 00 00 01 00 02 F6 FA
				15 00 00 00 01 00 02 F7 01
				15 00 00 00 01 00 02 F8 0B
				15 00 00 00 01 00 02 F9 01
				15 00 00 00 01 00 02 FA 1B
				15 00 00 00 01 00 02 FF 21
				15 00 00 00 01 00 02 FB 01
				15 00 00 00 01 00 02 00 01
				15 00 00 00 01 00 02 01 28
				15 00 00 00 01 00 02 02 01
				15 00 00 00 01 00 02 03 35
				15 00 00 00 01 00 02 04 01
				15 00 00 00 01 00 02 05 40
				15 00 00 00 01 00 02 06 01
				15 00 00 00 01 00 02 07 67
				15 00 00 00 01 00 02 08 01
				15 00 00 00 01 00 02 09 87
				15 00 00 00 01 00 02 0A 01
				15 00 00 00 01 00 02 0B B9
				15 00 00 00 01 00 02 0C 01
				15 00 00 00 01 00 02 0D E0
				15 00 00 00 01 00 02 0E 02
				15 00 00 00 01 00 02 0F 1D
				15 00 00 00 01 00 02 10 02
				15 00 00 00 01 00 02 11 4E
				15 00 00 00 01 00 02 12 02
				15 00 00 00 01 00 02 13 4F
				15 00 00 00 01 00 02 14 02
				15 00 00 00 01 00 02 15 7D
				15 00 00 00 01 00 02 16 02
				15 00 00 00 01 00 02 17 B1
				15 00 00 00 01 00 02 18 02
				15 00 00 00 01 00 02 19 DA
				15 00 00 00 01 00 02 1A 03
				15 00 00 00 01 00 02 1B 06
				15 00 00 00 01 00 02 1C 03
				15 00 00 00 01 00 02 1D 25
				15 00 00 00 01 00 02 1E 03
				15 00 00 00 01 00 02 1F 4D
				15 00 00 00 01 00 02 20 03
				15 00 00 00 01 00 02 21 59
				15 00 00 00 01 00 02 22 03
				15 00 00 00 01 00 02 23 68
				15 00 00 00 01 00 02 24 03
				15 00 00 00 01 00 02 25 7A
				15 00 00 00 01 00 02 26 03
				15 00 00 00 01 00 02 27 91
				15 00 00 00 01 00 02 28 03
				15 00 00 00 01 00 02 29 A5
				15 00 00 00 01 00 02 2A 03
				15 00 00 00 01 00 02 2B B1
				15 00 00 00 01 00 02 2D 03
				15 00 00 00 01 00 02 2F B6
				15 00 00 00 01 00 02 30 03
				15 00 00 00 01 00 02 31 FD
				15 00 00 00 01 00 02 32 00
				15 00 00 00 01 00 02 33 BD
				15 00 00 00 01 00 02 34 00
				15 00 00 00 01 00 02 35 CC
				15 00 00 00 01 00 02 36 00
				15 00 00 00 01 00 02 37 E6
				15 00 00 00 01 00 02 38 00
				15 00 00 00 01 00 02 39 FA
				15 00 00 00 01 00 02 3A 01
				15 00 00 00 01 00 02 3B 0B
				15 00 00 00 01 00 02 3D 01
				15 00 00 00 01 00 02 3F 1B
				15 00 00 00 01 00 02 40 01
				15 00 00 00 01 00 02 41 28
				15 00 00 00 01 00 02 42 01
				15 00 00 00 01 00 02 43 35
				15 00 00 00 01 00 02 44 01
				15 00 00 00 01 00 02 45 40
				15 00 00 00 01 00 02 46 01
				15 00 00 00 01 00 02 47 67
				15 00 00 00 01 00 02 48 01
				15 00 00 00 01 00 02 49 87
				15 00 00 00 01 00 02 4A 01
				15 00 00 00 01 00 02 4B B9
				15 00 00 00 01 00 02 4C 01
				15 00 00 00 01 00 02 4D E0
				15 00 00 00 01 00 02 4E 02
				15 00 00 00 01 00 02 4F 1D
				15 00 00 00 01 00 02 50 02
				15 00 00 00 01 00 02 51 4E
				15 00 00 00 01 00 02 52 02
				15 00 00 00 01 00 02 53 4F
				15 00 00 00 01 00 02 54 02
				15 00 00 00 01 00 02 55 7D
				15 00 00 00 01 00 02 56 02
				15 00 00 00 01 00 02 58 B1
				15 00 00 00 01 00 02 59 02
				15 00 00 00 01 00 02 5A DA
				15 00 00 00 01 00 02 5B 03
				15 00 00 00 01 00 02 5C 06
				15 00 00 00 01 00 02 5D 03
				15 00 00 00 01 00 02 5E 25
				15 00 00 00 01 00 02 5F 03
				15 00 00 00 01 00 02 60 4D
				15 00 00 00 01 00 02 61 03
				15 00 00 00 01 00 02 62 59
				15 00 00 00 01 00 02 63 03
				15 00 00 00 01 00 02 64 68
				15 00 00 00 01 00 02 65 03
				15 00 00 00 01 00 02 66 7A
				15 00 00 00 01 00 02 67 03
				15 00 00 00 01 00 02 68 91
				15 00 00 00 01 00 02 69 03
				15 00 00 00 01 00 02 6A A5
				15 00 00 00 01 00 02 6B 03
				15 00 00 00 01 00 02 6C B1
				15 00 00 00 01 00 02 6D 03
				15 00 00 00 01 00 02 6E B6
				15 00 00 00 01 00 02 6F 03
				15 00 00 00 01 00 02 70 FD
				15 00 00 00 01 00 02 71 02
				15 00 00 00 01 00 02 72 1D
				15 00 00 00 01 00 02 73 02
				15 00 00 00 01 00 02 74 1E
				15 00 00 00 01 00 02 75 02
				15 00 00 00 01 00 02 76 20
				15 00 00 00 01 00 02 77 02
				15 00 00 00 01 00 02 78 22
				15 00 00 00 01 00 02 79 02
				15 00 00 00 01 00 02 7A 24
				15 00 00 00 01 00 02 7B 02
				15 00 00 00 01 00 02 7C 26
				15 00 00 00 01 00 02 7D 02
				15 00 00 00 01 00 02 7E 28
				15 00 00 00 01 00 02 7F 02
				15 00 00 00 01 00 02 80 2A
				15 00 00 00 01 00 02 81 02
				15 00 00 00 01 00 02 82 2C
				15 00 00 00 01 00 02 83 02
				15 00 00 00 01 00 02 84 34
				15 00 00 00 01 00 02 85 02
				15 00 00 00 01 00 02 86 3B
				15 00 00 00 01 00 02 87 02
				15 00 00 00 01 00 02 88 4A
				15 00 00 00 01 00 02 89 02
				15 00 00 00 01 00 02 8A 59
				15 00 00 00 01 00 02 8B 02
				15 00 00 00 01 00 02 8C 75
				15 00 00 00 01 00 02 8D 02
				15 00 00 00 01 00 02 8E 92
				15 00 00 00 01 00 02 8F 02
				15 00 00 00 01 00 02 90 93
				15 00 00 00 01 00 02 91 02
				15 00 00 00 01 00 02 92 B7
				15 00 00 00 01 00 02 93 02
				15 00 00 00 01 00 02 94 E8
				15 00 00 00 01 00 02 95 03
				15 00 00 00 01 00 02 96 08
				15 00 00 00 01 00 02 97 03
				15 00 00 00 01 00 02 98 35
				15 00 00 00 01 00 02 99 03
				15 00 00 00 01 00 02 9A 50
				15 00 00 00 01 00 02 9B 03
				15 00 00 00 01 00 02 9C 6F
				15 00 00 00 01 00 02 9D 03
				15 00 00 00 01 00 02 9E 77
				15 00 00 00 01 00 02 9F 03
				15 00 00 00 01 00 02 A0 81
				15 00 00 00 01 00 02 A2 03
				15 00 00 00 01 00 02 A3 8B
				15 00 00 00 01 00 02 A4 03
				15 00 00 00 01 00 02 A5 95
				15 00 00 00 01 00 02 A6 03
				15 00 00 00 01 00 02 A7 A0
				15 00 00 00 01 00 02 A9 03
				15 00 00 00 01 00 02 AA AA
				15 00 00 00 01 00 02 AB 03
				15 00 00 00 01 00 02 AC AF
				15 00 00 00 01 00 02 AD 03
				15 00 00 00 01 00 02 AE FD
				15 00 00 00 01 00 02 AF 02
				15 00 00 00 01 00 02 B0 1D
				15 00 00 00 01 00 02 B1 02
				15 00 00 00 01 00 02 B2 1E
				15 00 00 00 01 00 02 B3 02
				15 00 00 00 01 00 02 B4 20
				15 00 00 00 01 00 02 B5 02
				15 00 00 00 01 00 02 B6 22
				15 00 00 00 01 00 02 B7 02
				15 00 00 00 01 00 02 B8 24
				15 00 00 00 01 00 02 B9 02
				15 00 00 00 01 00 02 BA 26
				15 00 00 00 01 00 02 BB 02
				15 00 00 00 01 00 02 BC 28
				15 00 00 00 01 00 02 BD 02
				15 00 00 00 01 00 02 BE 2A
				15 00 00 00 01 00 02 BF 02
				15 00 00 00 01 00 02 C0 2C
				15 00 00 00 01 00 02 C1 02
				15 00 00 00 01 00 02 C2 34
				15 00 00 00 01 00 02 C3 02
				15 00 00 00 01 00 02 C4 3B
				15 00 00 00 01 00 02 C5 02
				15 00 00 00 01 00 02 C6 4A
				15 00 00 00 01 00 02 C7 02
				15 00 00 00 01 00 02 C8 59
				15 00 00 00 01 00 02 C9 02
				15 00 00 00 01 00 02 CA 75
				15 00 00 00 01 00 02 CB 02
				15 00 00 00 01 00 02 CC 92
				15 00 00 00 01 00 02 CD 02
				15 00 00 00 01 00 02 CE 93
				15 00 00 00 01 00 02 CF 02
				15 00 00 00 01 00 02 D0 B7
				15 00 00 00 01 00 02 D1 02
				15 00 00 00 01 00 02 D2 E8
				15 00 00 00 01 00 02 D3 03
				15 00 00 00 01 00 02 D4 08
				15 00 00 00 01 00 02 D5 03
				15 00 00 00 01 00 02 D6 35
				15 00 00 00 01 00 02 D7 03
				15 00 00 00 01 00 02 D8 50
				15 00 00 00 01 00 02 D9 03
				15 00 00 00 01 00 02 DA 6F
				15 00 00 00 01 00 02 DB 03
				15 00 00 00 01 00 02 DC 77
				15 00 00 00 01 00 02 DD 03
				15 00 00 00 01 00 02 DE 81
				15 00 00 00 01 00 02 DF 03
				15 00 00 00 01 00 02 E0 8B
				15 00 00 00 01 00 02 E1 03
				15 00 00 00 01 00 02 E2 95
				15 00 00 00 01 00 02 E3 03
				15 00 00 00 01 00 02 E4 A0
				15 00 00 00 01 00 02 E5 03
				15 00 00 00 01 00 02 E6 AA
				15 00 00 00 01 00 02 E7 03
				15 00 00 00 01 00 02 E8 AF
				15 00 00 00 01 00 02 E9 03
				15 00 00 00 01 00 02 EA FD
				15 00 00 00 01 00 02 FB 01
				15 01 00 00 01 00 02 FF 10
				];
		qcom,mdss-dsi-dispparam-papermode5-state = "dsi_hs_mode";
		qcom,mdss-dsi-dispparam-papermode6-command = [
				15 01 00 00 78 00 02 FF 20
				15 00 00 00 01 00 02 FB 01
				15 00 00 00 01 00 02 75 00
				15 00 00 00 01 00 02 76 F0
				15 00 00 00 01 00 02 77 00
				15 00 00 00 01 00 02 78 FA
				15 00 00 00 01 00 02 79 01
				15 00 00 00 01 00 02 7A 0C
				15 00 00 00 01 00 02 7B 01
				15 00 00 00 01 00 02 7C 1C
				15 00 00 00 01 00 02 7D 01
				15 00 00 00 01 00 02 7E 2A
				15 00 00 00 01 00 02 7F 01
				15 00 00 00 01 00 02 80 36
				15 00 00 00 01 00 02 81 01
				15 00 00 00 01 00 02 82 42
				15 00 00 00 01 00 02 83 01
				15 00 00 00 01 00 02 84 4D
				15 00 00 00 01 00 02 85 01
				15 00 00 00 01 00 02 86 57
				15 00 00 00 01 00 02 87 01
				15 00 00 00 01 00 02 88 79
				15 00 00 00 01 00 02 89 01
				15 00 00 00 01 00 02 8A 95
				15 00 00 00 01 00 02 8B 01
				15 00 00 00 01 00 02 8C C3
				15 00 00 00 01 00 02 8D 01
				15 00 00 00 01 00 02 8E E8
				15 00 00 00 01 00 02 8F 02
				15 00 00 00 01 00 02 90 21
				15 00 00 00 01 00 02 91 02
				15 00 00 00 01 00 02 92 51
				15 00 00 00 01 00 02 93 02
				15 00 00 00 01 00 02 94 52
				15 00 00 00 01 00 02 95 02
				15 00 00 00 01 00 02 96 7F
				15 00 00 00 01 00 02 97 02
				15 00 00 00 01 00 02 98 B2
				15 00 00 00 01 00 02 99 02
				15 00 00 00 01 00 02 9A D9
				15 00 00 00 01 00 02 9B 03
				15 00 00 00 01 00 02 9C 04
				15 00 00 00 01 00 02 9D 03
				15 00 00 00 01 00 02 9E 26
				15 00 00 00 01 00 02 9F 03
				15 00 00 00 01 00 02 A0 4E
				15 00 00 00 01 00 02 A2 03
				15 00 00 00 01 00 02 A3 59
				15 00 00 00 01 00 02 A4 03
				15 00 00 00 01 00 02 A5 65
				15 00 00 00 01 00 02 A6 03
				15 00 00 00 01 00 02 A7 73
				15 00 00 00 01 00 02 A9 03
				15 00 00 00 01 00 02 AA 81
				15 00 00 00 01 00 02 AB 03
				15 00 00 00 01 00 02 AC 91
				15 00 00 00 01 00 02 AD 03
				15 00 00 00 01 00 02 AE A2
				15 00 00 00 01 00 02 AF 03
				15 00 00 00 01 00 02 B0 AE
				15 00 00 00 01 00 02 B1 03
				15 00 00 00 01 00 02 B2 FD
				15 00 00 00 01 00 02 B3 00
				15 00 00 00 01 00 02 B4 F0
				15 00 00 00 01 00 02 B5 00
				15 00 00 00 01 00 02 B6 FA
				15 00 00 00 01 00 02 B7 01
				15 00 00 00 01 00 02 B8 0C
				15 00 00 00 01 00 02 B9 01
				15 00 00 00 01 00 02 BA 1C
				15 00 00 00 01 00 02 BB 01
				15 00 00 00 01 00 02 BC 2A
				15 00 00 00 01 00 02 BD 01
				15 00 00 00 01 00 02 BE 36
				15 00 00 00 01 00 02 BF 01
				15 00 00 00 01 00 02 C0 42
				15 00 00 00 01 00 02 C1 01
				15 00 00 00 01 00 02 C2 4D
				15 00 00 00 01 00 02 C3 01
				15 00 00 00 01 00 02 C4 57
				15 00 00 00 01 00 02 C5 01
				15 00 00 00 01 00 02 C6 79
				15 00 00 00 01 00 02 C7 01
				15 00 00 00 01 00 02 C8 95
				15 00 00 00 01 00 02 C9 01
				15 00 00 00 01 00 02 CA C3
				15 00 00 00 01 00 02 CB 01
				15 00 00 00 01 00 02 CC E8
				15 00 00 00 01 00 02 CD 02
				15 00 00 00 01 00 02 CE 21
				15 00 00 00 01 00 02 CF 02
				15 00 00 00 01 00 02 D0 51
				15 00 00 00 01 00 02 D1 02
				15 00 00 00 01 00 02 D2 52
				15 00 00 00 01 00 02 D3 02
				15 00 00 00 01 00 02 D4 7F
				15 00 00 00 01 00 02 D5 02
				15 00 00 00 01 00 02 D6 B2
				15 00 00 00 01 00 02 D7 02
				15 00 00 00 01 00 02 D8 D9
				15 00 00 00 01 00 02 D9 03
				15 00 00 00 01 00 02 DA 04
				15 00 00 00 01 00 02 DB 03
				15 00 00 00 01 00 02 DC 26
				15 00 00 00 01 00 02 DD 03
				15 00 00 00 01 00 02 DE 4E
				15 00 00 00 01 00 02 DF 03
				15 00 00 00 01 00 02 E0 59
				15 00 00 00 01 00 02 E1 03
				15 00 00 00 01 00 02 E2 65
				15 00 00 00 01 00 02 E3 03
				15 00 00 00 01 00 02 E4 73
				15 00 00 00 01 00 02 E5 03
				15 00 00 00 01 00 02 E6 81
				15 00 00 00 01 00 02 E7 03
				15 00 00 00 01 00 02 E8 91
				15 00 00 00 01 00 02 E9 03
				15 00 00 00 01 00 02 EA A2
				15 00 00 00 01 00 02 EB 03
				15 00 00 00 01 00 02 EC AE
				15 00 00 00 01 00 02 ED 03
				15 00 00 00 01 00 02 EE FD
				15 00 00 00 01 00 02 EF 00
				15 00 00 00 01 00 02 F0 BD
				15 00 00 00 01 00 02 F1 00
				15 00 00 00 01 00 02 F2 CC
				15 00 00 00 01 00 02 F3 00
				15 00 00 00 01 00 02 F4 E6
				15 00 00 00 01 00 02 F5 00
				15 00 00 00 01 00 02 F6 FA
				15 00 00 00 01 00 02 F7 01
				15 00 00 00 01 00 02 F8 0B
				15 00 00 00 01 00 02 F9 01
				15 00 00 00 01 00 02 FA 1B
				15 00 00 00 01 00 02 FF 21
				15 00 00 00 01 00 02 FB 01
				15 00 00 00 01 00 02 00 01
				15 00 00 00 01 00 02 01 28
				15 00 00 00 01 00 02 02 01
				15 00 00 00 01 00 02 03 35
				15 00 00 00 01 00 02 04 01
				15 00 00 00 01 00 02 05 40
				15 00 00 00 01 00 02 06 01
				15 00 00 00 01 00 02 07 67
				15 00 00 00 01 00 02 08 01
				15 00 00 00 01 00 02 09 87
				15 00 00 00 01 00 02 0A 01
				15 00 00 00 01 00 02 0B B9
				15 00 00 00 01 00 02 0C 01
				15 00 00 00 01 00 02 0D E0
				15 00 00 00 01 00 02 0E 02
				15 00 00 00 01 00 02 0F 1D
				15 00 00 00 01 00 02 10 02
				15 00 00 00 01 00 02 11 4E
				15 00 00 00 01 00 02 12 02
				15 00 00 00 01 00 02 13 4F
				15 00 00 00 01 00 02 14 02
				15 00 00 00 01 00 02 15 7D
				15 00 00 00 01 00 02 16 02
				15 00 00 00 01 00 02 17 B1
				15 00 00 00 01 00 02 18 02
				15 00 00 00 01 00 02 19 DA
				15 00 00 00 01 00 02 1A 03
				15 00 00 00 01 00 02 1B 06
				15 00 00 00 01 00 02 1C 03
				15 00 00 00 01 00 02 1D 25
				15 00 00 00 01 00 02 1E 03
				15 00 00 00 01 00 02 1F 4D
				15 00 00 00 01 00 02 20 03
				15 00 00 00 01 00 02 21 59
				15 00 00 00 01 00 02 22 03
				15 00 00 00 01 00 02 23 68
				15 00 00 00 01 00 02 24 03
				15 00 00 00 01 00 02 25 7A
				15 00 00 00 01 00 02 26 03
				15 00 00 00 01 00 02 27 91
				15 00 00 00 01 00 02 28 03
				15 00 00 00 01 00 02 29 A5
				15 00 00 00 01 00 02 2A 03
				15 00 00 00 01 00 02 2B B1
				15 00 00 00 01 00 02 2D 03
				15 00 00 00 01 00 02 2F B6
				15 00 00 00 01 00 02 30 03
				15 00 00 00 01 00 02 31 FD
				15 00 00 00 01 00 02 32 00
				15 00 00 00 01 00 02 33 BD
				15 00 00 00 01 00 02 34 00
				15 00 00 00 01 00 02 35 CC
				15 00 00 00 01 00 02 36 00
				15 00 00 00 01 00 02 37 E6
				15 00 00 00 01 00 02 38 00
				15 00 00 00 01 00 02 39 FA
				15 00 00 00 01 00 02 3A 01
				15 00 00 00 01 00 02 3B 0B
				15 00 00 00 01 00 02 3D 01
				15 00 00 00 01 00 02 3F 1B
				15 00 00 00 01 00 02 40 01
				15 00 00 00 01 00 02 41 28
				15 00 00 00 01 00 02 42 01
				15 00 00 00 01 00 02 43 35
				15 00 00 00 01 00 02 44 01
				15 00 00 00 01 00 02 45 40
				15 00 00 00 01 00 02 46 01
				15 00 00 00 01 00 02 47 67
				15 00 00 00 01 00 02 48 01
				15 00 00 00 01 00 02 49 87
				15 00 00 00 01 00 02 4A 01
				15 00 00 00 01 00 02 4B B9
				15 00 00 00 01 00 02 4C 01
				15 00 00 00 01 00 02 4D E0
				15 00 00 00 01 00 02 4E 02
				15 00 00 00 01 00 02 4F 1D
				15 00 00 00 01 00 02 50 02
				15 00 00 00 01 00 02 51 4E
				15 00 00 00 01 00 02 52 02
				15 00 00 00 01 00 02 53 4F
				15 00 00 00 01 00 02 54 02
				15 00 00 00 01 00 02 55 7D
				15 00 00 00 01 00 02 56 02
				15 00 00 00 01 00 02 58 B1
				15 00 00 00 01 00 02 59 02
				15 00 00 00 01 00 02 5A DA
				15 00 00 00 01 00 02 5B 03
				15 00 00 00 01 00 02 5C 06
				15 00 00 00 01 00 02 5D 03
				15 00 00 00 01 00 02 5E 25
				15 00 00 00 01 00 02 5F 03
				15 00 00 00 01 00 02 60 4D
				15 00 00 00 01 00 02 61 03
				15 00 00 00 01 00 02 62 59
				15 00 00 00 01 00 02 63 03
				15 00 00 00 01 00 02 64 68
				15 00 00 00 01 00 02 65 03
				15 00 00 00 01 00 02 66 7A
				15 00 00 00 01 00 02 67 03
				15 00 00 00 01 00 02 68 91
				15 00 00 00 01 00 02 69 03
				15 00 00 00 01 00 02 6A A5
				15 00 00 00 01 00 02 6B 03
				15 00 00 00 01 00 02 6C B1
				15 00 00 00 01 00 02 6D 03
				15 00 00 00 01 00 02 6E B6
				15 00 00 00 01 00 02 6F 03
				15 00 00 00 01 00 02 70 FD
				15 00 00 00 01 00 02 71 02
				15 00 00 00 01 00 02 72 35
				15 00 00 00 01 00 02 73 02
				15 00 00 00 01 00 02 74 36
				15 00 00 00 01 00 02 75 02
				15 00 00 00 01 00 02 76 38
				15 00 00 00 01 00 02 77 02
				15 00 00 00 01 00 02 78 39
				15 00 00 00 01 00 02 79 02
				15 00 00 00 01 00 02 7A 3B
				15 00 00 00 01 00 02 7B 02
				15 00 00 00 01 00 02 7C 3D
				15 00 00 00 01 00 02 7D 02
				15 00 00 00 01 00 02 7E 3E
				15 00 00 00 01 00 02 7F 02
				15 00 00 00 01 00 02 80 40
				15 00 00 00 01 00 02 81 02
				15 00 00 00 01 00 02 82 42
				15 00 00 00 01 00 02 83 02
				15 00 00 00 01 00 02 84 48
				15 00 00 00 01 00 02 85 02
				15 00 00 00 01 00 02 86 4F
				15 00 00 00 01 00 02 87 02
				15 00 00 00 01 00 02 88 5C
				15 00 00 00 01 00 02 89 02
				15 00 00 00 01 00 02 8A 69
				15 00 00 00 01 00 02 8B 02
				15 00 00 00 01 00 02 8C 82
				15 00 00 00 01 00 02 8D 02
				15 00 00 00 01 00 02 8E 9E
				15 00 00 00 01 00 02 8F 02
				15 00 00 00 01 00 02 90 9F
				15 00 00 00 01 00 02 91 02
				15 00 00 00 01 00 02 92 C4
				15 00 00 00 01 00 02 93 02
				15 00 00 00 01 00 02 94 EF
				15 00 00 00 01 00 02 95 03
				15 00 00 00 01 00 02 96 14
				15 00 00 00 01 00 02 97 03
				15 00 00 00 01 00 02 98 3F
				15 00 00 00 01 00 02 99 03
				15 00 00 00 01 00 02 9A 58
				15 00 00 00 01 00 02 9B 03
				15 00 00 00 01 00 02 9C 75
				15 00 00 00 01 00 02 9D 03
				15 00 00 00 01 00 02 9E 7D
				15 00 00 00 01 00 02 9F 03
				15 00 00 00 01 00 02 A0 86
				15 00 00 00 01 00 02 A2 03
				15 00 00 00 01 00 02 A3 8F
				15 00 00 00 01 00 02 A4 03
				15 00 00 00 01 00 02 A5 99
				15 00 00 00 01 00 02 A6 03
				15 00 00 00 01 00 02 A7 A3
				15 00 00 00 01 00 02 A9 03
				15 00 00 00 01 00 02 AA AB
				15 00 00 00 01 00 02 AB 03
				15 00 00 00 01 00 02 AC AF
				15 00 00 00 01 00 02 AD 03
				15 00 00 00 01 00 02 AE FD
				15 00 00 00 01 00 02 AF 02
				15 00 00 00 01 00 02 B0 35
				15 00 00 00 01 00 02 B1 02
				15 00 00 00 01 00 02 B2 36
				15 00 00 00 01 00 02 B3 02
				15 00 00 00 01 00 02 B4 38
				15 00 00 00 01 00 02 B5 02
				15 00 00 00 01 00 02 B6 39
				15 00 00 00 01 00 02 B7 02
				15 00 00 00 01 00 02 B8 3B
				15 00 00 00 01 00 02 B9 02
				15 00 00 00 01 00 02 BA 3D
				15 00 00 00 01 00 02 BB 02
				15 00 00 00 01 00 02 BC 3E
				15 00 00 00 01 00 02 BD 02
				15 00 00 00 01 00 02 BE 40
				15 00 00 00 01 00 02 BF 02
				15 00 00 00 01 00 02 C0 42
				15 00 00 00 01 00 02 C1 02
				15 00 00 00 01 00 02 C2 48
				15 00 00 00 01 00 02 C3 02
				15 00 00 00 01 00 02 C4 4F
				15 00 00 00 01 00 02 C5 02
				15 00 00 00 01 00 02 C6 5C
				15 00 00 00 01 00 02 C7 02
				15 00 00 00 01 00 02 C8 69
				15 00 00 00 01 00 02 C9 02
				15 00 00 00 01 00 02 CA 82
				15 00 00 00 01 00 02 CB 02
				15 00 00 00 01 00 02 CC 9E
				15 00 00 00 01 00 02 CD 02
				15 00 00 00 01 00 02 CE 9F
				15 00 00 00 01 00 02 CF 02
				15 00 00 00 01 00 02 D0 C4
				15 00 00 00 01 00 02 D1 02
				15 00 00 00 01 00 02 D2 EF
				15 00 00 00 01 00 02 D3 03
				15 00 00 00 01 00 02 D4 14
				15 00 00 00 01 00 02 D5 03
				15 00 00 00 01 00 02 D6 3F
				15 00 00 00 01 00 02 D7 03
				15 00 00 00 01 00 02 D8 58
				15 00 00 00 01 00 02 D9 03
				15 00 00 00 01 00 02 DA 75
				15 00 00 00 01 00 02 DB 03
				15 00 00 00 01 00 02 DC 7D
				15 00 00 00 01 00 02 DD 03
				15 00 00 00 01 00 02 DE 86
				15 00 00 00 01 00 02 DF 03
				15 00 00 00 01 00 02 E0 8F
				15 00 00 00 01 00 02 E1 03
				15 00 00 00 01 00 02 E2 99
				15 00 00 00 01 00 02 E3 03
				15 00 00 00 01 00 02 E4 A3
				15 00 00 00 01 00 02 E5 03
				15 00 00 00 01 00 02 E6 AB
				15 00 00 00 01 00 02 E7 03
				15 00 00 00 01 00 02 E8 AF
				15 00 00 00 01 00 02 E9 03
				15 00 00 00 01 00 02 EA FD
				15 00 00 00 01 00 02 FB 01
				15 01 00 00 01 00 02 FF 10
				];
		qcom,mdss-dsi-dispparam-papermode6-state = "dsi_hs_mode";
		qcom,mdss-dsi-dispparam-papermode7-command = [
				15 01 00 00 78 00 02 FF 20
				15 00 00 00 01 00 02 FB 01
				15 00 00 00 01 00 02 75 00
				15 00 00 00 01 00 02 76 F0
				15 00 00 00 01 00 02 77 00
				15 00 00 00 01 00 02 78 FA
				15 00 00 00 01 00 02 79 01
				15 00 00 00 01 00 02 7A 0C
				15 00 00 00 01 00 02 7B 01
				15 00 00 00 01 00 02 7C 1C
				15 00 00 00 01 00 02 7D 01
				15 00 00 00 01 00 02 7E 2A
				15 00 00 00 01 00 02 7F 01
				15 00 00 00 01 00 02 80 36
				15 00 00 00 01 00 02 81 01
				15 00 00 00 01 00 02 82 42
				15 00 00 00 01 00 02 83 01
				15 00 00 00 01 00 02 84 4D
				15 00 00 00 01 00 02 85 01
				15 00 00 00 01 00 02 86 57
				15 00 00 00 01 00 02 87 01
				15 00 00 00 01 00 02 88 79
				15 00 00 00 01 00 02 89 01
				15 00 00 00 01 00 02 8A 95
				15 00 00 00 01 00 02 8B 01
				15 00 00 00 01 00 02 8C C3
				15 00 00 00 01 00 02 8D 01
				15 00 00 00 01 00 02 8E E8
				15 00 00 00 01 00 02 8F 02
				15 00 00 00 01 00 02 90 21
				15 00 00 00 01 00 02 91 02
				15 00 00 00 01 00 02 92 51
				15 00 00 00 01 00 02 93 02
				15 00 00 00 01 00 02 94 52
				15 00 00 00 01 00 02 95 02
				15 00 00 00 01 00 02 96 7F
				15 00 00 00 01 00 02 97 02
				15 00 00 00 01 00 02 98 B2
				15 00 00 00 01 00 02 99 02
				15 00 00 00 01 00 02 9A D9
				15 00 00 00 01 00 02 9B 03
				15 00 00 00 01 00 02 9C 04
				15 00 00 00 01 00 02 9D 03
				15 00 00 00 01 00 02 9E 26
				15 00 00 00 01 00 02 9F 03
				15 00 00 00 01 00 02 A0 4E
				15 00 00 00 01 00 02 A2 03
				15 00 00 00 01 00 02 A3 59
				15 00 00 00 01 00 02 A4 03
				15 00 00 00 01 00 02 A5 65
				15 00 00 00 01 00 02 A6 03
				15 00 00 00 01 00 02 A7 73
				15 00 00 00 01 00 02 A9 03
				15 00 00 00 01 00 02 AA 81
				15 00 00 00 01 00 02 AB 03
				15 00 00 00 01 00 02 AC 91
				15 00 00 00 01 00 02 AD 03
				15 00 00 00 01 00 02 AE A2
				15 00 00 00 01 00 02 AF 03
				15 00 00 00 01 00 02 B0 AE
				15 00 00 00 01 00 02 B1 03
				15 00 00 00 01 00 02 B2 FD
				15 00 00 00 01 00 02 B3 00
				15 00 00 00 01 00 02 B4 F0
				15 00 00 00 01 00 02 B5 00
				15 00 00 00 01 00 02 B6 FA
				15 00 00 00 01 00 02 B7 01
				15 00 00 00 01 00 02 B8 0C
				15 00 00 00 01 00 02 B9 01
				15 00 00 00 01 00 02 BA 1C
				15 00 00 00 01 00 02 BB 01
				15 00 00 00 01 00 02 BC 2A
				15 00 00 00 01 00 02 BD 01
				15 00 00 00 01 00 02 BE 36
				15 00 00 00 01 00 02 BF 01
				15 00 00 00 01 00 02 C0 42
				15 00 00 00 01 00 02 C1 01
				15 00 00 00 01 00 02 C2 4D
				15 00 00 00 01 00 02 C3 01
				15 00 00 00 01 00 02 C4 57
				15 00 00 00 01 00 02 C5 01
				15 00 00 00 01 00 02 C6 79
				15 00 00 00 01 00 02 C7 01
				15 00 00 00 01 00 02 C8 95
				15 00 00 00 01 00 02 C9 01
				15 00 00 00 01 00 02 CA C3
				15 00 00 00 01 00 02 CB 01
				15 00 00 00 01 00 02 CC E8
				15 00 00 00 01 00 02 CD 02
				15 00 00 00 01 00 02 CE 21
				15 00 00 00 01 00 02 CF 02
				15 00 00 00 01 00 02 D0 51
				15 00 00 00 01 00 02 D1 02
				15 00 00 00 01 00 02 D2 52
				15 00 00 00 01 00 02 D3 02
				15 00 00 00 01 00 02 D4 7F
				15 00 00 00 01 00 02 D5 02
				15 00 00 00 01 00 02 D6 B2
				15 00 00 00 01 00 02 D7 02
				15 00 00 00 01 00 02 D8 D9
				15 00 00 00 01 00 02 D9 03
				15 00 00 00 01 00 02 DA 04
				15 00 00 00 01 00 02 DB 03
				15 00 00 00 01 00 02 DC 26
				15 00 00 00 01 00 02 DD 03
				15 00 00 00 01 00 02 DE 4E
				15 00 00 00 01 00 02 DF 03
				15 00 00 00 01 00 02 E0 59
				15 00 00 00 01 00 02 E1 03
				15 00 00 00 01 00 02 E2 65
				15 00 00 00 01 00 02 E3 03
				15 00 00 00 01 00 02 E4 73
				15 00 00 00 01 00 02 E5 03
				15 00 00 00 01 00 02 E6 81
				15 00 00 00 01 00 02 E7 03
				15 00 00 00 01 00 02 E8 91
				15 00 00 00 01 00 02 E9 03
				15 00 00 00 01 00 02 EA A2
				15 00 00 00 01 00 02 EB 03
				15 00 00 00 01 00 02 EC AE
				15 00 00 00 01 00 02 ED 03
				15 00 00 00 01 00 02 EE FD
				15 00 00 00 01 00 02 EF 00
				15 00 00 00 01 00 02 F0 BD
				15 00 00 00 01 00 02 F1 00
				15 00 00 00 01 00 02 F2 CC
				15 00 00 00 01 00 02 F3 00
				15 00 00 00 01 00 02 F4 E6
				15 00 00 00 01 00 02 F5 00
				15 00 00 00 01 00 02 F6 FA
				15 00 00 00 01 00 02 F7 01
				15 00 00 00 01 00 02 F8 0B
				15 00 00 00 01 00 02 F9 01
				15 00 00 00 01 00 02 FA 1B
				15 00 00 00 01 00 02 FF 21
				15 00 00 00 01 00 02 FB 01
				15 00 00 00 01 00 02 00 01
				15 00 00 00 01 00 02 01 28
				15 00 00 00 01 00 02 02 01
				15 00 00 00 01 00 02 03 35
				15 00 00 00 01 00 02 04 01
				15 00 00 00 01 00 02 05 40
				15 00 00 00 01 00 02 06 01
				15 00 00 00 01 00 02 07 67
				15 00 00 00 01 00 02 08 01
				15 00 00 00 01 00 02 09 87
				15 00 00 00 01 00 02 0A 01
				15 00 00 00 01 00 02 0B B9
				15 00 00 00 01 00 02 0C 01
				15 00 00 00 01 00 02 0D E0
				15 00 00 00 01 00 02 0E 02
				15 00 00 00 01 00 02 0F 1D
				15 00 00 00 01 00 02 10 02
				15 00 00 00 01 00 02 11 4E
				15 00 00 00 01 00 02 12 02
				15 00 00 00 01 00 02 13 4F
				15 00 00 00 01 00 02 14 02
				15 00 00 00 01 00 02 15 7D
				15 00 00 00 01 00 02 16 02
				15 00 00 00 01 00 02 17 B1
				15 00 00 00 01 00 02 18 02
				15 00 00 00 01 00 02 19 DA
				15 00 00 00 01 00 02 1A 03
				15 00 00 00 01 00 02 1B 06
				15 00 00 00 01 00 02 1C 03
				15 00 00 00 01 00 02 1D 25
				15 00 00 00 01 00 02 1E 03
				15 00 00 00 01 00 02 1F 4D
				15 00 00 00 01 00 02 20 03
				15 00 00 00 01 00 02 21 59
				15 00 00 00 01 00 02 22 03
				15 00 00 00 01 00 02 23 68
				15 00 00 00 01 00 02 24 03
				15 00 00 00 01 00 02 25 7A
				15 00 00 00 01 00 02 26 03
				15 00 00 00 01 00 02 27 91
				15 00 00 00 01 00 02 28 03
				15 00 00 00 01 00 02 29 A5
				15 00 00 00 01 00 02 2A 03
				15 00 00 00 01 00 02 2B B1
				15 00 00 00 01 00 02 2D 03
				15 00 00 00 01 00 02 2F B6
				15 00 00 00 01 00 02 30 03
				15 00 00 00 01 00 02 31 FD
				15 00 00 00 01 00 02 32 00
				15 00 00 00 01 00 02 33 BD
				15 00 00 00 01 00 02 34 00
				15 00 00 00 01 00 02 35 CC
				15 00 00 00 01 00 02 36 00
				15 00 00 00 01 00 02 37 E6
				15 00 00 00 01 00 02 38 00
				15 00 00 00 01 00 02 39 FA
				15 00 00 00 01 00 02 3A 01
				15 00 00 00 01 00 02 3B 0B
				15 00 00 00 01 00 02 3D 01
				15 00 00 00 01 00 02 3F 1B
				15 00 00 00 01 00 02 40 01
				15 00 00 00 01 00 02 41 28
				15 00 00 00 01 00 02 42 01
				15 00 00 00 01 00 02 43 35
				15 00 00 00 01 00 02 44 01
				15 00 00 00 01 00 02 45 40
				15 00 00 00 01 00 02 46 01
				15 00 00 00 01 00 02 47 67
				15 00 00 00 01 00 02 48 01
				15 00 00 00 01 00 02 49 87
				15 00 00 00 01 00 02 4A 01
				15 00 00 00 01 00 02 4B B9
				15 00 00 00 01 00 02 4C 01
				15 00 00 00 01 00 02 4D E0
				15 00 00 00 01 00 02 4E 02
				15 00 00 00 01 00 02 4F 1D
				15 00 00 00 01 00 02 50 02
				15 00 00 00 01 00 02 51 4E
				15 00 00 00 01 00 02 52 02
				15 00 00 00 01 00 02 53 4F
				15 00 00 00 01 00 02 54 02
				15 00 00 00 01 00 02 55 7D
				15 00 00 00 01 00 02 56 02
				15 00 00 00 01 00 02 58 B1
				15 00 00 00 01 00 02 59 02
				15 00 00 00 01 00 02 5A DA
				15 00 00 00 01 00 02 5B 03
				15 00 00 00 01 00 02 5C 06
				15 00 00 00 01 00 02 5D 03
				15 00 00 00 01 00 02 5E 25
				15 00 00 00 01 00 02 5F 03
				15 00 00 00 01 00 02 60 4D
				15 00 00 00 01 00 02 61 03
				15 00 00 00 01 00 02 62 59
				15 00 00 00 01 00 02 63 03
				15 00 00 00 01 00 02 64 68
				15 00 00 00 01 00 02 65 03
				15 00 00 00 01 00 02 66 7A
				15 00 00 00 01 00 02 67 03
				15 00 00 00 01 00 02 68 91
				15 00 00 00 01 00 02 69 03
				15 00 00 00 01 00 02 6A A5
				15 00 00 00 01 00 02 6B 03
				15 00 00 00 01 00 02 6C B1
				15 00 00 00 01 00 02 6D 03
				15 00 00 00 01 00 02 6E B6
				15 00 00 00 01 00 02 6F 03
				15 00 00 00 01 00 02 70 FD
				15 00 00 00 01 00 02 71 02
				15 00 00 00 01 00 02 72 46
				15 00 00 00 01 00 02 73 02
				15 00 00 00 01 00 02 74 47
				15 00 00 00 01 00 02 75 02
				15 00 00 00 01 00 02 76 48
				15 00 00 00 01 00 02 77 02
				15 00 00 00 01 00 02 78 4A
				15 00 00 00 01 00 02 79 02
				15 00 00 00 01 00 02 7A 4B
				15 00 00 00 01 00 02 7B 02
				15 00 00 00 01 00 02 7C 4D
				15 00 00 00 01 00 02 7D 02
				15 00 00 00 01 00 02 7E 4E
				15 00 00 00 01 00 02 7F 02
				15 00 00 00 01 00 02 80 50
				15 00 00 00 01 00 02 81 02
				15 00 00 00 01 00 02 82 51
				15 00 00 00 01 00 02 83 02
				15 00 00 00 01 00 02 84 57
				15 00 00 00 01 00 02 85 02
				15 00 00 00 01 00 02 86 5D
				15 00 00 00 01 00 02 87 02
				15 00 00 00 01 00 02 88 69
				15 00 00 00 01 00 02 89 02
				15 00 00 00 01 00 02 8A 75
				15 00 00 00 01 00 02 8B 02
				15 00 00 00 01 00 02 8C 8D
				15 00 00 00 01 00 02 8D 02
				15 00 00 00 01 00 02 8E A8
				15 00 00 00 01 00 02 8F 02
				15 00 00 00 01 00 02 90 A9
				15 00 00 00 01 00 02 91 02
				15 00 00 00 01 00 02 92 D0
				15 00 00 00 01 00 02 93 02
				15 00 00 00 01 00 02 94 FA
				15 00 00 00 01 00 02 95 03
				15 00 00 00 01 00 02 96 1D
				15 00 00 00 01 00 02 97 03
				15 00 00 00 01 00 02 98 46
				15 00 00 00 01 00 02 99 03
				15 00 00 00 01 00 02 9A 5E
				15 00 00 00 01 00 02 9B 03
				15 00 00 00 01 00 02 9C 7A
				15 00 00 00 01 00 02 9D 03
				15 00 00 00 01 00 02 9E 82
				15 00 00 00 01 00 02 9F 03
				15 00 00 00 01 00 02 A0 8A
				15 00 00 00 01 00 02 A2 03
				15 00 00 00 01 00 02 A3 93
				15 00 00 00 01 00 02 A4 03
				15 00 00 00 01 00 02 A5 9C
				15 00 00 00 01 00 02 A6 03
				15 00 00 00 01 00 02 A7 A5
				15 00 00 00 01 00 02 A9 03
				15 00 00 00 01 00 02 AA AC
				15 00 00 00 01 00 02 AB 03
				15 00 00 00 01 00 02 AC AF
				15 00 00 00 01 00 02 AD 03
				15 00 00 00 01 00 02 AE FD
				15 00 00 00 01 00 02 AF 02
				15 00 00 00 01 00 02 B0 46
				15 00 00 00 01 00 02 B1 02
				15 00 00 00 01 00 02 B2 47
				15 00 00 00 01 00 02 B3 02
				15 00 00 00 01 00 02 B4 48
				15 00 00 00 01 00 02 B5 02
				15 00 00 00 01 00 02 B6 4A
				15 00 00 00 01 00 02 B7 02
				15 00 00 00 01 00 02 B8 4B
				15 00 00 00 01 00 02 B9 02
				15 00 00 00 01 00 02 BA 4D
				15 00 00 00 01 00 02 BB 02
				15 00 00 00 01 00 02 BC 4E
				15 00 00 00 01 00 02 BD 02
				15 00 00 00 01 00 02 BE 50
				15 00 00 00 01 00 02 BF 02
				15 00 00 00 01 00 02 C0 51
				15 00 00 00 01 00 02 C1 02
				15 00 00 00 01 00 02 C2 57
				15 00 00 00 01 00 02 C3 02
				15 00 00 00 01 00 02 C4 5D
				15 00 00 00 01 00 02 C5 02
				15 00 00 00 01 00 02 C6 69
				15 00 00 00 01 00 02 C7 02
				15 00 00 00 01 00 02 C8 75
				15 00 00 00 01 00 02 C9 02
				15 00 00 00 01 00 02 CA 8D
				15 00 00 00 01 00 02 CB 02
				15 00 00 00 01 00 02 CC A8
				15 00 00 00 01 00 02 CD 02
				15 00 00 00 01 00 02 CE A9
				15 00 00 00 01 00 02 CF 02
				15 00 00 00 01 00 02 D0 D0
				15 00 00 00 01 00 02 D1 02
				15 00 00 00 01 00 02 D2 FA
				15 00 00 00 01 00 02 D3 03
				15 00 00 00 01 00 02 D4 1D
				15 00 00 00 01 00 02 D5 03
				15 00 00 00 01 00 02 D6 46
				15 00 00 00 01 00 02 D7 03
				15 00 00 00 01 00 02 D8 5E
				15 00 00 00 01 00 02 D9 03
				15 00 00 00 01 00 02 DA 7A
				15 00 00 00 01 00 02 DB 03
				15 00 00 00 01 00 02 DC 82
				15 00 00 00 01 00 02 DD 03
				15 00 00 00 01 00 02 DE 8A
				15 00 00 00 01 00 02 DF 03
				15 00 00 00 01 00 02 E0 93
				15 00 00 00 01 00 02 E1 03
				15 00 00 00 01 00 02 E2 9C
				15 00 00 00 01 00 02 E3 03
				15 00 00 00 01 00 02 E4 A5
				15 00 00 00 01 00 02 E5 03
				15 00 00 00 01 00 02 E6 AC
				15 00 00 00 01 00 02 E7 03
				15 00 00 00 01 00 02 E8 AF
				15 00 00 00 01 00 02 E9 03
				15 00 00 00 01 00 02 EA FD
				15 00 00 00 01 00 02 FB 01
				15 01 00 00 01 00 02 FF 10
				];
		qcom,mdss-dsi-dispparam-papermode7-state = "dsi_hs_mode";
		qcom,mdss-dsi-dispparam-scon-command = [
				15 01 00 00 01 00 02 FF 22
				15 01 00 00 01 00 02 FB 01
				15 01 00 00 01 00 02 68 00
				15 01 00 00 01 00 02 56 77
				15 01 00 00 01 00 02 58 0E
				15 01 00 00 01 00 02 59 12
				15 01 00 00 01 00 02 5A 0C
				15 01 00 00 01 00 02 5B 14
				15 01 00 00 01 00 02 5C 0A
				15 01 00 00 01 00 02 5D 16
				15 01 00 00 01 00 02 5E 08
				15 01 00 00 01 00 02 5F 18
				15 01 00 00 01 00 02 60 06
				15 01 00 00 01 00 02 61 1A
				15 01 00 00 01 00 02 62 04
				15 01 00 00 01 00 02 63 1C
				15 01 00 00 01 00 02 64 20
				15 01 00 00 01 00 02 FF 10
				];
		qcom,mdss-dsi-dispparam-sreon-command = [
				15 01 00 00 01 00 02 FF 22
				15 01 00 00 01 00 02 FB 01
				15 01 00 00 01 00 02 68 00
				15 01 00 00 01 00 02 56 77
				15 01 00 00 01 00 02 58 12
				15 01 00 00 01 00 02 59 0E
				15 01 00 00 01 00 02 5A 14
				15 01 00 00 01 00 02 5B 0E
				15 01 00 00 01 00 02 5C 16
				15 01 00 00 01 00 02 5D 0E
				15 01 00 00 01 00 02 5E 18
				15 01 00 00 01 00 02 5F 0E
				15 01 00 00 01 00 02 60 1A
				15 01 00 00 01 00 02 61 0E
				15 01 00 00 01 00 02 62 1C
				15 01 00 00 01 00 02 63 0E
				15 01 00 00 01 00 02 64 2F
				15 01 00 00 01 00 02 FF 10
				];
		qcom,mdss-dsi-dispparam-sreoff-command = [
				15 01 00 00 01 00 02 FF 22
				15 01 00 00 01 00 02 FB 01
				15 01 00 00 01 00 02 56 00
				15 01 00 00 01 00 02 FF 10
				];
		qcom,mdss-dsi-dispparam-vividweak-command = [
				15 01 00 00 10 00 02 FF 22
				15 01 00 00 10 00 02 FB 01
				15 01 00 00 10 00 02 00 00
				15 01 00 00 10 00 02 01 04
				15 01 00 00 10 00 02 02 08
				15 01 00 00 10 00 02 03 0C
				15 01 00 00 10 00 02 04 10
				15 01 00 00 10 00 02 05 14
				15 01 00 00 10 00 02 06 18
				15 01 00 00 10 00 02 07 20
				15 01 00 00 10 00 02 08 24
				15 01 00 00 10 00 02 09 28
				15 01 00 00 10 00 02 0A 30
				15 01 00 00 10 00 02 0B 38
				15 01 00 00 10 00 02 0C 38
				15 01 00 00 10 00 02 0D 30
				15 01 00 00 10 00 02 0E 28
				15 01 00 00 10 00 02 0F 20
				15 01 00 00 10 00 02 10 10
				15 01 00 00 10 00 02 11 00
				15 01 00 00 10 00 02 12 00
				15 01 00 00 10 00 02 13 00
				15 01 00 00 10 00 02 14 10
				15 01 00 00 10 00 02 15 18
				15 01 00 00 10 00 02 16 20
				15 01 00 00 10 00 02 17 28
				15 01 00 00 10 00 02 18 30
				15 01 00 00 10 00 02 19 38
				15 01 00 00 10 00 02 1A 77
				15 01 00 00 10 00 02 53 00
				15 01 00 00 10 00 02 68 00
				15 01 00 00 10 00 02 FF 10
				];
		qcom,mdss-dsi-dispparam-vividstrong-command = [
				15 01 00 00 01 00 02 FF 22
				15 01 00 00 01 00 02 FB 01
				15 01 00 00 01 00 02 00 28
				15 01 00 00 01 00 02 01 2C
				15 01 00 00 01 00 02 02 30
				15 01 00 00 01 00 02 03 34
				15 01 00 00 01 00 02 04 38
				15 01 00 00 01 00 02 05 3C
				15 01 00 00 01 00 02 06 40
				15 01 00 00 01 00 02 07 48
				15 01 00 00 01 00 02 08 4C
				15 01 00 00 01 00 02 09 50
				15 01 00 00 01 00 02 0A 58
				15 01 00 00 01 00 02 0B 60
				15 01 00 00 01 00 02 0C 60
				15 01 00 00 01 00 02 0D 58
				15 01 00 00 01 00 02 0E 50
				15 01 00 00 01 00 02 0F 48
				15 01 00 00 01 00 02 10 38
				15 01 00 00 01 00 02 11 28
				15 01 00 00 01 00 02 12 28
				15 01 00 00 01 00 02 13 28
				15 01 00 00 01 00 02 32 00
				15 01 00 00 01 00 02 33 00
				15 01 00 00 01 00 02 34 00
				15 01 00 00 01 00 02 35 02
				15 01 00 00 01 00 02 36 04
				15 01 00 00 01 00 02 37 06
				15 01 00 00 01 00 02 38 08
				15 01 00 00 01 00 02 39 0A
				15 01 00 00 01 00 02 3A 0C
				15 01 00 00 01 00 02 3B 0E
				15 01 00 00 01 00 02 3F 10
				15 01 00 00 01 00 02 40 12
				15 01 00 00 01 00 02 41 14
				15 01 00 00 01 00 02 42 14
				15 01 00 00 01 00 02 43 12
				15 01 00 00 01 00 02 44 10
				15 01 00 00 01 00 02 45 0E
				15 01 00 00 01 00 02 46 0C
				15 01 00 00 01 00 02 47 0A
				15 01 00 00 01 00 02 48 08
				15 01 00 00 01 00 02 49 06
				15 01 00 00 01 00 02 4A 04
				15 01 00 00 01 00 02 4B 02
				15 01 00 00 01 00 02 4C 00
				15 01 00 00 01 00 02 4D 08
				15 01 00 00 01 00 02 4E 08
				15 01 00 00 01 00 02 4F 08
				15 01 00 00 01 00 02 50 08
				15 01 00 00 01 00 02 51 08
				15 01 00 00 01 00 02 52 08
				15 01 00 00 01 00 02 1A 00
				15 01 00 00 01 00 02 53 00
				15 01 00 00 01 00 02 56 00
				15 01 00 00 01 00 02 58 12
				15 01 00 00 01 00 02 59 0E
				15 01 00 00 01 00 02 5A 14
				15 01 00 00 01 00 02 5B 0E
				15 01 00 00 01 00 02 5C 16
				15 01 00 00 01 00 02 5D 0E
				15 01 00 00 01 00 02 5E 18
				15 01 00 00 01 00 02 5F 0E
				15 01 00 00 01 00 02 60 1A
				15 01 00 00 01 00 02 61 0E
				15 01 00 00 01 00 02 62 1C
				15 01 00 00 01 00 02 63 0E
				15 01 00 00 01 00 02 64 2F
				15 01 00 00 01 00 02 68 00
				15 01 00 00 01 00 02 FF 10
				15 01 00 00 01 00 02 55 80
				];
		qcom,mdss-dsi-dispparam-vividoff-command = [
				15 01 00 00 10 00 02 FF 22
				15 01 00 00 10 00 02 FB 01
				15 01 00 00 10 00 02 1A 00
				15 01 00 00 10 00 02 53 00
				15 01 00 00 10 00 02 68 00
				15 01 00 00 10 00 02 FF 10
				];
		qcom,mdss-dsi-dispparam-smartweak-command = [
				15 00 00 00 01 00 02 FF 22
				15 00 00 00 01 00 02 FB 01
				15 00 00 00 01 00 02 00 28
				15 00 00 00 01 00 02 01 2C
				15 00 00 00 01 00 02 02 30
				15 00 00 00 01 00 02 03 34
				15 00 00 00 01 00 02 04 38
				15 00 00 00 01 00 02 05 3C
				15 00 00 00 01 00 02 06 40
				15 00 00 00 01 00 02 07 48
				15 00 00 00 01 00 02 08 4C
				15 00 00 00 01 00 02 09 50
				15 00 00 00 01 00 02 0A 58
				15 00 00 00 01 00 02 0B 60
				15 00 00 00 01 00 02 0C 60
				15 00 00 00 01 00 02 0D 58
				15 00 00 00 01 00 02 0E 50
				15 00 00 00 01 00 02 0F 48
				15 00 00 00 01 00 02 10 38
				15 00 00 00 01 00 02 11 28
				15 00 00 00 01 00 02 12 28
				15 00 00 00 01 00 02 13 28
				15 00 00 00 01 00 02 32 00
				15 00 00 00 01 00 02 33 00
				15 00 00 00 01 00 02 34 00
				15 00 00 00 01 00 02 35 02
				15 00 00 00 01 00 02 36 04
				15 00 00 00 01 00 02 37 06
				15 00 00 00 01 00 02 38 08
				15 00 00 00 01 00 02 39 0A
				15 00 00 00 01 00 02 3A 0C
				15 00 00 00 01 00 02 3B 0E
				15 00 00 00 01 00 02 3F 10
				15 00 00 00 01 00 02 40 12
				15 00 00 00 01 00 02 41 14
				15 00 00 00 01 00 02 42 14
				15 00 00 00 01 00 02 43 12
				15 00 00 00 01 00 02 44 10
				15 00 00 00 01 00 02 45 0E
				15 00 00 00 01 00 02 46 0C
				15 00 00 00 01 00 02 47 0A
				15 00 00 00 01 00 02 48 08
				15 00 00 00 01 00 02 49 06
				15 00 00 00 01 00 02 4A 04
				15 00 00 00 01 00 02 4B 02
				15 00 00 00 01 00 02 4C 00
				15 00 00 00 01 00 02 4D 00
				15 00 00 00 01 00 02 4E 08
				15 00 00 00 01 00 02 4F 10
				15 00 00 00 01 00 02 50 18
				15 00 00 00 01 00 02 51 20
				15 00 00 00 01 00 02 52 28
				15 00 00 00 01 00 02 1A 00
				15 00 00 00 01 00 02 53 77
				15 00 00 00 01 00 02 56 00
				15 00 00 00 01 00 02 68 00
				15 01 00 00 01 00 02 FF 10
				];
		qcom,mdss-dsi-dispparam-smartstrong-command = [
				15 00 00 00 01 00 02 FF 22
				15 00 00 00 01 00 02 FB 01
				15 00 00 00 01 00 02 00 28
				15 00 00 00 01 00 02 01 2C
				15 00 00 00 01 00 02 02 30
				15 00 00 00 01 00 02 03 34
				15 00 00 00 01 00 02 04 38
				15 00 00 00 01 00 02 05 3C
				15 00 00 00 01 00 02 06 40
				15 00 00 00 01 00 02 07 48
				15 00 00 00 01 00 02 08 4C
				15 00 00 00 01 00 02 09 50
				15 00 00 00 01 00 02 0A 58
				15 00 00 00 01 00 02 0B 60
				15 00 00 00 01 00 02 0C 60
				15 00 00 00 01 00 02 0D 58
				15 00 00 00 01 00 02 0E 50
				15 00 00 00 01 00 02 0F 48
				15 00 00 00 01 00 02 10 38
				15 00 00 00 01 00 02 11 28
				15 00 00 00 01 00 02 12 28
				15 00 00 00 01 00 02 13 28
				15 00 00 00 01 00 02 32 00
				15 00 00 00 01 00 02 33 00
				15 00 00 00 01 00 02 34 00
				15 00 00 00 01 00 02 35 03
				15 00 00 00 01 00 02 36 06
				15 00 00 00 01 00 02 37 09
				15 00 00 00 01 00 02 38 0C
				15 00 00 00 01 00 02 39 0F
				15 00 00 00 01 00 02 3A 12
				15 00 00 00 01 00 02 3B 15
				15 00 00 00 01 00 02 3F 18
				15 00 00 00 01 00 02 40 1B
				15 00 00 00 01 00 02 41 1E
				15 00 00 00 01 00 02 42 1E
				15 00 00 00 01 00 02 43 1B
				15 00 00 00 01 00 02 44 18
				15 00 00 00 01 00 02 45 15
				15 00 00 00 01 00 02 46 12
				15 00 00 00 01 00 02 47 0F
				15 00 00 00 01 00 02 48 0C
				15 00 00 00 01 00 02 49 09
				15 00 00 00 01 00 02 4A 06
				15 00 00 00 01 00 02 4B 03
				15 00 00 00 01 00 02 4C 00
				15 00 00 00 01 00 02 4D 00
				15 00 00 00 01 00 02 4E 08
				15 00 00 00 01 00 02 4F 10
				15 00 00 00 01 00 02 50 18
				15 00 00 00 01 00 02 51 20
				15 00 00 00 01 00 02 52 28
				15 00 00 00 01 00 02 1A 00
				15 00 00 00 01 00 02 53 77
				15 00 00 00 01 00 02 56 00
				15 00 00 00 01 00 02 68 00
				15 01 00 00 01 00 02 FF 10
				];
		qcom,mdss-dsi-dispparam-smartoff-command = [
				15 01 00 00 01 00 02 FF 22
				15 01 00 00 01 00 02 53 77
				15 01 00 00 01 00 02 FF 10
				];
		qcom,mdss-dsi-dispparam-level0-command = [
				15 01 00 00 10 00 02 FF 22
				15 01 00 00 10 00 02 56 00
				15 01 00 00 10 00 02 FF 10
				];
		qcom,mdss-dsi-dispparam-level1-command = [
				15 01 00 00 10 00 02 FF 22
				15 01 00 00 10 00 02 58 12
				15 01 00 00 10 00 02 59 0E
				15 01 00 00 10 00 02 56 01
				15 01 00 00 10 00 02 FF 10
				];
		qcom,mdss-dsi-dispparam-level2-command = [
				15 01 00 00 10 00 02 FF 22
				15 01 00 00 10 00 02 58 14
				15 01 00 00 10 00 02 59 0E
				15 01 00 00 10 00 02 56 01
				15 01 00 00 10 00 02 FF 10
				];
		qcom,mdss-dsi-dispparam-level3-command = [
				15 01 00 00 10 00 02 FF 22
				15 01 00 00 10 00 02 58 16
				15 01 00 00 10 00 02 59 0E
				15 01 00 00 10 00 02 56 01
				15 01 00 00 10 00 02 FF 10
				];
		qcom,mdss-dsi-dispparam-level4-command = [
				15 01 00 00 10 00 02 FF 22
				15 01 00 00 10 00 02 58 18
				15 01 00 00 10 00 02 59 0E
				15 01 00 00 10 00 02 56 01
				15 01 00 00 10 00 02 FF 10
				];
		qcom,mdss-dsi-dispparam-level5-command = [
				15 01 00 00 10 00 02 FF 22
				15 01 00 00 10 00 02 58 1A
				15 01 00 00 10 00 02 59 0E
				15 01 00 00 10 00 02 56 01
				15 01 00 00 10 00 02 FF 10
				];
		qcom,mdss-dsi-dispparam-level6-command = [
				15 01 00 00 10 00 02 FF 22
				15 01 00 00 10 00 02 58 1C
				15 01 00 00 10 00 02 59 0E
				15 01 00 00 10 00 02 56 01
				15 01 00 00 10 00 02 FF 10
				];
		qcom,mdss-dsi-dispparam-idleon-command = [
				15 01 00 00 10 00 02 FF 10
				15 01 00 00 10 00 02 39 00
				];
		qcom,mdss-dsi-dispparam-idleoff-command = [
				15 01 00 00 10 00 02 FF 10
				15 01 00 00 10 00 02 38 00
				];
		qcom,mdss-dsi-dispparam-test-command = [
				15 01 00 00 10 00 02 FF 20
				];
		qcom,mdss-dsi-dispparam-test-command-state = "dsi_hs_mode";
	};
};
