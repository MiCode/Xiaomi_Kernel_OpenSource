## audio-kernel/asoc/codecs/dbmdx/Kconfig
```kconfig
#
# DBMDX SoC audio configuration
#
#

# DBMDX SOC enabler.
# y - Enable DSPG VT/VE Chip
# n - Disable DSPG VT/VE Chip
# m - Build as module
config SND_SOC_DBMDX
	tristate "DSPG Voice Trigger/Enhancement Chip"
	default n
	help
		DSPG Voice Trigger/Enhancement Chip
		y - Enable DSPG VT/VE Chip
		n - Disable DSPG VT/VE Chip
		m - Build as module

# Register DBMDX SOC as a separate sound card.
# y - Register DBMDX SOC as separate sound card
# n - Do not register DBMDX SOC as separate sound card
# .
config SND_SOC_DBMDX_SND_CAPTURE
	bool "DSPG Capture Device Support"
	depends on SND_SOC_DBMDX
	default y
	help
		Register DBMDX SOC as a separate sound card.
		.
		y - Register DBMDX SOC as separate sound card
		n - Do not register DBMDX SOC as separate sound card

# Register DBMDX SOC as a separate sound card.
# .
# .
# .
config SND_SOC_DBMD4_SPI
	bool "DSPG Voice Trigger/Enhancement Chip"
	default y
	help
		DSPG Voice Trigger/Enhancement Chip SPI Interface
		.
		.
		.

# Register DBMDX SOC as a separate sound card.
# .
# .
# .
config SND_SOC_DBMD4_I2C
	bool "DSPG Voice Trigger/Enhancement Chip"
	default n
	help
		DSPG Voice Trigger/Enhancement Chip SPI Interface
		.
		.
		.

# Register DBMDX SOC as a separate sound card.
# .
# .
# .
config SND_SOC_DBMD4_UART
	bool "DSPG Voice Trigger/Enhancement Chip"
	default n
	help
		DSPG Voice Trigger/Enhancement Chip SPI Interface
		.
		.
		.

# Register DBMDX SOC as a separate sound card.
# .
# .
# .
config SND_SOC_DBMD2_SPI
	bool "DSPG Voice Trigger/Enhancement Chip"
	default n
	help
		DSPG Voice Trigger/Enhancement Chip SPI Interface
		.
		.
		.

# Register DBMDX SOC as a separate sound card.
# .
# .
# .
config SND_SOC_DBMD2_I2C
	bool "DSPG Voice Trigger/Enhancement Chip"
	default n
	help
		DSPG Voice Trigger/Enhancement Chip SPI Interface
		.
		.
		.

# Register DBMDX SOC as a separate sound card.
# .
# .
# .
config SND_SOC_DBMD2_UART
	bool "DSPG Voice Trigger/Enhancement Chip"
	default n
	help
		DSPG Voice Trigger/Enhancement Chip SPI Interface
		.
		.
		.
```

## block/Kconfig.iosched
```kconfig
if BLOCK

menu "IO Schedulers"

config IOSCHED_NOOP
	bool
	default y
	---help---
	  The no-op I/O scheduler is a minimal scheduler that does basic merging
	  and sorting. Its main uses include non-disk based block devices like
	  memory devices, and specialised software or hardware environments
	  that do their own scheduling and require only minimal assistance from
	  the kernel.

config IOSCHED_TEST
	tristate "Test I/O scheduler"
	depends on DEBUG_FS
	default m
	---help---
	  The test I/O scheduler is a duplicate of the noop scheduler with
	  addition of test utlity.
	  It allows testing a block device by dispatching specific requests
	  according to the test case and declare PASS/FAIL according to the
	  requests completion error code.

config IOSCHED_DEADLINE
	tristate "Deadline I/O scheduler"
	default y
	---help---
	  The deadline I/O scheduler is simple and compact. It will provide
	  CSCAN service with FIFO expiration of requests, switching to
	  a new point in the service tree and doing a batch of IO from there
	  in case of expiry.

config IOSCHED_ROW
	tristate "ROW I/O scheduler"
	default y
	---help---
	  The ROW I/O scheduler gives priority to READ requests over the
	  WRITE requests when dispatching, without starving WRITE requests.
	  Requests are kept in priority queues. Dispatching is done in a RR
	  manner when the dispatch quantum for each queue is calculated
	  according to queue priority.
	  Most suitable for mobile devices.

config IOSCHED_CFQ
	tristate "CFQ I/O scheduler"
	default y
	---help---
	  The CFQ I/O scheduler tries to distribute bandwidth equally
	  among all processes in the system. It should provide a fair
	  and low latency working environment, suitable for both desktop
	  and server systems.

	  This is the default I/O scheduler.

config IOSCHED_FIOPS
	tristate "IOPS based I/O scheduler"
	default y
	---help---
	  This is an IOPS based I/O scheduler. It will try to distribute
	  IOPS equally among all processes in the system. It's mainly for
	  Flash based storage.

config CFQ_GROUP_IOSCHED
	bool "CFQ Group Scheduling support"
	depends on IOSCHED_CFQ && BLK_CGROUP
	default n
	---help---
	  Enable group IO scheduling in CFQ.

config IOSCHED_SIO
	tristate "Simple I/O scheduler"
	default y
	---help---
	  The Simple I/O scheduler is an extremely simple scheduler,
	  based on noop and deadline, that relies on deadlines to
	  ensure fairness. The algorithm does not do any sorting but
	  basic merging, trying to keep a minimum overhead. It is aimed
	  mainly for aleatory access devices (eg: flash devices).

config IOSCHED_BFQ
	tristate "BFQ I/O scheduler"
	default n
	---help---
	  The BFQ I/O scheduler tries to distribute bandwidth among
	  all processes according to their weights.
	  It aims at distributing the bandwidth as desired, independently of
	  the disk parameters and with any workload. It also tries to
	  guarantee low latency to interactive and soft real-time
	  applications. If compiled built-in (saying Y here), BFQ can
	  be configured to support hierarchical scheduling.

config CGROUP_BFQIO
	bool "BFQ hierarchical scheduling support"
	depends on CGROUPS && IOSCHED_BFQ=y
	default n
	---help---
	  Enable hierarchical scheduling in BFQ, using the cgroups
	  filesystem interface.  The name of the subsystem will be
	  bfqio.

choice
	prompt "Default I/O scheduler"
	default DEFAULT_CFQ
	help
	  Select the I/O scheduler which will be used by default for all
	  block devices.

	config DEFAULT_DEADLINE
		bool "Deadline" if IOSCHED_DEADLINE=y

	config DEFAULT_ROW
		bool "ROW" if IOSCHED_ROW=y
		help
		  The ROW I/O scheduler gives priority to READ requests
		  over the WRITE requests when dispatching, without starving
		  WRITE requests. Requests are kept in priority queues.
		  Dispatching is done in a RR manner when the dispatch quantum
		  for each queue is defined according to queue priority.
		  Most suitable for mobile devices.

	config DEFAULT_CFQ
		bool "CFQ" if IOSCHED_CFQ=y

	config DEFAULT_BFQ
		bool "BFQ" if IOSCHED_BFQ=y
		help
		  Selects BFQ as the default I/O scheduler which will be
		  used by default for all block devices.
		  The BFQ I/O scheduler aims at distributing the bandwidth
		  as desired, independently of the disk parameters and with
		  any workload. It also tries to guarantee low latency to
		  interactive and soft real-time applications.

	config DEFAULT_NOOP
		bool "No-op" if IOSCHED_NOOP=y

	config DEFAULT_FIOPS
		bool "FIOPS" if IOSCHED_FIOPS=y

	config DEFAULT_SIO
		bool "SIO" if IOSCHED_SIO=y

endchoice

config DEFAULT_IOSCHED
	string
	default "deadline" if DEFAULT_DEADLINE
	default "row" if DEFAULT_ROW
	default "cfq" if DEFAULT_CFQ
	default "bfq" if DEFAULT_BFQ
	default "noop" if DEFAULT_NOOP
	default "sio" if DEFAULT_SIO
	default "fiops" if DEFAULT_FIOPS

endmenu

endif
```

## drivers/airoha/Kconfig
```kconfig
config CONFIG_AIROHA_GPS
	bool "Airoha GPS Support"
	default y
	help
		Airoha GPS Support
```

## drivers/base/regmap/Kconfig
```kconfig
# SPDX-License-Identifier: GPL-2.0
# Generic register map support.  There are no user servicable options here,
# this is an API intended to be used by other kernel subsystems.  These
# subsystems should select the appropriate symbols.

config REGMAP
	default y if (REGMAP_I2C || REGMAP_SPI || REGMAP_SPMI || REGMAP_W1 || REGMAP_AC97 || REGMAP_MMIO || REGMAP_IRQ)
	select IRQ_DOMAIN if REGMAP_IRQ
	bool

config REGCACHE_COMPRESSED
	select LZO_COMPRESS
	select LZO_DECOMPRESS
	bool

config REGMAP_AC97
	tristate

config REGMAP_I2C
	tristate
	depends on I2C

config REGMAP_SPI
	tristate
	depends on SPI

config REGMAP_SPMI
	tristate
	depends on SPMI

config REGMAP_W1
	tristate
	depends on W1

config REGMAP_MMIO
	tristate

config REGMAP_IRQ
	bool

config REGMAP_WCD_IRQ
	depends on SND_SOC
	bool "Enable REGMAP IRQ for WCD"
	select REGMAP_IRQ
	default n
	help
	  Say 'y' here to enable REGMAP_IRQ for generic WCD IRQ.
	  This config is intended for enabling REGMAP_IRQ for
	  WCD IRQ. Generic WCD IRQ will be used for
	  wcd937x and later targets.

config REGMAP_ALLOW_WRITE_DEBUGFS
	depends on REGMAP && DEBUG_FS
	bool "Allow REGMAP debugfs write"
	default n
	help
	  Say 'y' here to allow the regmap debugfs write. Regmap debugfs write
	  could be risky when accessing some essential hardwares, so it is not
	  recommended to enable this option on any production device.
```

## drivers/bif/Kconfig
```kconfig
#
# BIF framework and drivers
#
menuconfig BIF
	bool "MIPI-BIF support"
	select CRC_CCITT
	select BITREVERSE
	help
	  MIPI-BIF (battery interface) is a one-wire serial interface between a
	  host master device and one or more slave devices which are located in
	  a battery pack or also on the host.  Enabling this option allows for
	  BIF consumer drivers to issue transactions via BIF controller drivers.

if BIF
config BIF_QPNP
	depends on SPMI || MSM_SPMI
	depends on OF_SPMI
	tristate "Qualcomm QPNP BIF support"
	help
	  This driver supports the QPNP BSI peripheral found inside of Qualcomm
	  QPNP PMIC devices.  The BSI peripheral is able to communicate using
	  the BIF protocol.  The QPNP BSI driver hooks into the BIF framework.
	  Enable this option in order to provide support for BIF communication
	  on targets which have BSI PMIC peripherals.

endif
```

## drivers/block/zram/Kconfig
```kconfig
# SPDX-License-Identifier: GPL-2.0
config ZRAM
	tristate "Compressed RAM block device support"
	depends on BLOCK && SYSFS && ZSMALLOC && CRYPTO
	select CRYPTO_LZO
	default n
	help
	  Creates virtual block devices called /dev/zramX (X = 0, 1, ...).
	  Pages written to these disks are compressed and stored in memory
	  itself. These disks allow very fast I/O and compression provides
	  good amounts of memory savings.

	  It has several use cases, for example: /tmp storage, use as swap
	  disks and maybe many more.

	  See zram.txt for more information.

config ZRAM_DEDUP
	bool "Deduplication support for ZRAM data"
	depends on ZRAM
	default n
	help
	  Deduplicate ZRAM data to reduce amount of memory consumption.
	  Advantage largely depends on the workload. In some cases, this
          option reduces memory usage to the half. However, if there is no
	  duplicated data, the amount of memory consumption would be
	  increased due to additional metadata usage. And, there is
	  computation time trade-off. Please check the benefit before
	  enabling this option. Experiment shows the positive effect when
	  the zram is used as blockdev and is used to store build output.

config ZRAM_WRITEBACK
       bool "Write back incompressible page to backing device"
       depends on ZRAM
       default n
       help
	 With incompressible page, there is no memory saving to keep it
	 in memory. Instead, write it out to backing device.
	 For this feature, admin should set up backing device via
	 /sys/block/zramX/backing_dev.

	 See zram.txt for more infomration.
```

## drivers/bluetooth/sd8797/Kconfig
```kconfig
config SD8797_BT_DEBUG
	depends on SD8797
	bool "Debug option"
	default n
	---help---
          DEBUG LEVEL n/1/2:
          n: NO DEBUG
          1: Only PRINTM(MMSG,...), PRINTM(MFATAL,...), ...
          2: All PRINTM()
```

## drivers/bluetooth/sd8897/Kconfig
```kconfig
config SD8897_BT_DEBUG
	depends on SD8897
	bool "Debug option"
	default n
	---help---
          DEBUG LEVEL n/1/2:
          n: NO DEBUG
          1: Only PRINTM(MMSG,...), PRINTM(MFATAL,...), ...
          2: All PRINTM()
```

## drivers/bus/mhi/controllers/Kconfig
```kconfig
menu "MHI controllers"

config MHI_QCOM
       tristate "MHI QCOM"
       depends on MHI_BUS
       help
	  If you say yes to this option, MHI bus support for QCOM modem chipsets
	  will be enabled.

endmenu
```

## drivers/bus/mhi/devices/Kconfig
```kconfig
# SPDX-License-Identifier: GPL-2.0

menu "MHI device support"

config MHI_NETDEV
       tristate "MHI NETDEV"
       depends on MHI_BUS
       help
	  MHI based net device driver for transferring IP traffic
	  between host and modem. By enabling this driver, clients
	  can transfer data using standard network interface. Over
	  the air traffic goes thru mhi netdev interface.

config MHI_UCI
       tristate "MHI UCI"
       depends on MHI_BUS
       help
	  MHI based uci driver is for transferring data between host and
	  modem using standard file operations from user space. Open, read,
	  write, ioctl, and close operations are supported by this driver.
	  Please check mhi_uci_match_table for all supported channels that
	  are exposed to userspace.
endmenu
```

## drivers/char/diag/Kconfig
```kconfig
menu "Diag Support"

config DIAG_CHAR
	tristate "DIAG CHAR Interface Core"
	default n
	depends on USB_CONFIGFS_F_DIAG || USB_FUNCTION_DIAG || USB_QCOM_MAEMO
	depends on ARCH_QCOM
	depends on POWER_RESET_QCOM
	select CRC_CCITT
	help
	  Char driver interface for SoC Diagnostic information. The DIAG Char
	  driver provides diag forwarding to user space and SoC Peripherals.
	  This enables diagchar for maemo usb gadget or android usb gadget
	  based on config selected.

config DIAG_OVER_USB
	bool "Enable DIAG traffic to go over USB"
	depends on DIAG_CHAR
	depends on ARCH_QCOM
	default y
	help
	  Diag over USB enables sending DIAG traffic over a USB transport. When
	  the USB endpoints become available, the DIAG driver will enable Diag
	  traffic over USB. This allows for host side tools to parse and display
	  Diag traffic from the USB endpoint.

config DIAGFWD_BRIDGE_CODE
	bool "Enable remote DIAG traffic over MHI/HSIC"
	depends on DIAG_CHAR
	depends on USB_QTI_DIAG_BRIDGE || MHI_BUS
	default y
	help
	  MHI/HSIC Transport Layer for DIAG Router. When the MHI/HSIC endpoints
	  become available, this bridge driver enables DIAG traffic over MHI
	  and HSIC.

config DIAG_OVER_PCIE
	bool "Enable Diag traffic to go over PCIE"
	depends on DIAG_CHAR
	depends on MSM_MHI_DEV
	help
	  Diag over PCIE enables sending diag traffic over PCIE endpoint when
	  pcie is available. Diag PCIE channels should be configured
	  and connected to use the transport. If PCIE is not configured
	  diag will switch to usb mode and diag traffic will be routed
	  over USB.

endmenu
```

## drivers/char/rpmb/Kconfig
```kconfig
# SPDX-License-Identifier: GPL-2.0-only
#
# RPMB character device configuration
#

config RPMB_INTF_DEV
	tristate "RPMB character device interface /dev/rpmbN"
	help
	  Say yes here if you want to access RPMB from user space
	  via character device interface /dev/rpmb%d


config RPMB_SIM
	tristate "RPMB partition device simulator"
	default n
	select RPMB
	select CRYPTO_SHA256
	select CRYPTO_HMAC
	help
	  RPMB partition simulation device is a virtual device that
	  provides simulation of the RPMB protocol and use kernel memory
	  as storage.

	  Be aware it doesn't promise any real security. This driver is
	  suitable only for testing of the RPMB subsystem or RPMB applications
	  prior to RPMB key provisioning.
          Most people should say N here.
```

## drivers/clk/msm/Kconfig
```kconfig
config COMMON_CLK_MSM
	tristate "Support for MSM clock controllers"
	depends on OF
	depends on ARCH_QCOM
	select RATIONAL
	select ARCH_HAS_RESET_CONTROLLER
	help
	  This support clock controller used by MSM devices which support
	  global, mmss and gpu clock controller.
	  Say Y if you want to support the clocks exposed by the MSM on
	  platforms such as msm8953 etc.

config MSM_CLK_CONTROLLER_V2
	bool "QTI clock driver"
	depends on COMMON_CLK_MSM
	---help---
	   Generate clock data structures from definitions found in
	   device tree.
```

## drivers/clk/msm/mdss/Kconfig
```kconfig
config MSM_MDSS_PLL
	bool "MDSS pll programming"
	---help---
	It provides support for DSI, eDP and HDMI interface pll programming on MDSS
	hardware. It also handles the pll specific resources and turn them on/off when
	mdss pll client tries to enable/disable pll clocks.
```
