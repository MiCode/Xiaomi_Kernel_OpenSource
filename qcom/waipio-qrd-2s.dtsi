#include "waipio-qrd.dtsi"

&battery_charger {
	qcom,thermal-mitigation = <10000000 9500000 9000000 8500000 8000000
				7500000 7000000 6500000 6000000 5500000
				5000000 4500000 4000000 3500000 3000000
				2500000 2000000 1500000 1000000 500000>;
	qcom,shutdown-voltage = <6200>;
};
