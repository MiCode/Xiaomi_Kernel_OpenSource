/dts-v1/;
/plugin/;

#include "cape-v2-cdp.dtsi"

/ {
	model = "Qualcomm Technologies, Inc. Cape LTE Only CDP";
	compatible = "qcom,cape-v2-cdp", "qcom,cape-v2", "qcom,cdp";
	qcom,msm-id = <540 0x10000>;
	qcom,board-id = <1 0>;
};
