/dts-v1/;

#include "waipio-vm.dtsi"
#include "waipio-vm-qrd.dtsi"

/ {
	model = "Qualcomm Technologies, Inc. Waipio SVM QRD";
	compatible = "qcom,waipio-qrd", "qcom,waipio", "qcom,qrd";
	qcom,board-id = <0x1000B 0>;
};
