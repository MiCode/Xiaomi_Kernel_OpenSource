/dts-v1/;
/plugin/;

#include "cape-cdp.dtsi"

/ {
	model = "Qualcomm Technologies, Inc. Cape CDP";
	compatible = "qcom,cape-cdp", "qcom,cape", "qcom,cdp";
	qcom,msm-id = <530 0x10000>;
	qcom,board-id = <1 0>;
};
