/dts-v1/;
/plugin/;

#include <dt-bindings/interconnect/qcom,diwali.h>
#include "diwali-idp-hsp.dtsi"

/ {
	model = "Qualcomm Technologies, Inc. Diwali IDP + HSP";
	compatible = "qcom,diwali-idp", "qcom,diwali", "qcom,idp";
	qcom,msm-id = <506 0x10000>, <547 0x10000>, <564 0x10000>;
	qcom,board-id = <34 2>;
	qcom,pmic-id-size = <9>;
	qcom,pmic-id = <0x0 0x0 0x0 0x0 0x0 0x0 0x0 0x0 0x2E>;
};
