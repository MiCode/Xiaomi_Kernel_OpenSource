/dts-v1/;

#include "waipio-v2.dtsi"
#include "waipio-qrd-2s.dtsi"
#include "waipio-pm8010-spmi.dtsi"

/ {
	model = "Qualcomm Technologies, Inc. Waipio v2 QRD with PM8010 + 2S";
	compatible = "qcom,waipio-qrd", "qcom,waipio", "qcom,qrd";
	qcom,board-id = <0x2000b 0>;
};
