/dts-v1/;
/plugin/;

#include "lahaina-qrd-module.dtsi"

/ {
	model = "Qualcomm Technologies, Inc. Lahaina QRD Module";
	compatible = "qcom,lahaina-qrd-module", "qcom,lahaina", "qcom,qrd";
	qcom,board-id = <0x1000B 0x8>;
};
