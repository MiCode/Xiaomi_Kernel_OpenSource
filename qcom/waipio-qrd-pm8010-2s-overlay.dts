/dts-v1/;
/plugin/;

#include "waipio-qrd-2s.dtsi"
#include "waipio-pm8010-spmi.dtsi"

/ {
	model = "Qualcomm Technologies, Inc. Waipio QRD with PM8010 + 2S";
	compatible = "qcom,waipio-qrd", "qcom,waipio", "qcom,qrd";
	qcom,msm-id = <457 0x10000>, <482 0x10000>;
	qcom,board-id = <0x2000b 0>;
};
