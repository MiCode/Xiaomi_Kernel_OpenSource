#include <dt-bindings/gpio/gpio.h>

/* Remove regulator nodes specific to SM8150 */
&apps_rsc {
	/delete-node/ regulator-pm8150-s4;
	/delete-node/ rpmh-regulator-msslvl;
	/delete-node/ rpmh-regulator-smpa2;
	/delete-node/ rpmh-regulator-ebilvl;
	/delete-node/ rpmh-regulator-smpa5;
	/delete-node/ rpmh-regulator-smpa6;
	/delete-node/ rpmh-regulator-ldoa1;
	/delete-node/ rpmh-regulator-ldoa2;
	/delete-node/ rpmh-regulator-ldoa3;
	/delete-node/ rpmh-regulator-lmxlvl;
	/delete-node/ rpmh-regulator-ldoa5;
	/delete-node/ rpmh-regulator-ldoa6;
	/delete-node/ rpmh-regulator-ldoa7;
	/delete-node/ rpmh-regulator-lcxlvl;
	/delete-node/ rpmh-regulator-ldoa9;
	/delete-node/ rpmh-regulator-ldoa10;
	/delete-node/ rpmh-regulator-ldoa11;
	/delete-node/ rpmh-regulator-ldoa12;
	/delete-node/ rpmh-regulator-ldoa13;
	/delete-node/ rpmh-regulator-ldoa14;
	/delete-node/ rpmh-regulator-ldoa15;
	/delete-node/ rpmh-regulator-ldoa16;
	/delete-node/ rpmh-regulator-ldoa17;
	/delete-node/ rpmh-regulator-smpc1;
	/delete-node/ rpmh-regulator-gfxlvl;
	/delete-node/ rpmh-regulator-mxlvl;
	/delete-node/ rpmh-regulator-mmcxlvl;
	/delete-node/ rpmh-regulator-cxlvl;
	/delete-node/ rpmh-regulator-smpc8;
	/delete-node/ rpmh-regulator-ldoc1;
	/delete-node/ rpmh-regulator-ldoc2;
	/delete-node/ rpmh-regulator-ldoc3;
	/delete-node/ rpmh-regulator-ldoc4;
	/delete-node/ rpmh-regulator-ldoc5;
	/delete-node/ rpmh-regulator-ldoc6;
	/delete-node/ rpmh-regulator-ldoc7;
	/delete-node/ rpmh-regulator-ldoc8;
	/delete-node/ rpmh-regulator-ldoc9;
	/delete-node/ rpmh-regulator-ldoc10;
	/delete-node/ rpmh-regulator-ldoc11;
	/delete-node/ rpmh-regulator-bobc1;
	/delete-node/ rpmh-regulator-smpf2;
	/delete-node/ rpmh-regulator-ldof2;
	/delete-node/ rpmh-regulator-ldof5;
	/delete-node/ rpmh-regulator-ldof6;
};

&slpi_tlmm {
	status = "ok";
};

/* Add regulator nodes specific to SA8155 */
#include "sa8155-regulator.dtsi"
