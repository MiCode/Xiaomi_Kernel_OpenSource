/dts-v1/;

#include "waipiop-v2.dtsi"
#include "waipio-qrd.dtsi"
#include "waipio-pm8008.dtsi"

/ {
	model = "Qualcomm Technologies, Inc. WaipioP v2 QRD with PM8008";
	compatible = "qcom,waipiop-qrd", "qcom,waipiop", "qcom,qrd";
	qcom,board-id = <11 0>;
};
