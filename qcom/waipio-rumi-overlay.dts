/dts-v1/;
/plugin/;

#include "waipio-rumi.dtsi"

/ {
	model = "Qualcomm Technologies, Inc. Waipio RUMI";
	compatible = "qcom,waipio-rumi", "qcom,waipio", "qcom,rumi";
	qcom,msm-id = <457 0x10000>;
	qcom,board-id = <0x1000F 0>;
};
