/dts-v1/;
/plugin/;

#include "neo-rumi.dtsi"

/ {
	model = "Qualcomm Technologies, Inc. NEO RUMI";
	compatible = "qcom,neo-rumi", "qcom,neo", "qcom,rumi";
	qcom,msm-id = <525 0x10000>;
	qcom,board-id = <0x1000F 0>;
};
