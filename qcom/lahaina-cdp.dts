/dts-v1/;

#include "lahaina.dtsi"
#include "lahaina-cdp.dtsi"

/ {
	model = "Qualcomm Technologies, Inc. Lahaina CDP";
	compatible = "qcom,lahaina-cdp", "qcom,lahaina", "qcom,cdp";
	qcom,board-id = <0x10001 0>;
};
