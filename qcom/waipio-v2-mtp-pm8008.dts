/dts-v1/;

#include "waipio-v2.dtsi"
#include "waipio-mtp.dtsi"
#include "waipio-pm8008.dtsi"

/ {
	model = "Qualcomm Technologies, Inc. Waipio v2 MTP with PM8008";
	compatible = "qcom,waipio-mtp", "qcom,waipio", "qcom,mtp";
	qcom,board-id = <8 0>;
};
