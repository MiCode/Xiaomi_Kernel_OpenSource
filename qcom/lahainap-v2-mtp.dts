/dts-v1/;

#include "lahainap-v2.dtsi"
#include "lahainap-mtp.dtsi"

/ {
	model = "Qualcomm Technologies, Inc. LahainaP v2 MTP";
	compatible = "qcom,lahainap-mtp", "qcom,lahainap", "qcom,mtp";
	qcom,board-id = <0x10008 0>;
};
