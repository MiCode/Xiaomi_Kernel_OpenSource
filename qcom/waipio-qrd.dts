/dts-v1/;

#include "waipio.dtsi"
#include "waipio-qrd.dtsi"

/ {
	model = "Qualcomm Technologies, Inc. Waipio QRD";
	compatible = "qcom,waipio-qrd", "qcom,waipio", "qcom,qrd";
	qcom,board-id = <11 0>;
};
