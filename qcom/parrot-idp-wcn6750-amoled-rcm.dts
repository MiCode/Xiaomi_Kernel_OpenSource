/dts-v1/;

#include "parrot-wcn6750.dtsi"
#include "parrot-idp-wcn6750-amoled-rcm.dtsi"
#include "parrot-idp-pm7250b.dtsi"

/ {
	model = "Qualcomm Technologies, Inc. Parrot WCN6750 IDP + AMOLED + RCM";
	compatible = "qcom,parrot-idp", "qcom,parrot", "qcom,idp";
	qcom,board-id = <34 2>;
};
