&qupv3_se4_i2c {
	status = "ok";
	focaltech@38 {
		compatible = "focaltech,fts_ts";
		reg = <0x38>;
		focaltech,display-coords = <0 0 1080 2340>;
		focaltech,trusted-touch-mode = "vm_mode";
		focaltech,touch-environment = "tvm";
		focaltech,trusted-touch-spi-irq = <754>;
		focaltech,trusted-touch-io-bases = <0xF110000 0xF111000 0xF112000 0xF113000
						0xF114000 0xF115000 0x990000 0x00910000>;
		focaltech,trusted-touch-io-sizes = <0x1000 0x1000 0x1000 0x1000
						0x1000 0x1000 0x1000 0x4000>;
	};
};
