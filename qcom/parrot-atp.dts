/dts-v1/;

#include "parrot-wcn3990.dtsi"
#include "parrot-atp.dtsi"

/ {
	model = "Qualcomm Technologies, Inc. Parrot ATP";
	compatible = "qcom,parrot-atp", "qcom,parrot", "qcom,atp";
	qcom,board-id = <33 0>;
};
