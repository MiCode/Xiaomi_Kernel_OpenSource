/dts-v1/;
/plugin/;

#include "lahaina-qrd.dtsi"

/ {
	model = "Qualcomm Technologies, Inc. Lahaina QRD";
	compatible = "qcom,lahaina-qrd", "qcom,lahaina", "qcom,qrd";
	qcom,board-id = <0x1000B 0>;
};
