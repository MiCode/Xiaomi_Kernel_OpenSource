/dts-v1/;
/plugin/;

#include "ingres-sm8450.dtsi"
#include "ingres-wl2866d.dtsi"

/ {
	model = "Ingres based on Qualcomm Technologies, Inc SM8450";
	compatible = "qcom,waipio-mtp", "qcom,waipio", "qcom,mtp";
	qcom,msm-id = <457 0x10000>, <482 0x10000>, <457 0x20000>, <482 0x20000>, <552 0x10000>;
	qcom,board-id = <0x10008 0>, <0x03010008 0x03>;
	xiaomi,miboard-id = <0x4 0>;
};
