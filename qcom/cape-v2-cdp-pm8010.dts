/dts-v1/;

#include "cape-v2.dtsi"
#include "cape-cdp.dtsi"
#include "waipio-pm8010-spmi.dtsi"

/ {
	model = "Qualcomm Technologies, Inc. Cape LTE Only CDP with PM8010";
	compatible = "qcom,cape-v2-cdp", "qcom,cape-v2", "qcom,cdp";
	qcom,board-id = <0x10001 0>;
};
