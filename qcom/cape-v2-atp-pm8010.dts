/dts-v1/;

#include "cape-v2.dtsi"
#include "cape-atp.dtsi"
#include "waipio-pm8010-spmi.dtsi"

/ {
	model = "Qualcomm Technologies, Inc. Cape LTE Only ATP with PM8010";
	compatible = "qcom,cape-v2-atp", "qcom,cape-v2", "qcom,atp";
	qcom,board-id = <0x10021 0>;
};
