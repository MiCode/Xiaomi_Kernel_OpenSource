/dts-v1/;

#include "waipio.dtsi"
#include "waipio-atp.dtsi"
#include "waipio-pm8010-spmi.dtsi"

/ {
	model = "Qualcomm Technologies, Inc. Waipio ATP with PM8010";
	compatible = "qcom,waipio-atp", "qcom,waipio", "qcom,atp";
	qcom,board-id = <0x10021 0>;
};
