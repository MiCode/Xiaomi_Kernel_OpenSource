/dts-v1/;
/plugin/;

#include "cape-v2-qrd.dtsi"

/ {
	model = "Qualcomm Technologies, Inc. Cape LTE Only QRD";
	compatible = "qcom,cape-v2-qrd", "qcom,cape-v2", "qcom,qrd";
	qcom,msm-id = <540 0x10000>;
	qcom,board-id = <0x1000B 0>;
};

