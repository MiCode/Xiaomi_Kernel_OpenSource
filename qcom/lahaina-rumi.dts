/dts-v1/;
/memreserve/ 0x90000000 0x00000100;

#include "lahaina.dtsi"
#include "lahaina-rumi.dtsi"

/ {
	model = "Qualcomm Technologies, Inc. Lahaina RUMI";
	compatible = "qcom,lahaina-rumi", "qcom,lahaina", "qcom,rumi";
	qcom,board-id = <0x1000F 0>;
};
