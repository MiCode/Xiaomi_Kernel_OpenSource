#include <dt-bindings/arm/msm/msm_ion_ids.h>

/ {
	qcom,ion {
		compatible = "qcom,msm-ion";
		#address-cells = <1>;
		#size-cells = <0>;

		tui_heap: qcom,ion-heap-tui { /* TRUSTED UI CARVEOUT HEAP */
			reg = <ION_TUI_CARVEOUT_HEAP_ID>;
			qcom,dynamic-heap;
			qcom,ion-heap-type = "MSM_CARVEOUT";
		};
	};
};
