/dts-v1/;

#include "diwali-vm.dtsi"
#include "diwali-vm-qrd.dtsi"

/ {
	model = "Qualcomm Technologies, Inc. Diwali SVM QRD";
	compatible = "qcom,diwali-qrd", "qcom,diwali", "qcom,qrd";
	qcom,board-id = <0x1000B 0>;
};
