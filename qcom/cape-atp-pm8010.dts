/dts-v1/;

#include "cape.dtsi"
#include "cape-atp.dtsi"
#include "waipio-pm8010-spmi.dtsi"

/ {
	model = "Qualcomm Technologies, Inc. Cape ATP with PM8010";
	compatible = "qcom,cape-atp", "qcom,cape", "qcom,atp";
	qcom,board-id = <0x10021 0>;
};
