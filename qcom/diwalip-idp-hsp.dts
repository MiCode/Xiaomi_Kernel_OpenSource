/dts-v1/;

#include "diwalip.dtsi"
#include "diwalip-idp-hsp.dtsi"

/ {
	model = "Qualcomm Technologies, Inc. DiwaliP IDP + HSP";
	compatible = "qcom,diwalip-idp", "qcom,diwalip", "qcom,idp";
	qcom,board-id = <34 2>;
	qcom,pmic-id-size = <9>;
	qcom,pmic-id = <0x0 0x0 0x0 0x0 0x0 0x0 0x0 0x0 0x2E>;
};
