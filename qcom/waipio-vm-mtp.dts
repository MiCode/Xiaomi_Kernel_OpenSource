/dts-v1/;

#include "waipio-vm.dtsi"
#include "waipio-vm-mtp.dtsi"

/ {
	model = "Qualcomm Technologies, Inc. Waipio SVM MTP";
	compatible = "qcom,waipio-mtp", "qcom,waipio", "qcom,mtp";
	qcom,board-id = <0x10008 0>;
};
