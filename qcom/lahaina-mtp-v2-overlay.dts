/dts-v1/;
/plugin/;

#include "lahaina-mtp-v2.dtsi"

/ {
	model = "Qualcomm Technologies, Inc. Lahaina MTP v2";
	compatible = "qcom,lahaina-mtp", "qcom,lahaina", "qcom,mtp";
	qcom,board-id = <0x20008 0>;
};
