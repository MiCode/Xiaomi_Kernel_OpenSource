/dts-v1/;

#include "diwali.dtsi"
#include "diwali-qrd.dtsi"

/ {
	model = "Qualcomm Technologies, Inc. Diwali QRD NOPMI";
	compatible = "qcom,diwali-qrd", "qcom,diwali", "qcom,qrd";
	qcom,board-id = <0x1000B 0>;
	qcom,pmic-id-size = <9>;
	qcom,pmic-id = <0x0 0x0 0x0 0x0 0x0 0x0 0x0 0x0 0x0>;
};
