/dts-v1/;

#include "cape-v2.dtsi"
#include "cape-mtp.dtsi"
#include "waipio-pm8010-spmi.dtsi"

/ {
	model = "Qualcomm Technologies, Inc. Cape LTE Only MTP with PM8010";
	compatible = "qcom,cape-v2-mtp", "qcom,cape-v2", "qcom,mtp";
	qcom,board-id = <0x10008 0>;
};
