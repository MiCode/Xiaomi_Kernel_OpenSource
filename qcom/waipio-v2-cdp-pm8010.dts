/dts-v1/;

#include "waipio-v2.dtsi"
#include "waipio-cdp.dtsi"
#include "waipio-pm8010-spmi.dtsi"

/ {
	model = "Qualcomm Technologies, Inc. Waipio v2 CDP with PM8010";
	compatible = "qcom,waipio-cdp", "qcom,waipio", "qcom,cdp";
	qcom,board-id = <0x10001 0>;
};
