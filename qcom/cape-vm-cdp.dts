/dts-v1/;

#include "cape-vm.dtsi"
#include "cape-vm-cdp.dtsi"

/ {
	model = "Qualcomm Technologies, Inc. Cape SVM CDP";
	compatible = "qcom,cape-cdp", "qcom,cape", "qcom,cdp";
	qcom,board-id = <0x10001 0>;
};
