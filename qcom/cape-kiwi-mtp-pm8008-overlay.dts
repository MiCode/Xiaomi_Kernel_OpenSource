/dts-v1/;
/plugin/;

#include "cape-mtp.dtsi"
#include "waipio-pm8008.dtsi"
#include "cape-kiwi.dtsi"

/ {
	model = "Qualcomm Technologies, Inc. Cape MTP with kiwi";
	compatible = "qcom,cape-cdp", "qcom,cape", "qcom,cdp";
	qcom,msm-id = <530 0x10000>, <531 0x10000>, <540 0x10000>;
	qcom,board-id = <0x10008 0x1>;
};
