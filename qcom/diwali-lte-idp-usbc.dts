/dts-v1/;

#include "diwali-lte.dtsi"
#include "diwali-lte-idp-usbc.dtsi"

/ {
	model = "Qualcomm Technologies, Inc. Diwali LTE IDP USBC audio";
	compatible = "qcom,diwali-lte-idp", "qcom,diwali-lte", "qcom,idp";
	qcom,board-id = <34 1>;
	qcom,pmic-id-size = <9>;
	qcom,pmic-id = <0x0 0x0 0x0 0x0 0x0 0x0 0x0 0x0 0x2E>;
};
