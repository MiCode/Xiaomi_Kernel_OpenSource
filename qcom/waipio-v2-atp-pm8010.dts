/dts-v1/;

#include "waipio-v2.dtsi"
#include "waipio-atp.dtsi"
#include "waipio-pm8010-spmi.dtsi"

/ {
	model = "Qualcomm Technologies, Inc. Waipio v2 ATP with PM8010";
	compatible = "qcom,waipio-atp", "qcom,waipio", "qcom,atp";
	qcom,board-id = <0x10021 0>;
};
