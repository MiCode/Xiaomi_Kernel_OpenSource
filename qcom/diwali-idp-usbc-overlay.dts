/dts-v1/;
/plugin/;

#include "diwali-idp-usbc.dtsi"

/ {
	model = "Qualcomm Technologies, Inc. Diwali IDP USBC audio";
	compatible = "qcom,diwali-idp", "qcom,diwali", "qcom,idp";
	qcom,msm-id = <506 0x10000>;
	qcom,board-id = <34 1>;
};
