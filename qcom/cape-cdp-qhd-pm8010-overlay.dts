/dts-v1/;
/plugin/;

#include "cape-cdp-qhd-pm8010.dtsi"

/ {
	model = "Qualcomm Technologies, Inc. Cape CDP + QHD with PM8010";
	compatible = "qcom,cape-cdp", "qcom,cape", "qcom,cdp";
	qcom,msm-id = <530 0x10000>, <531 0x10000>, <540 0x10000>;
	qcom,board-id = <0x10001 2>;
};
