/dts-v1/;

#include "parrot-wcn3990.dtsi"
#include "parrot-idp-wcn3990-amoled-rcm.dtsi"
#include "parrot-idp-pm7250b.dtsi"

/ {
	model = "Qualcomm Technologies, Inc. Parrot WCN3990 IDP + AMOLED + RCM";
	compatible = "qcom,parrot-idp", "qcom,parrot", "qcom,idp";
	qcom,board-id = <34 3>;
};
