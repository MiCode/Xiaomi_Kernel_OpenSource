/dts-v1/;

#include "sm8150.dtsi"
#include "sm8150-cdp.dtsi"

/ {
	model = "Qualcomm Technologies, Inc. SM8150 CDP";
	compatible = "qcom,sm8150-cdp", "qcom,sm8150", "qcom,cdp";
	qcom,board-id = <1 0>;
};
