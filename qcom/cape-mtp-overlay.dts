/dts-v1/;
/plugin/;

#include "cape-mtp.dtsi"

/ {
	model = "Qualcomm Technologies, Inc. Cape MTP";
	compatible = "qcom,cape-mtp", "qcom,cape", "qcom,mtp";
	qcom,msm-id = <530 0x10000>;
	qcom,board-id = <8 0>;
};

