/dts-v1/;

#include "diwali.dtsi"
#include "diwali-idp.dtsi"

/ {
	model = "Qualcomm Technologies, Inc. Diwali IDP NOPMI";
	compatible = "qcom,diwali-idp", "qcom,diwali", "qcom,idp";
	qcom,board-id = <34 0>;
	qcom,pmic-id-size = <9>;
	qcom,pmic-id = <0x0 0x0 0x0 0x0 0x0 0x0 0x0 0x0 0x0>;
};
