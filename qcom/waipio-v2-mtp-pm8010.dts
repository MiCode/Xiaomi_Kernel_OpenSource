/dts-v1/;

#include "waipio-v2.dtsi"
#include "waipio-mtp.dtsi"
#include "waipio-pm8010-spmi.dtsi"

/ {
	model = "Qualcomm Technologies, Inc. Waipio v2 MTP with PM8010";
	compatible = "qcom,waipio-mtp", "qcom,waipio", "qcom,mtp";
	qcom,board-id = <0x10008 0>;
};
