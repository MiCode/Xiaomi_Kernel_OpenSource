/dts-v1/;
/plugin/;

#include "parrot-idp-wcn3990-amoled-rcm.dtsi"
#include "parrot-idp-pm7250b.dtsi"

/ {
	model = "Qualcomm Technologies, Inc. Parrot WCN3990 IDP + AMOLED + RCM";
	compatible = "qcom,parrot-idp", "qcom,parrot", "qcom,idp";
	qcom,msm-id = <537 0x10000>;
	qcom,board-id = <34 3>;
};
