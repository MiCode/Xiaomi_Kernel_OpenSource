/dts-v1/;
/plugin/;

#include "anorak-rumi.dtsi"

/ {
	model = "Qualcomm Technologies, Inc. Anorak RUMI";
	compatible = "qcom,anorak-rumi", "qcom,anorak", "qcom,rumi";
	qcom,msm-id = <549 0x10000>;
	qcom,board-id = <0x1000F 0x0>;
};
