#include "parrot-pm7250b.dtsi"

/ {
	qcom,pmic-id-size = <9>;
	qcom,pmic-id = <0x0 0x0 0x0 0x0 0x0 0x0 0x0 0x0 0x2E>;
};

&battery_charger {
	qcom,thermal-mitigation = <11500000 11000000 10500000 10000000 9500000
				9000000 8500000 8000000 7500000 7000000 6500000
				6000000 5500000 5000000 4500000 4000000 3500000
				3000000 2500000 2000000 1500000 1000000 500000>;
};
