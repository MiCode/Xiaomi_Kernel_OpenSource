/dts-v1/;

#include "diwali-hsp.dtsi"
#include "diwali-idp-hsp.dtsi"

/ {
	model = "Qualcomm Technologies, Inc. Diwali IDP + HSP";
	compatible = "qcom,diwali-idp", "qcom,diwali", "qcom,idp";
	qcom,board-id = <34 2>;
	qcom,pmic-id-size = <9>;
	qcom,pmic-id = <0x0 0x0 0x0 0x0 0x0 0x0 0x0 0x0 0x2E>;
};
