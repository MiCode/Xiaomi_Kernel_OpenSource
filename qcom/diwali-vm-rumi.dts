/dts-v1/;

#include "diwali-vm.dtsi"
#include "diwali-vm-rumi.dtsi"

/ {
	model = "Qualcomm Technologies, Inc. Diwali SVM RUMI";
	compatible = "qcom,diwali-rumi", "qcom,diwali", "qcom,rumi";
	qcom,board-id = <15 0>;
};
