/dts-v1/;

#include "parrot-wcn6750.dtsi"
#include "parrot-qrd-wcn6750.dtsi"
#include "parrot-qrd-pm7250b.dtsi"

/ {
	model = "Qualcomm Technologies, Inc. Parrot QRD";
	compatible = "qcom,parrot-qrd", "qcom,parrot", "qcom,qrd";
	qcom,board-id = <0x1000B 1>;
};
