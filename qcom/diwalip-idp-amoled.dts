/dts-v1/;

#include "diwalip.dtsi"
#include "diwalip-idp-amoled.dtsi"

/ {
	model = "Qualcomm Technologies, Inc. DiwaliP IDP AMOLED";
	compatible = "qcom,diwalip-idp", "qcom,diwalip", "qcom,idp";
	qcom,board-id = <34 3>;
	qcom,pmic-id-size = <9>;
	qcom,pmic-id = <0x0 0x0 0x0 0x0 0x0 0x0 0x0 0x0 0x2E>;
};
