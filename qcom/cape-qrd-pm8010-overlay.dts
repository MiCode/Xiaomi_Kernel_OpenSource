/dts-v1/;
/plugin/;

#include "cape-qrd.dtsi"
#include "waipio-pm8010-spmi.dtsi"

/ {
	model = "Qualcomm Technologies, Inc. Cape QRD with PM8010";
	compatible = "qcom,cape-qrd", "qcom,cape", "qcom,qrd";
	qcom,msm-id = <530 0x10000>, <531 0x10000>, <540 0x10000>;
	qcom,board-id = <0x1000B 0>;
};

