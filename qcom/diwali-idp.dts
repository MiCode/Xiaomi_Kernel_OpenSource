/dts-v1/;

#include "diwali.dtsi"
#include "diwali-idp.dtsi"

/ {
	model = "Qualcomm Technologies, Inc. Diwali IDP";
	compatible = "qcom,diwali-idp", "qcom,diwali", "qcom,idp";
	qcom,board-id = <34 0>;
};
