/dts-v1/;

#include "parrot-wcn6750.dtsi"
#include "parrot-idp.dtsi"

/ {
	model = "Qualcomm Technologies, Inc. Parrot IDP";
	compatible = "qcom,parrot-idp", "qcom,parrot", "qcom,idp";
	qcom,board-id = <34 0>;
	qcom,pmic-id-size = <9>;
	qcom,pmic-id = <0x0 0x0 0x0 0x0 0x0 0x0 0x0 0x0 0x0>;
};
