/dts-v1/;
/plugin/;

#include "cape-mtp.dtsi"
#include "thor-sm8475-pm8008.dtsi"
#include "thor-pm8010-spmi.dtsi"

/ {
	model = "Qualcomm Technologies, Inc. Cape MTP with PM8008";
	compatible = "qcom,cape-mtp", "qcom,cape", "qcom,mtp";
	qcom,msm-id = <530 0x10000>, <531 0x10000>, <540 0x10000>;
	qcom,board-id = <0x10008 0>;
};

