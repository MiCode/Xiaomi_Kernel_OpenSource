/dts-v1/;

#include "neo.dtsi"
#include "neo-rumi.dtsi"

/ {
	model = "Qualcomm Technologies, Inc. NEO RUMI";
	compatible = "qcom,neo-rumi", "qcom,neo", "qcom,rumi";
	qcom,board-id = <0x1000f 0x0400>;
};
