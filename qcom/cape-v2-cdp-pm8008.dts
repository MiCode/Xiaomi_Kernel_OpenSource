/dts-v1/;

#include "cape-v2.dtsi"
#include "cape-cdp.dtsi"
#include "waipio-pm8008.dtsi"

/ {
	model = "Qualcomm Technologies, Inc. Cape LTE Only CDP with PM8008";
	compatible = "qcom,cape-v2-cdp", "qcom,cape-v2", "qcom,cdp";
	qcom,board-id = <0x10001 0>;
};
