/dts-v1/;

#include "waipio.dtsi"
#include "waipio-cdp.dtsi"

/ {
	model = "Qualcomm Technologies, Inc. Waipio CDP";
	compatible = "qcom,waipio-cdp", "qcom,waipio", "qcom,cdp";
	qcom,board-id = <1 0>;
};
