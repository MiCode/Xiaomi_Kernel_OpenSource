/dts-v1/;
/plugin/;

#include "lahainap-qrd.dtsi"

/ {
	model = "Qualcomm Technologies, Inc. LahainaP QRD";
	compatible = "qcom,lahainap-qrd", "qcom,lahainap", "qcom,qrd";
	qcom,board-id = <0x1000B 0>;
};
