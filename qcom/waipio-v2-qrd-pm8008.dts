/dts-v1/;

#include "waipio-v2.dtsi"
#include "waipio-qrd.dtsi"
#include "waipio-pm8008.dtsi"

/ {
	model = "Qualcomm Technologies, Inc. Waipio v2 QRD with PM8008";
	compatible = "qcom,waipio-qrd", "qcom,waipio", "qcom,qrd";
	qcom,board-id = <11 0>;
};
