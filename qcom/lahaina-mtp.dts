/dts-v1/;

#include "lahaina.dtsi"
#include "lahaina-mtp.dtsi"

/ {
	model = "Qualcomm Technologies, Inc. Lahaina MTP";
	compatible = "qcom,lahaina-mtp", "qcom,lahaina", "qcom,mtp";
	qcom,board-id = <8 0>;
};
