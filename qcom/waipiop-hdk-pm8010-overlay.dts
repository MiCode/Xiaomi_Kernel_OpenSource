/dts-v1/;
/plugin/;

#include "waipio-hdk.dtsi"
#include "waipio-pm8010-spmi.dtsi"

/ {
	model = "Qualcomm Technologies, Inc. WaipioP HDK with PM8010";
	compatible = "qcom,waipiop-hdk", "qcom,waipiop", "qcom,hdk";
	qcom,msm-id = <482 0x10000>, <482 0x20000>;
	qcom,board-id = <0x1001f 0>;
};
