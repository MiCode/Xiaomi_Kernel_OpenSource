/dts-v1/;

#include "cape-v2.dtsi"
#include "cape-qrd.dtsi"
#include "waipio-pm8010-spmi.dtsi"

/ {
	model = "Qualcomm Technologies, Inc. Cape LTE Only QRD with PM8010";
	compatible = "qcom,cape-v2-qrd", "qcom,cape-v2", "qcom,qrd";
	qcom,board-id = <0x1000B 0>;
};
