/dts-v1/;

#include "parrot-wcn3990.dtsi"
#include "parrot-idp-wcn3990.dtsi"
#include "parrot-idp-pm7250b.dtsi"

/ {
	model = "Qualcomm Technologies, Inc. Parrot IDP + WCN3990";
	compatible = "qcom,parrot-idp", "qcom,parrot", "qcom,idp";
	qcom,board-id = <34 1>;
};
