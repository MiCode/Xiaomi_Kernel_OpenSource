/dts-v1/;

#include "capep.dtsi"
#include "cape-mtp.dtsi"
#include "waipio-pm8010-spmi.dtsi"

/ {
	model = "Qualcomm Technologies, Inc. CapeP MTP with PM8010";
	compatible = "qcom,capep-mtp", "qcom,capep", "qcom,mtp";
	qcom,board-id = <0x10008 0>;
};
