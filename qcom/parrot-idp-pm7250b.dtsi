#include "parrot-pm7250b.dtsi"

/ {
	qcom,pmic-id-size = <9>;
	qcom,pmic-id = <0x0 0x0 0x0 0x0 0x0 0x0 0x0 0x0 0x2E>;
};

&battery_charger {
	qcom,thermal-mitigation = <3000000 1500000 1000000 500000>;
};
