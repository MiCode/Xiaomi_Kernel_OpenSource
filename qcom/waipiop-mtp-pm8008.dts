/dts-v1/;

#include "waipiop.dtsi"
#include "waipio-mtp.dtsi"
#include "waipio-pm8008.dtsi"

/ {
	model = "Qualcomm Technologies, Inc. WaipioP MTP with PM8008";
	compatible = "qcom,waipiop-mtp", "qcom,waipiop", "qcom,mtp";
	qcom,board-id = <8 0>;
};
