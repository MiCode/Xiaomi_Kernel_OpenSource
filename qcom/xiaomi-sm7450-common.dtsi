&soc {
	mtdoops_pmsg@0xa7000000 {
		compatible = "mtdoops_pmsg";
		reg = <0xa7000000 0x400000>;
		console-size = <0x200000>;
		pmsg-size = <0x200000>;
	};

};

&reserved_memory {
	#address-cells = <2>;
	#size-cells = <2>;
	ranges;

	ramoops@0xa7000000 {
	    compatible = "ramoops";
		reg = <0x0 0xa7000000 0x0 0x400000>;
		console-size = <0x200000>;
		pmsg-size = <0x200000>;
	};
};
