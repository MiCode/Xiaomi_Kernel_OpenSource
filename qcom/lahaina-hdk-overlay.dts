/dts-v1/;
/plugin/;

#include "lahaina-hdk.dtsi"

/ {
	model = "Qualcomm Technologies, Inc. Lahaina HDK";
	compatible = "qcom,lahaina-hdk", "qcom,lahaina", "qcom,hdk";
	qcom,board-id = <0x1001f 0>;
};
