/dts-v1/;

#include "waipio-vm.dtsi"
#include "waipio-vm-cdp.dtsi"

/ {
	model = "Qualcomm Technologies, Inc. Waipio SVM CDP";
	compatible = "qcom,waipio-cdp", "qcom,waipio", "qcom,cdp";
	qcom,board-id = <0x10001 0>;
};
