#include <dt-bindings/interrupt-controller/arm-gic.h>

&soc {
	apps_smmu: apps-smmu@15000000 {
		status = "disabled";
		/*
		 * reg, #global-interrupts & interrupts  properties will
		 * be added dynamically by bootloader.
		 */
		compatible = "qcom,qsmmu-v500", "qcom,virt-smmu";
		#iommu-cells = <2>;
		qcom,use-3-lvl-tables;
		dma-coherent;
		qcom,actlr =
			<0x2803 0x0400 0x00000001>,
			<0x2804 0x0402 0x00000001>;
	};
};
