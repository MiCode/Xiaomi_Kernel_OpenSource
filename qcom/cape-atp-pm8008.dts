/dts-v1/;

#include "cape.dtsi"
#include "cape-atp.dtsi"
#include "waipio-pm8008.dtsi"

/ {
	model = "Qualcomm Technologies, Inc. Cape ATP with PM8008";
	compatible = "qcom,cape-atp", "qcom,cape", "qcom,atp";
	qcom,board-id = <0x10021 0>;
};
