// SPDX-License-Identifier: GPL-2.0-only OR BSD-2-Clause
/*
 * Device Tree defines for LCM settings
 * Copyright (c) 2022 MediaTek Inc.
 */

&pio {
	nt36672c_fhdp_shechao_round_corner_pattern: nt36672c-fhdp-shechao-round-corner-pattern {
		compatible = "mediatek,nt36672c_fhdp_shechao_round_corner_pattern";

		pattern-height = <32>;
		pattern-height-bot = <32>;

		left-top =
			[1d 00 03 01 1b 04 38 04 03 00 f0 a0],
			[30 30 a0 f0 1b 00 02 01 1d 04 38 04],
			[03 00 c0 60 10 60 c0 19 00 02 01 1f],
			[04 38 04 02 00 a0 20 20 a0 17 00 02],
			[01 21 04 38 04 02 00 b0 20 20 c0 15],
			[00 02 01 23 04 38 04 02 00 c0 40 40],
			[c0 13 00 02 01 25 04 38 04 02 00 f0],
			[50 50 f0 12 00 02 01 26 04 38 04 02],
			[00 b0 10 10 c0 10 00 02 01 28 04 38],
			[04 02 00 f0 70 70 f0 0f 00 02 01 29],
			[04 38 04 02 00 d0 20 20 d0 0e 00 02],
			[01 2a 04 38 04 02 00 d0 10 10 d0 0d],
			[00 01 01 2b 04 38 04 02 00 a0 10 a0],
			[0c 00 01 01 2c 04 38 04 01 00 a0 a0],
			[0b 00 01 01 2d 04 38 04 01 00 a0 a0],
			[0a 00 01 01 2e 04 38 04 01 00 a0 a0],
			[09 00 01 01 2f 04 38 04 02 00 d0 10],
			[d0 08 00 02 01 30 04 38 04 02 00 d0],
			[10 10 d0 07 00 02 01 31 04 38 04 02],
			[00 f0 20 20 f0 07 00 01 01 31 04 38],
			[04 01 00 70 70 06 00 01 01 32 04 38],
			[04 01 00 b0 c0 05 00 02 01 33 04 38],
			[04 02 00 f0 10 10 f0 05 00 01 01 33],
			[04 38 04 01 00 50 50 04 00 01 01 34],
			[04 38 04 01 00 c0 c0 04 00 01 01 34],
			[04 38 04 01 00 40 40 03 00 01 01 35],
			[04 38 04 01 00 b0 c0 03 00 01 01 35],
			[04 38 04 01 00 20 20 02 00 01 01 36],
			[04 38 04 01 00 a0 a0 02 00 01 01 36],
			[04 38 04 01 00 20 20 01 00 01 01 37],
			[04 38 04 01 00 c0 c0 01 00 01 01 37],
			[04 38 04 01 00 60 60 00 00 01 01 38],
			[04 38 04 02 00 f0 10 f0 00 00 00 01],
			[38 04 38 04 01 00 a0 00 00 00 01 38],
			[04 38 04 01 00 30],
			[00 00 00 01 38 04 38 04 01 00 30 00],
			[00 00 01 38 04 38 04 01 00 a0 00 00],
			[00 01 38 04 38 04 02 00 10 ef 00 00],
			[00 01 37 04 38 04 01 00 60 00 00 01],
			[01 37 04 38 04 01 00 70 c0 00 00 01],
			[01 36 04 38 04 01 00 80 20 00 00 01],
			[01 36 04 38 04 01 00 b0 a0 01 00 00],
			[01 35 04 38 04 01 00 20 01 00 01 01],
			[35 04 38 04 01 00 50 c0 01 00 01 01],
			[34 04 38 04 01 00 90 40 01 00 01 01],
			[34 04 38 04 01 00 df c0 02 00 01 01],
			[33 04 38 04 01 00 40 50 02 00 01 01],
			[33 04 38 04 02 00 bf 10 ef 03 00 01],
			[01 32 04 38 04 01 00 50 c0 03 00 01],
			[01 31 04 38 04 01 00 df 70 04 00 01],
			[01 31 04 38 04 02 00 60 20 ef 04 00],
			[02 01 30 04 38 04 02 00 ef 30 10 cf],
			[05 00 02 01 2f 04 38 04 02 00 df 10],
			[10 cf 06 00 01 01 2e 04 38 04 01 00],
			[bf a0 07 00 01 01 2d 04 38 04 01 00],
			[9f a0 08 00 01 01 2c 04 38 04 01 00],
			[9f a0 09 00 02 01 2b 04 38 04 02 00],
			[bf 10 10 9f 0a 00 02 01 2a 04 38 04],
			[02 00 cf 30 10 cf 0b 00 02 01 29 04],
			[38 04 02 00 ef 40 20 cf 0d 00 02 01],
			[28 04 38 04 02 00 af 20 70 ef 0e 00],
			[02 01 26 04 38 04 02 00 ef 7f 10 bf],
			[10 00 02 01 25 04 38 04 02 00 df 40],
			[50 ef 12 00 02 01 23 04 38 04 02 00],
			[cf 5f 40 bf 14 00 03 01 21 04 38 04],
			[02 00 ef 7f 20 20 bf 17 00 02 01 1f],
			[04 38 04 02 00 9f 4f 20 9f 19 00 04],
			[01 1d 04 38 04 03 00 ef 9f 5f 10 10],
			[5f bf 1d 00 03 01 1b 04 38 04 03 00],
			[bf 6f 20 30 9f ef];

		left-top-left;
		left-top-right;
		right-top;
		left-bottom;
		right-bottom;

		lk-params {
			compatible = "mediatek,lk-round-corner";
			lk-rc-is-notch;
			lk-rc-full-content = <0>;
			lk-rc-width;
			lk-rc-height;
			lk-rc-width-bot;
			lk-rc-height-bot;
		};
	};
};

