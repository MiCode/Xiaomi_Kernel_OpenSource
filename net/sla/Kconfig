## net/sla/Kconfig
```kconfig
menu "SLA Configuration"
	depends on NET && INET && NETFILTER

config SLA_STAIC_COLLECT
	tristate "SLA Statistics collector"
	depends on NETFILTER
	---help---
	  QTI Smart Link Aggregation for Web Browsing

endmenu
```

## net/sprd_net/Kconfig
```kconfig
#
# Sprd net helper configuration
#

config SPRD_NET_HELPER
	tristate "Spreadtrum net helper support"
	depends on NET && IPV6
	default n
	help
	  This option adds net helper support to the kernel.
	  We will get the global ipv6 address.
	  To compile it as a module, choose M here.
	  If unsure, say N.
```

## security/Kconfig.hardening
```kconfig
menu "Kernel hardening options"

menu "Memory initialization"

choice
	prompt "Initialize kernel stack variables at function entry"
	default INIT_STACK_NONE
	help
	  This option enables initialization of stack variables at
	  function entry time. This has the possibility to have the
	  greatest coverage (since all functions can have their
	  variables initialized), but the performance impact depends
	  on the function calling complexity of a given workload's
	  syscalls.

	  This chooses the level of coverage over classes of potentially
	  uninitialized variables. The selected class will be
	  initialized before use in a function.

	config INIT_STACK_NONE
		bool "no automatic initialization (weakest)"
		help
		  Disable automatic stack variable initialization.
		  This leaves the kernel vulnerable to the standard
		  classes of uninitialized stack variable exploits
		  and information exposures.

	config INIT_STACK_ALL
		bool "0xAA-init everything on the stack (strongest)"
		help
		  Initializes everything on the stack with a 0xAA
		  pattern. This is intended to eliminate all classes
		  of uninitialized stack variable exploits and information
		  exposures, even variables that were warned to have been
		  left uninitialized.

endchoice

endmenu

endmenu
```

## security/hie/Kconfig
```kconfig
menu "Storage Hardware Inline Encryption"

config HIE
	bool  "Hardware-Inline-Encryption (HIE)"
	default n
	select KEYS
	help
	  This driver provides an interface for storage driver to
	  retrieve file-oriented encrypt keys from file system.
	  The storage driver must register hardware encryption
	  capability to HIE.

config HIE_DEBUG
	bool  "HIE debug"
	default n
	depends on DEBUG_FS
	depends on HIE
	help
	  Enable debug facility. Print logs when encryption,
	  decryption, attach/retrieve key from bio.

	  /d/hie/debug: debug log control
	  Mask    Debug Messages
	  0x02    print logs when accessing certain inode.
	  0x04    dump bio basic info when decrypt/encrypt.
	  0x08    print keys when decrypt/encrypt.
	  0x10    print pointer to the bio when decrypt/encrypt.
	  Example: "echo 16 > /d/hie/debug"

	  /d/hie/ino: target inode number, when log mask = 0x02.

config HIE_NO_CRYPT
	bool  "HIE no crypt"
	default n
	depends on HIE
	help
	  Skip calling driver registered encryption/decryption
	  function. Used to simulate theoretical speed limit of
	  hardware encryption, that is, encryption overhead time
	  equals zero.

config HIE_DUMMY_CRYPT
	bool "HIE dummy crypt"
	default n
	depends on HIE
	help
	  XOR the buffer with 0xFFFF, instead of calling driver
	  registered encryption/decryption function. Used to
	  verify the correctness of hie_encrypt(), hie_decrypt()
	  insertion points in the driver.

config HIE_DUMMY_CRYPT_KEY_SWITCH
	bool "HIE dummy crypt with key switch"
	default n
	depends on HIE_DUMMY_CRYPT
	help
	  XOR the buffer with real keys. Used to verify the
	  correctness of key passing from the file system to
	  the block layer, and finally to the HIE driver.

config HIE_DUMMY_CRYPT_IV
	bool "HIE dummy crypt with iv"
	default n
	depends on HIE_DUMMY_CRYPT
	help
	  XOR the buffer with the initialzation vector(iv.),
	  if BC_IV_PAGE_IDX flag is set in the bio crypt
	  context. Used to verify the correctness of iv.
	  calculation and block merge.

endmenu
```

## security/mirootdetect/Kconfig
```kconfig
config MI_ROOT_DETECT
	bool "Mi Root Detect Driver"
	default y
	---help---
	  Enable support for root detect action
```

## security/pfe/Kconfig
```kconfig
menu "Qualcomm Technologies, Inc Per File Encryption security device drivers"
	depends on ARCH_QCOM

config PFT
	bool "Per-File-Tagger driver"
	depends on SECURITY
	default n
	help
		This driver is used for tagging enterprise files.
		It is part of the Per-File-Encryption (PFE) feature.
		The driver is tagging files when created by
		registered application.
		Tagged files are encrypted using the dm-req-crypt driver.

config PFK
	bool "Per-File-Key driver"
	depends on SECURITY
	depends on SECURITY_SELINUX
	default n
	help
		This driver is used for storing eCryptfs information
		in file node.
		This is part of eCryptfs hardware enhanced solution
		provided by Qualcomm Technologies, Inc.
		Information is used when file is encrypted later using
		ICE or dm crypto engine

config PFK_WRAPPED_KEY_SUPPORTED
	bool "Per-File-Key driver with wrapped key support"
	depends on SECURITY
	depends on SECURITY_SELINUX
	depends on QSEECOM
	depends on PFK
	default n
	help
		Adds wrapped key support in PFK driver. Instead of setting
		the key directly in ICE, it unwraps the key and sets the key
		in ICE.
endmenu
```

## security/tf_driver/Kconfig
```kconfig
config TRUSTED_FOUNDATIONS
	bool "Enable TF Driver"
	default n
	select CRYPTO_SHA1
	select TEGRA_USE_SECURE_KERNEL
	help
	  This option adds kernel support for communication with the Trusted Foundations.
	  Default options is n
	  If you are unsure how to answer this question, answer N.
```

## security/tlk_driver/Kconfig
```kconfig
config TRUSTED_LITTLE_KERNEL
	bool "Enable Open Trusted Execution driver"
	select TEGRA_USE_SECURE_KERNEL
	help
	  This option adds kernel support for communication with the
	  Trusted LK secure OS monitor/runtime support.
	  If you are unsure how to answer this question, answer N.

config OTE_ENABLE_LOGGER
	bool "Enable TLK logs in linux kmsg"
	depends on TRUSTED_LITTLE_KERNEL
	help
	 This option adds support in the kernel driver to read the logs
	 from the secure world and make them available as a part of kmsg.
```

## sound/hda/Kconfig
```kconfig
menu "HD-Audio Common Library"

config SND_CORE_HDA
	tristate "Enable HD Audio Common Library"
	default n
	depends on !SND_HDA_INTEL
	select SND_VMASTER
	select SND_KCTL_JACK
	help
	  Say Y here to enable the HD-audio codec common library.

if SND_CORE_HDA

config SND_HDA_PREALLOC_SIZE
	int "Pre-allocated buffer size for HD-audio driver"
	range 0 32768
        default 64
	help
	Specifies the default pre-allocated buffer-size in kB for the
	HD-audio driver.  A larger buffer (e.g. 2048) is preferred for systems
	using PulseAudio.  The default 64 is chosen just
	for compatibility reasons.

	Note that the pre-allocation size can be changed dynamically
        via a proc file (/proc/asound/card*/pcm*/sub*/prealloc), too.

config SND_HDA_RECONFIG
	bool "Allow dynamic codec reconfiguration"
	help
	  Say Y here to enable the HD-audio codec re-configuration feature.
	  This adds the sysfs interfaces to allow user to clear the whole
	  codec configuration, change the codec setup, add extra verbs,
	  and re-configure the codec dynamically.

config SND_CORE_HDA_INPUT_BEEP
	bool "Support digital beep via input layer"
	depends on INPUT=y || INPUT=SND_HDA
	help
	  Say Y here to build a digital beep interface for HD-audio
	  driver. This interface is used to generate digital beeps.

config SND_HDA_INPUT_BEEP_MODE
	int "Digital beep registration mode (0=off, 1=on)"
	depends on SND_CORE_HDA_INPUT_BEEP=y
	default "1"
	range 0 1
	help
	  Set 0 to disable the digital beep interface for HD-audio by default.
	  Set 1 to always enable the digital beep interface for HD-audio by
	  default.

config SND_HDA_INPUT_JACK
	bool "Support jack plugging notification via input layer"
	depends on INPUT=y || INPUT=SND
	select SND_JACK
	help
	  Say Y here to enable the jack plugging notification via
	  input layer.

config SND_CORE_HDA_GENERIC
	tristate "Enable generic HD-audio codec parser"
	help
	  Say Y or M here to enable the generic HD-audio codec parser
	  in HDA library.

endif

endmenu
```

## sound/soc/codecs/TAS2562/Kconfig
```kconfig
if SND_SOC_TAS2562
config TAS2562_REGMAP
    bool "Use of RegMap API"
    default y

config TAS2562_CODEC
    bool "Codec Driver support"
    default y
#config TAS2562_MISC
#    bool "Misc Driver support"

endif # SND_SOC_TAS2562
```

## sound/soc/codecs/aw87359/Kconfig
```kconfig
config SND_SOC_AW87359
	tristate "SoC Audio for awinic AW87359 Smart K PA"
	depends on I2C
	help
	This option enables support for AW87359 Smart K PA
```

## sound/soc/codecs/aw87519/Kconfig
```kconfig
config SND_SOC_AW87519
	tristate "SoC Audio for awinic AW87519 Smart K PA"
	depends on I2C
	help
	This option enables support for AW87519 Smart K PA
```

## sound/soc/codecs/aw882xx/Kconfig
```kconfig
config SND_SMARTPA_AW882XX
	tristate "SoC Audio for awinic aw882xxseries"
	depends on I2C
	help
	This option enables support for aw882xxseries Smart PA.
```

## sound/soc/codecs/aw882xxV11/Kconfig
```kconfig
config SND_SMARTPA_AW882XX_V11
	tristate "SoC Audio for awinic aw882xxseries"
	depends on I2C
	help


config SND_SMARTPA_AW882XX_GPIO_CONFIG_V11
	tristate "SoC Audio for awinic aw882xxseries config reset GPIO"
	depends on I2C
	help
```

## sound/soc/codecs/cs35l41/Kconfig
```kconfig
config SND_SOC_CS35L41
	tristate "Cirrus Logic CS35L41 CODEC"
	default y

config SND_SOC_CS35L41_I2C
	tristate "Cirrus Logic CS35L41 CODEC (I2C)"
	depends on I2C
	select SND_SOC_CS35L41
	select REGMAP_I2C

config SND_SOC_CS35L41_SPI
	tristate "Cirrus Logic CS35L41 CODEC (SPI)"
	depends on SPI_MASTER
	select SND_SOC_CS35L41
	select REGMAP_SPI

config SND_SOC_WM_ADSP
	tristate
	select SND_SOC_COMPRESS
	default y if SND_SOC_CS35L41=y
	default m if SND_SOC_CS35L41=m

config SND_SOC_CS35L41_ARES
	tristate "Cirrus Logic CS35L41 CODEC (ARES)"
	default n

config SND_SOC_CS35L41_CHOPIN
	tristate "Cirrus Logic CS35L41 CODEC (CHOPIN)"
	default n

config SND_SOC_CS35L41_AGATE
	tristate "Cirrus Logic CS35L41 CODEC (AGATE)"
	default n

config SND_SOC_CS35L41_PISSARRO
	tristate "Cirrus Logic CS35L41 CODEC (PISSARRO)"
	default n
```

## sound/soc/codecs/cs35l43/Kconfig
```kconfig
config SND_SOC_CS35L43
	tristate "cirrus Semiconductors cs35l43 amplifier"
	default n
```

## sound/soc/codecs/fs1599/Kconfig
```kconfig
config SND_SOC_FS1599
	tristate "FourSemi FS1599 speaker amplifier"
	depends on I2C
	help
	  Config of FourSemi FS1599 speaker amplifier.
```

## sound/soc/codecs/fs15xx/Kconfig
```kconfig
config SND_SOC_FS15XX
	tristate "SoC Audio for foursemi FS15XX Smart K PA"
	depends on I2C
	help
	  This option enables support for FS15XX Smart K PA.
```

## sound/soc/codecs/fs1815/Kconfig
```kconfig
config SND_SOC_FS16XX
	tristate "SoC Audio for foursemi FS16XX Smart K PA"
	depends on I2C
	help
	  This option enables support for FS16XX Smart K PA.
```

## sound/soc/codecs/fs18xx/Kconfig
```kconfig
config SND_SOC_FS16XX
	tristate "FourSemi fs16xx Codec Driver"
	depends on I2C
#	default y
	help
	  for FourSemi True Smart Amplifier.
```

## sound/soc/codecs/lct_audio_info/Kconfig
```kconfig
config LCT_AUDIO_INFO
	tristate "Show audio infomation"
	help
	  This option enables support for Show audio infomation.
```

## sound/soc/codecs/msm_sdw/Kconfig
```kconfig
config SND_SOC_MSM_SDW
	tristate "MSM Internal soundwire codec"
	 help
	 MSM-based soundwire codec core driver
	 supported along with internal digital
	 codec core.
```

## sound/soc/codecs/sdm660_cdc/Kconfig
```kconfig
config SND_SOC_SDM660_CDC
	tristate "MSM Internal PMIC based codec"

config SND_SOC_DBMDX
	bool "DSPG Voice Trigger/Enhancement Chip"
	default n
	help
		DSPG Voice Trigger/Enhancement Chip

config SND_SOC_DBMDX_SND_CAPTURE
	bool "DSPG Capture Device Support"
	depends on SND_SOC_DBMDX
	default n
	help
		DSPG Capture Device Support

config SND_SOC_TAS2557
	tristate "Texas Instruments TAS2557 SmartAmp(R)"

if SND_SOC_TAS2557
config TAS2557_REGMAP
    bool "Use of RegMap API"

config TAS2557_CODEC
    bool "Codec Driver support"

config TAS2557_MISC
    bool "Misc Driver support"

endif # SND_SOC_TAS2557
```
